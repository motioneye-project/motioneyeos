## boot/grub/Config.in
```kconfig
config BR2_TARGET_GRUB
	bool "grub"
	depends on BR2_i386 || BR2_x86_64
	select BR2_HOSTARCH_NEEDS_IA32_COMPILER
	help
	  The GRand Unified Bootloader for x86 systems.

	  Some notes on creating a disk image with Grub installed:
	    1. Create an empty disk image
	       dd if=/dev/zero of=disk.img bs=1M count=32
	    2. Create one primary partition
	       cfdisk -h 16 -s 63 disk.img
	    3. Set up a loop device
	       sudo losetup -f disk.img
	    4. Set up loop devices per partitions
	       sudo partx -a /dev/loop0
	    5. Create the ext2 filesystem
	       sudo mkfs.ext2 -L root /dev/loop0p1
	    6. Mount the filesystem
	       mount /dev/loop0p1 /mnt
	    7. Extract the root filesystem
	       sudo tar -C /mnt -xf output/images/rootfs.tar
	    8. Unmount the filesystem, clean up loop device
	       sudo umount /mnt
	       sudo partx -d /dev/loop0
	       sudo losetup -d /dev/loop0
	    9. Install grub
	       output/host/sbin/grub --device-map=/dev/null
	       and in the grub shell, enter:
		device (hd0) disk.img
		geometry (hd0) <cylinders> 16 63
		root (hd0,0)
		setup (hd0)
	    10. Image is ready
		Can be tested in Qemu, with:
		  qemu-system-{i386,x86-64} -hda disk.img

if BR2_TARGET_GRUB

config BR2_TARGET_GRUB_SPLASH
	bool "Splashimage support"
	help
	  Add support for splashimage.

	  A splashimage is a 14-color indexed .xpm picture which is
	  displayed as background for the grub menu. See
	  http://www.katspace.org/computers/Grub_Splash/ for details
	  on how to generate a splashimage.

config BR2_TARGET_GRUB_DISKLESS
	bool "diskless support"
	help
	  enable diskless support

menu "filesystem drivers"

config BR2_TARGET_GRUB_FS_EXT2
	bool "ext2"
	default y
	help
	  Enable support for the ext2 filesystem in Grub

config BR2_TARGET_GRUB_FS_FAT
	bool "FAT"
	default y
	help
	  Enable support for the FAT filesystem in Grub.

config BR2_TARGET_GRUB_FS_ISO9660
	bool "ISO9660"
	help
	  Enable support for the ISO9660 filesystem in Grub.

config BR2_TARGET_GRUB_FS_JFS
	bool "IBM JFS"
	help
	  Enable support for the JFS filesystem in Grub.

config BR2_TARGET_GRUB_FS_REISERFS
	bool "ReiserFS"
	help
	  Enable support for the ReiserFS filesystem in Grub.

config BR2_TARGET_GRUB_FS_XFS
	bool "SGI XFS"
	help
	  Enable support for the XFS filesystem in Grub.

endmenu

menu "network drivers"

config BR2_TARGET_GRUB_3c595
	bool "3Com595 driver"
	help
	  enable 3Com595 driver

config BR2_TARGET_GRUB_3c90x
	bool "3Com90x driver"
	help
	  enable 3Com90x driver

config BR2_TARGET_GRUB_davicom
	bool "Davicom driver"
	help
	  enable Davicom driver

config BR2_TARGET_GRUB_e1000
	bool "Etherexpress Pro/1000 driver"
	help
	  enable Etherexpress Pro/1000 driver

config BR2_TARGET_GRUB_eepro100
	bool "Etherexpress Pro/100 driver"
	help
	  enable Etherexpress Pro/100 driver

config BR2_TARGET_GRUB_epic100
	bool "SMC 83c170 EPIC/100 driver"
	help
	  enable SMC 83c170 EPIC/100 driver

config BR2_TARGET_GRUB_forcedeth
	bool "Nvidia Geforce driver"
	help
	  enable Nvidia Geforce driver

config BR2_TARGET_GRUB_natsemi
	bool "NatSemi DP8381x driver"
	help
	  enable NatSemi DP8381x driver

config BR2_TARGET_GRUB_ns83820
	bool "NS83820 driver"
	help
	  enable NS83820 driver

config BR2_TARGET_GRUB_ns8390
	bool "NE2000 PCI driver"
	help
	  enable NE2000 PCI driver

config BR2_TARGET_GRUB_pcnet32
	bool "AMD Lance/PCI PCNet/32 driver"
	help
	  enable AMD Lance/PCI PCNet/32 driver

config BR2_TARGET_GRUB_pnic
	bool "Bochs Pseudo Nic driver"
	help
	  enable Bochs Pseudo Nic driver

config BR2_TARGET_GRUB_rtl8139
	bool "Realtek 8139 driver"
	help
	  enable Realtek 8139 driver

config BR2_TARGET_GRUB_r8169
	bool "Realtek 8169 driver"
	help
	  enable Realtek 8169 driver

config BR2_TARGET_GRUB_sis900
	bool "SIS 900 and SIS 7016 driver"
	help
	  enable SIS 900 and SIS 7016 driver

config BR2_TARGET_GRUB_tg3
	bool "Broadcom Tigon3 driver"
	help
	  enable Broadcom Tigon3 driver

config BR2_TARGET_GRUB_tulip
	bool "Tulip driver"
	help
	  enable Tulip driver

config BR2_TARGET_GRUB_tlan
	bool "TI ThunderLAN driver"
	help
	  enable TI ThunderLAN driver

config BR2_TARGET_GRUB_undi
	bool "PXE UNDI driver"
	help
	  enable PXE UNDI driver

config BR2_TARGET_GRUB_via_rhine
	bool "Rhine-I/II driver"
	help
	  enable Rhine-I/II driver

config BR2_TARGET_GRUB_w89c840
	bool "Winbond W89c840 driver"
	help
	  enable Winbond W89c840 driver

endmenu

endif # BR2_TARGET_GRUB
```

## boot/grub2/Config.in
```kconfig
config BR2_TARGET_GRUB2_ARCH_SUPPORTS
	bool
	default y if BR2_i386
	default y if BR2_x86_64
	default y if BR2_arm
	default y if BR2_aarch64
	depends on BR2_USE_MMU

config BR2_TARGET_GRUB2
	bool "grub2"
	depends on BR2_TARGET_GRUB2_ARCH_SUPPORTS
	depends on BR2_USE_WCHAR
	help
	  GNU GRUB is a Multiboot boot loader. It was derived from
	  GRUB, the GRand Unified Bootloader, which was originally
	  designed and implemented by Erich Stefan Boleyn. GRUB 2 has
	  replaced what was formerly known as GRUB (i.e. version
	  0.9x), which has, in turn, become GRUB Legacy.

	  Amongst others, GRUB2 offers EFI support, which GRUB Legacy
	  doesn't provide.

	  For additional notes on using Grub 2 with Buildroot, see
	  boot/grub2/readme.txt

	  http://www.gnu.org/software/grub/

if BR2_TARGET_GRUB2

choice
	prompt "Platform"

config BR2_TARGET_GRUB2_I386_PC
	bool "i386-pc"
	depends on BR2_i386 || BR2_x86_64
	help
	  Select this option if the platform you're targetting is a
	  x86 or x86-64 legacy BIOS based platform.

config BR2_TARGET_GRUB2_I386_EFI
	bool "i386-efi"
	depends on BR2_i386 || BR2_x86_64
	help
	  Select this option if the platform you're targetting has a
	  32 bits EFI BIOS. Note that some x86-64 platforms use a 32
	  bits EFI BIOS, and this option should be used in this case.

config BR2_TARGET_GRUB2_X86_64_EFI
	bool "x86-64-efi"
	depends on BR2_x86_64
	help
	  Select this option if the platform you're targetting has a
	  64 bits EFI BIOS.

config BR2_TARGET_GRUB2_ARM_UBOOT
	bool "arm-uboot"
	depends on BR2_arm
	help
	  Select this option if the platform you're targetting is an
	  ARM u-boot platform, and you want to boot Grub 2 as an u-boot
	  compatible image.

config BR2_TARGET_GRUB2_ARM_EFI
	bool "arm-efi"
	depends on BR2_arm
	help
	  Select this option if the platform you're targetting is an
	  ARM platform and you want to boot Grub 2 as an EFI
	  application.

config BR2_TARGET_GRUB2_ARM64_EFI
	bool "arm64-efi"
	depends on BR2_aarch64
	help
	  Select this option if the platform you're targetting is an
	  Aarch64 platform and you want to boot Grub 2 as an EFI
	  application.

endchoice

if BR2_TARGET_GRUB2_I386_PC || BR2_TARGET_GRUB2_ARM_UBOOT

config BR2_TARGET_GRUB2_BOOT_PARTITION
	string "boot partition"
	default "hd0,msdos1"
	help
	  Specify the partition where the /boot/grub/grub.cfg file is
	  located. Use 'hd0,msdos1' for the first partition of the
	  first disk if using a legacy partition table, or 'hd0,gpt1'
	  if using GPT partition table.

endif # BR2_TARGET_GRUB2_I386_PC || BR2_TARGET_GRUB2_ARM_UBOOT

config BR2_TARGET_GRUB2_BUILTIN_MODULES
	string "builtin modules"
	default "boot linux ext2 fat squash4 part_msdos part_gpt normal biosdisk" if BR2_TARGET_GRUB2_I386_PC
	default "boot linux ext2 fat squash4 part_msdos part_gpt normal efi_gop" \
		if BR2_TARGET_GRUB2_I386_EFI || BR2_TARGET_GRUB2_X86_64_EFI || \
		   BR2_TARGET_GRUB2_ARM_EFI  || BR2_TARGET_GRUB2_ARM64_EFI
	default "linux ext2 fat part_msdos normal" if BR2_TARGET_GRUB2_ARM_UBOOT

config BR2_TARGET_GRUB2_BUILTIN_CONFIG
	string "builtin config"
	help
	  Path to a Grub 2 configuration file that will be embedded
	  into the Grub image itself. This allows to set the root
	  device and other configuration parameters, but however menu
	  entries cannot be described in this embedded configuration.

config BR2_TARGET_GRUB2_INSTALL_TOOLS
	bool "install tools"
	help
	  Install support tools to interact with GNU GRUB Multiboot
	  boot loader.

	  This will also install the Grub 2 loadable modules to the
	  target.

endif # BR2_TARGET_GRUB2

comment "grub2 needs a toolchain w/ wchar"
	depends on BR2_TARGET_GRUB2_ARCH_SUPPORTS
	depends on !BR2_USE_WCHAR
```

## boot/gummiboot/Config.in
```kconfig
config BR2_TARGET_GUMMIBOOT
	bool "gummiboot"
	depends on BR2_i386 || BR2_x86_64
	select BR2_PACKAGE_GNU_EFI
	select BR2_PACKAGE_UTIL_LINUX
	select BR2_PACKAGE_UTIL_LINUX_LIBBLKID
	help
	  gummiboot is a simple UEFI boot manager which executes
	  configured EFI images. The default entry is selected by a
	  configured pattern (glob) or an on-screen menu.

	  gummiboot operates on the EFI System Partition (ESP)
	  only. Configuration file fragments, kernels, initrds, other
	  EFI images need to reside on the ESP. Linux kernels need to
	  be built with CONFIG_EFI_STUB to be able to be directly
	  executed as an EFI image.

	  See the Grub2 help text for details on preparing an EFI
	  capable disk image using Gummiboot: the instructions are
	  exactly the same, except that the Gummiboot configuration
	  files will be located in /loader/ inside the EFI partition.

	  http://freedesktop.org/wiki/Software/gummiboot/
```

## boot/lpc32xxcdl/Config.in
```kconfig
config BR2_TARGET_LPC32XXCDL
	bool "LPC32XX CDL (kickstart and S1L)"
	depends on BR2_arm926t

if BR2_TARGET_LPC32XXCDL

config BR2_TARGET_LPC32XXCDL_BOARDNAME
	string "LPC32xx board name"

endif #BR2_TARGET_LPC32XXCDL
```

## boot/mv-ddr-marvell/Config.in
```kconfig
config BR2_TARGET_MV_DDR_MARVELL
	bool "mv-ddr-marvell"
	depends on BR2_aarch64
	help
	  Marvell keeps algorithms for DDR training in a separate
	  repository. This code is not built separately, it is needed
	  as a dependency to build ATF firmware for Marvell Armada 7040
	  and 8040 SoCs.

	  https://github.com/MarvellEmbeddedProcessors/mv-ddr-marvell/
```

## boot/mxs-bootlets/Config.in
```kconfig
config BR2_TARGET_MXS_BOOTLETS
	bool "mxs-bootlets"
	depends on BR2_arm
	help
	  Stage1 bootloaders for Freescale iMX23/iMX28 SoCs

if BR2_TARGET_MXS_BOOTLETS

choice
	prompt "Source"
	default BR2_TARGET_MXS_BOOTLETS_FREESCALE
	help
	  Select the location of the bootlets you want to use

config BR2_TARGET_MXS_BOOTLETS_FREESCALE
	bool "Freescale 10.12.01 version"

config BR2_TARGET_MXS_BOOTLETS_CUSTOM_TARBALL
	bool "Custom tarball"

config BR2_TARGET_MXS_BOOTLETS_CUSTOM_GIT
	bool "Custom Git repository"

endchoice

config BR2_TARGET_MXS_BOOTLETS_CUSTOM_TARBALL_URL
	depends on BR2_TARGET_MXS_BOOTLETS_CUSTOM_TARBALL
	string "URL of custom bootlets tarball"

if BR2_TARGET_MXS_BOOTLETS_CUSTOM_GIT

config BR2_TARGET_MXS_BOOTLETS_CUSTOM_GIT_URL
	string "URL of custom Git repository"

config BR2_TARGET_MXS_BOOTLETS_CUSTOM_GIT_VERSION
	string "Custom Git version"

endif

choice
	prompt "Bootstream"
	help
	  Select which bootstream to generate

config BR2_TARGET_MXS_BOOTLETS_BAREBOX
       depends on BR2_TARGET_BAREBOX
       bool "Barebox Bootloader"

config BR2_TARGET_MXS_BOOTLETS_LINUX
       depends on BR2_LINUX_KERNEL
       bool "Linux Kernel"

config BR2_TARGET_MXS_BOOTLETS_UBOOT
       depends on BR2_TARGET_UBOOT
       bool "U-boot bootloader"

endchoice

config BR2_TARGET_MXS_BOOTLETS_HAS_IVT
	bool "HAB Support"
	help
	  Enable this option if you are building bootlets
	  for the iMX28 platform that needs to include instructions
	  for the secure boot mechanism present on these SoCs

choice
	prompt "Board"
	help
	  Select the board to build the bootlets for

config BR2_TARGET_MXS_BOOTLETS_STMP37xx
	bool "Sigmatel ST-MP3-7xx Board"

config BR2_TARGET_MXS_BOOTLETS_STMP378x
	bool "Sigmatel ST-MP3-78x Board"

config BR2_TARGET_MXS_BOOTLETS_IMX28EVK
	bool "Freescale iMX28 EVK Board"

config BR2_TARGET_MXS_BOOTLETS_CUSTOM_BOARD
	bool "Custom board"
endchoice

config BR2_TARGET_MXS_BOOTLETS_CUSTOM_BOARD_NAME
       string "Custom board name"
       depends on BR2_TARGET_MXS_BOOTLETS_CUSTOM_BOARD
       help
         Name of the board to build the bootlets for

endif
```

## boot/opensbi/Config.in
```kconfig
config BR2_TARGET_OPENSBI
	bool "opensbi"
	depends on BR2_riscv
	help
	  OpenSBI aims to provide an open-source and extensible
	  implementation of the RISC-V SBI specification for a platform
	  specific firmware (M-mode) and a general purpose OS,
	  hypervisor or bootloader (S-mode or HS-mode). OpenSBI
	  implementation can be easily extended by RISC-V platform or
	  System-on-Chip vendors to fit a particular hadware
	  configuration.

	  https://github.com/riscv/opensbi.git

if BR2_TARGET_OPENSBI
config BR2_TARGET_OPENSBI_PLAT
	string "OpenSBI Platform"
	default ""
	help
	  Specifies the OpenSBI platform to build. If no platform is
	  specified only the OpenSBI platform independent static
	  library libsbi.a is built. If a platform is specified then
	  the platform specific static library libplatsbi.a and firmware
	  examples are built.

config BR2_TARGET_OPENSBI_LINUX_PAYLOAD
	bool "Include Linux as OpenSBI Payload"
	depends on BR2_TARGET_OPENSBI_PLAT != ""
	depends on BR2_LINUX_KERNEL
	depends on BR2_LINUX_KERNEL_IMAGE
	help
	  Build OpenSBI with the Linux kernel as a Payload.

endif
```
