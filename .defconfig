## boot/at91bootstrap/Config.in
```kconfig
config BR2_TARGET_AT91BOOTSTRAP
	depends on BR2_arm926t
	bool "AT91 Bootstrap"
	help
	  AT91Bootstrap is a first level bootloader for the Atmel AT91
	  devices. It integrates algorithms for:
	  - Device initialization such as clock configuration, PIO settings...
	  - Peripheral drivers such as PIO, PMC or SDRAMC...
	  - Physical media algorithm such as DataFlash, NandFlash, NOR Flash...

if	BR2_TARGET_AT91BOOTSTRAP

config BR2_TARGET_AT91BOOTSTRAP_CUSTOM_PATCH_DIR
	string "custom patch dir"
	help
	  If your board requires custom patches, add the path to the
	  directory containing the patches here. The patches must be
	  named at91bootstrap-<version>-<something>.patch.

	  Most users may leave this empty

config BR2_TARGET_AT91BOOTSTRAP_BOARD
	string "Bootstrap board"
	default ""
	help
	  This is used to do a make <board>_config

choice
	prompt "Boot Memory"
	default BR2_TARGET_AT91BOOTSTRAP_DATAFLASH
	help
	  Select Chip for which AT91 bootstrap should be built

config BR2_TARGET_AT91BOOTSTRAP_DATAFLASH
	bool "Data Flash"

config BR2_TARGET_AT91BOOTSTRAP_NANDFLASH
	bool "NAND Flash"

endchoice

config BR2_TARGET_AT91BOOTSTRAP_MEMORY
	string
	default	"dataflash"	if	BR2_TARGET_AT91BOOTSTRAP_DATAFLASH
	default	"nandflash"	if	BR2_TARGET_AT91BOOTSTRAP_NANDFLASH

endif
```

## boot/at91bootstrap3/Config.in
```kconfig
config BR2_TARGET_AT91BOOTSTRAP3
	bool "AT91 Bootstrap 3"
	depends on BR2_arm926t || BR2_cortex_a5
	help
	  AT91Bootstrap is a first level bootloader for the Atmel AT91
	  devices. It integrates algorithms for:
	  - Device initialization such as clock configuration, PIO
	    settings...
	  - Peripheral drivers such as PIO, PMC or SDRAMC...
	  - Physical media algorithm such as DataFlash, NandFlash, NOR
	    Flash...

	  https://www.at91.com/linux4sam/bin/view/Linux4SAM/AT91Bootstrap

if BR2_TARGET_AT91BOOTSTRAP3

choice

	prompt "AT91 Bootstrap 3 version"

config BR2_TARGET_AT91BOOTSTRAP3_LATEST_VERSION
	bool "3.8.6"

config BR2_TARGET_AT91BOOTSTRAP3_CUSTOM_GIT
	bool "Custom Git repository"
	help
	  This option allows Buildroot to get the AT91 Bootstrap 3
	  source code from a Git repository.

endchoice

if BR2_TARGET_AT91BOOTSTRAP3_CUSTOM_GIT

config BR2_TARGET_AT91BOOTSTRAP3_CUSTOM_REPO_URL
	string "URL of custom repository"

config BR2_TARGET_AT91BOOTSTRAP3_CUSTOM_REPO_VERSION
	string "Custom repository version"
	help
	  Revision to use in the typical format used by Git
	  E.G. a sha id, a tag, branch, ..

endif

config BR2_TARGET_AT91BOOTSTRAP3_VERSION
	string
	default "v3.8.6" if BR2_TARGET_AT91BOOTSTRAP3_LATEST_VERSION
	default BR2_TARGET_AT91BOOTSTRAP3_CUSTOM_REPO_VERSION \
		if BR2_TARGET_AT91BOOTSTRAP3_CUSTOM_GIT

config BR2_TARGET_AT91BOOTSTRAP3_CUSTOM_PATCH_DIR
	string "custom patch dir"
	help
	  If your board requires custom patches, add the path to the
	  directory containing the patches here. The patches must be
	  named at91bootstrap3-<something>.patch.

	  Most users may leave this empty

#
# Configuration selection
#

choice
	prompt "AT91 Bootstrap 3 configuration"
	default BR2_TARGET_AT91BOOTSTRAP3_USE_DEFCONFIG

config BR2_TARGET_AT91BOOTSTRAP3_USE_DEFCONFIG
	bool "Using a defconfig"

config BR2_TARGET_AT91BOOTSTRAP3_USE_CUSTOM_CONFIG
	bool "Using a custom config file"

endchoice

config BR2_TARGET_AT91BOOTSTRAP3_DEFCONFIG
	string "Defconfig name"
	depends on BR2_TARGET_AT91BOOTSTRAP3_USE_DEFCONFIG
	help
	  Name of the at91bootstrap3 defconfig file to use, without the
	  trailing _defconfig.  The defconfig is located at
	  board/<processor>/<board>_defconfig in the at91bootstrap3
	  tree.

config BR2_TARGET_AT91BOOTSTRAP3_CUSTOM_CONFIG_FILE
	string "Configuration file path"
	depends on BR2_TARGET_AT91BOOTSTRAP3_USE_CUSTOM_CONFIG
	help
	  Path to the at91bootstrap3 configuration file

endif # BR2_TARGET_AT91BOOTSTRAP3
```

## boot/at91dataflashboot/Config.in
```kconfig
config BR2_TARGET_AT91DATAFLASHBOOT
	bool "AT91 DataFlashBoot"
	depends on BR2_arm926t
```

## boot/barebox/Config.in
```kconfig
config BR2_TARGET_BAREBOX
	bool "Barebox"
	help
	  The Barebox bootloader, formerly known as U-Boot v2.

	  http://www.barebox.org

if BR2_TARGET_BAREBOX
choice
	prompt "version"
	help
	  Select the specific Barebox version you want to use

config BR2_TARGET_BAREBOX_LATEST_VERSION
	bool "2016.06.0"

config BR2_TARGET_BAREBOX_CUSTOM_VERSION
	bool "Custom version"
	help
	  This option allows to use a specific official versions

config BR2_TARGET_BAREBOX_CUSTOM_TARBALL
	bool "Custom tarball"

config BR2_TARGET_BAREBOX_CUSTOM_GIT
	bool "Custom Git repository"

endchoice

config BR2_TARGET_BAREBOX_CUSTOM_VERSION_VALUE
	string "Barebox version"
	depends on BR2_TARGET_BAREBOX_CUSTOM_VERSION

if BR2_TARGET_BAREBOX_CUSTOM_TARBALL

config BR2_TARGET_BAREBOX_CUSTOM_TARBALL_LOCATION
	string "URL of custom Barebox tarball"

endif

config BR2_TARGET_BAREBOX_VERSION
	string
	default "2016.06.0"	if BR2_TARGET_BAREBOX_LATEST_VERSION
	default BR2_TARGET_BAREBOX_CUSTOM_VERSION_VALUE if BR2_TARGET_BAREBOX_CUSTOM_VERSION
	default "custom"	if BR2_TARGET_BAREBOX_CUSTOM_TARBALL
	default BR2_TARGET_BAREBOX_CUSTOM_GIT_VERSION if BR2_TARGET_BAREBOX_CUSTOM_GIT

config BR2_TARGET_BAREBOX_CUSTOM_PATCH_DIR
	string "custom patch dir"
	help
	  If your board requires custom patches, add the path to the
	  directory containing the patches here. The patches must be
	  named barebox-<version>-<something>.patch.

	  Most users may leave this empty

if BR2_TARGET_BAREBOX_CUSTOM_GIT

config BR2_TARGET_BAREBOX_CUSTOM_GIT_REPO_URL
	string "URL of custom Git repository"

config BR2_TARGET_BAREBOX_CUSTOM_GIT_VERSION
	string "Custom Git version"

endif

source boot/barebox/barebox/Config.in

menuconfig BR2_TARGET_BAREBOX_AUX
	bool "Build barebox with an auxiliary config"
	help
	  Build barebox with an auxiliary configuration.

	  Useful for building an SPL (Secondary Program Loader) in
	  addition to the traditional TPL (Tertiary Program Loader),
	  such as the X-Loader or MLO for Texas Instruments
	  processors.

if BR2_TARGET_BAREBOX_AUX

source boot/barebox/barebox-aux/Config.in

endif

endif
```

## boot/barebox/barebox-aux/Config.in
```kconfig
choice
	prompt "Barebox configuration"
	default BR2_TARGET_BAREBOX_AUX_USE_DEFCONFIG

config BR2_TARGET_BAREBOX_AUX_USE_DEFCONFIG
	bool "Using a defconfig"

config BR2_TARGET_BAREBOX_AUX_USE_CUSTOM_CONFIG
	bool "Using a custom config file"

endchoice

config BR2_TARGET_BAREBOX_AUX_BOARD_DEFCONFIG
	string "board defconfig"
	depends on BR2_TARGET_BAREBOX_AUX_USE_DEFCONFIG
	help
	  Name of the board for which Barebox should be built, without
	  the _defconfig suffix.

config BR2_TARGET_BAREBOX_AUX_CUSTOM_CONFIG_FILE
	string "Configuration file path"
	depends on BR2_TARGET_BAREBOX_AUX_USE_CUSTOM_CONFIG
	help
	  Path to the barebox configuration file

config BR2_TARGET_BAREBOX_AUX_CONFIG_FRAGMENT_FILES
	string "Additional configuration fragment files"
	help
	  A space-separated list of configuration fragment files,
	  that will be merged to the main Barebox configuration file.

config BR2_TARGET_BAREBOX_AUX_IMAGE_FILE
	string "Image filename"
	help
	  Name of the generated barebox image, which will be copied to
	  the images directory.

	  If left empty, defaults to:
	  - barebox.bin for barebox versions older than 2012.10.
	  - barebox-flash-image for later versions.

config BR2_TARGET_BAREBOX_AUX_CUSTOM_ENV
	bool "Generate an environment image"
	help
	  Generate a custom environment image. This environment will
	  contain the variables and scripts to be used at boot by
	  barebox.

config BR2_TARGET_BAREBOX_AUX_CUSTOM_ENV_PATH
	string "Environment path"
	depends on BR2_TARGET_BAREBOX_AUX_CUSTOM_ENV
	help
	  Path to the directory containing the custom barebox
	  environment. Depending on your setup, it will probably be
	  based on either the content of the defaultenv or
	  defaultenv-2 directories in the barebox source code, plus
	  the additions needed. The output will be an image in the
	  barebox devfs format, stored in the images directory, with
	  the same name as the directory name given here.
```

## boot/barebox/barebox/Config.in
```kconfig
choice
	prompt "Barebox configuration"
	default BR2_TARGET_BAREBOX_USE_DEFCONFIG

config BR2_TARGET_BAREBOX_USE_DEFCONFIG
	bool "Using a defconfig"

config BR2_TARGET_BAREBOX_USE_CUSTOM_CONFIG
	bool "Using a custom config file"

endchoice

config BR2_TARGET_BAREBOX_BOARD_DEFCONFIG
	string "board defconfig"
	depends on BR2_TARGET_BAREBOX_USE_DEFCONFIG
	help
	  Name of the board for which Barebox should be built, without
	  the _defconfig suffix.

config BR2_TARGET_BAREBOX_CUSTOM_CONFIG_FILE
	string "Configuration file path"
	depends on BR2_TARGET_BAREBOX_USE_CUSTOM_CONFIG
	help
	  Path to the barebox configuration file

config BR2_TARGET_BAREBOX_CONFIG_FRAGMENT_FILES
	string "Additional configuration fragment files"
	help
	  A space-separated list of configuration fragment files,
	  that will be merged to the main Barebox configuration file.

config BR2_TARGET_BAREBOX_IMAGE_FILE
	string "Image file names"
	help
	  Space-separated list of barebox images which will be copied to
	  the images directory.

	  If left empty, defaults to:
	  - barebox.bin for barebox versions older than 2012.10.
	  - barebox-flash-image for later versions.

config BR2_TARGET_BAREBOX_BAREBOXENV
	bool "bareboxenv tool in target"
	help
	  Install bareboxenv tool in target.

config BR2_TARGET_BAREBOX_CUSTOM_ENV
	bool "Generate an environment image"
	help
	  Generate a custom environment image. This environment will
	  contain the variables and scripts to be used at boot by
	  barebox.

config BR2_TARGET_BAREBOX_CUSTOM_ENV_PATH
	string "Environment path"
	depends on BR2_TARGET_BAREBOX_CUSTOM_ENV
	help
	  Path to the directory containing the custom barebox
	  environment. Depending on your setup, it will probably be
	  based on either the content of the defaultenv or
	  defaultenv-2 directories in the barebox source code, plus
	  the additions needed. The output will be an image in the
	  barebox devfs format, stored in the images directory, with
	  the same name as the directory name given here.

config BR2_TARGET_BAREBOX_CUSTOM_EMBEDDED_ENV_PATH
	string "Embedded environment path"
	help
	  If this option is not empty, it is the path to a custom
	  embedded barebox environment. This image will be used when
	  the environment found in the environment sector is
	  invalid. This option sets the barebox Kconfig option
	  CONFIG_DEFAULT_ENVIRONMENT_PATH to the specified path. This
	  way it is possible to use Buildroot variables like
	  TOPDIR etc. to refer to the custom environment.

	  Depending on your setup, the custom embedded environment
	  will probably be based on either the content of the
	  defaultenv or defaultenv-2 directories in the barebox source
	  code.
```

## boot/binaries-marvell/Config.in
```kconfig
config BR2_TARGET_BINARIES_MARVELL
	bool "binaries-marvell"
	depends on BR2_aarch64
	help
	  Some systems, including Marvell Armada SoC, have a separate
	  System Control Processor (SCP) for power management, clocks,
	  reset and system control. ATF Boot Loader stage 2 (BL2) loads
	  optional SCP_BL2 image into a platform-specific region
	  of secure memory. This package downloads and installs such
	  firmware, which is needed to build ATF.

	  https://github.com/MarvellEmbeddedProcessors/binaries-marvell/
```

## boot/boot-wrapper-aarch64/Config.in
```kconfig
comment "boot-wrapper-aarch64 needs a Linux kernel to be built"
	depends on BR2_aarch64
	depends on !BR2_LINUX_KERNEL

config BR2_TARGET_BOOT_WRAPPER_AARCH64
	bool "boot-wrapper-aarch64"
	depends on BR2_aarch64
	depends on BR2_LINUX_KERNEL
	help
	  The boot-wrapper-aarch64 is a small bootloader that makes it
	  possible to start an Aarch64 kernel inside the available
	  software simulators for the Aarch64 architecture.

	  git://git.kernel.org/pub/scm/linux/kernel/git/mark/boot-wrapper-aarch64.git

if BR2_TARGET_BOOT_WRAPPER_AARCH64

config BR2_TARGET_BOOT_WRAPPER_AARCH64_DTS
	string "Device Tree Source name"
	default ""
	help
	  Name of the Device Tree Source file to use to generate the
	  Device Tree Blob that will be embedded in the image
	  generated by the boot wrapper. Valid names are the .dts
	  files from arch/arm64/boot/dts/ in the kernel source
	  tree. The name must be specified without the .dts suffix.

config BR2_TARGET_BOOT_WRAPPER_AARCH64_BOOTARGS
	string "Kernel bootargs"
	default ""
	help
	  Kernel bootargs to embed inside the image generated by the
	  boot wrapper.

config BR2_TARGET_BOOT_WRAPPER_AARCH64_PSCI
	bool "Boot secondary SMP cores using PSCI"
	help
	  Boot secondary SMP cores using PSCI firmware calls. If
	  disabled, the spin-table method is used instead.

endif
```
