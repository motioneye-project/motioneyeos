## boot/optee-os/Config.in
```kconfig
config BR2_TARGET_OPTEE_OS
	bool "optee_os"
	depends on BR2_ARM_CPU_ARMV8A || BR2_ARM_CPU_ARMV7A
	help
	  OP-TEE OS provides the secure world boot image and the trust
	  application development kit of the OP-TEE project. OP-TEE OS
	  also provides generic trusted application one can embedded
	  into its system.

	  http://github.com/OP-TEE/optee_os

if BR2_TARGET_OPTEE_OS

choice
	prompt "OP-TEE OS version"
	default BR2_TARGET_OPTEE_OS_LATEST
	help
	  Select the version of OP-TEE OS you want to use

config BR2_TARGET_OPTEE_OS_LATEST
	bool "3.7.0"
	help
	  Use the latest release tag from the OP-TEE OS official Git
	  repository.

config BR2_TARGET_OPTEE_OS_CUSTOM_GIT
	bool "Custom Git repository"
	help
	  Use a custom version fetched from a Git repository.

endchoice

if BR2_TARGET_OPTEE_OS_CUSTOM_GIT

config BR2_TARGET_OPTEE_OS_CUSTOM_REPO_URL
	string "URL of custom repository"
	depends on BR2_TARGET_OPTEE_OS_CUSTOM_GIT
	help
	  Specific location of the reference source tree Git
	  repository.

config BR2_TARGET_OPTEE_OS_CUSTOM_REPO_VERSION
	string "Custom repository version"
	depends on BR2_TARGET_OPTEE_OS_CUSTOM_GIT
	help
	  Revision to use in the typical format used by Git, i.e a
	  SHA1 or a tag.

endif

config BR2_TARGET_OPTEE_OS_VERSION
	string
	default "3.7.0"		if BR2_TARGET_OPTEE_OS_LATEST
	default BR2_TARGET_OPTEE_OS_CUSTOM_REPO_VERSION \
				if BR2_TARGET_OPTEE_OS_CUSTOM_GIT

config BR2_TARGET_OPTEE_OS_CORE
	bool "Build core"
	default y
	help
	  This option will build and install the OP-TEE core
	  boot images.

config BR2_TARGET_OPTEE_OS_SDK
	bool "Build TA devkit"
	default y
	help
	  This option will build and install the OP-TEE development
	  kit for building OP-TEE trusted application images. It is
	  installed in the staging directory /lib/optee.

config BR2_TARGET_OPTEE_OS_SERVICES
	bool "Build service TAs and libs"
	default y
	select BR2_TARGET_OPTEE_OS_CORE
	help
	  This option installs the service trusted applications and
	  trusted shared libraries built from OP-TEE OS source tree.
	  These are installed in target /lib/optee_armtz directory
	  as other trusted applications. At runtime OP-TEE OS can
	  load these from this non-secure filesystem/directory into
	  the secure world for execution.

config BR2_TARGET_OPTEE_OS_PLATFORM
	string "Target platform (mandatory)"
	help
	  Value for the mandated PLATFORM build directive provided to
	  OP-TEE OS.

config BR2_TARGET_OPTEE_OS_PLATFORM_FLAVOR
	string "Target platform flavor (optional)"
	help
	  Value for the optional PLATFORM_FLAVOR build directive
	  provided to OP-TEE OS.

config BR2_TARGET_OPTEE_OS_ADDITIONAL_VARIABLES
	string "Additional build variables"
	help
	  Additional parameters for the OP-TEE OS build
	  E.g. 'CFG_TEE_CORE_LOG_LEVEL=3 CFG_UNWIND=y'

config BR2_TARGET_OPTEE_OS_CORE_IMAGES
	string "Binary boot images"
	default "tee.bin tee-*_v2.bin"
	help
	  Names of generated image files that are installed in the
	  output images/ directory.

endif # BR2_TARGET_OPTEE_OS
```

## boot/riscv-pk/Config.in
```kconfig
comment "riscv-pk needs a Linux kernel to be built"
	depends on BR2_riscv
	depends on !BR2_LINUX_KERNEL

config BR2_TARGET_RISCV_PK
	bool "riscv-pk"
	depends on BR2_riscv
	depends on BR2_LINUX_KERNEL
	help
	  The RISC-V Proxy Kernel (pk) package contains the Berkeley
	  Boot Loader (BBL) which has been designed to boot a Linux
	  kernel on a RISC-V processor.

	  https://github.com/riscv/riscv-pk.git
```

## boot/s500-bootloader/Config.in
```kconfig
config BR2_TARGET_S500_BOOTLOADER
	bool "s500-bootloader"
	depends on BR2_arm
	depends on BR2_HOSTARCH = "x86_64" || BR2_HOSTARCH = "x86"
	select BR2_HOSTARCH_NEEDS_IA32_LIBS
	help
	  1st level bootloader for Actions Semiconductor S500 SoC.

	  https://github.com/xapp-le/owl

config BR2_TARGET_S500_BOOTLOADER_BOARD
	string "board to configure for"
	depends on BR2_TARGET_S500_BOOTLOADER
	help
	  Specify the board to configure the bootloader for.
	  This should be the name of a directory under s500/boards
	  containing a suitable bootloader.ini file.
```

## boot/shim/Config.in
```kconfig
config BR2_TARGET_SHIM
	bool "shim"
	depends on BR2_PACKAGE_GNU_EFI_ARCH_SUPPORTS
	# ARM32 build currently broken
	depends on !BR2_ARM_CPU_HAS_ARM
	select BR2_PACKAGE_GNU_EFI
	help
	  Boot loader to chain-load signed boot loaders under Secure
	  Boot.

	  This package provides a minimalist boot loader which allows
	  verifying signatures of other UEFI binaries against either
	  the Secure Boot DB/DBX or against a built-in signature
	  database.  Its purpose is to allow a small,
	  infrequently-changing binary to be signed by the UEFI CA,
	  while allowing an OS distributor to revision their main
	  bootloader independently of the CA.

	  https://github.com/rhboot/shim
```

## boot/syslinux/Config.in
```kconfig
config BR2_TARGET_SYSLINUX
	bool "syslinux"
	depends on BR2_i386 || BR2_x86_64
	# Make sure at least one of the flavors is installed
	select BR2_TARGET_SYSLINUX_ISOLINUX \
		if !BR2_TARGET_SYSLINUX_PXELINUX && \
		   !BR2_TARGET_SYSLINUX_MBR && \
		   !BR2_TARGET_SYSLINUX_EFI
	select BR2_PACKAGE_UTIL_LINUX
	select BR2_PACKAGE_UTIL_LINUX_LIBUUID
	help
	  The syslinux bootloader for x86 systems.
	  This includes: syslinux, pxelinux, extlinux.

	  http://syslinux.org

if BR2_TARGET_SYSLINUX

config BR2_TARGET_SYSLINUX_LEGACY_BIOS
	bool

config BR2_TARGET_SYSLINUX_ISOLINUX
	bool "install isolinux"
	select BR2_TARGET_SYSLINUX_LEGACY_BIOS
	help
	  Install the legacy-BIOS 'isolinux' image, to boot off
	  optical media (CDROM, DVD.)

config BR2_TARGET_SYSLINUX_PXELINUX
	bool "install pxelinux"
	select BR2_TARGET_SYSLINUX_LEGACY_BIOS
	help
	  Install the legacy-BIOS 'pxelinux' image, to boot off
	  the network using PXE.

config BR2_TARGET_SYSLINUX_MBR
	bool "install mbr"
	depends on !BR2_TOOLCHAIN_HAS_BINUTILS_BUG_19615
	select BR2_TARGET_SYSLINUX_LEGACY_BIOS
	help
	  Install the legacy-BIOS 'mbr' image, to boot off a
	  local MBR-partition (e.g. prepared with 'extlinux'
	  or 'syslinux').

config BR2_TARGET_SYSLINUX_EFI
	bool "install efi"
	depends on BR2_PACKAGE_GNU_EFI_ARCH_SUPPORTS
	select BR2_PACKAGE_GNU_EFI
	help
	  Install the 'efi' image, to boot from an EFI environment.

if BR2_TARGET_SYSLINUX_LEGACY_BIOS

config BR2_TARGET_SYSLINUX_C32
	string "modules to install"
	help
	  Enter a space-separated list of .c32 modules to install.
	  Leave empty to install no module.

endif # BR2_TARGET_SYSLINUX_LEGACY_BIOS

endif # BR2_TARGET_SYSLINUX
```

## boot/ts4800-mbrboot/Config.in
```kconfig
config BR2_TARGET_TS4800_MBRBOOT
	bool "ts4800-mbrboot"
	depends on BR2_ARM_CPU_ARMV7A
	help
	  First level bootloader for TS4800 board

	  https://github.com/embeddedarm/ts4800-mbrboot
```
