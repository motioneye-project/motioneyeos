## configs/warp7_defconfig
```kconfig
# architecture
BR2_arm=y
BR2_cortex_a7=y
BR2_ARM_FPU_NEON_VFPV4=y

# Linux headers same as kernel, a 4.16 series
BR2_PACKAGE_HOST_LINUX_HEADERS_CUSTOM_4_16=y

# system
BR2_TARGET_GENERIC_GETTY_PORT="ttymxc0"

# rootfs overlay
BR2_ROOTFS_OVERLAY="board/warp7/rootfs_overlay"

# Kernel
BR2_LINUX_KERNEL=y
BR2_LINUX_KERNEL_CUSTOM_VERSION=y
BR2_LINUX_KERNEL_CUSTOM_VERSION_VALUE="4.16.3"
BR2_LINUX_KERNEL_DEFCONFIG="imx_v6_v7"
BR2_LINUX_KERNEL_DTS_SUPPORT=y
BR2_LINUX_KERNEL_INTREE_DTS_NAME="imx7s-warp"
BR2_LINUX_KERNEL_NEEDS_HOST_OPENSSL=y

# U-Boot
BR2_TARGET_UBOOT=y
BR2_TARGET_UBOOT_BOARDNAME="warp7"
BR2_TARGET_UBOOT_CUSTOM_VERSION=y
BR2_TARGET_UBOOT_CUSTOM_VERSION_VALUE="2018.03"
BR2_TARGET_UBOOT_FORMAT_IMX=y

# wifi firmware for brcm43430
BR2_PACKAGE_LINUX_FIRMWARE=y
BR2_PACKAGE_LINUX_FIRMWARE_BRCM_BCM43XXX=y

# For automatic firmware loading
BR2_ROOTFS_DEVICE_CREATION_DYNAMIC_MDEV=y

# wireless packages
BR2_PACKAGE_WIRELESS_TOOLS=y
BR2_PACKAGE_WPA_SUPPLICANT=y
BR2_PACKAGE_WPA_SUPPLICANT_PASSPHRASE=y

# Filesystem
BR2_ROOTFS_POST_IMAGE_SCRIPT="board/freescale/common/imx/post-image.sh"
BR2_TARGET_ROOTFS_EXT2=y
BR2_TARGET_ROOTFS_EXT2_4=y

# required tools to create the eMMC image
BR2_PACKAGE_HOST_DOSFSTOOLS=y
BR2_PACKAGE_HOST_GENIMAGE=y
BR2_PACKAGE_HOST_MTOOLS=y
```

## configs/warpboard_defconfig
```kconfig
# architecture
BR2_arm=y
BR2_cortex_a9=y

# patches
BR2_GLOBAL_PATCH_DIR="board/freescale/warpboard/patches/"

# Linux headers same as kernel, a 4.0 series
BR2_PACKAGE_HOST_LINUX_HEADERS_CUSTOM_4_0=y

# system
BR2_TARGET_GENERIC_HOSTNAME="warpboard"
BR2_TARGET_GENERIC_GETTY_PORT="ttymxc0"

# rootfs overlay
BR2_ROOTFS_OVERLAY="board/freescale/warpboard/rootfs_overlay"

# kernel
BR2_LINUX_KERNEL=y
BR2_LINUX_KERNEL_CUSTOM_TARBALL=y
BR2_LINUX_KERNEL_CUSTOM_TARBALL_LOCATION="http://github.com/Freescale/linux-fslc/tarball/38ec11d/linux-fslc-38ec11d.tar.gz"
BR2_LINUX_KERNEL_DEFCONFIG="imx_v6_v7"
BR2_LINUX_KERNEL_DTS_SUPPORT=y
BR2_LINUX_KERNEL_INTREE_DTS_NAME="imx6sl-warp"

# wifi firmware for brcm4330
BR2_PACKAGE_LINUX_FIRMWARE=y
BR2_PACKAGE_LINUX_FIRMWARE_BRCM_BCM43XX=y

# uboot
BR2_TARGET_UBOOT=y
BR2_TARGET_UBOOT_BOARDNAME="warp"
BR2_TARGET_UBOOT_CUSTOM_VERSION=y
BR2_TARGET_UBOOT_CUSTOM_VERSION_VALUE="2015.07-rc2"
BR2_TARGET_UBOOT_FORMAT_IMX=y

# host utility
BR2_PACKAGE_HOST_DFU_UTIL=y
BR2_PACKAGE_HOST_IMX_USB_LOADER=y
```

## configs/zedboard_defconfig
```kconfig
BR2_arm=y
BR2_cortex_a9=y
BR2_ARM_ENABLE_NEON=y
# Linux headers same as kernel, a 3.18 series
BR2_PACKAGE_HOST_LINUX_HEADERS_CUSTOM_3_18=y
BR2_TARGET_GENERIC_GETTY_PORT="ttyPS0"
BR2_LINUX_KERNEL=y
BR2_LINUX_KERNEL_CUSTOM_GIT=y
BR2_LINUX_KERNEL_CUSTOM_REPO_URL="git://github.com/Xilinx/linux-xlnx.git"
BR2_LINUX_KERNEL_CUSTOM_REPO_VERSION="xilinx-v2015.1"
BR2_LINUX_KERNEL_DEFCONFIG="xilinx_zynq"
BR2_LINUX_KERNEL_UIMAGE_LOADADDR="0x8000"
BR2_LINUX_KERNEL_DTS_SUPPORT=y
BR2_LINUX_KERNEL_INTREE_DTS_NAME="zynq-zed"
BR2_TARGET_ROOTFS_CPIO=y
BR2_TARGET_ROOTFS_CPIO_GZIP=y
BR2_TARGET_ROOTFS_CPIO_UIMAGE=y
BR2_TARGET_UBOOT=y
BR2_TARGET_UBOOT_BOARDNAME="zynq_zed"
BR2_TARGET_UBOOT_CUSTOM_VERSION=y
BR2_TARGET_UBOOT_CUSTOM_VERSION_VALUE="2015.07"
BR2_TARGET_UBOOT_PATCH="$(TOPDIR)/board/avnet/zedboard/uboot"
BR2_TARGET_UBOOT_NEEDS_DTC=y
BR2_TARGET_UBOOT_FORMAT_DTB_IMG=y
BR2_TARGET_UBOOT_SPL=y
BR2_TARGET_UBOOT_ZYNQ_IMAGE=y
```

## configs/zynq_qmtech_defconfig
```kconfig
BR2_arm=y
BR2_cortex_a9=y
BR2_ARM_ENABLE_NEON=y
BR2_ARM_ENABLE_VFP=y
BR2_GLOBAL_PATCH_DIR="board/qmtech/zynq/patches"
BR2_PACKAGE_HOST_LINUX_HEADERS_CUSTOM_4_19=y
BR2_TARGET_GENERIC_GETTY_PORT="ttyPS0"
BR2_ROOTFS_POST_IMAGE_SCRIPT="board/zynq/post-image.sh"
BR2_LINUX_KERNEL=y
BR2_LINUX_KERNEL_CUSTOM_TARBALL=y
BR2_LINUX_KERNEL_CUSTOM_TARBALL_LOCATION="$(call github,Xilinx,linux-xlnx,xilinx-v2019.2.01)/linux-xilinx-v2019.2.01.tar.gz"
BR2_LINUX_KERNEL_DEFCONFIG="xilinx_zynq"
BR2_LINUX_KERNEL_UIMAGE=y
BR2_LINUX_KERNEL_UIMAGE_LOADADDR="0x8000"
BR2_LINUX_KERNEL_DTS_SUPPORT=y
BR2_LINUX_KERNEL_INTREE_DTS_NAME="zynq-qmtech"
BR2_TARGET_ROOTFS_CPIO=y
BR2_TARGET_ROOTFS_CPIO_GZIP=y
BR2_TARGET_ROOTFS_CPIO_UIMAGE=y
BR2_TARGET_UBOOT=y
BR2_TARGET_UBOOT_BUILD_SYSTEM_KCONFIG=y
BR2_TARGET_UBOOT_CUSTOM_TARBALL=y
BR2_TARGET_UBOOT_CUSTOM_TARBALL_LOCATION="$(call github,jolivain,u-boot-xlnx,xilinx-v2019.2.qmtech.1)/uboot-xilinx-v2019.2.qmtech.1.tar.gz"
BR2_TARGET_UBOOT_BOARD_DEFCONFIG="zynq_qmtech"
BR2_TARGET_UBOOT_NEEDS_DTC=y
BR2_TARGET_UBOOT_NEEDS_OPENSSL=y
BR2_TARGET_UBOOT_FORMAT_IMG=y
BR2_TARGET_UBOOT_SPL=y
BR2_TARGET_UBOOT_SPL_NAME="spl/boot.bin"
BR2_PACKAGE_HOST_DOSFSTOOLS=y
BR2_PACKAGE_HOST_GENIMAGE=y
BR2_PACKAGE_HOST_MTOOLS=y
```

## configs/zynq_zed_defconfig
```kconfig
BR2_arm=y
BR2_cortex_a9=y
BR2_ARM_ENABLE_NEON=y
BR2_ARM_ENABLE_VFP=y
BR2_PACKAGE_HOST_LINUX_HEADERS_CUSTOM_4_16=y
BR2_TARGET_GENERIC_GETTY_PORT="ttyPS0"
BR2_ROOTFS_POST_IMAGE_SCRIPT="board/zynq/post-image.sh"
BR2_LINUX_KERNEL=y
BR2_LINUX_KERNEL_CUSTOM_VERSION=y
BR2_LINUX_KERNEL_CUSTOM_VERSION_VALUE="4.16"
BR2_LINUX_KERNEL_USE_ARCH_DEFAULT_CONFIG=y
BR2_LINUX_KERNEL_UIMAGE=y
BR2_LINUX_KERNEL_UIMAGE_LOADADDR="0x8000"
BR2_LINUX_KERNEL_DTS_SUPPORT=y
BR2_LINUX_KERNEL_INTREE_DTS_NAME="zynq-zed"
BR2_TARGET_ROOTFS_CPIO=y
BR2_TARGET_ROOTFS_CPIO_GZIP=y
BR2_TARGET_ROOTFS_CPIO_UIMAGE=y
BR2_TARGET_UBOOT=y
BR2_TARGET_UBOOT_BUILD_SYSTEM_KCONFIG=y
BR2_TARGET_UBOOT_CUSTOM_GIT=y
BR2_TARGET_UBOOT_CUSTOM_REPO_URL="https://github.com/Xilinx/u-boot-xlnx.git"
BR2_TARGET_UBOOT_CUSTOM_REPO_VERSION="xilinx-v2018.2"
BR2_TARGET_UBOOT_BOARD_DEFCONFIG="zynq_zed"
BR2_TARGET_UBOOT_NEEDS_DTC=y
BR2_TARGET_UBOOT_NEEDS_OPENSSL=y
BR2_TARGET_UBOOT_FORMAT_IMG=y
BR2_TARGET_UBOOT_SPL=y
BR2_TARGET_UBOOT_SPL_NAME="spl/boot.bin"
BR2_PACKAGE_HOST_DOSFSTOOLS=y
BR2_PACKAGE_HOST_GENIMAGE=y
BR2_PACKAGE_HOST_MTOOLS=y
```

## configs/zynq_zybo_defconfig
```kconfig
BR2_arm=y
BR2_cortex_a9=y
BR2_ARM_ENABLE_NEON=y
BR2_ARM_ENABLE_VFP=y
BR2_PACKAGE_HOST_LINUX_HEADERS_CUSTOM_4_6=y
BR2_TARGET_GENERIC_GETTY_PORT="ttyPS0"
BR2_ROOTFS_POST_IMAGE_SCRIPT="board/digilent/zybo/post-image.sh"
BR2_LINUX_KERNEL=y
BR2_LINUX_KERNEL_CUSTOM_VERSION=y
BR2_LINUX_KERNEL_CUSTOM_VERSION_VALUE="4.6.4"
BR2_LINUX_KERNEL_DEFCONFIG="multi_v7"
BR2_LINUX_KERNEL_UIMAGE=y
BR2_LINUX_KERNEL_UIMAGE_LOADADDR="0x8000"
BR2_LINUX_KERNEL_DTS_SUPPORT=y
BR2_LINUX_KERNEL_INTREE_DTS_NAME="zynq-zybo"
BR2_TARGET_ROOTFS_EXT2=y
BR2_TARGET_ROOTFS_EXT2_4=y
BR2_TARGET_UBOOT=y
BR2_TARGET_UBOOT_BUILD_SYSTEM_KCONFIG=y
BR2_TARGET_UBOOT_CUSTOM_VERSION=y
BR2_TARGET_UBOOT_CUSTOM_VERSION_VALUE="2016.05"
BR2_TARGET_UBOOT_BOARD_DEFCONFIG="zynq_zybo"
BR2_TARGET_UBOOT_NEEDS_DTC=y
BR2_TARGET_UBOOT_NEEDS_OPENSSL=y
BR2_TARGET_UBOOT_FORMAT_DTB_IMG=y
BR2_TARGET_UBOOT_SPL=y
BR2_TARGET_UBOOT_ZYNQ_IMAGE=y
BR2_PACKAGE_HOST_DOSFSTOOLS=y
BR2_PACKAGE_HOST_GENIMAGE=y
BR2_PACKAGE_HOST_MTOOLS=y
```

## configs/zynqmp_zcu106_defconfig
```kconfig
BR2_aarch64=y
BR2_GLOBAL_PATCH_DIR="board/zynqmp/patches/"
BR2_PACKAGE_HOST_LINUX_HEADERS_CUSTOM_4_9=y
BR2_ROOTFS_POST_IMAGE_SCRIPT="board/zynqmp/post-image.sh"
BR2_LINUX_KERNEL=y
BR2_LINUX_KERNEL_CUSTOM_GIT=y
BR2_LINUX_KERNEL_CUSTOM_REPO_URL="git://github.com/Xilinx/linux-xlnx.git"
BR2_LINUX_KERNEL_CUSTOM_REPO_VERSION="xilinx-v2017.4"
BR2_LINUX_KERNEL_DEFCONFIG="xilinx_zynqmp"
BR2_LINUX_KERNEL_DTS_SUPPORT=y
BR2_LINUX_KERNEL_INTREE_DTS_NAME="xilinx/zynqmp-zcu106-revA"
BR2_TARGET_ROOTFS_EXT2=y
BR2_TARGET_ROOTFS_EXT2_4=y
# BR2_TARGET_ROOTFS_TAR is not set
BR2_TARGET_ARM_TRUSTED_FIRMWARE=y
BR2_TARGET_ARM_TRUSTED_FIRMWARE_CUSTOM_GIT=y
BR2_TARGET_ARM_TRUSTED_FIRMWARE_CUSTOM_REPO_URL="https://github.com/ARM-software/arm-trusted-firmware.git"
BR2_TARGET_ARM_TRUSTED_FIRMWARE_CUSTOM_REPO_VERSION="v1.5"
BR2_TARGET_ARM_TRUSTED_FIRMWARE_PLATFORM="zynqmp"
BR2_TARGET_ARM_TRUSTED_FIRMWARE_BL31_UBOOT=y
BR2_TARGET_UBOOT=y
BR2_TARGET_UBOOT_BUILD_SYSTEM_KCONFIG=y
BR2_TARGET_UBOOT_CUSTOM_GIT=y
BR2_TARGET_UBOOT_CUSTOM_REPO_URL="git://github.com/xilinx/u-boot-xlnx.git"
BR2_TARGET_UBOOT_CUSTOM_REPO_VERSION="228801a215909365ae1dcdd799034195ad7264f7"
BR2_TARGET_UBOOT_BOARD_DEFCONFIG="xilinx_zynqmp_zcu106_revA"
BR2_TARGET_UBOOT_NEEDS_DTC=y
BR2_TARGET_UBOOT_SPL=y
BR2_TARGET_UBOOT_SPL_NAME="spl/boot.bin"
BR2_TARGET_UBOOT_ZYNQMP=y
BR2_TARGET_UBOOT_ZYNQMP_PMUFW="https://github.com/lucaceresoli/zynqmp-pmufw-binaries/raw/53fdb7b6c92860ceb0ec5fd14deee302f4a84269/bin/pmufw-zcu106-default-v2017.4.bin"
BR2_PACKAGE_HOST_DOSFSTOOLS=y
BR2_PACKAGE_HOST_GENIMAGE=y
BR2_PACKAGE_HOST_MTOOLS=y
```

## fs/Config.in
```kconfig
menu "Filesystem images"

source "fs/axfs/Config.in"
source "fs/btrfs/Config.in"
source "fs/cloop/Config.in"
source "fs/cpio/Config.in"
source "fs/cramfs/Config.in"
source "fs/erofs/Config.in"
source "fs/ext2/Config.in"
source "fs/f2fs/Config.in"
source "fs/initramfs/Config.in"
source "fs/iso9660/Config.in"
source "fs/jffs2/Config.in"
source "fs/romfs/Config.in"
source "fs/squashfs/Config.in"
source "fs/tar/Config.in"
source "fs/ubi/Config.in"
source "fs/ubifs/Config.in"
source "fs/yaffs2/Config.in"

endmenu
```

## fs/axfs/Config.in
```kconfig
config BR2_TARGET_ROOTFS_AXFS
	bool "axfs root filesystem"
	help
	  The Advanced XIP File System is a Linux kernel filesystem
	  driver that enables files to be executed directly from flash
	  or ROM memory rather than being copied into RAM. It has the
	  ability to store individual *pages* in a file
	  uncompressed/XIP or compressed/Demand Paged.

	  So far, the only supported mode is 'XIP all', so all the
	  files that have the execute attribute set will be XIP'ed.

	  At the moment, the FS is not supported in Linux mainline
	  (v4.3-rc5), so the kernel has to be built with the axfs
	  patches to be able to read it. Patches can be found at:

	  https://github.com/jaredeh/axfs
```

## fs/btrfs/Config.in
```kconfig
config BR2_TARGET_ROOTFS_BTRFS
	bool "btrfs root filesystem"
	select BR2_PACKAGE_HOST_BTRFS_PROGS
	help
	  Build a btrfs root filesystem. If you enable this option, you
	  probably want to enable the btrfs-progs package too.

if BR2_TARGET_ROOTFS_BTRFS

config BR2_TARGET_ROOTFS_BTRFS_LABEL
	string "filesystem label"

config BR2_TARGET_ROOTFS_BTRFS_SIZE
	string "filesystem size"
	default "100m"
	help
	  The size of the filesystem image in bytes.
	  Suffix with k, m, g or t for power-of-two kilo-, mega-, giga-
	  or terabytes.

config BR2_TARGET_ROOTFS_BTRFS_SIZE_SECTOR
	string "sector size"
	default "4096"
	help
	  This value should be set to the page size in bytes. The
	  default value of 4096 is the the most common page size for
	  most systems.  If the sectorsize differs from the page size,
	  the created filesystem may not be mountable by the kernel.
	  Therefore it is recommended to leave this value at
	  4096. Unless you know that your kernel uses a different page
	  size.  Suffix with k for power-of-two kilobytes.

config BR2_TARGET_ROOTFS_BTRFS_SIZE_NODE
	string "btree node size"
	default "16384"
	help
	  The tree block size in which btrfs stores metadata in bytes.
	  This must be a multiple of the sectorsize, but not larger
	  than 64KiB (65536).
	  Suffix with k for power-of-two kilobytes.

config BR2_TARGET_ROOTFS_BTRFS_FEATURES
	string "Filesystem Features"
	help
	  A comma separated string of features that can be enabled
	  during creation time.
	  For a list of available options, use:
	    `.../host/bin/mkfs.btrfs -O list-all`

endif # BR2_TARGET_ROOTFS_BTRFS
```

## fs/cpio/Config.in
```kconfig
config BR2_TARGET_ROOTFS_CPIO
	bool "cpio the root filesystem (for use as an initial RAM filesystem)"
	help
	  Build a cpio archive of the root filesystem. This is typically
	  used for an initial RAM filesystem that is passed to the
	  kernel by the bootloader.

if BR2_TARGET_ROOTFS_CPIO

choice
	prompt "Compression method"
	default BR2_TARGET_ROOTFS_CPIO_NONE
	help
	  Select compressor for cpio filesystem of the root filesystem.
	  If you use the cpio archive as an initial RAM filesystem, make
	  sure the kernel contains the decompression algorithm selected
	  here.

config BR2_TARGET_ROOTFS_CPIO_NONE
	bool "no compression"
	help
	  Do not compress the cpio filesystem.

config BR2_TARGET_ROOTFS_CPIO_GZIP
	bool "gzip"
	help
	  Do compress the cpio filesystem with gzip.

config BR2_TARGET_ROOTFS_CPIO_BZIP2
	bool "bzip2"
	help
	  Do compress the cpio filesystem with bzip2.

config BR2_TARGET_ROOTFS_CPIO_LZ4
	bool "lz4"
	help
	  Do compress the cpio filesystem with lz4.

config BR2_TARGET_ROOTFS_CPIO_LZMA
	bool "lzma"
	help
	  Do compress the cpio filesystem with lzma.

config BR2_TARGET_ROOTFS_CPIO_LZO
	bool "lzo"
	help
	  Do compress the cpio filesystem with lzop.

config BR2_TARGET_ROOTFS_CPIO_XZ
	bool "xz"
	help
	  Do compress the cpio filesystem with xz.

endchoice

config BR2_TARGET_ROOTFS_CPIO_UIMAGE
	bool "Create U-Boot image of the root filesystem"
	select BR2_PACKAGE_HOST_UBOOT_TOOLS
	help
	  Add a U-Boot header to the cpio root filesystem. This allows
	  the initramfs to be loaded with the bootm command in U-Boot.

	  The U-Boot image will be called rootfs.cpio.uboot

endif # BR2_TARGET_ROOTFS_CPIO
```

## fs/cramfs/Config.in
```kconfig
config BR2_TARGET_ROOTFS_CRAMFS
	bool "cramfs root filesystem"
	help
	  Build a cramfs root filesystem

	  https://github.com/npitre/cramfs-tools

if BR2_TARGET_ROOTFS_CRAMFS

config BR2_TARGET_ROOTFS_CRAMFS_XIP
	bool "Support XIP of all ELF files"
	help
	  For ELF files, uncompressed and properly aligned data blocks
	  will be automatically be mapped directly into user space
	  whenever possible providing eXecute-In-Place (XIP) from ROM
	  of read-only segments. Data segments mapped read-write
	  (hence they have to be copied to RAM) may still be
	  compressed in the cramfs image in the same file along with
	  non compressed read-only segments. Both MMU and no-MMU
	  systems are supported. This is particularly handy for tiny
	  embedded systems with very tight memory constraints.

	  The CRAMFS_MTD Kconfig option must also be enabled in a
	  4.15+ kernel.

endif # BR2_TARGET_ROOTFS_CRAMFS
```

## fs/erofs/Config.in
```kconfig
config BR2_TARGET_ROOTFS_EROFS
	bool "erofs root filesystem"
	select BR2_PACKAGE_HOST_EROFS_UTILS
	help
	  Build a EROFS root filesystem.

if BR2_TARGET_ROOTFS_EROFS

config BR2_TARGET_ROOTFS_EROFS_LZ4HC
	bool "lz4hc compression"
	help
	  Use lz4 high-compression to compress data in the filesystem.

endif # BR2_TARGET_ROOTFS_EROFS
```
