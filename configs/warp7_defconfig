## fs/ext2/Config.in
```kconfig
config BR2_TARGET_ROOTFS_EXT2
	bool "ext2/3/4 root filesystem"
	select BR2_PACKAGE_HOST_E2FSPROGS
	help
	  Build an ext2/3/4 root filesystem

if BR2_TARGET_ROOTFS_EXT2

config BR2_TARGET_ROOTFS_EXT2_2
	bool

choice
	bool "ext2/3/4 variant"
	default BR2_TARGET_ROOTFS_EXT2_2r1

config BR2_TARGET_ROOTFS_EXT2_2r0
	bool "ext2 (rev0)"
	select BR2_TARGET_ROOTFS_EXT2_2

config BR2_TARGET_ROOTFS_EXT2_2r1
	bool "ext2 (rev1)"
	select BR2_TARGET_ROOTFS_EXT2_2

config BR2_TARGET_ROOTFS_EXT2_3
	bool "ext3"

config BR2_TARGET_ROOTFS_EXT2_4
	bool "ext4"

endchoice

config BR2_TARGET_ROOTFS_EXT2_GEN
	int
	default 2 if BR2_TARGET_ROOTFS_EXT2_2
	default 3 if BR2_TARGET_ROOTFS_EXT2_3
	default 4 if BR2_TARGET_ROOTFS_EXT2_4

# All ext generations are revision 1, except ext2r0, which is revision 0
config BR2_TARGET_ROOTFS_EXT2_REV
	int
	default 0   if BR2_TARGET_ROOTFS_EXT2_2r0
	default 1   if !BR2_TARGET_ROOTFS_EXT2_2r0

config BR2_TARGET_ROOTFS_EXT2_LABEL
	string "filesystem label"

config BR2_TARGET_ROOTFS_EXT2_SIZE
	string "exact size"
	default BR2_TARGET_ROOTFS_EXT2_BLOCKS if BR2_TARGET_ROOTFS_EXT2_BLOCKS_WRAP # legacy 2017.08
	default "60M"
	help
	  The size of the filesystem image. If it does not have a suffix,
	  it is interpreted as power-of-two kilobytes. If it is suffixed
	  by 'k', 'm', 'g', 't' (either upper-case or lower-case), then
	  it is interpreted in power-of-two kilobytes, megabytes,
	  gigabytes, terabytes, etc.

config BR2_TARGET_ROOTFS_EXT2_INODES
	int "exact number of inodes (leave at 0 for auto calculation)"
	default 0

config BR2_TARGET_ROOTFS_EXT2_RESBLKS
	int "reserved blocks percentage"
	default 5
	help
	  The number of blocks on the filesystem (as a percentage of the
	  total number of blocksi), that are reserved for use by root.
	  Traditionally, this has been 5%, and all ext-related tools still
	  default to reserving 5% when creating a new ext filesystem.

config BR2_TARGET_ROOTFS_EXT2_MKFS_OPTIONS
	string "additional mke2fs options"
	default "-O ^64bit"
	help
	  Specify a space-separated list of mke2fs options, including any
	  ext2/3/4 filesystem features.

	  For more information about the mke2fs options, see the manual
	  page mke2fs(8).

	  For more information about the ext2/3/4 features which can be
	  set, see the manual page ext4(5).

	  The default is "-O ^64bit", i.e. disable 64-bit filesystem
	  support. This default value has been chosen because U-Boot
	  versions before 2017.02 don't support this filesystem
	  option: using it may make the filesystem unreadable by
	  U-Boot.

choice
	prompt "Compression method"
	default BR2_TARGET_ROOTFS_EXT2_NONE
	help
	  Select compressor for ext2/3/4 filesystem of the root filesystem

config BR2_TARGET_ROOTFS_EXT2_NONE
	bool "no compression"
	help
	  Do not compress the ext2/3/4 filesystem.

config BR2_TARGET_ROOTFS_EXT2_GZIP
	bool "gzip"
	help
	  Do compress the ext2/3/4 filesystem with gzip.

config BR2_TARGET_ROOTFS_EXT2_BZIP2
	bool "bzip2"
	help
	  Do compress the ext2/3/4 filesystem with bzip2.

config BR2_TARGET_ROOTFS_EXT2_LZMA
	bool "lzma"
	help
	  Do compress the ext2/3/4 filesystem with lzma.

config BR2_TARGET_ROOTFS_EXT2_LZO
	bool "lzo"
	help
	  Do compress the ext2 filesystem with lzop.

config BR2_TARGET_ROOTFS_EXT2_XZ
	bool "xz"
	help
	  Do compress the ext2 filesystem with xz.

endchoice

endif # BR2_TARGET_ROOTFS_EXT2
```

## fs/f2fs/Config.in
```kconfig
config BR2_TARGET_ROOTFS_F2FS
	bool "f2fs root filesystem"
	select BR2_PACKAGE_HOST_F2FS_TOOLS
	help
	  Build a f2fs root filesystem. If you enable this option, you
	  probably want to enable the f2fs-tools package too.

if BR2_TARGET_ROOTFS_F2FS

config BR2_TARGET_ROOTFS_F2FS_LABEL
	string "filesystem label"

config BR2_TARGET_ROOTFS_F2FS_SIZE
	string "filesystem size"
	default "100M"
	help
	  The size of the filesystem image in bytes.
	  Suffix with K, M, G or T for power-of-two kilo-, mega-, giga-
	  or terabytes.

config BR2_TARGET_ROOTFS_F2FS_COLD_FILES
	string "extension list for cold files"
	help
	  Specify a comma separated file extension list in order f2fs
	  to treat them as cold files. The default list includes most
	  of multimedia file extensions such as jpg, gif, mpeg, mkv,
	  and so on.

config BR2_TARGET_ROOTFS_F2FS_HOT_FILES
	string "extension list for hot files"
	help
	  Specify a comma separated file extension list in order f2fs
	  to treat them as hot files. The default list includes only
	  a db extension.

config BR2_TARGET_ROOTFS_F2FS_OVERPROVISION
	int "overprovision ratio"
	default 0
	help
	  The percentage over the volume size for overprovision
	  area. This area is hidden to users, and utilized by F2FS
	  cleaner.

	  Leave at 0 for autocalculation according to the partition
	  size.

config BR2_TARGET_ROOTFS_F2FS_DISCARD
	bool "discard policy"
	default y
	help
	  Enable or disable discard policy.

config BR2_TARGET_ROOTFS_F2FS_FEATURES
	string "filesystem features"
	help
	  List of features that the F2FS filesystem should support
	  (e.g "encrypt")

endif # BR2_TARGET_ROOTFS_F2FS
```

## fs/initramfs/Config.in
```kconfig
config BR2_TARGET_ROOTFS_INITRAMFS
	bool "initial RAM filesystem linked into linux kernel"
	depends on BR2_LINUX_KERNEL
	select BR2_TARGET_ROOTFS_CPIO
	help
	  Integrate the root filesystem generated by Buildroot as an
	  initramfs inside the kernel image. This integration will
	  take place automatically.

	  A rootfs.cpio file will be generated in the images/ directory.
	  This is the archive that will be included in the kernel image.
	  The default rootfs compression set in the kernel configuration
	  is used, regardless of how buildroot's cpio archive is configured.

	  Note that enabling initramfs together with another filesystem
	  formats doesn't make sense: you would end up having two
	  identical root filesystems, one embedded inside the kernel
	  image, and one separately.

comment "initramfs needs a Linux kernel to be built"
	depends on !BR2_LINUX_KERNEL
```

## fs/iso9660/Config.in
```kconfig
config BR2_TARGET_ROOTFS_ISO9660
	bool "iso image"
	depends on (BR2_i386 || BR2_x86_64)
	depends on BR2_LINUX_KERNEL
	depends on BR2_TARGET_GRUB2_I386_PC || \
		BR2_TARGET_SYSLINUX_ISOLINUX
	select BR2_LINUX_KERNEL_INSTALL_TARGET \
	       if (!BR2_TARGET_ROOTFS_ISO9660_INITRD && !BR2_TARGET_ROOTFS_INITRAMFS)
	help
	  Build a bootable ISO9660 image. By default, the root
	  filesystem is directly packed as the ISO9660 filesystem,
	  which means the root filesystem will be read-only. It
	  requires ISO9660 filesystem support and CDROM support in the
	  kernel.

	  However, if BR2_TARGET_ROOTFS_INITRAMFS or
	  BR2_TARGET_ROOTFS_ISO9660_INITRD have been enabled, the
	  ISO9660 filesystem will only contain a kernel image and
	  optionally an external initrd image. In this case, the
	  filesystem being in RAM, it will be read/write. No ISO9660
	  or CDROM support is needed in the kernel.

if BR2_TARGET_ROOTFS_ISO9660

choice
	prompt "Bootloader"

config BR2_TARGET_ROOTFS_ISO9660_GRUB2
	bool "grub2"
	depends on BR2_TARGET_GRUB2_I386_PC
	help
	  Use Grub 2 as the bootloader for the ISO9660 image. Make
	  sure to enable the 'iso9660' module in
	  BR2_TARGET_GRUB2_BUILTIN_MODULES and to use 'cd' as the boot
	  partition in BR2_TARGET_GRUB2_BOOT_PARTITION=.

config BR2_TARGET_ROOTFS_ISO9660_ISOLINUX
	bool "isolinux"
	depends on BR2_TARGET_SYSLINUX_ISOLINUX

endchoice

config BR2_TARGET_ROOTFS_ISO9660_BOOT_MENU
	string "Boot menu config file"
	default "fs/iso9660/grub.cfg" if BR2_TARGET_ROOTFS_ISO9660_GRUB2
	default "fs/iso9660/isolinux.cfg" if BR2_TARGET_ROOTFS_ISO9660_ISOLINUX
	help
	  Use this option to provide a custom bootloader configuration
	  file (grub.cfg for Grub 2, isolinux.cfg for isolinux).

	  Note that the strings __KERNEL_PATH__ and __INITRD_PATH__
	  will automatically be replaced by the path to the kernel and
	  initrd images respectively.

config BR2_TARGET_ROOTFS_ISO9660_INITRD
	bool "Use initrd"
	default y
	select BR2_TARGET_ROOTFS_CPIO
	help
	  Enable this option to have the root filesystem bundled as an
	  initrd/initramfs rather than directly as the ISO9660
	  filesystem. With this option enabled, the ISO9660 will only
	  contain a kernel image, an initrd image (unless an initramfs
	  linked into the kernel is used) and the bootloader.

config BR2_TARGET_ROOTFS_ISO9660_TRANSPARENT_COMPRESSION
	bool "transparent compression"
	depends on !BR2_TARGET_ROOTFS_ISO9660_INITRD
	depends on !BR2_TARGET_ROOTFS_INITRAMFS
	help
	  Say 'y' to enable use of transparent (de)compression. Files
	  are stored compressed and will be decompressed on-the-fly
	  upon access at runtime.

config BR2_TARGET_ROOTFS_ISO9660_HYBRID
	bool "Build hybrid image"
	depends on BR2_TARGET_ROOTFS_ISO9660_ISOLINUX
	help
	  Enable this option to build an hybrid image, i.e an image
	  which can either be booted from a CD-ROM or from a device
	  which BIOS considers a hard disk or ZIP disk, e.g. a USB key
	  or similar.

endif

comment "iso image needs a Linux kernel and either grub2 i386-pc or isolinux to be built"
	depends on BR2_i386 || BR2_x86_64
	depends on !BR2_LINUX_KERNEL || \
		!(BR2_TARGET_GRUB2_I386_PC || BR2_TARGET_SYSLINUX_ISOLINUX)
```

## fs/jffs2/Config.in
```kconfig
config BR2_TARGET_ROOTFS_JFFS2
	bool "jffs2 root filesystem"
	help
	  Build a jffs2 root filesystem

if BR2_TARGET_ROOTFS_JFFS2

choice
	prompt "Flash Type"
	default BR2_TARGET_ROOTFS_JFFS2_FLASH_128

config BR2_TARGET_ROOTFS_JFFS2_DATAFLASH_1056
	bool "AT45 dataflash with 1056 byte pagesize"
	select BR2_TARGET_ROOTFS_JFFS2_NOCLEANMARKER

config BR2_TARGET_ROOTFS_JFFS2_DATAFLASH_528
	bool "AT45 dataflash with 528 byte pagesize"
	select BR2_TARGET_ROOTFS_JFFS2_NOCLEANMARKER

config BR2_TARGET_ROOTFS_JFFS2_NANDFLASH_16K
	bool "NAND flash with 16 kB erasesize"
	select BR2_TARGET_ROOTFS_JFFS2_NOCLEANMARKER

config BR2_TARGET_ROOTFS_JFFS2_NANDFLASH_128K
	bool "NAND flash with 128 kB erasesize"
	select BR2_TARGET_ROOTFS_JFFS2_NOCLEANMARKER

config BR2_TARGET_ROOTFS_JFFS2_FLASH_128
	bool "Parallel flash with 128 kB erase size"

config BR2_TARGET_ROOTFS_JFFS2_FLASH_64
	bool "Parallel flash with 64 kB erase size"

config BR2_TARGET_ROOTFS_JFFS2_CUSTOM
	bool "Select custom erase size"

endchoice

config BR2_TARGET_ROOTFS_JFFS2_CUSTOM_EBSIZE
	hex "Erase block size"
	depends on BR2_TARGET_ROOTFS_JFFS2_CUSTOM
	default 0x20000
	help
	  Set to erase size of memory

config BR2_TARGET_ROOTFS_JFFS2_EBSIZE
	hex
	default 0x2100 if BR2_TARGET_ROOTFS_JFFS2_DATAFLASH_1056
	default 0x1080 if BR2_TARGET_ROOTFS_JFFS2_DATAFLASH_528
	default 0x4000 if BR2_TARGET_ROOTFS_JFFS2_NANDFLASH_16K
	default 0x20000 if BR2_TARGET_ROOTFS_JFFS2_NANDFLASH_128K
	default 0x20000 if BR2_TARGET_ROOTFS_JFFS2_FLASH_128
	default 0x10000 if BR2_TARGET_ROOTFS_JFFS2_FLASH_64
	default BR2_TARGET_ROOTFS_JFFS2_CUSTOM_EBSIZE if BR2_TARGET_ROOTFS_JFFS2_CUSTOM

config BR2_TARGET_ROOTFS_JFFS2_NOCLEANMARKER
	bool "Do not use Cleanmarker"
	default y if BR2_TARGET_ROOTFS_JFFS2_DATAFLASH_1056
	default y if BR2_TARGET_ROOTFS_JFFS2_DATAFLASH_528
	default y if BR2_TARGET_ROOTFS_JFFS2_NANDFLASH_16K
	default y if BR2_TARGET_ROOTFS_JFFS2_NANDFLASH_128K
	help
	  Do not use cleanmarkers if using NAND flash or Dataflash where
	  the pagesize is not a power of 2

config BR2_TARGET_ROOTFS_JFFS2_PAD
	bool "Pad output"

config BR2_TARGET_ROOTFS_JFFS2_PADSIZE
	hex "Pad output size (0x0 = to end of EB)"
	depends on BR2_TARGET_ROOTFS_JFFS2_PAD
	default 0x0
	help
	  Set to 0x0 to pad to end of erase block.

choice
	prompt "Endianess"
	default BR2_TARGET_ROOTFS_JFFS2_BE if BR2_ENDIAN = "BIG"

config BR2_TARGET_ROOTFS_JFFS2_LE
	bool "little-endian"

config BR2_TARGET_ROOTFS_JFFS2_BE
	bool "big-endian"

endchoice

config BR2_TARGET_ROOTFS_JFFS2_SUMMARY
	bool "Produce a summarized JFFS2 image"
	help
	  A summarised image can be mounted faster if support is
	  enabled in the kernel (CONFIG_JFFS2_SUMMARY)

config BR2_TARGET_ROOTFS_JFFS2_USE_CUSTOM_PAGESIZE
	bool "Select custom virtual memory page size"
	help
	  Use a custom virtual memory page size.  Note that this is not related to
	  the flash memory page size.  Using this option is only needed if Linux is
	  configured to use a page size different than 4kB.


config BR2_TARGET_ROOTFS_JFFS2_CUSTOM_PAGESIZE
	hex "Virtual memory page size"
	depends on BR2_TARGET_ROOTFS_JFFS2_USE_CUSTOM_PAGESIZE
	default 0x1000
	help
	  Set to virtual memory page size of target system (in bytes).  This value
	  should match the virtual page size in Linux (i.e. this should have the
	  same value as the value of the PAGE_SIZE macro in Linux).  It is not
	  related to the flash memory page size.

endif
```

## fs/romfs/Config.in
```kconfig
config BR2_TARGET_ROOTFS_ROMFS
	bool "romfs root filesystem"
	help
	  Build a romfs image of the root filesystem.
```

## fs/squashfs/Config.in
```kconfig
config BR2_TARGET_ROOTFS_SQUASHFS
	bool "squashfs root filesystem"
	help
	  Build a squashfs root filesystem

if BR2_TARGET_ROOTFS_SQUASHFS

choice
	prompt "Compression algorithm"
	default BR2_TARGET_ROOTFS_SQUASHFS4_GZIP
	help
	  Select the squashfs compression algorithm to use when
	  generating the filesystem.

config BR2_TARGET_ROOTFS_SQUASHFS4_GZIP
	bool "gzip"

config BR2_TARGET_ROOTFS_SQUASHFS4_LZMA
	bool "lzma"

config BR2_TARGET_ROOTFS_SQUASHFS4_LZO
	bool "lzo"

config BR2_TARGET_ROOTFS_SQUASHFS4_XZ
	bool "xz"

endchoice
endif
```

## fs/tar/Config.in
```kconfig
config BR2_TARGET_ROOTFS_TAR
	bool "tar the root filesystem"
	default y
	help
	  Build a tar archive of the root filesystem

choice
	prompt "Compression method"
	default BR2_TARGET_ROOTFS_TAR_NONE
	depends on BR2_TARGET_ROOTFS_TAR
	help
	  Select compressor for tar archive of the root filesystem

config BR2_TARGET_ROOTFS_TAR_NONE
	bool "no compression"
	help
	  Do not compress the tarball.

config BR2_TARGET_ROOTFS_TAR_GZIP
	bool "gzip"
	help
	  Do compress the tarball with gzip.

config BR2_TARGET_ROOTFS_TAR_BZIP2
	bool "bzip2"
	help
	  Do compress the tarball with bzip2.

config BR2_TARGET_ROOTFS_TAR_LZ4
	bool "lz4"
	help
	  Do compress the tarball with lz4.

config BR2_TARGET_ROOTFS_TAR_LZMA
	bool "lzma"
	help
	  Do compress the tarball with lzma.

config BR2_TARGET_ROOTFS_TAR_LZO
	bool "lzo"
	help
	  Do compress the tarball with lzop.

config BR2_TARGET_ROOTFS_TAR_XZ
	bool "xz"
	help
	  Do compress the tarball with xz.

endchoice

config BR2_TARGET_ROOTFS_TAR_OPTIONS
	string "other random options to pass to tar"
	depends on BR2_TARGET_ROOTFS_TAR
	default ""
	help
	  Any other flags you want to pass to tar
	  Refer to tar --help for details
```
