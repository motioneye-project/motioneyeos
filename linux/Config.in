## package.bak/dejavu/Config.in
```kconfig
config BR2_PACKAGE_DEJAVU
	bool "DejaVu fonts"
	help
	  The DejaVu fonts are a font family based on the Vera Fonts.
	  Its purpose is to provide a wider range of characters while
	  maintaining the original look and feel through the process
	  of collaborative development, under a Free license.

	  http://dejavu-fonts.org

if BR2_PACKAGE_DEJAVU

config BR2_PACKAGE_DEJAVU_MONO
	bool "mono fonts"
	default y

config BR2_PACKAGE_DEJAVU_SANS
	bool "sans fonts"
	default y

config BR2_PACKAGE_DEJAVU_SERIF
	bool "serif fonts"
	default y

config BR2_PACKAGE_DEJAVU_SANS_CONDENSED
	bool "sans condensed fonts"
	default y

config BR2_PACKAGE_DEJAVU_SERIF_CONDENSED
	bool "serif condensed fonts"
	default y

endif
```
