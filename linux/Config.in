## package.bak/alljoyn-base/Config.in
```kconfig
config BR2_PACKAGE_ALLJOYN_BASE
	bool "alljoyn-base"
	depends on BR2_USE_MMU # alljoyn
	depends on !BR2_STATIC_LIBS
	depends on BR2_INSTALL_LIBSTDCPP
	depends on BR2_TOOLCHAIN_HAS_THREADS
	depends on BR2_USE_WCHAR # alljoyn
	depends on BR2_TOOLCHAIN_HAS_SYNC_4 # alljoyn
	select BR2_PACKAGE_ALLJOYN
	select BR2_PACKAGE_OPENSSL
	select BR2_PACKAGE_ALLJOYN_BASE_CONTROLPANEL if \
		!BR2_PACKAGE_ALLJOYN_BASE_NOTIFICATION && \
		!BR2_PACKAGE_ALLJOYN_BASE_ONBOARDING
	help

	  AllJoyn Base Services are common services used by many
	  devices, providing a set of interfaces for different devices
	  to interact and interoperate with one another.

	  https://allseenalliance.org

if BR2_PACKAGE_ALLJOYN_BASE

config BR2_PACKAGE_ALLJOYN_BASE_CONTROLPANEL
	bool "controlpanel"
	help
	  Enable AllJoyn Control Panel base service which allows
	  devices to advertise a virtual control panel to be
	  controlled remotely.

config BR2_PACKAGE_ALLJOYN_BASE_NOTIFICATION
	bool "notification"
	help
	  Enable AllJoyn Notification base service which allows
	  text-based notifications to be sent and received by devices
	  on the AllJoyn network. Also supports audio and images via
	  URLs.

config BR2_PACKAGE_ALLJOYN_BASE_ONBOARDING
	bool "onboarding"
	help
	  Enable AllJoyn Onboarding base service which provides a
	  consistent way to bring a new device onto the Wi-Fi network.

endif # BR2_PACKAGE_ALLJOYN_BASE

comment "alljoyn-base needs a toolchain w/ C++, threads, wchar, dynamic library"
	depends on BR2_USE_MMU
	depends on BR2_TOOLCHAIN_HAS_SYNC_4
	depends on !BR2_INSTALL_LIBSTDCPP || !BR2_TOOLCHAIN_HAS_THREADS || \
		!BR2_USE_WCHAR || BR2_STATIC_LIBS
```

## package.bak/alljoyn-tcl-base/Config.in
```kconfig
config BR2_PACKAGE_ALLJOYN_TCL_BASE
	bool "alljoyn-tcl-base"
	depends on !BR2_STATIC_LIBS
	depends on BR2_TOOLCHAIN_HAS_THREADS # alljoyn-tcl
	select BR2_PACKAGE_ALLJOYN_TCL
	help
	  AllJoyn Base Services are common services used by many
	  devices, providing a set of interfaces for different devices
	  to interact and interoperate with one another.

	  Thin Client Library is designed to bring the benefits of the
	  AllJoyn distributed programming environment to embedded
	  systems.

	  https://allseenalliance.org

comment "alljoyn-tcl-base needs a toolchain w/ threads and dynamic library"
	depends on !BR2_TOOLCHAIN_HAS_THREADS || BR2_STATIC_LIBS
```

## package.bak/alljoyn-tcl/Config.in
```kconfig
config BR2_PACKAGE_ALLJOYN_TCL
	bool "alljoyn-tcl"
	depends on !BR2_STATIC_LIBS
	depends on BR2_TOOLCHAIN_HAS_THREADS
	help
	  The AllJoyn framework defines a common way for devices and
	  apps to communicate with one another regardless of brands,
	  categories, transports, and OSes. Developers write
	  applications that discover nearby devices, and communicate
	  with each other directly and through the cloud, unleashing
	  new possibilities in the Internet of Things.

	  AllJoyn Thin Core Library (AJTCL) is designed to bring the
	  benefits of the AllJoyn distributed programming environment
	  to embedded systems.

	  https://allseenalliance.org

comment "alljoyn-tcl needs a toolchain w/ threads and dynamic library"
	depends on !BR2_TOOLCHAIN_HAS_THREADS || BR2_STATIC_LIBS
```

## package.bak/amd-catalyst/Config.in
```kconfig
comment "amd-catalyst needs a glibc toolchain"
	depends on BR2_i386 || BR2_x86_64
	depends on !BR2_TOOLCHAIN_USES_GLIBC

config BR2_PACKAGE_AMD_CATALYST
	bool "amd-catalyst"
	depends on BR2_i386 || BR2_x86_64
	depends on BR2_TOOLCHAIN_USES_GLIBC
	help
	  The binary-only driver blob for AMD cards.
	  This driver supports AMD Radeon HD 5xxx and newer graphics
	  cards.

	  http://www.amd.com/

if BR2_PACKAGE_AMD_CATALYST

comment "amd-catalyst X.org drivers needs a modular Xorg server <= 1.17"
	depends on !BR2_PACKAGE_XORG7 \
	|| !BR2_PACKAGE_XSERVER_XORG_SERVER_MODULAR \
	|| !BR2_PACKAGE_XSERVER_XORG_SERVER_VIDEODRV_ABI_19

config BR2_PACKAGE_AMD_CATALYST_XORG
	bool "X.org drivers"
	default y
	depends on BR2_PACKAGE_XORG7
	depends on BR2_PACKAGE_XSERVER_XORG_SERVER_MODULAR
	depends on BR2_PACKAGE_XSERVER_XORG_SERVER_VIDEODRV_ABI_19
	select BR2_PACKAGE_XSERVER_XORG_SERVER_AIGLX
	select BR2_PACKAGE_ACPID # runtime
	select BR2_PACKAGE_XLIB_LIBX11 # runtime
	select BR2_PACKAGE_XLIB_LIBXEXT # runtime
	select BR2_PACKAGE_XLIB_LIBXCOMPOSITE # runtime
	# This package does not have standard GL headers
	select BR2_PACKAGE_MESA3D_HEADERS
	select BR2_PACKAGE_HAS_LIBGL

if BR2_PACKAGE_AMD_CATALYST_XORG

config BR2_PACKAGE_PROVIDES_LIBGL
	default "amd-catalyst"

config BR2_PACKAGE_AMD_CATALYST_CMDLINE_TOOLS
	bool "command-line configuration tools"
	help
	  Build and install the AMD command line tools.

comment "Catalyst Control Center needs Qt4 with X11 and PNG support"
	depends on !BR2_PACKAGE_QT || !BR2_PACKAGE_QT_X11 \
		|| BR2_PACKAGE_QT_NOPNG

config BR2_PACKAGE_AMD_CATALYST_CCCLE
	bool "Catalyst Control Center"
	depends on BR2_PACKAGE_QT
	depends on BR2_PACKAGE_QT_X11
	depends on !BR2_PACKAGE_QT_NOPNG
	select BR2_PACKAGE_BUSYBOX_SHOW_OTHERS # procps-ng
	select BR2_PACKAGE_PROCPS_NG # runtime
	select BR2_PACKAGE_QT_ACCESSIBILITY
	help
	  Installs the Catalyst Control Center, a Qt graphical tool to
	  control AMD graphics accelerators.

endif

comment "amd-catalyst kernel module needs a kernel to be built"
	depends on !BR2_LINUX_KERNEL

config BR2_PACKAGE_AMD_CATALYST_MODULE
	bool "fglrx kernel module"
	depends on BR2_LINUX_KERNEL
	help
	  Builds and install the fglrx kernel module

config BR2_PACKAGE_AMD_CATALYST_OPENCL
	bool "OpenCL support"
	help
	  Installs the OpenCL binary blobs and the ICD profile
	  for GPGPU computing.

endif # BR2_PACKAGE_AMD_CATALYST
```

## package.bak/angularjs/Config.in
```kconfig
config BR2_PACKAGE_ANGULARJS
	bool "angularjs"
	help
	  AngularJS web application framework.

	  http://angularjs.org
```

## package.bak/apache/Config.in
```kconfig
config BR2_PACKAGE_APACHE
	bool "apache"
	select BR2_PACKAGE_APR_UTIL
	select BR2_PACKAGE_PCRE
	depends on !BR2_STATIC_LIBS
	depends on BR2_TOOLCHAIN_HAS_THREADS
	depends on BR2_USE_MMU # apr
	help
	  The Apache HTTP Server Project is an effort to develop and maintain an
	  open-source HTTP server for modern operating systems including UNIX
	  and Windows NT. The goal of this project is to provide a secure,
	  efficient and extensible server that provides HTTP services in sync
	  with the current HTTP standards.

	  http://httpd.apache.org

if BR2_PACKAGE_APACHE

choice
	prompt "Multi-Processing Module (MPM)"
	default BR2_PACKAGE_APACHE_MPM_WORKER
	help
	  Select the Multi-Processing Module (MPM).

config BR2_PACKAGE_APACHE_MPM_EVENT
	bool "event"
	help
	  A variant of the worker MPM with the goal of consuming threads
	  only for connections with active processing

config BR2_PACKAGE_APACHE_MPM_PREFORK
	bool "prefork"
	help
	  Implements a non-threaded, pre-forking web server

config BR2_PACKAGE_APACHE_MPM_WORKER
	bool "worker"
	help
	  Implements a hybrid multi-threaded multi-process web server

endchoice

endif

comment "apache needs a toolchain w/ dynamic library, threads"
	depends on BR2_USE_MMU
	depends on BR2_STATIC_LIBS || !BR2_TOOLCHAIN_HAS_THREADS
```

## package.bak/apitrace/Config.in
```kconfig
comment "apitrace needs a glibc toolchain w/ C++, gcc >= 4.6"
	depends on BR2_PACKAGE_XORG7
	depends on !BR2_INSTALL_LIBSTDCPP || !BR2_TOOLCHAIN_USES_GLIBC \
		|| !BR2_TOOLCHAIN_GCC_AT_LEAST_4_6

config BR2_PACKAGE_APITRACE
	bool "apitrace"
	depends on BR2_INSTALL_LIBSTDCPP
	depends on BR2_TOOLCHAIN_USES_GLIBC # uses glibc specific __libc_dlsym
	depends on BR2_TOOLCHAIN_GCC_AT_LEAST_4_6
	depends on BR2_PACKAGE_XORG7
	select BR2_PACKAGE_XLIB_LIBX11
	select BR2_PACKAGE_LIBPNG
	help
	  Trace and replay OpenGL and OpenGL ES APIs calls to/from a
	  file. You may install apitrace GUI from your distribution to
	  inspect generated traces.

	  http://apitrace.github.io/
```

## package.bak/atf/Config.in
```kconfig
config BR2_PACKAGE_ATF
	bool "atf"
	depends on BR2_INSTALL_LIBSTDCPP
	depends on BR2_USE_MMU # fork()
	help
	  ATF, or Automated Testing Framework, is a collection of
	  libraries to write test programs in C, C++ and POSIX shell.

	  https://github.com/jmmv/atf

comment "atf needs a toolchain w/ C++"
	depends on !BR2_INSTALL_LIBSTDCPP
	depends on BR2_USE_MMU
```

## package.bak/atop/Config.in
```kconfig
config BR2_PACKAGE_ATOP
	bool "atop"
	depends on BR2_USE_MMU # fork()
	select BR2_PACKAGE_NCURSES
	select BR2_PACKAGE_ZLIB
	help
	  Atop is an ASCII full-screen performance monitor for Linux
	  that is capable of reporting the activity of all processes
	  (even if processes have finished during the interval), daily
	  logging of system and process activity for long-term analysis,
	  highlighting overloaded system resources by using colors, etc.
	  At regular intervals, it shows system-level activity related
	  to the CPU, memory, swap, disks (including LVM) and network
	  layers, and for every process (and thread) it shows e.g. the
	  CPU utilization, memory growth, disk utilization, priority,
	  username, state, and exit code.

	  http://www.atoptool.nl
```

## package.bak/aufs-util/Config.in
```kconfig
comment "aufs-util needs a linux kernel and a toolchain w/ threads"
	depends on BR2_USE_MMU
	depends on !BR2_LINUX_KERNEL || !BR2_TOOLCHAIN_HAS_THREADS

config BR2_PACKAGE_AUFS_UTIL
	bool "aufs-util"
	depends on BR2_USE_MMU
	depends on BR2_LINUX_KERNEL
	depends on BR2_TOOLCHAIN_HAS_THREADS
	help
	  Aufs command line utilities.

	  Needs a kernel with aufs support. A kernel
	  extension package is available.

	  http://sourceforge.net/p/aufs/aufs-util/

if BR2_PACKAGE_AUFS_UTIL

config BR2_PACKAGE_AUFS_UTIL_VERSION
	string "aufs-util version"
	default ""
	help
	  The version you choose must match that of the aufs support
	  in your kernel. Usually, this is aufs3.x for 3.x kernels and
	  aufs4.x for 4.x kernels.

	  Usually, the sha1 of the cset you want to use; avoid using a
	  branch name as this yields non-reproducible builds.

	  See the following resources to see what versions are available:

	  https://sourceforge.net/p/aufs/aufs-util/ci/master/tree/

endif
```

## package.bak/bonnie/Config.in
```kconfig
config BR2_PACKAGE_BONNIE
	bool "bonnie++"
	depends on BR2_INSTALL_LIBSTDCPP
	depends on BR2_USE_MMU # fork()
	help
	  A benchmark suite that is aimed at performing a number of
	  simple tests of hard drive and file system performance.

	  http://www.coker.com.au/bonnie++/

comment "bonnie++ needs a toolchain w/ C++"
	depends on BR2_USE_MMU
	depends on !BR2_INSTALL_LIBSTDCPP
```

## package.bak/bullet/Config.in
```kconfig
config BR2_PACKAGE_BULLET
	bool "bullet"
	depends on BR2_INSTALL_LIBSTDCPP
	# Affected by
	# https://gcc.gnu.org/bugzilla/show_bug.cgi?id=68476
	depends on !BR2_microblaze
	help
	  Bullet is a Collision Detection and Rigid Body Dynamics
	  Library.

	  http://bulletphysics.org

comment "bullet needs a toolchain w/ C++"
	depends on !BR2_INSTALL_LIBSTDCPP
	depends on !BR2_microblaze
```

## package.bak/c-icap/Config.in
```kconfig
config BR2_PACKAGE_C_ICAP
	bool "c-icap"
	depends on !BR2_STATIC_LIBS
	depends on BR2_TOOLCHAIN_HAS_THREADS
	depends on BR2_USE_MMU # fork()
	help
	  c-icap is an implementation of an ICAP server. It can be
	  used with HTTP proxies that support the ICAP protocol to
	  implement content adaptation and filtering services.  Most
	  of the commercial HTTP proxies must support the ICAP
	  protocol.  The open source Squid 3.x proxy server supports
	  it.

	  http://c-icap.sourceforge.net/

comment "c-icap needs a toolchain w/ threads and dynamic library"
	depends on BR2_USE_MMU
	depends on BR2_STATIC_LIBS || !BR2_TOOLCHAIN_HAS_THREADS
```

## package.bak/can-utils/Config.in
```kconfig
config BR2_PACKAGE_CAN_UTILS
	bool "can-utils"
	depends on BR2_USE_MMU # fork()
	depends on BR2_TOOLCHAIN_HAS_THREADS_NPTL # clock_nanosleep()
	help
	  SocketCAN is a set of open source CAN drivers and a
	  networking stack.
	  This package provides various tools for this stack.

	  http://elinux.org/Can-utils

comment "can-utils needs a toolchain w/ NPTL"
	depends on !BR2_TOOLCHAIN_HAS_THREADS_NPTL
	depends on BR2_USE_MMU
```

## package.bak/civetweb/Config.in
```kconfig
config BR2_PACKAGE_CIVETWEB
	bool "civetweb"
	depends on BR2_TOOLCHAIN_HAS_THREADS
	depends on BR2_USE_MMU # fork()
	help
	  Full featured embedded web server with Lua support.

	  https://sourceforge.net/projects/civetweb

if BR2_PACKAGE_CIVETWEB

config BR2_PACKAGE_CIVETWEB_WITH_LUA
	bool "enable Lua support"
	# required by the bundled Sqlite3 and Lua code
	depends on !BR2_STATIC_LIBS
	help
	  Enable Lua support in Civetweb. Note that this will use a
	  version of Lua and Sqlite bundled within the Civetweb
	  sources, and not the packages from Buildroot.

comment "lua support needs a toolchain w/ dynamic library"
	depends on BR2_STATIC_LIBS

endif

comment "civetweb needs a toolchain w/ threads"
	depends on BR2_USE_MMU
	depends on !BR2_TOOLCHAIN_HAS_THREADS
```

## package.bak/classpath/Config.in
```kconfig
config BR2_PACKAGE_CLASSPATH_ARCH_SUPPORTS
	bool
	default y if BR2_arm || BR2_armeb || BR2_i386 || BR2_m68k \
		|| BR2_mips || BR2_mipsel || BR2_mips64 || BR2_mips64el \
		|| BR2_powerpc || BR2_powerpc64 || BR2_powerpc64le \
		|| BR2_sh || BR2_x86_64

config BR2_PACKAGE_CLASSPATH
	bool "classpath"
	select BR2_NEEDS_HOST_JAR
	select BR2_NEEDS_HOST_JAVAC
	depends on BR2_PACKAGE_CLASSPATH_ARCH_SUPPORTS
	help
	  GNU Classpath, Essential Libraries for Java, is a GNU
	  project to create free core class libraries for use with
	  virtual machines and compilers for the java programming
	  language.

	  http://classpath.org
```

## package.bak/cppzmq/Config.in
```kconfig
config BR2_PACKAGE_CPPZMQ
	bool "cppzmq"
	depends on BR2_INSTALL_LIBSTDCPP
	depends on BR2_TOOLCHAIN_HAS_THREADS # zeromq
	select BR2_PACKAGE_ZEROMQ
	help
	  C++ binding for zeromq (ZeroMQ, 0MQ, zmq).

	  http://github.com/zeromq/cppzmq

comment "cppzmq needs a toolchain w/ C++, threads"
	depends on !(BR2_INSTALL_LIBSTDCPP && BR2_TOOLCHAIN_HAS_THREADS)
```

## package.bak/ctorrent/Config.in
```kconfig
comment "ctorrent needs a toolchain w/ C++"
	depends on !BR2_INSTALL_LIBSTDCPP

config BR2_PACKAGE_CTORRENT
	bool "ctorrent"
	depends on BR2_INSTALL_LIBSTDCPP
	help
	  CTorrent is a BitTorrent client implemented in C++
	  to be lightweight and quick.
	  http://ctorrent.sourceforge.net/

	  This is the enhanced version from
	  http://www.rahul.net/dholmes/ctorrent/
```

## package.bak/dash/Config.in
```kconfig
config BR2_PACKAGE_DASH
	bool "dash"
	depends on BR2_USE_MMU # fork()
	depends on BR2_PACKAGE_BUSYBOX_SHOW_OTHERS
	help
	  The Debian/Linux port of the NetBSD version of
	  ash (the Almquist SHell).

	  http://gondor.apana.org.au/~herbert/dash
```

## package.bak/dbus/Config.in
```kconfig
config BR2_PACKAGE_DBUS
	bool "dbus"
	depends on BR2_TOOLCHAIN_HAS_THREADS
	# uses fork()
	depends on BR2_USE_MMU
	select BR2_PACKAGE_EXPAT
	help
	  The D-Bus message bus system.

	  http://www.freedesktop.org/wiki/Software/dbus

comment "dbus needs a toolchain w/ threads"
	depends on BR2_USE_MMU
	depends on !BR2_TOOLCHAIN_HAS_THREADS
```

## package.bak/debianutils/Config.in
```kconfig
config BR2_PACKAGE_DEBIANUTILS
	bool "debianutils"
	depends on BR2_USE_MMU # fork()
	depends on BR2_PACKAGE_BUSYBOX_SHOW_OTHERS
	help
	  Miscellaneous utilities specific to Debian.

	  The specific utilities included are: add-shell installkernel
	  ischroot remove-shell run-parts savelog tempfile which.

	  https://tracker.debian.org/pkg/debianutils
```
