## package.bak/directfb/Config.in
```kconfig
config BR2_PACKAGE_DIRECTFB
	bool "directfb"
	depends on !BR2_STATIC_LIBS # static link issues
	depends on BR2_TOOLCHAIN_HAS_THREADS_NPTL
	depends on BR2_INSTALL_LIBSTDCPP
	depends on BR2_TOOLCHAIN_GCC_AT_LEAST_4_5
	depends on !BR2_TOOLCHAIN_USES_MUSL # sigval_t issue
	depends on BR2_TOOLCHAIN_HAS_SYNC_4
	select BR2_PACKAGE_FREETYPE
	select BR2_PACKAGE_ZLIB
	help
	  DirectFB (Direct Frame Buffer) is a set of graphics APIs implemented
	  on top of the Linux Frame Buffer (fbdev) abstraction layer. It is an
	  alternative to X11 with a smaller memory footprint that still has an
	  integrated windowing system. As of 4 October 2015, DirectFB's website
	  http://www.directfb.org/ is down. See alternative site listed below.

	  http://elinux.org/DirectFB

if BR2_PACKAGE_DIRECTFB

config BR2_PACKAGE_DIRECTFB_MULTI
	bool "directfb multi application"
	select BR2_PACKAGE_LINUX_FUSION
	depends on BR2_USE_MMU # madvise()
	depends on BR2_LINUX_KERNEL
	help
	  Enable use of multiple concurrent DirectFB applications

comment "directfb multi application needs a Linux kernel to be built"
	depends on !BR2_LINUX_KERNEL

config BR2_PACKAGE_DIRECTFB_DEBUG_SUPPORT
	bool "directfb debugging support"
	default y
	help
	  Compile DirectFB with debugging support. It provides
	  functions to print debug information, for DirectFB as well as
	  external DirectFB drivers.

	  When disabled, DirectFB does not print any debug information.
	  The drivers will be installed to and loaded from
	  /usr/lib/directfb-<version>-pure instead of
	  /usr/lib/directfb-<version>.

config BR2_PACKAGE_DIRECTFB_DEBUG
	bool "directfb debugging"
	depends on BR2_PACKAGE_DIRECTFB_DEBUG_SUPPORT
	help
	  Compile DirectFB with lots of debug output

config BR2_PACKAGE_DIRECTFB_TRACE
	bool "directfb call trace support"
	help
	  Enable call tracing for DirectFB applications

config BR2_PACKAGE_DIRECTFB_DIVINE
	bool "divine"
	help
	  Enable the DiVine feature (virtual input)

config BR2_PACKAGE_DIRECTFB_SAWMAN
	bool "sawman"
	help
	  Enable the SawMan feature (window manager)

config BR2_PACKAGE_DIRECTFB_ATI128
	bool "compile ati128 graphics driver"
	depends on BR2_i386 || BR2_x86_64

config BR2_PACKAGE_DIRECTFB_MATROX
	bool "compile matrox graphics driver"
	depends on BR2_i386 || BR2_x86_64

config BR2_PACKAGE_DIRECTFB_PXA3XX
	bool "compile pxa3xx graphics driver"
	depends on BR2_arm
	help
	  The Marvell PXA3xx Processor Family is a system-on-chip based
	  on XScale® microarchitecture. This option enables the graphic
	  driver support for the PXA3xx processor family.

	  http://www.marvell.com/application-processors/pxa-family/

config BR2_PACKAGE_DIRECTFB_EP9X
	bool "compile ep9x graphics driver"
	depends on BR2_arm
	help
	  Enable the graphic driver support for the EP93xx ARMv9 based
	  processors from Cirrus Logic.

	  http://cirrus.com/en/products/arm9.html

config BR2_PACKAGE_DIRECTFB_I830
	bool "compile i830 graphics driver"
	depends on BR2_i386 || BR2_x86_64

config BR2_PACKAGE_DIRECTFB_LINUXINPUT
	bool "compile /dev/input/eventX input driver"
	default y

config BR2_PACKAGE_DIRECTFB_KEYBOARD
	bool "compile keyboard input driver"
	default y

config BR2_PACKAGE_DIRECTFB_PS2MOUSE
	bool "compile PS2 mouse input driver"
	default y

config BR2_PACKAGE_DIRECTFB_SERIALMOUSE
	bool "compile serial mouse input driver"
	default y

config BR2_PACKAGE_DIRECTFB_TSLIB
	bool "enable touchscreen support"
	depends on !BR2_STATIC_LIBS # tslib
	default y
	select BR2_PACKAGE_TSLIB

comment "touchscreen support needs a toolchain w/ dynamic library"
	depends on BR2_STATIC_LIBS

config BR2_PACKAGE_DIRECTFB_GIF
	bool "enable GIF support"
	default y

config BR2_PACKAGE_DIRECTFB_TIFF
	bool "enable TIFF support"
	select BR2_PACKAGE_TIFF

config BR2_PACKAGE_DIRECTFB_IMLIB2
	bool "enable IMLIB2 support"
	select BR2_PACKAGE_IMLIB2
	depends on !BR2_STATIC_LIBS

comment "imlib2 support needs a toolchain w/ dynamic library"
	depends on BR2_STATIC_LIBS

config BR2_PACKAGE_DIRECTFB_JPEG
	bool "enable JPEG support"
	default y
	select BR2_PACKAGE_JPEG

config BR2_PACKAGE_DIRECTFB_PNG
	bool "enable PNG support"
	default y
	select BR2_PACKAGE_LIBPNG

config BR2_PACKAGE_DIRECTFB_SVG
	bool "enable SVG support"
	default y
	select BR2_PACKAGE_LIBSVG_CAIRO

config BR2_PACKAGE_DIRECTFB_DITHER_RGB16
	bool "enable advanced dithering of RGB16 surfaces"
	help
	  Enable dithering when loading images to RGB16 surfaces.
	  This increases the data section by 64 KBytes.

config BR2_PACKAGE_DIRECTFB_TESTS
	bool "build directfb tests"

endif # BR2_PACKAGE_DIRECTFB

comment "directfb needs a glibc or uClibc toolchain w/ C++, NPTL, gcc >= 4.5, dynamic library"
	depends on BR2_TOOLCHAIN_HAS_SYNC_4
	depends on !BR2_TOOLCHAIN_HAS_THREADS_NPTL || !BR2_INSTALL_LIBSTDCPP || \
		!BR2_TOOLCHAIN_GCC_AT_LEAST_4_5 || BR2_TOOLCHAIN_USES_MUSL || \
		BR2_STATIC_LIBS
```

## package.bak/domoticz/Config.in
```kconfig
config BR2_PACKAGE_DOMOTICZ
	bool "domoticz"
	depends on BR2_USE_MMU # mosquitto
	depends on BR2_TOOLCHAIN_HAS_SYNC_4 # mosquitto
	depends on !BR2_STATIC_LIBS # mosquitto
	depends on BR2_TOOLCHAIN_HAS_THREADS
	depends on BR2_INSTALL_LIBSTDCPP
	depends on BR2_USE_WCHAR
	depends on BR2_PACKAGE_LUA_5_2 || BR2_PACKAGE_LUA_5_3
	# These result in internal compiler error
	depends on !BR2_TOOLCHAIN_EXTERNAL_CODESOURCERY_SH
	select BR2_PACKAGE_BOOST
	select BR2_PACKAGE_BOOST_DATE_TIME
	select BR2_PACKAGE_BOOST_SYSTEM
	select BR2_PACKAGE_BOOST_THREAD
	select BR2_PACKAGE_LIBCURL
	select BR2_PACKAGE_MOSQUITTO
	select BR2_PACKAGE_OPENSSL
	select BR2_PACKAGE_SQLITE
	select BR2_PACKAGE_ZLIB
	help
	  Domoticz is a Home Automation System that lets you monitor
	  and configure various devices like: Lights, Switches,
	  various sensors/meters like Temperature, Rain, Wind, UV,
	  Electra, Gas, Water and much more. Notifications/Alerts can
	  be sent to any mobile device.

	  http://domoticz.com

comment "domoticz needs lua >= 5.2 and a toolchain w/ C++, threads, wchar, dynamic library"
	depends on BR2_USE_MMU
	depends on BR2_TOOLCHAIN_HAS_SYNC_4
	depends on !BR2_TOOLCHAIN_EXTERNAL_CODESOURCERY_SH
	depends on !BR2_INSTALL_LIBSTDCPP || !BR2_TOOLCHAIN_HAS_THREADS || \
		!BR2_USE_WCHAR || BR2_STATIC_LIBS || \
		!(BR2_PACKAGE_LUA_5_2 || BR2_PACKAGE_LUA_5_3)
```

## package.bak/dos2unix/Config.in
```kconfig
config BR2_PACKAGE_DOS2UNIX
	select BR2_PACKAGE_GETTEXT if BR2_NEEDS_GETTEXT_IF_LOCALE
	bool "dos2unix"
	depends on BR2_PACKAGE_BUSYBOX_SHOW_OTHERS
	help
	  dos2unix converts text file line endings between CRLF and LF

	  http://waterlan.home.xs4all.nl/dos2unix.html
```

## package.bak/dos2unix/Config.in.host
```kconfig
config BR2_PACKAGE_HOST_DOS2UNIX
	bool "host dos2unix"
	help
	  dos2unix converts text file line endings between CRLF and LF

	  http://waterlan.home.xs4all.nl/dos2unix.html
```

## package.bak/dsp-tools/Config.in
```kconfig
config BR2_PACKAGE_DSP_TOOLS
	bool "dsp-tools"
	depends on BR2_cortex_a8
	select BR2_PACKAGE_TIDSP_BINARIES
	help
	  Utilities for TI OMAP3 DSP.

	  http://github.com/felipec/dsp-tools
```

## package.bak/dtach/Config.in
```kconfig
config BR2_PACKAGE_DTACH
	bool "dtach"
	depends on BR2_USE_MMU # fork()
	help
	  dtach is a tiny program that emulates the detach feature of screen,
	  allowing you to run a program in an environment that is protected
	  from the controlling terminal and attach to it later.

	  http://dtach.sourceforge.net/
```

## package.bak/erlang-lager/Config.in
```kconfig
config BR2_PACKAGE_ERLANG_LAGER
	bool "erlang-lager"
	select BR2_PACKAGE_ERLANG_GOLDRUSH
	help
	  Lager (as in the beer) is a logging framework for
	  Erlang. Its purpose is to provide a more traditional way to
	  perform logging in an erlang application that plays nicely
	  with traditional UNIX logging tools like logrotate and
	  syslog.

	  https://github.com/basho/lager
```

## package.bak/erlang-p1-stringprep/Config.in
```kconfig
comment "erlang-p1-stringprep needs a toolchain w/ C++"
	depends on !BR2_INSTALL_LIBSTDCPP

config BR2_PACKAGE_ERLANG_P1_STRINGPREP
	bool "erlang-p1-stringprep"
	depends on BR2_INSTALL_LIBSTDCPP
	select BR2_PACKAGE_ERLANG_P1_UTILS
	help
	  Erlang interface to stringprep

	  https://github.com/processone/stringprep
```

## package.bak/erlang-p1-utils/Config.in
```kconfig
config BR2_PACKAGE_ERLANG_P1_UTILS
	bool "erlang-p1-utils"
	help
	  Set of small Erlang libraries

	  https://github.com/processone/p1_utils
```

## package.bak/eventlog/Config.in
```kconfig
config BR2_PACKAGE_EVENTLOG
	bool "eventlog"
	help
	  eventlog is a library for creating structured events from
	  applications, and is the workhorse behind syslog-ng's own
	  messages.

	  https://my.balabit.com/downloads/eventlog/
```

## package.bak/exfat/Config.in
```kconfig
config BR2_PACKAGE_EXFAT
	bool "exFAT (FUSE)"
	depends on BR2_TOOLCHAIN_HAS_THREADS # libfuse
	depends on BR2_USE_MMU # libfuse
	depends on BR2_USE_WCHAR
	depends on !BR2_STATIC_LIBS # libfuse
	select BR2_PACKAGE_LIBFUSE
	help
	  A full-featured exFAT file system implementation for GNU/Linux
	  and other Unix-like systems as a FUSE module.

	  https://github.com/relan/exfat

comment "exfat needs a toolchain w/ wchar, threads, dynamic library"
	depends on BR2_USE_MMU
	depends on !BR2_TOOLCHAIN_HAS_THREADS || !BR2_USE_WCHAR || BR2_STATIC_LIBS
```

## package.bak/expat/Config.in
```kconfig
config BR2_PACKAGE_EXPAT
	bool "expat"
	help
	  The Expat XML Parser.

	  http://expat.sourceforge.net
```

## package.bak/explorercanvas/Config.in
```kconfig
config BR2_PACKAGE_EXPLORERCANVAS
	bool "explorercanvas"
	help
	  Modern browsers like Firefox, Safari, Chrome and Opera
	  support the HTML5 canvas tag to allow 2D command-based
	  drawing. ExplorerCanvas brings the same functionality to
	  Internet Explorer (<v9). To use, web developers only need to
	  include a single script tag in their existing web pages.

	  http://excanvas.sf.net/
```

## package.bak/file/Config.in
```kconfig
config BR2_PACKAGE_FILE
	bool "file"
	select BR2_PACKAGE_ZLIB
	help
	  Program to identify a file's format by scanning binary data
	  for known patterns.

	  http://www.darwinsys.com/file/
```

## package.bak/flex/Config.in
```kconfig
config BR2_PACKAGE_FLEX
	bool "flex"
	select BR2_PACKAGE_GETTEXT if BR2_NEEDS_GETTEXT_IF_LOCALE
	help
	  A fast lexical analyser generator. A tool for generating
	  programs that perform pattern-matching on text.

	  http://flex.sourceforge.net/
```

## package.bak/freeradius-client/Config.in
```kconfig
config BR2_PACKAGE_FREERADIUS_CLIENT
	bool "freeradius-client"
	help
	  FreeRADIUS Client is a framework and library for
	  writing RADIUS Clients.

	  http://wiki.freeradius.org/project/Radiusclient
```

## package.bak/freerdp/Config.in
```kconfig
config BR2_PACKAGE_FREERDP
	bool "freerdp"
	# FreeRDP does not have a single C++ source file, however it
	# insists on having a C++ compiler. Removing that requirement
	# is a bit too much involving, so we just depend on it...
	depends on BR2_INSTALL_LIBSTDCPP
	depends on BR2_USE_WCHAR
	depends on !BR2_STATIC_LIBS # uses dlfcn.h
	depends on BR2_TOOLCHAIN_HAS_THREADS
	depends on BR2_USE_MMU # libglib2
	depends on BR2_TOOLCHAIN_HAS_SYNC_4
	select BR2_PACKAGE_OPENSSL
	select BR2_PACKAGE_ZLIB
	select BR2_PACKAGE_LIBGLIB2
	help
	  FreeRDP is a free implementation of the Remote Desktop
	  Protocol (RDP), released under the Apache license

	  This only installs the freerdp libraries.

	  http://www.freerdp.com/

	  Note: this also installs a key and certificate in
	  /etc/freerdp/keys/ . These are publicly-known, as they
	  are present in FreeRDP's source tree. It is strongly
	  suggested that you overwrite them with your own set,
	  either in an overlay rootfs or in a post-build script.

if BR2_PACKAGE_FREERDP

choice
	bool "gstreamer support"
	depends on BR2_PACKAGE_XORG7 # xlib-libxrandr
	depends on BR2_PACKAGE_GSTREAMER || BR2_PACKAGE_GSTREAMER1

config BR2_PACKAGE_FREERDP_GSTREAMER1
	bool "gstreamer-1.x"
	depends on BR2_PACKAGE_GSTREAMER1
	# gstreamer-1.x dependencies already dependencies of FreeRDP
	select BR2_PACKAGE_GST1_PLUGINS_BASE
	select BR2_PACKAGE_GST1_PLUGINS_BASE_PLUGIN_APP
	select BR2_PACKAGE_XLIB_LIBXRANDR

config BR2_PACKAGE_FREERDP_GSTREAMER
	bool "gstreamer-0.x"
	depends on BR2_PACKAGE_GSTREAMER
	# gstreamer-0.x dependencies already dependencies of FreeRDP
	select BR2_PACKAGE_GST_PLUGINS_BASE
	select BR2_PACKAGE_GST_PLUGINS_BASE_PLUGIN_APP
	select BR2_PACKAGE_XLIB_LIBXRANDR
	select BR2_PACKAGE_LIBXML2

config BR2_PACKAGE_FREERDP_GSTREAMER_NO
	bool "none"

endchoice

comment "gstreamer support needs X.Org"
	depends on !BR2_PACKAGE_XORG7
	depends on BR2_PACKAGE_GSTREAMER || BR2_PACKAGE_GSTREAMER1

config BR2_PACKAGE_FREERDP_SERVER
	bool "server"
	depends on BR2_PACKAGE_XORG7
	select BR2_PACKAGE_XLIB_LIBX11
	select BR2_PACKAGE_XLIB_LIBXDAMAGE
	select BR2_PACKAGE_XLIB_LIBXEXT
	select BR2_PACKAGE_XLIB_LIBXFIXES

config BR2_PACKAGE_FREERDP_CLIENT_X11
	bool "X11 client"
	default y
	depends on BR2_PACKAGE_XORG7
	select BR2_PACKAGE_XLIB_LIBX11
	select BR2_PACKAGE_XLIB_LIBXEXT

comment "server and X11 client need X.Org"
	depends on !BR2_PACKAGE_XORG7

config BR2_PACKAGE_FREERDP_CLIENT_WL
	bool "wayland client"
	default y
	depends on BR2_PACKAGE_WAYLAND

endif

comment "freerdp needs a toolchain w/ wchar, dynamic library, threads, C++"
	depends on BR2_TOOLCHAIN_HAS_SYNC_4
	depends on !BR2_USE_WCHAR || BR2_STATIC_LIBS \
		|| !BR2_TOOLCHAIN_HAS_THREADS || !BR2_INSTALL_LIBSTDCPP
```

## package.bak/fwup/Config.in.host
```kconfig
config BR2_PACKAGE_HOST_FWUP
	bool "host fwup"
	help
	  Fwup is a scriptable embedded Linux firmware update creator
	  and runner.

	  https://github.com/fhunleth/fwup
```

## package.bak/gauche/Config.in
```kconfig
# Architecture dependency from the bundled bdwgc.
config BR2_PACKAGE_GAUCHE_ARCH_SUPPORTS
	bool
	default y if BR2_arm || BR2_armeb || BR2_i386 || BR2_m68k || \
		BR2_mips || BR2_mipsel || BR2_mips64 || \
		BR2_mips64el || BR2_powerpc || BR2_powerpc64 || \
		BR2_powerpc64le || BR2_sh || BR2_x86_64

config BR2_PACKAGE_GAUCHE
	bool "gauche"
	depends on BR2_TOOLCHAIN_HAS_THREADS_NPTL
	depends on BR2_USE_MMU # fork()
	depends on BR2_PACKAGE_GAUCHE_ARCH_SUPPORTS
	depends on !BR2_STATIC_LIBS
	help
	  Gauche is an R7RS Scheme implementation developed to be a
	  handy script interpreter, which allows programmers and
	  system administrators to write small to large scripts for
	  their daily chores. Quick startup, built-in system
	  interface, native multilingual support are some of its
	  goals.

	  http://practical-scheme.net/gauche/

comment "gauche needs a toolchain w/ NPTL, dynamic library"
	depends on BR2_USE_MMU
	depends on BR2_PACKAGE_GAUCHE_ARCH_SUPPORTS
	depends on !BR2_TOOLCHAIN_HAS_THREADS_NPTL || BR2_STATIC_LIBS
```

## package.bak/genimage/Config.in.host
```kconfig
config BR2_PACKAGE_HOST_GENIMAGE
	bool "host genimage"
	help
	  genimage is a tool to generate multiple filesystem and flash
	  images from a given root filesystem tree. genimage is
	  intended to be run in a fakeroot environment.

	  Configuration is done in a config file parsed by
	  libconfuse. Options like the path to tools can be given in
	  environment variables, the config file or commandline
	  switches.

	  http://www.pengutronix.de/software/genimage/
```

## package.bak/git-crypt/Config.in
```kconfig
config BR2_PACKAGE_GIT_CRYPT
	bool "git-crypt"
	depends on BR2_INSTALL_LIBSTDCPP
	depends on BR2_USE_MMU # git
	select BR2_PACKAGE_GIT # runtime
	select BR2_PACKAGE_OPENSSL
	help
	  git-crypt enables transparent encryption and decryption of
	  files in a git repository.

	  https://www.agwa.name/projects/git-crypt/

comment "git-crypt needs a toolchain w/ C++"
	depends on !BR2_INSTALL_LIBSTDCPP
	depends on BR2_USE_MMU
```
