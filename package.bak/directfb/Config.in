## package.bak/google-material-design-icons/Config.in
```kconfig
config BR2_PACKAGE_GOOGLE_MATERIAL_DESIGN_ICONS
	bool "google-material-design-icons"
	help
	  Material design icons are the official icon set from Google that
	  are designed under the material design guidelines.

	  https://github.com/google/material-design-icons

if BR2_PACKAGE_GOOGLE_MATERIAL_DESIGN_ICONS

config BR2_PACKAGE_GOOGLE_MATERIAL_DESIGN_ICONS_TYPE_PNG
	bool "Install PNG icons"
	help
	  Use PNG icon types.

	  The default. Traditional format; simplicity and compatibility.

config BR2_PACKAGE_GOOGLE_MATERIAL_DESIGN_ICONS_TYPE_SVG
	bool "Install SVG icons"
	help
	  Use SVG icon types.

	  Vector format that is limitlessly scalable.

config BR2_PACKAGE_GOOGLE_MATERIAL_DESIGN_ICONS_FONT
	bool "Install TrueType font"
	help
	  Install the Material TrueType font (ttf) on the target system.

config BR2_PACKAGE_GOOGLE_MATERIAL_DESIGN_ICONS_SPRITES_CSS
	bool "Install CSS sprites"
	help
	  Install CSS (PNG) spritesheets.

config BR2_PACKAGE_GOOGLE_MATERIAL_DESIGN_ICONS_SPRITES_SVG
	bool "Install SVG sprites"
	help
	  Install SVG spritesheets.

endif
```

## package.bak/googlefontdirectory/Config.in
```kconfig
config BR2_PACKAGE_GOOGLEFONTDIRECTORY
	bool "Google font directory"
	help
	  Google font directory

	  http://code.google.com/p/googlefontdirectory/

if BR2_PACKAGE_GOOGLEFONTDIRECTORY

config BR2_PACKAGE_GOOGLEFONTDIRECTORY_FONTS
	string "List of fonts to install"
	default "droid"
	help
	  Specify a space-separated list of fonts to install

endif
```

## package.bak/gperf/Config.in
```kconfig
config BR2_PACKAGE_GPERF
	bool "gperf"
	depends on BR2_INSTALL_LIBSTDCPP
	help
	  A 'perfect hash function' generator

	  http://www.gnu.org/software/gperf/

comment "gperf needs a toolchain w/ C++"
	depends on !BR2_INSTALL_LIBSTDCPP
```

## package.bak/gr-osmosdr/Config.in
```kconfig
config BR2_PACKAGE_GR_OSMOSDR
	bool "gr-osmosdr"
	depends on BR2_PACKAGE_GNURADIO
	select BR2_PACKAGE_GNURADIO_BLOCKS
	help
	  GNU Radio block for interfacing with various radio hardware

if BR2_PACKAGE_GR_OSMOSDR

config BR2_PACKAGE_GR_OSMOSDR_PYTHON
	bool "python support"
	depends on BR2_PACKAGE_GNURADIO_PYTHON
	help
	  Enable Python support

config BR2_PACKAGE_GR_OSMOSDR_IQFILE
	bool "IQ File Source support"
	help
	  Enable IQ File Source support

config BR2_PACKAGE_GR_OSMOSDR_RTLSDR
	bool "Osmocom RTLSDR support"
	select BR2_PACKAGE_LIBRTLSDR
	help
	  Enable Osmocom RTLSDR support

config BR2_PACKAGE_GR_OSMOSDR_RTLSDR_TCP
	bool "RTLSDR TCP Client support"
	help
	  Enable RTLSDR TCP client support

config BR2_PACKAGE_GR_OSMOSDR_RFSPACE
	bool "RFSPACE Receivers support"
	help
	  Enable RFSPACE Receivers support

endif
```
