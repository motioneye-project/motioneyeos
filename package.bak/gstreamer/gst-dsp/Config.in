## package.bak/jemalloc/Config.in
```kconfig
config BR2_PACKAGE_JEMALLOC_ARCH_SUPPORTS
	bool
	default y if BR2_arm || BR2_armeb
	default y if BR2_aarch64 || BR2_aarch64_be
	default y if BR2_i386 || BR2_x86_64
	default y if BR2_mips || BR2_mipsel
	default y if BR2_sparc64
	default y if BR2_powerpc
	default y if BR2_sh4 || BR2sh4eb || BR2_sh4a || BR2_sh4aeb

config BR2_PACKAGE_JEMALLOC
	bool "jemalloc"
	depends on BR2_PACKAGE_JEMALLOC_ARCH_SUPPORTS
	depends on !BR2_STATIC_LIBS
	depends on BR2_TOOLCHAIN_HAS_THREADS
	help
	  This library providing a malloc(3) implementation that emphasizes
	  fragmentation avoidance and scalable concurrency support.

	  http://www.canonware.com/jemalloc/

comment "jemalloc needs a toolchain w/ dynamic library, threads"
	depends on BR2_PACKAGE_JEMALLOC_ARCH_SUPPORTS
	depends on BR2_STATIC_LIBS || !BR2_TOOLCHAIN_HAS_THREADS
```

## package.bak/jquery-ui/Config.in
```kconfig
config BR2_PACKAGE_JQUERY_UI
	bool "jquery-ui"
	help
	  jQuery UI provides abstractions for low-level interaction and
	  animation, advanced effects and high-level, themeable widgets,
	  built on top of the jQuery JavaScript Library, that you can use
	  to build highly interactive web applications.

	  http://jqueryui.com/
```

## package.bak/jquery-validation/Config.in
```kconfig
config BR2_PACKAGE_JQUERY_VALIDATION
	bool "jquery-validation"
	help
	  The jQuery Validation Plugin provides drop-in validation for
	  your existing forms, while making all kinds of
	  customizations to fit your application really easy.

	  http://jqueryvalidation.org/
```

## package.bak/jsmn/Config.in
```kconfig
config BR2_PACKAGE_JSMN
	bool "jsmn"
	help
	  jsmn (pronounced like 'jasmine') is a minimalistic JSON
	  parser in C. It can be easily integrated into
	  resource-limited or embedded projects.

	  https://github.com/zserge/jsmn/
```

## package.bak/json-c/Config.in
```kconfig
config BR2_PACKAGE_JSON_C
	bool "json-c"
	# uses __sync_val_compare_and_swap_4
	depends on BR2_TOOLCHAIN_HAS_SYNC_4
	help
	  JSON-C - A JSON implementation in C

	  JSON-C implements a reference counting object model that
	  allows you to easily construct JSON objects in C, output
	  them as JSON formatted strings and parse JSON formatted
	  strings back into the C representation of JSON objects.

	  https://github.com/json-c/json-c/
```

## package.bak/json-javascript/Config.in
```kconfig
config BR2_PACKAGE_JSON_JAVASCRIPT
	bool "json-javascript"
	help
	  JSON in JavaScript

	  https://github.com/douglascrockford/JSON-js/
```

## package.bak/kodi-audiodecoder-opus/Config.in
```kconfig
config BR2_PACKAGE_KODI_AUDIODECODER_OPUS
	bool "kodi-audiodecoder-opus"
	select BR2_PACKAGE_KODI_PLATFORM
	select BR2_PACKAGE_LIBOGG
	select BR2_PACKAGE_OPUS
	select BR2_PACKAGE_OPUSFILE
	help
	  Opus audio decoder for Kodi

	  https://github.com/notspiff/audiodecoder.opus
```

## package.bak/kodi-pvr-hts/Config.in
```kconfig
config BR2_PACKAGE_KODI_PVR_HTS
	bool "kodi-pvr-hts"
	select BR2_PACKAGE_KODI_PLATFORM
	help
	  Tvheadend HTSP PVR client addon for Kodi

	  https://github.com/kodi-pvr/pvr.hts
```

## package.bak/kodi-pvr-iptvsimple/Config.in
```kconfig
config BR2_PACKAGE_KODI_PVR_IPTVSIMPLE
	bool "kodi-pvr-iptvsimple"
	select BR2_PACKAGE_KODI_PLATFORM
	help
	  IPTV Live TV and Radio PVR client addon for Kodi

	  https://github.com/kodi-pvr/pvr.iptvsimple
```
