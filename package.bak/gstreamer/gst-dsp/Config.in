## package.bak/gstreamer/gst-dsp/Config.in
```kconfig
config BR2_PACKAGE_GST_DSP
	bool "gst-dsp"
	depends on BR2_cortex_a8
	select BR2_PACKAGE_TIDSP_BINARIES
	help
	  GStreamer plug-in to access TI OMAP3 DSP algorithms.

	  http://code.google.com/p/gst-dsp/
```

## package.bak/gstreamer/gst-plugins-bad/Config.in
```kconfig
menuconfig BR2_PACKAGE_GST_PLUGINS_BAD
	bool "gst-plugins-bad"
	select BR2_PACKAGE_GST_PLUGINS_BASE
	help
	  A set of plug-ins for GStreamer that may be of poor quality or
	  lacking some features.

	  http://gstreamer.freedesktop.org/

if BR2_PACKAGE_GST_PLUGINS_BAD

comment "dependency-less plugins"

config BR2_PACKAGE_GST_PLUGINS_BAD_PLUGIN_ADPCMDEC
	bool "adpcmdec"

config BR2_PACKAGE_GST_PLUGINS_BAD_PLUGIN_ADPCMENC
	bool "adpcmenc"

config BR2_PACKAGE_GST_PLUGINS_BAD_PLUGIN_AIFF
	bool "aiff"

config BR2_PACKAGE_GST_PLUGINS_BAD_PLUGIN_ASFMUX
	bool "asfmux"

config BR2_PACKAGE_GST_PLUGINS_BAD_PLUGIN_AUTOCONVERT
	bool "autoconvert"

config BR2_PACKAGE_GST_PLUGINS_BAD_PLUGIN_AUDIOVISUALIZERS
	bool "audiovisualizers"

config BR2_PACKAGE_GST_PLUGINS_BAD_PLUGIN_BAYER
	bool "bayer"

config BR2_PACKAGE_GST_PLUGINS_BAD_PLUGIN_CAMERABIN
	bool "camerabin"

config BR2_PACKAGE_GST_PLUGINS_BAD_PLUGIN_CAMERABIN2
	bool "camerabin2"

config BR2_PACKAGE_GST_PLUGINS_BAD_PLUGIN_CDXAPARSE
	bool "cdxaparse"

config BR2_PACKAGE_GST_PLUGINS_BAD_PLUGIN_COLOREFFECTS
	bool "coloreffects"

config BR2_PACKAGE_GST_PLUGINS_BAD_PLUGIN_COLORSPACE
	bool "colorspace"

config BR2_PACKAGE_GST_PLUGINS_BAD_PLUGIN_DATAURISRC
	bool "dataurisrc"

config BR2_PACKAGE_GST_PLUGINS_BAD_PLUGIN_DCCP
	bool "dccp"

config BR2_PACKAGE_GST_PLUGINS_BAD_PLUGIN_DEBUGUTILS
	bool "debugutils"

config BR2_PACKAGE_GST_PLUGINS_BAD_PLUGIN_DECKLINK
	depends on BR2_INSTALL_LIBSTDCPP
	bool "decklink"

comment "decklink needs a toolchain w/ C++"
	depends on !BR2_INSTALL_LIBSTDCPP

config BR2_PACKAGE_GST_PLUGINS_BAD_PLUGIN_DTMF
	bool "dtmf"

config BR2_PACKAGE_GST_PLUGINS_BAD_PLUGIN_DVBSUBOVERLAY
	bool "dvdsuboverlay"

config BR2_PACKAGE_GST_PLUGINS_BAD_PLUGIN_DVDSPU
	bool "dvdspu"

config BR2_PACKAGE_GST_PLUGINS_BAD_PLUGIN_FACEOVERLAY
	bool "faceoverlay"

config BR2_PACKAGE_GST_PLUGINS_BAD_PLUGIN_FESTIVAL
	bool "festival"

config BR2_PACKAGE_GST_PLUGINS_BAD_PLUGIN_FIELDANALYSIS
	bool "fieldanalysis"

config BR2_PACKAGE_GST_PLUGINS_BAD_PLUGIN_FREEVERB
	bool "freeverb"

config BR2_PACKAGE_GST_PLUGINS_BAD_PLUGIN_FREEZE
	bool "freeze"

config BR2_PACKAGE_GST_PLUGINS_BAD_PLUGIN_FREI0R
	bool "frei0r"

config BR2_PACKAGE_GST_PLUGINS_BAD_PLUGIN_GAUDIEFFECTS
	bool "gaudieffects"

config BR2_PACKAGE_GST_PLUGINS_BAD_PLUGIN_GEOMETRICTRANSFORM
	bool "geometrictransform"

config BR2_PACKAGE_GST_PLUGINS_BAD_PLUGIN_GSETTINGS
	bool "gsettings"

config BR2_PACKAGE_GST_PLUGINS_BAD_PLUGIN_H264PARSE
	bool "h264parse"

config BR2_PACKAGE_GST_PLUGINS_BAD_PLUGIN_HDVPARSE
	bool "hdvparse"

config BR2_PACKAGE_GST_PLUGINS_BAD_PLUGIN_HLS
	bool "hls"

config BR2_PACKAGE_GST_PLUGINS_BAD_PLUGIN_ID3TAG
	bool "id3tag"

config BR2_PACKAGE_GST_PLUGINS_BAD_PLUGIN_INTER
	bool "inter"

config BR2_PACKAGE_GST_PLUGINS_BAD_PLUGIN_INTERLACE
	bool "interlace"

config BR2_PACKAGE_GST_PLUGINS_BAD_PLUGIN_IVFPARSE
	bool "ivfparse"

config BR2_PACKAGE_GST_PLUGINS_BAD_PLUGIN_JP2KDECIMATOR
	bool "jp2kdecimator"

config BR2_PACKAGE_GST_PLUGINS_BAD_PLUGIN_JPEGFORMAT
	bool "jpegformat"

config BR2_PACKAGE_GST_PLUGINS_BAD_PLUGIN_LEGACYRESAMPLE
	bool "legacyresample"

config BR2_PACKAGE_GST_PLUGINS_BAD_PLUGIN_LIBRFB
	bool "librfb"

config BR2_PACKAGE_GST_PLUGINS_BAD_PLUGIN_LINSYS
	bool "linsys"

config BR2_PACKAGE_GST_PLUGINS_BAD_PLUGIN_LIVEADDER
	bool "liveadder"

config BR2_PACKAGE_GST_PLUGINS_BAD_PLUGIN_MPEGDEMUX
	bool "mpegdemux"

config BR2_PACKAGE_GST_PLUGINS_BAD_PLUGIN_MPEGPSMUX
	bool "mpegpsmux"

config BR2_PACKAGE_GST_PLUGINS_BAD_PLUGIN_MPEGTSDEMUX
	bool "mpegtsdemux"

config BR2_PACKAGE_GST_PLUGINS_BAD_PLUGIN_MPEGTSMUX
	bool "mpegtsmux"

config BR2_PACKAGE_GST_PLUGINS_BAD_PLUGIN_MPEGVIDEOPARSE
	bool "mpegvideoparse"

config BR2_PACKAGE_GST_PLUGINS_BAD_PLUGIN_MVE
	bool "mve"

config BR2_PACKAGE_GST_PLUGINS_BAD_PLUGIN_MXF
	bool "mxf"

config BR2_PACKAGE_GST_PLUGINS_BAD_PLUGIN_NSF
	bool "nsf"

config BR2_PACKAGE_GST_PLUGINS_BAD_PLUGIN_NUVDEMUX
	bool "nuvdemux"

config BR2_PACKAGE_GST_PLUGINS_BAD_PLUGIN_PATCHDETECT
	bool "patchdetect"

config BR2_PACKAGE_GST_PLUGINS_BAD_PLUGIN_PCAPPARSE
	bool "pcapparse"

config BR2_PACKAGE_GST_PLUGINS_BAD_PLUGIN_PNM
	bool "pnm"

config BR2_PACKAGE_GST_PLUGINS_BAD_PLUGIN_RAWPARSE
	bool "rawparse"

config BR2_PACKAGE_GST_PLUGINS_BAD_PLUGIN_REAL
	bool "real"

config BR2_PACKAGE_GST_PLUGINS_BAD_PLUGIN_REMOVESILENCE
	bool "removesilence"

config BR2_PACKAGE_GST_PLUGINS_BAD_PLUGIN_RTPMUX
	bool "rtpmux"

config BR2_PACKAGE_GST_PLUGINS_BAD_PLUGIN_RTPVP8
	bool "rtpvp8"

config BR2_PACKAGE_GST_PLUGINS_BAD_PLUGIN_SCALETEMPO
	bool "scaletempo"

config BR2_PACKAGE_GST_PLUGINS_BAD_PLUGIN_SDI
	bool "sdi"

config BR2_PACKAGE_GST_PLUGINS_BAD_PLUGIN_SDP
	bool "sdp"

config BR2_PACKAGE_GST_PLUGINS_BAD_PLUGIN_SEGMENTCLIP
	bool "segmentclip"

config BR2_PACKAGE_GST_PLUGINS_BAD_PLUGIN_SIREN
	bool "siren"

config BR2_PACKAGE_GST_PLUGINS_BAD_PLUGIN_SMOOTH
	bool "smooth"

config BR2_PACKAGE_GST_PLUGINS_BAD_PLUGIN_SPEED
	bool "speed"

config BR2_PACKAGE_GST_PLUGINS_BAD_PLUGIN_STEREO
	bool "stereo"

config BR2_PACKAGE_GST_PLUGINS_BAD_PLUGIN_SUBENC
	bool "subenc"

config BR2_PACKAGE_GST_PLUGINS_BAD_PLUGIN_TTA
	bool "tta"

config BR2_PACKAGE_GST_PLUGINS_BAD_PLUGIN_VIDEOFILTERS
	bool "videofilters"

config BR2_PACKAGE_GST_PLUGINS_BAD_PLUGIN_VIDEOMAXRATE
	bool "videomaxrate"

config BR2_PACKAGE_GST_PLUGINS_BAD_PLUGIN_VIDEOMEASURE
	bool "videomeasure"

config BR2_PACKAGE_GST_PLUGINS_BAD_PLUGIN_VIDEOPARSERS
	bool "videoparsers"

config BR2_PACKAGE_GST_PLUGINS_BAD_PLUGIN_VIDEOSIGNAL
	bool "videosignal"

config BR2_PACKAGE_GST_PLUGINS_BAD_PLUGIN_VMNC
	bool "vmnc"

config BR2_PACKAGE_GST_PLUGINS_BAD_PLUGIN_Y4M
	bool "y4m"

comment "plugins with external dependencies (there may be more available)"

config BR2_PACKAGE_GST_PLUGINS_BAD_PLUGIN_APEXSINK
	bool "apexsink"
	select BR2_PACKAGE_OPENSSL

config BR2_PACKAGE_GST_PLUGINS_BAD_PLUGIN_BZ2
	bool "bz2"
	select BR2_PACKAGE_BZIP2

config BR2_PACKAGE_GST_PLUGINS_BAD_PLUGIN_CDAUDIO
	bool "cdaudio"
	depends on !BR2_nios2 # libcdaudio
	select BR2_PACKAGE_LIBCDAUDIO

config BR2_PACKAGE_GST_PLUGINS_BAD_PLUGIN_CURL
	bool "curl"
	select BR2_PACKAGE_LIBCURL

config BR2_PACKAGE_GST_PLUGINS_BAD_PLUGIN_DIRECTFB
	bool "directfb"
	depends on BR2_PACKAGE_DIRECTFB
	default y

config BR2_PACKAGE_GST_PLUGINS_BAD_PLUGIN_DVB
	bool "dvb"

config BR2_PACKAGE_GST_PLUGINS_BAD_PLUGIN_FBDEV
	bool "fbdev"

config BR2_PACKAGE_GST_PLUGINS_BAD_PLUGIN_FAAD
	bool "faad"
	select BR2_PACKAGE_FAAD2

config BR2_PACKAGE_GST_PLUGINS_BAD_PLUGIN_LIBMMS
	bool "libmms"
	depends on BR2_USE_WCHAR # libmms -> libglib2
	depends on BR2_TOOLCHAIN_HAS_THREADS # libmms -> libglib2
	select BR2_PACKAGE_LIBMMS

comment "libmms needs a toolchain w/ wchar, threads"
	depends on !BR2_USE_WCHAR || !BR2_TOOLCHAIN_HAS_THREADS

config BR2_PACKAGE_GST_PLUGINS_BAD_PLUGIN_MUSEPACK
	bool "musepack"
	select BR2_PACKAGE_MUSEPACK

config BR2_PACKAGE_GST_PLUGINS_BAD_PLUGIN_NEON
	bool "neon"
	select BR2_PACKAGE_NEON

config BR2_PACKAGE_GST_PLUGINS_BAD_PLUGIN_OPUS
	bool "opus"
	select BR2_PACKAGE_OPUS

config BR2_PACKAGE_GST_PLUGINS_BAD_PLUGIN_RSVG
	bool "rsvg"
	depends on BR2_INSTALL_LIBSTDCPP # librsvg -> pango
	depends on BR2_TOOLCHAIN_HAS_SYNC_4 # librsvg -> pango -> harfbuzz
	select BR2_PACKAGE_LIBRSVG

comment "rsvg plugin needs a toolchain w/ C++"
	depends on !BR2_INSTALL_LIBSTDCPP
	depends on BR2_TOOLCHAIN_HAS_SYNC_4

config BR2_PACKAGE_GST_PLUGINS_BAD_PLUGIN_SDL
	bool "sdl"
	select BR2_PACKAGE_SDL

config BR2_PACKAGE_GST_PLUGINS_BAD_PLUGIN_SNDFILE
	bool "sndfile"
	select BR2_PACKAGE_LIBSNDFILE

config BR2_PACKAGE_GST_PLUGINS_BAD_PLUGIN_VCD
	bool "vcd"

config BR2_PACKAGE_GST_PLUGINS_BAD_PLUGIN_VP8
	bool "vp8"
	depends on !BR2_bfin # libvpx
	select BR2_PACKAGE_LIBVPX

config BR2_PACKAGE_GST_PLUGINS_BAD_ZBAR
	bool "zbar"
	depends on BR2_TOOLCHAIN_HAS_THREADS # zbar-> libv4l
	depends on BR2_USE_MMU # zbar-> libv4l
	depends on !BR2_STATIC_LIBS # zbar-> libv4l
	depends on BR2_INSTALL_LIBSTDCPP # zbar-> libv4l
	depends on BR2_TOOLCHAIN_HEADERS_AT_LEAST_3_0 # zbar-> libv4l
	select BR2_PACKAGE_ZBAR

comment "zbar plugin needs a toolchain w/ threads, dynamic library, C++ and headers >= 3.0"
	depends on BR2_USE_MMU
	depends on !BR2_TOOLCHAIN_HAS_THREADS || BR2_STATIC_LIBS \
		|| !BR2_INSTALL_LIBSTDCPP || !BR2_TOOLCHAIN_HEADERS_AT_LEAST_3_0

endif
```

## package.bak/gstreamer1/gst1-rtsp-server/Config.in
```kconfig
config BR2_PACKAGE_GST1_RTSP_SERVER
	bool "gst1-rtsp-server"
	select BR2_PACKAGE_GST1_PLUGINS_BASE
	select BR2_PACKAGE_GST1_PLUGINS_BASE_PLUGIN_APP # runtime
	select BR2_PACKAGE_GST1_PLUGINS_GOOD
	select BR2_PACKAGE_GST1_PLUGINS_GOOD_PLUGIN_RTP # runtime
	select BR2_PACKAGE_GST1_PLUGINS_GOOD_PLUGIN_RTPMANAGER # runtime
	select BR2_PACKAGE_GST1_PLUGINS_GOOD_PLUGIN_UDP # runtime
	help
	  RTSP server library based on GStreamer.

	  http://gstreamer.freedesktop.org/
```

## package.bak/gtksourceview/Config.in
```kconfig
config BR2_PACKAGE_GTKSOURCEVIEW
	bool "gtksourceview"
	depends on BR2_PACKAGE_LIBGTK3
	select BR2_PACKAGE_LIBXML2
	help
	  GtkSourceView is a portable C library that extends the
	  standard GTK+ framework for multiline text editing with
	  support for configurable syntax highlighting, unlimited
	  undo/redo, search and replace, a completion framework,
	  printing and other features typical of a source code editor.

	  https://projects.gnome.org/gtksourceview
```

## package.bak/gzip/Config.in
```kconfig
config BR2_PACKAGE_GZIP
	bool "gzip"
	depends on BR2_USE_WCHAR
	depends on BR2_PACKAGE_BUSYBOX_SHOW_OTHERS
	help
	  Standard GNU compressor. Provides things like gzip,
	  gunzip, gzcat, etc...

	  http://www.gnu.org/software/gzip/gzip.html

comment "gzip needs a toolchain w/ wchar"
	depends on !BR2_USE_WCHAR
	depends on BR2_PACKAGE_BUSYBOX_SHOW_OTHERS
```

## package.bak/haveged/Config.in
```kconfig
config BR2_PACKAGE_HAVEGED
	bool "haveged"
	depends on BR2_USE_MMU # fork()
	help
	  The haveged project is an attempt to provide an easy-to-use,
	  unpredictable random number generator based upon an adaptation
	  of the HAVEGE algorithm.

	  http://www.issihosts.com/haveged/
```

## package.bak/hwloc/Config.in
```kconfig
config BR2_PACKAGE_HWLOC
	bool "hwloc"
	depends on BR2_TOOLCHAIN_HAS_THREADS
	help
	  Portable Hardware Locality

	  Provides a portable abstraction (across OS, versions,
	  architectures, ...)  of the hierarchical topology of modern
	  architectures, including NUMA memory nodes, sockets, shared
	  caches, cores and simultaneous multithreading.

	  http://www.open-mpi.org/projects/hwloc/

comment "hwloc needs a toolchain w/ threads"
	depends on !BR2_TOOLCHAIN_HAS_THREADS
```

## package.bak/ibrdtn/Config.in
```kconfig
config BR2_PACKAGE_IBRDTN
	bool "ibrdtn"
	depends on BR2_INSTALL_LIBSTDCPP
	depends on BR2_TOOLCHAIN_HAS_THREADS
	select BR2_PACKAGE_IBRCOMMON
	help
	  IBR-DTN is a small dtn application that supports:
	  Bundle Protocol RFC 5050
	  Bundle Security Protocol RFC 6257

	  This package contains the ibrdtn library.

	  http://trac.ibr.cs.tu-bs.de/project-cm-2012-ibrdtn

comment "ibrdtn needs a toolchain w/ C++, threads"
	depends on !BR2_INSTALL_LIBSTDCPP || !BR2_TOOLCHAIN_HAS_THREADS
```

## package.bak/igd2-for-linux/Config.in
```kconfig
config BR2_PACKAGE_IGD2_FOR_LINUX
	bool "igd2-for-linux"
	depends on BR2_USE_MMU # fork()
	depends on BR2_TOOLCHAIN_HAS_THREADS
	depends on BR2_USE_WCHAR
	select BR2_PACKAGE_IPTABLES # runtime
	select BR2_PACKAGE_LIBUPNP
	help
	  This is The Linux UPnP Internet Gateway Device 2. It is
	  modified from the original Linux UPnP Internet Gateway Device
	  [http://linux-igd.sourceforge.net/] according to UPnP
	  InternetGatewayDevice:2 specifications.

	  It implements the UPnP Internet Gateway Device version 2
	  specification (IGDv2) and allows UPnP aware clients, such as
	  MSN Messenger, Azureus or Miranda to work properly from behind
	  a NAT firewall.

	  Please edit /etc/upnpd.conf before using upnpd!

	  https://github.com/ffontaine/igd2-for-linux

comment "igd2-for-linux needs a toolchain w/ threads, wchar"
	depends on BR2_USE_MMU
	depends on !BR2_TOOLCHAIN_HAS_THREADS || !BR2_USE_WCHAR
```

## package.bak/igh-ethercat/Config.in
```kconfig
comment "igh-ethercat needs a Linux kernel to be built"
	depends on !BR2_LINUX_KERNEL

config BR2_PACKAGE_IGH_ETHERCAT
	bool "igh-ethercat"
	depends on BR2_LINUX_KERNEL
	help
	  IgH EtherCAT Master for Linux.

	  http://www.etherlab.org/en/ethercat/index.php

if BR2_PACKAGE_IGH_ETHERCAT

config BR2_PACKAGE_IGH_ETHERCAT_8139TOO
	bool "8139too driver"

config BR2_PACKAGE_IGH_ETHERCAT_E100
	bool "e100 driver"

config BR2_PACKAGE_IGH_ETHERCAT_E1000
	bool "e1000 driver"

config BR2_PACKAGE_IGH_ETHERCAT_E1000E
	bool "e1000e driver"

config BR2_PACKAGE_IGH_ETHERCAT_R8169
	bool "r8169 driver"

endif
```

## package.bak/input-event-daemon/Config.in
```kconfig
config BR2_PACKAGE_INPUT_EVENT_DAEMON
	bool "input-event-daemon"
	# Uses fork()
	depends on BR2_USE_MMU
	help
	  input-event-daemon is a daemon which executes
	  a user-defined command on input events, such as
	  keys, mouse buttons and switches.

	  http://github.com/gandro/input-event-daemon
```

## package.bak/ipmiutil/Config.in
```kconfig
config BR2_PACKAGE_IPMIUTIL
	bool "ipmiutil"
	depends on BR2_USE_MMU
	depends on !BR2_STATIC_LIBS
	depends on BR2_TOOLCHAIN_HAS_THREADS
	depends on BR2_x86_64 || BR2_i386
	help
	  The ipmiutil package provides easy-to-use utilities to view
	  the SEL, perform an IPMI chassis reset, set up the IPMI LAN
	  and Platform Event Filter entries to allow SNMP alerts,
	  Serial-Over-LAN console, event daemon, and other IPMI tasks.

	  http://ipmiutil.sourceforge.net/

comment "ipmiutil needs a toolchain w/ threads, dynamic library"
	depends on BR2_USE_MMU
	depends on !BR2_TOOLCHAIN_HAS_THREADS || BR2_STATIC_LIBS
	depends on BR2_x86_64 || BR2_i386
```

## package.bak/iptraf-ng/Config.in
```kconfig
config BR2_PACKAGE_IPTRAF_NG
	bool "iptraf-ng"
	depends on BR2_USE_MMU # fork()
	select BR2_PACKAGE_NCURSES
	help
	  IPTraf-ng is a ncurses-based network monitoring utility. It gathers
	  data like TCP connection packet and byte counts, interface statistics
	  and activity indicators.

	  https://fedorahosted.org/iptraf-ng/

	  IPTraf-ng is a fork of original IPTraf v3.0.0 (http://iptraf.seul.org).
```

## package.bak/irda-utils/Config.in
```kconfig
config BR2_PACKAGE_IRDA_UTILS
	bool "irda-utils"
	help
	  user space utilities which control the IrDA stack

	  http://irda.sourceforge.net/

if BR2_PACKAGE_IRDA_UTILS

config BR2_PACKAGE_IRDA_UTILS_IRATTACH
	bool "irattach"

config BR2_PACKAGE_IRDA_UTILS_IRDAPING
	bool "irdaping"

config BR2_PACKAGE_IRDA_UTILS_IRNETD
	bool "irnetd"

endif
```

## package.bak/jamvm/Config.in
```kconfig
config BR2_PACKAGE_JAMVM
	bool "jamvm"
	depends on BR2_TOOLCHAIN_HAS_THREADS
	depends on !BR2_STATIC_LIBS
	depends on BR2_arm || BR2_armeb || BR2_i386 || BR2_x86_64 \
		|| BR2_mips || BR2_mipsel || BR2_powerpc
	depends on BR2_PACKAGE_CLASSPATH_ARCH_SUPPORTS
	select BR2_PACKAGE_ZLIB
	select BR2_PACKAGE_CLASSPATH
	help
	  JamVM is a new Java Virtual Machine which conforms to the
	  JVM specification version 2 (blue book).

	  http://jamvm.sf.net

comment "jamvm needs a toolchain w/ threads, dynamic library"
	depends on BR2_arm || BR2_armeb || BR2_i386 || BR2_x86_64 \
		|| BR2_mips || BR2_mipsel || BR2_powerpc
	depends on BR2_PACKAGE_CLASSPATH_ARCH_SUPPORTS
	depends on !BR2_TOOLCHAIN_HAS_THREADS || BR2_STATIC_LIBS
```

## package.bak/jasper/Config.in
```kconfig
config BR2_PACKAGE_JASPER
	bool "jasper"
	help
	  JPEG-2000 decoder

	  http://www.ece.uvic.ca/~mdadams/jasper/
```
