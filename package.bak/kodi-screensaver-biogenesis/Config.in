## package.bak/kodi-screensaver-biogenesis/Config.in
```kconfig
config BR2_PACKAGE_KODI_SCREENSAVER_BIOGENESIS
	bool "kodi-screensaver-biogenesis"
	depends on BR2_PACKAGE_HAS_LIBGL
	help
	  BioGenesis screensaver for Kodi

	  https://github.com/notspiff/screensaver.biogenesis

comment "kodi-screensaver-biogenesis needs OpenGL"
	depends on !BR2_PACKAGE_HAS_LIBGL
```

## package.bak/kodi-screensaver-matrixtrails/Config.in
```kconfig
config BR2_PACKAGE_KODI_SCREENSAVER_MATRIXTRAILS
	bool "kodi-screensaver-matrixtrails"
	depends on BR2_PACKAGE_HAS_LIBGL # libsoil
	select BR2_PACKAGE_LIBSOIL
	help
	  Matrix trails screensaver for Kodi

	  https://github.com/notspiff/screensaver.matrixtrails

comment "kodi-screensaver-matrixtrails needs OpenGL"
	depends on !BR2_PACKAGE_HAS_LIBGL
```

## package.bak/kodi-visualisation-goom/Config.in
```kconfig
config BR2_PACKAGE_KODI_VISUALISATION_GOOM
	bool "kodi-visualisation-goom"
	depends on BR2_PACKAGE_HAS_LIBGL
	help
	  GOOM visualiser for Kodi

	  https://github.com/notspiff/visualization.goom

comment "kodi-visualization-goom needs OpenGL"
	depends on !BR2_PACKAGE_HAS_LIBGL
```

## package.bak/kodi-visualisation-shadertoy/Config.in
```kconfig
config BR2_PACKAGE_KODI_VISUALISATION_SHADERTOY
	bool "kodi-visualisation-shadertoy"
	select BR2_PACKAGE_LIBGLEW if BR2_PACKAGE_HAS_LIBGL
	select BR2_PACKAGE_LIBPLATFORM
	help
	  Shadertoy visualiser for Kodi

	  https://github.com/notspiff/visualization.shadertoy
```

## package.bak/latencytop/Config.in
```kconfig
config BR2_PACKAGE_LATENCYTOP
	bool "latencytop"
	depends on BR2_USE_WCHAR # libglib2
	depends on BR2_TOOLCHAIN_HAS_THREADS # libglib2
	depends on BR2_USE_MMU # libglib2
	select BR2_PACKAGE_NCURSES
	select BR2_PACKAGE_LIBGLIB2
	help
	  There are many types and causes of latency. LatencyTOP
	  focuses on the type of latency that causes skips in audio,
	  stutters in your desktop experience or that overloads your
	  server (while you have plenty of CPU power left).

	  LatencyTOP focuses on the cases where the applications want
	  to run and execute useful code, but there's some resource
	  that's not currently available (and the kernel then blocks
	  the process). This is done both on a system level and on a
	  per process level, so that you can see what's happening to
	  the system, and which process is suffering and/or causing
	  the delays.

	  http://www.latencytop.org

comment "latencytop needs a toolchain w/ wchar, threads"
	depends on BR2_USE_MMU
	depends on !BR2_USE_WCHAR || !BR2_TOOLCHAIN_HAS_THREADS
```

## package.bak/lbase64/Config.in
```kconfig
config BR2_PACKAGE_LBASE64
	bool "lbase64"
	depends on BR2_PACKAGE_HAS_LUAINTERPRETER
	depends on BR2_PACKAGE_LUA_5_1 || BR2_PACKAGE_LUAJIT
	help
	  A base64 library for Lua

	  http://luaforge.net/projects/lbase64/

comment "lbase64 needs a Lua 5.1 interpreter"
	depends on !BR2_PACKAGE_LUA_5_1
	depends on !BR2_PACKAGE_LUAJIT
```

## package.bak/lcms2/Config.in
```kconfig
config BR2_PACKAGE_LCMS2
	bool "lcms2"
	help
	  Little Color Management Software (CMS) intends to be an OPEN
	  SOURCE small-footprint color management engine, with special
	  focus on accuracy and performance.
	  It uses the International Color Consortium standard (ICC), which is
	  the modern standard when regarding to color management.

	  http://www.littlecms.com/
```

## package.bak/libcec/Config.in
```kconfig
config BR2_PACKAGE_LIBCEC
	bool "libcec"
	depends on BR2_INSTALL_LIBSTDCPP
	depends on BR2_TOOLCHAIN_HAS_THREADS
	depends on BR2_USE_WCHAR
	depends on !BR2_STATIC_LIBS
	depends on BR2_TOOLCHAIN_GCC_AT_LEAST_4_7 # C++11
	select BR2_PACKAGE_LIBPLATFORM
	help
	  libcec allows you in combination with the right hardware to
	  control your home theater devices with your TV remote
	  control utilizing existing HDMI cabling.

	  http://libcec.pulse-eight.com

comment "libcec needs a toolchain w/ C++, wchar, threads, dynamic library, gcc >= 4.7"
	depends on !BR2_INSTALL_LIBSTDCPP || !BR2_TOOLCHAIN_HAS_THREADS || \
		!BR2_USE_WCHAR || !BR2_TOOLCHAIN_GCC_AT_LEAST_4_7 || \
		BR2_STATIC_LIBS
```

## package.bak/libdvdcss/Config.in
```kconfig
config BR2_PACKAGE_LIBDVDCSS
	bool "libdvdcss"
	help
	  libdvdcss is a simple library designed for accessing DVDs like
	  a block device without having to bother about the decryption.

	  http://www.videolan.org/developers/libdvdcss.html
```

## package.bak/libebur128/Config.in
```kconfig
config BR2_PACKAGE_LIBEBUR128
	bool "libebur128"
	# build system has no support to disable shared linking
	# leading to a build error with a static-only toolchain
	depends on !BR2_STATIC_LIBS
	select BR2_PACKAGE_SPEEX
	help
	  libebur128 is a library that implements the EBU R 128 standard
	  for loudness normalization.

	  https://github.com/jiixyj/libebur128

comment "libebur128 needs a toolchain w/ dynamic library"
	depends on BR2_STATIC_LIBS
```

## package.bak/libenca/Config.in
```kconfig
config BR2_PACKAGE_LIBENCA
	bool "libenca"
	help
	  Extremely Naive Charset Analyser

	  http://cihar.com/software/enca/
```

## package.bak/libevdev/Config.in
```kconfig
config BR2_PACKAGE_LIBEVDEV
	bool "libevdev"
	help
	  libevdev is a wrapper library for evdev devices

	  http://freedesktop.org/wiki/Software/libevdev/
```

## package.bak/libfcgi/Config.in
```kconfig
config BR2_PACKAGE_LIBFCGI
	bool "libfcgi"
	depends on BR2_USE_MMU # fork()
	help
	  FCGI, a fastcgi developer library for C/C++

	  http://www.fastcgi.com/
```

## package.bak/libfreefare/Config.in
```kconfig
config BR2_PACKAGE_LIBFREEFARE
	bool "libfreefare"
	depends on BR2_TOOLCHAIN_HAS_THREADS # libusb
	select BR2_PACKAGE_OPENSSL
	select BR2_PACKAGE_LIBNFC
	help
	  Library for high level manipulation of MIFARE cards.

	  http://nfc-tools.org/index.php?title=Libfreefare

comment "libfreefare needs a toolchain w/ threads"
	depends on !BR2_TOOLCHAIN_HAS_THREADS
```

## package.bak/libfuse/Config.in
```kconfig
config BR2_PACKAGE_LIBFUSE
	bool "libfuse"
	# Really doesn't like static, see fuse/lib/fuse.c
	depends on !BR2_STATIC_LIBS
	depends on BR2_TOOLCHAIN_HAS_THREADS
	depends on BR2_USE_MMU # fork()
	help
	  FUSE (Filesystem in UserSpacE)

	  https://github.com/libfuse/libfuse

comment "libfuse needs a toolchain w/ threads, dynamic library"
	depends on BR2_USE_MMU
	depends on !BR2_TOOLCHAIN_HAS_THREADS || BR2_STATIC_LIBS
```

## package.bak/libglew/Config.in
```kconfig
config BR2_PACKAGE_LIBGLEW
	bool "libglew"
	depends on BR2_PACKAGE_XORG7
	depends on BR2_PACKAGE_HAS_LIBGL
	select BR2_PACKAGE_XLIB_LIBX11
	select BR2_PACKAGE_XLIB_LIBXEXT
	select BR2_PACKAGE_XLIB_LIBXI
	select BR2_PACKAGE_XLIB_LIBXMU
	help
	  The OpenGL Extension Wrangler Library (GLEW) is a cross-platform C/C++
	  extension loading library. GLEW provides efficient run-time mechanisms
	  for determining which OpenGL extensions are supported on the target
	  platform. OpenGL core and extension functionality is exposed in a
	  single header file.

	  http://glew.sourceforge.net

comment "libglew depends on X.org and needs an OpenGL backend"
	depends on !BR2_PACKAGE_XORG7 || !BR2_PACKAGE_HAS_LIBGL
```

## package.bak/libglob/Config.in
```kconfig
config BR2_PACKAGE_LIBGLOB
	bool "libglob"
	help
	  OpenBSD implementation of glob(3).
```

## package.bak/libical/Config.in
```kconfig
config BR2_PACKAGE_LIBICAL
	bool "libical"
	depends on BR2_INSTALL_LIBSTDCPP
	depends on !BR2_STATIC_LIBS
	depends on BR2_USE_WCHAR
	select BR2_TARGET_TZ_INFO
	help
	  libical is an Open Source (MPL/LGPL) implementation of the IETF's
	  iCalendar Calendaring and Scheduling protocols.

	  http://libical.github.io/libical

comment "libical needs a toolchain w/ C++, dynamic library, wchar"
	depends on !BR2_INSTALL_LIBSTDCPP || !BR2_USE_WCHAR || \
		BR2_STATIC_LIBS
```

## package.bak/libilbc/Config.in
```kconfig
config BR2_PACKAGE_LIBILBC
	bool "libilbc"
	help
	  iLBC (internet Low Bitrate Codec) is a FREE speech codec
	  suitable for robust voice communication over IP.

	  http://www.webrtc.org/license-rights/ilbc-freeware
```

## package.bak/libimxvpuapi/Config.in
```kconfig
comment "libimxvpuapi needs an i.MX platform with VPU support"
	depends on BR2_arm
	depends on !BR2_PACKAGE_FREESCALE_IMX_HAS_VPU

config BR2_PACKAGE_LIBIMXVPUAPI
	bool "libimxvpuapi"
	depends on BR2_arm # Only relevant for i.MX
	depends on BR2_PACKAGE_FREESCALE_IMX_HAS_VPU
	select BR2_PACKAGE_IMX_VPU
	help
	  This library provides an API for using the iMX6 VPU video
	  engine. It is an alternative to Freescale's VPU
	  wrapper. Both the wrapper and this library are layered on
	  top of imx-vpu, the low-level iMX6 VPU interface.

	  https://github.com/Freescale/libimxvpuapi
```

## package.bak/libinput/Config.in
```kconfig
config BR2_PACKAGE_LIBINPUT
	bool "libinput"
	depends on BR2_ENABLE_LOCALE
	depends on BR2_PACKAGE_HAS_UDEV
	select BR2_PACKAGE_LIBEVDEV
	select BR2_PACKAGE_MTDEV
	help
	  libinput is a library to handle input devices in Wayland
	  compositors and to provide a generic X.Org input driver.
	  It provides device detection, device handling, input device
	  event processing and abstraction so minimize the amount of
	  custom input code compositors need to provide the common
	  set of functionality that users expect.

	  http://freedesktop.org/wiki/Software/libinput/

comment "libinput needs udev /dev management and a toolchain w/ locale"
	depends on !BR2_PACKAGE_HAS_UDEV || !BR2_ENABLE_LOCALE
```

## package.bak/libite/Config.in
```kconfig
config BR2_PACKAGE_LIBITE
	bool "libite"
	help
	  Libite is a lightweight library of frog DNA. It can be used
	  to fill the gaps in any dinosaur project. It holds useful
	  functions and macros developed by both Finit and the OpenBSD
	  project. Most notably the string functions: strlcpy(3),
	  strlcat(3) and the highly useful *BSD sys/queue.h and
	  sys/tree.h API's.

	  Libite is the frog DNA missing in GNU libc. However, -lite
	  does not aim to become another GLIB! One noticeable gap in
	  GLIBC is the missing _SAFE macros in the BSD sys/queue.h API
	  - highly recommended when traversing lists to delete/free
	  nodes.

	  https://github.com/troglobit/libite
```

## package.bak/libksba/Config.in
```kconfig
config BR2_PACKAGE_LIBKSBA
	bool "libksba"
	depends on BR2_PACKAGE_LIBGPG_ERROR_ARCH_SUPPORTS # libgpg-error
	select BR2_PACKAGE_LIBGPG_ERROR
	help
	  CMS and X.509 library

	  https://www.gnupg.org/related_software/libksba/
```

## package.bak/liblog4c-localtime/Config.in
```kconfig
config BR2_PACKAGE_LIBLOG4C_LOCALTIME
	bool "liblog4c-localtime"
	select BR2_PACKAGE_EXPAT
	help
	  Log4c is a library of C for flexible logging to files, syslog
	  and other destinations.
	  This version is with localtime patch, to make lib show times in
	  local timezone.

	  https://github.com/rcmadruga/log4c-localtime
	  http://log4c.sourceforge.net/
```

## package.bak/libmicrohttpd/Config.in
```kconfig
config BR2_PACKAGE_LIBMICROHTTPD
	bool "libmicrohttpd"
	depends on BR2_TOOLCHAIN_HAS_THREADS
	help
	  GNU libmicrohttpd is a small C library that makes it easy to
	  run an HTTP server as part of another application.

	  http://www.gnu.org/software/libmicrohttpd/

if BR2_PACKAGE_LIBMICROHTTPD

config BR2_PACKAGE_LIBMICROHTTPD_SSL
	bool "https support"
	depends on BR2_PACKAGE_LIBGPG_ERROR_ARCH_SUPPORTS # libgcrypt
	depends on BR2_USE_WCHAR
	select BR2_PACKAGE_GNUTLS
	select BR2_PACKAGE_LIBGCRYPT
	help
	  Enable HTTPS (SSL) support.

comment "libmicrohttpd https support needs a toolchain w/ wchar"
	depends on !BR2_USE_WCHAR

endif

comment "libmicrohttpd needs a toolchain w/ threads"
	depends on !BR2_TOOLCHAIN_HAS_THREADS
```
