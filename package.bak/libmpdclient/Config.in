## package.bak/libmpdclient/Config.in
```kconfig
config BR2_PACKAGE_LIBMPDCLIENT
	bool "libmpdclient"
	help
	  A stable, documented, asynchronous API library for interfacing MPD
	  in the C, C++ & Objective C languages.

	  http://www.musicpd.org/libs/libmpdclient/
```

## package.bak/libogg/Config.in
```kconfig
config BR2_PACKAGE_LIBOGG
	bool "libogg"
	help
	  Ogg is a multimedia container format, and the native file
	  and stream format for the Xiph.org multimedia codecs. As
	  with all Xiph.org technology is it an open format free for
	  anyone to use.

	  http://xiph.org/ogg/
```

## package.bak/libpthsem/Config.in
```kconfig
config BR2_PACKAGE_LIBPTHSEM
	bool "libpthsem"
	depends on BR2_USE_MMU # fork()
	help
	  GNU pth is a user mode multi threading library. pthsem is an extend
	  version, with support for semaphores added.

	  http://www.auto.tuwien.ac.at/~mkoegler/pth/

if BR2_PACKAGE_LIBPTHSEM

config BR2_PACKAGE_LIBPTHSEM_COMPAT
	bool "libpth compatibility"
	help
	  This option enables the compatibility with the original
	  libpth library.

endif
```

## package.bak/libraw1394/Config.in
```kconfig
config BR2_PACKAGE_LIBRAW1394
	bool "libraw1394"
	help
	  libraw1394 provides direct access to the IEEE 1394 bus through
	  the Linux 1394 subsystem's raw1394 user space interface.

	  http://sourceforge.net/projects/libraw1394/
```

## package.bak/libsepol/Config.in
```kconfig
config BR2_PACKAGE_LIBSEPOL
	bool "libsepol"
	help
	  Libsepol is the binary policy manipulation library. It doesn't
	  depend upon or use any of the other SELinux components.

	  http://selinuxproject.org/page/Main_Page
```

## package.bak/libserialport/Config.in
```kconfig
config BR2_PACKAGE_LIBSERIALPORT
	bool "libserialport"
	help
	  Libserialport is a minimal, cross-platform shared
	  library written in C that is intended to take care
	  of the OS-specific details when writing software
	  that uses serial ports.

	  http://sigrok.org/wiki/Libserialport
```

## package.bak/libsha1/Config.in
```kconfig
config BR2_PACKAGE_LIBSHA1
	bool "libsha1"
	help
	  libsha1 is a tiny library providing SHA1 implementation,
	  created for facilitating X server compilation on devices
	  when larger libraries containing SHA1 implementations
	  (OpenSSL, Mozilla NSS) are not needed.

	  https://github.com/dottedmag/libsha1
```

## package.bak/libshairplay/Config.in
```kconfig
config BR2_PACKAGE_LIBSHAIRPLAY
	bool "libshairplay"
	depends on BR2_TOOLCHAIN_HAS_THREADS
	depends on BR2_USE_MMU # avahi
	depends on !BR2_STATIC_LIBS # avahi
	select BR2_PACKAGE_AVAHI
	select BR2_PACKAGE_AVAHI_DAEMON
	select BR2_PACKAGE_AVAHI_LIBDNSSD_COMPATIBILITY # runtime
	help
	  libshairplay is a client library that emulates an airplay
	  server.

	  https://github.com/juhovh/shairplay

comment "libshairplay needs a toolchain w/ threads, dynamic library"
	depends on BR2_USE_MMU
	depends on !BR2_TOOLCHAIN_HAS_THREADS || BR2_STATIC_LIBS
```

## package.bak/libsigsegv/Config.in
```kconfig
config BR2_PACKAGE_LIBSIGSEGV_ARCH_SUPPORTS
	bool
	# with glibc/musl, ucontext is available for all supported
	# architectures
	default y if BR2_TOOLCHAIN_USES_GLIBC
	default y if BR2_TOOLCHAIN_USES_MUSL
	# with uclibc, ucontext is only available for a subset of the
	# supported architectures
	default y if BR2_TOOLCHAIN_USES_UCLIBC && \
		(BR2_ARM_CPU_HAS_ARM || BR2_i386 || \
		 BR2_mips || BR2_mipsel || BR2_mips64 || BR2_mips64el || \
		 BR2_sparc || BR2_x86_64)

config BR2_PACKAGE_LIBSIGSEGV
	bool "libsigsegv"
	depends on BR2_PACKAGE_LIBSIGSEGV_ARCH_SUPPORTS
	help
	  Library for handling page faults in user mode.

	  http://www.gnu.org/software/libsigsegv/
```

## package.bak/libsvg-cairo/Config.in
```kconfig
config BR2_PACKAGE_LIBSVG_CAIRO
	bool "libsvg-cairo"
	select BR2_PACKAGE_CAIRO
	select BR2_PACKAGE_CAIRO_SVG
	select BR2_PACKAGE_LIBSVG
	help
	  Libsvg-cairo provides the ability to render SVG content from
	  files or buffers. All rendering is performed using the cairo
	  rendering library.

	  http://cairographics.org
```

## package.bak/libuci/Config.in
```kconfig
config BR2_PACKAGE_LIBUCI
	bool "libuci"
	depends on !BR2_STATIC_LIBS
	select BR2_PACKAGE_LIBUBOX
	help
	  This library originates from the OpenWrt project to
	  handle the configuration file infrastructure, but can
	  also be used for the same purposes in projects other
	  than OpenWrt.

	  This package will also install CLI tool uci.

	  http://wiki.openwrt.org/doc/techref/uci

comment "libuci needs a toolchain w/ dynamic library"
	depends on BR2_STATIC_LIBS
```

## package.bak/libunistring/Config.in
```kconfig
config BR2_PACKAGE_LIBUNISTRING
	bool "libunistring"
	depends on BR2_USE_WCHAR
	help
	  The libunistring library provides functions for manipulating
	  Unicode strings and for manipulating C strings according to
	  the Unicode standard.

	  http://www.gnu.org/software/libunistring/

comment "libunistring needs a toolchain w/ wchar"
	depends on !BR2_USE_WCHAR
```

## package.bak/libv4l/Config.in
```kconfig
config BR2_PACKAGE_LIBV4L
	bool "libv4l"
	depends on BR2_TOOLCHAIN_HAS_THREADS
	depends on BR2_USE_MMU # fork()
	depends on !BR2_STATIC_LIBS # dlopen()
	depends on BR2_INSTALL_LIBSTDCPP
	depends on BR2_TOOLCHAIN_HEADERS_AT_LEAST_3_0 # media headers
	select BR2_PACKAGE_ARGP_STANDALONE if BR2_TOOLCHAIN_USES_UCLIBC || BR2_TOOLCHAIN_USES_MUSL
	select BR2_PACKAGE_LIBICONV if !BR2_ENABLE_LOCALE
	help
	  libv4l is a collection of libraries which adds a thin abstraction
	  layer on top of video4linux2 devices. libv4l consists of 3 different
	  libraries: libv4lconvert, libv4l1 and libv4l2.

	  http://linuxtv.org/wiki/index.php/V4l-utils

if BR2_PACKAGE_LIBV4L

comment "libv4l JPEG support not enabled"
	depends on !BR2_PACKAGE_JPEG

config BR2_PACKAGE_LIBV4L_UTILS
	bool "v4l-utils tools"
	depends on BR2_ENABLE_LOCALE
	select BR2_PACKAGE_GETTEXT if BR2_NEEDS_GETTEXT_IF_LOCALE
	help
	  v4l-utils is a collection of various video4linux and DVB utilities.
	  Enable this if you want to build the following tools:
	  - cx18-ctl
	  - dvb-fe-tool, dvbv5-zap, dvbv5-scan, dvb-format-convert
	  - decode_tm6000
	  - ir-keytable
	  - media-ctl
	  - v4l2-compliance
	  - v4l2-ctl, cx18-ctl, ivtv-ctl
	  - v4l2-sysfs-path
	  - rds-ctl
	  - qv4l2 (if Qt is enabled)

comment "libv4l-utils tools need a toolchain w/ locale"
	depends on !BR2_ENABLE_LOCALE

endif

comment "libv4l needs a toolchain w/ threads, dynamic library, C++ and headers >= 3.0"
	depends on BR2_USE_MMU
	depends on !BR2_TOOLCHAIN_HAS_THREADS || BR2_STATIC_LIBS \
		|| !BR2_INSTALL_LIBSTDCPP || !BR2_TOOLCHAIN_HEADERS_AT_LEAST_3_0
```

## package.bak/libvncserver/Config.in
```kconfig
config BR2_PACKAGE_LIBVNCSERVER
	bool "libvncserver"
	depends on BR2_USE_MMU # VNCommand.c uses fork()
	# binutils issue (bad expression)
	depends on !BR2_nios2
	help
	  libvncserver is a VNC server/client library.

	  http://libvncserver.sourceforge.net/

if BR2_PACKAGE_LIBVNCSERVER

config BR2_PACKAGE_LIBVNCSERVER_TIGHTPNG
	bool "TightPNG encoding support"
	select BR2_PACKAGE_JPEG
	select BR2_PACKAGE_LIBPNG
	help
	  TightPNG encoding speeds up HTML5 based VNC clients like
	  noVNC.

	  http://wiki.qemu.org/VNC_Tight_PNG

endif
```

## package.bak/libvpx/Config.in
```kconfig
config BR2_PACKAGE_LIBVPX
	bool "libvpx"
	depends on !BR2_bfin
	depends on BR2_TOOLCHAIN_HAS_THREADS
	help
	  A high-quality, open video format that's freely available to
	  everyone. Supports the VP8 and VP9 formats.

	  http://webmproject.org

comment "libvpx needs a toolchain w/ threads"
	depends on !BR2_bfin
	depends on !BR2_TOOLCHAIN_HAS_THREADS
```

## package.bak/linux-syscall-support/Config.in
```kconfig
config BR2_PACKAGE_LINUX_SYSCALL_SUPPORT
	bool "linux-syscall-support (lss)"
	help
	  This project provides a header file that can be included into
	  your application whenever you need to make direct system
	  calls.

	  https://chromium.googlesource.com/linux-syscall-support/
```

## package.bak/log4cxx/Config.in
```kconfig
config BR2_PACKAGE_LOG4CXX
	bool "log4cxx"
	select BR2_PACKAGE_APR
	select BR2_PACKAGE_APR_UTIL
	# apr really needs shared library support
	depends on !BR2_STATIC_LIBS
	depends on BR2_INSTALL_LIBSTDCPP
	depends on BR2_TOOLCHAIN_HAS_THREADS
	depends on BR2_USE_MMU # apr
	help
	  Apache log4cxx is a logging framework for C++ patterned
	  after Apache log4j.

	  https://logging.apache.org/log4cxx/

comment "log4cxx needs a toolchain w/ C++, threads, dynamic library"
	depends on !BR2_INSTALL_LIBSTDCPP || !BR2_TOOLCHAIN_HAS_THREADS || \
		BR2_STATIC_LIBS
	depends on BR2_USE_MMU
```

## package.bak/lshw/Config.in
```kconfig
config BR2_PACKAGE_LSHW
	bool "lshw"
	depends on BR2_INSTALL_LIBSTDCPP
	depends on BR2_USE_WCHAR
	select BR2_PACKAGE_GETTEXT if BR2_NEEDS_GETTEXT_IF_LOCALE
	help
	  lshw (Hardware Lister) is a small tool to provide
	  detailed information on the hardware configuration of the machine.

	  http://ezix.org/project/wiki/HardwareLiSter

comment "lshw needs a toolchain w/ C++, wchar"
	depends on !BR2_INSTALL_LIBSTDCPP || !BR2_USE_WCHAR
```

## package.bak/lttng-babeltrace/Config.in
```kconfig
config BR2_PACKAGE_LTTNG_BABELTRACE
	bool "lttng-babeltrace"
	select BR2_PACKAGE_UTIL_LINUX
	select BR2_PACKAGE_UTIL_LINUX_LIBUUID
	select BR2_PACKAGE_LIBGLIB2
	select BR2_PACKAGE_POPT
	depends on BR2_USE_WCHAR # libglib2
	depends on BR2_TOOLCHAIN_HAS_THREADS # libglib2
	depends on BR2_USE_MMU # libglib2
	help
	  The Babeltrace project provides trace read and write
	  libraries, as well as a trace converter application. Plugins
	  can be created for any trace format to allow its conversion
	  to/from another trace format.

	  Babeltrace is the reference implementation of the Common
	  Trace Format (see <http://diamon.org/ctf/>). Babeltrace
	  can decode and display LTTng traces, since the latter are
	  written using the CTF format.

	  To get support for debugging information, enable the
	  elfutils package.

	  Having this tool on the target is not mandatory. You can
	  transfer the binary trace output from the target to your
	  development workstation, and use babeltrace here.

	  See the lttng-babeltrace host utility to install Babeltrace
	  on the host.

	  http://diamon.org/babeltrace

comment "lttng-babeltrace needs a toolchain w/ wchar, threads"
	depends on BR2_USE_MMU
	depends on !BR2_USE_WCHAR || !BR2_TOOLCHAIN_HAS_THREADS
```

## package.bak/lttng-babeltrace/Config.in.host
```kconfig
config BR2_PACKAGE_HOST_LTTNG_BABELTRACE
	bool "host lttng-babeltrace"
	help
	  The Babeltrace project provides trace read and write
	  libraries, as well as a trace converter application. Plugins
	  can be created for any trace format to allow its conversion
	  to/from another trace format.

	  Babeltrace is the reference implementation of the Common
	  Trace Format (see <http://diamon.org/ctf/>). Babeltrace
	  can decode and display LTTng traces, since the latter are
	  written using the CTF format.

	  http://diamon.org/babeltrace
```

## package.bak/lttng-libust/Config.in
```kconfig
config BR2_PACKAGE_LTTNG_LIBUST
	bool "lttng-libust"
	select BR2_PACKAGE_LIBURCU
	select BR2_PACKAGE_UTIL_LINUX
	select BR2_PACKAGE_UTIL_LINUX_LIBUUID
	depends on BR2_USE_WCHAR # uses wchar_t
	# liburcu only works on some architectures and requires threads support"
	depends on BR2_PACKAGE_LIBURCU_ARCH_SUPPORTS
	depends on BR2_TOOLCHAIN_HAS_THREADS
	depends on !BR2_STATIC_LIBS
	help
	  Userspace tracing library for the LTTng 2.x tracing
	  infrastructure. It allows userspace programs to create
	  custom trace events that are integrated with all other
	  events gathered by LTTng.

	  http://lttng.org

comment "lttng-libust needs a toolchain w/ dynamic library, wchar, threads"
	depends on BR2_PACKAGE_LIBURCU_ARCH_SUPPORTS
	depends on BR2_STATIC_LIBS || !BR2_USE_WCHAR || !BR2_TOOLCHAIN_HAS_THREADS
```

## package.bak/lunit/Config.in
```kconfig
config BR2_PACKAGE_LUNIT
	bool "lunit"
	depends on BR2_PACKAGE_LUA_5_1 || BR2_PACKAGE_LUAJIT
	help
	  A unit testing framework for Lua.

	  http://www.mroth.net/lunit/

comment "lunit needs a Lua 5.1 interpreter"
	depends on !BR2_PACKAGE_LUA_5_1
	depends on !BR2_PACKAGE_LUAJIT
```

## package.bak/lzop/Config.in
```kconfig
config BR2_PACKAGE_LZOP
	bool "lzop"
	select BR2_PACKAGE_LZO
	help
	  lzop is a file compressor which is very similar to gzip.
	  lzop uses the LZO data compression library for compression services.

	  http://www.lzop.org/
```

## package.bak/memtest86/Config.in
```kconfig
config BR2_PACKAGE_MEMTEST86
	bool "memtest86"
	depends on BR2_i386 || BR2_x86_64
	help
	  Memtest86+ is a bootable standalone memory test program.

	  Buildroot does not support packages with a '+' sign in their
	  name, which explains why it is named memtest86 and not
	  memtest86+.

	  Memtest86+ is a utility designed to test whether your memory
	  is in working order. It repeatedly writes an enormous amount
	  of different patterns to all memory locations and reads them
	  back again and verifies whether the result of the read is the
	  same as what was written to memory.

	  Memtest86+ will only work on 32-bit or 64-bit x86 targets.
	  It boots as an i486 program and autodetects hardware. It can
	  be added to the grub2 boot menu by adding the following lines
	  to the bottom of /boot/grub/grub.cfg - note the use of linux16.

	  menuentry "Memtest86+" {
		 linux16 /boot/memtest86+.bin
	  }

	  Other boot loaders will have similar requirements.

	  http://www.memtest.org
```

## package.bak/mfgtools/Config.in.host
```kconfig
comment "mfgtools needs host gcc >= 4.8"
	depends on !BR2_HOST_GCC_AT_LEAST_4_8

config BR2_PACKAGE_HOST_MFGTOOLS
	bool "host mfgtools"
	depends on BR2_arm
	depends on BR2_HOST_GCC_AT_LEAST_4_8 # needs C++11
	help
	  This package contains the Freescale manufacturing tool.
	  It is designed to program firmware to i.MX boards during
	  production. The communication is done over USB using the
	  Freescale UTP protocol.

	  https://github.com/NXPmicro/mfgtools
```
