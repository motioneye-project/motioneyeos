## package.bak/ncmpc/Config.in
```kconfig
config BR2_PACKAGE_NCMPC
	bool "ncmpc"
	depends on BR2_USE_MMU # fork()
	depends on BR2_USE_WCHAR # libglib2 -> gettext
	depends on BR2_TOOLCHAIN_HAS_THREADS # libglib2
	select BR2_PACKAGE_LIBGLIB2
	select BR2_PACKAGE_LIBMPDCLIENT
	select BR2_PACKAGE_NCURSES
	help
	  ncmpc is a fully featured MPD client, which runs in a terminal
	  (using ncurses). Its goal is to provide a keyboard oriented
	  and consistent interface to MPD, without wasting resources.

	  http://www.musicpd.org/clients/ncmpc/

comment "ncmpc needs a toolchain w/ wchar, threads"
	depends on BR2_USE_MMU
	depends on !BR2_USE_WCHAR || !BR2_TOOLCHAIN_HAS_THREADS
```

## package.bak/neon/Config.in
```kconfig
config BR2_PACKAGE_NEON
	bool "libneon"
	help
	  HTTP and WebDAV client library, with a C interface.

	  http://www.webdav.org/neon/

if BR2_PACKAGE_NEON

config BR2_PACKAGE_NEON_ZLIB
	bool "ZLIB support"
	select BR2_PACKAGE_ZLIB
	help
	  build with ZLIB support

config BR2_PACKAGE_NEON_SSL
	bool "SSL support"
	select BR2_PACKAGE_OPENSSL
	help
	  build with SSL support

# This is an hidden symbol other packages can select to ensure that
# Neon has XML support, either provided by Expat or libxml2.
config BR2_PACKAGE_NEON_XML
	bool
	select BR2_PACKAGE_NEON_EXPAT if !BR2_PACKAGE_NEON_LIBXML2

config BR2_PACKAGE_NEON_EXPAT
	bool "XML support with expat"
	select BR2_PACKAGE_EXPAT
	depends on !BR2_PACKAGE_NEON_LIBXML2
	help
	  Enable XML support in neon, using the Expat XML library.

config BR2_PACKAGE_NEON_LIBXML2
	bool "XML support with libxml2"
	select BR2_PACKAGE_LIBXML2
	help
	  Enable XML support in neon, using the libxml2 XML library.

endif
```

## package.bak/netcat-openbsd/Config.in
```kconfig
config BR2_PACKAGE_NETCAT_OPENBSD
	bool "netcat-openbsd"
	select BR2_PACKAGE_LIBBSD
	depends on BR2_PACKAGE_LIBBSD_ARCH_SUPPORTS
	depends on BR2_TOOLCHAIN_HAS_THREADS
	depends on BR2_TOOLCHAIN_USES_GLIBC
	depends on BR2_PACKAGE_BUSYBOX_SHOW_OTHERS
	help
	  A simple Unix utility which reads and writes data across network
	  connections using TCP or UDP protocol. It is designed to be a
	  reliable "back-end" tool that can be used directly or easily driven
	  by other programs and scripts. At the same time it is a feature-rich
	  network debugging and exploration tool, since it can create almost
	  any kind of connection you would need and has several interesting
	  built-in capabilities.

	  This package contains the OpenBSD rewrite of netcat, including
	  support for IPv6, proxies, and Unix sockets.

	  https://packages.debian.org/sid/netcat-openbsd

comment "netcat-openbsd needs a glibc toolchain w/ threads"
	depends on BR2_PACKAGE_LIBBSD_ARCH_SUPPORTS
	depends on !BR2_TOOLCHAIN_HAS_THREADS || !BR2_TOOLCHAIN_USES_GLIBC
	depends on BR2_PACKAGE_BUSYBOX_SHOW_OTHERS
```

## package.bak/netstat-nat/Config.in
```kconfig
config BR2_PACKAGE_NETSTAT_NAT
	bool "netstat-nat"
	help
	  Displays NAT connections

	  http://tweegy.nl/projects/netstat-nat/
```

## package.bak/nginx-naxsi/Config.in
```kconfig
config BR2_PACKAGE_NGINX_NAXSI
	bool "nginx-naxsi"
	depends on BR2_PACKAGE_NGINX_HTTP
	# uses pcre, so nginx needs to be built with pcre support
	select BR2_PACKAGE_PCRE
	help
	  NAXSI means Nginx Anti XSS & SQL Injection.

	  Technically, it is a third party nginx module, available as
	  a package for many UNIX-like platforms. This module, by
	  default, reads a small subset of simple (and readable) rules
	  containing 99% of known patterns involved in website
	  vulnerabilities. For example, <, | or drop are not supposed
	  to be part of a URI.

	  Being very simple, those patterns may match legitimate
	  queries, it is the Naxsi's administrator duty to add
	  specific rules that will whitelist legitimate
	  behaviours. The administrator can either add whitelists
	  manually by analyzing nginx's error log, or (recommended)
	  start the project with an intensive auto-learning phase that
	  will automatically generate whitelisting rules regarding a
	  website's behaviour.

	  In short, Naxsi behaves like a DROP-by-default firewall, the
	  only task is to add required ACCEPT rules for the target
	  website to work properly.

	  https://github.com/nbs-system/naxsi
```

## package.bak/nginx-upload/Config.in
```kconfig
config BR2_PACKAGE_NGINX_UPLOAD
	bool "nginx-upload"
	depends on BR2_PACKAGE_NGINX_HTTP
	select BR2_PACKAGE_OPENSSL
	help
	  A module for nginx web server for handling file uploads
	  using multipart/form-data encoding (RFC 1867).

	  https://github.com/vkholodkov/nginx-upload-module
```

## package.bak/noip/Config.in
```kconfig
config BR2_PACKAGE_NOIP
	bool "noip"
	depends on BR2_USE_MMU # fork()
	help
	  Dynamic DNS update client for no-ip.com

	  http://www.no-ip.com/downloads.php
```

## package.bak/norm/Config.in
```kconfig
comment "norm needs a toolchain w/ C++, threads, dynamic library"
	depends on !BR2_INSTALL_LIBSTDCPP || BR2_STATIC_LIBS || \
		!BR2_TOOLCHAIN_HAS_THREADS

config BR2_PACKAGE_NORM
	bool "norm"
	depends on BR2_INSTALL_LIBSTDCPP
	depends on BR2_TOOLCHAIN_HAS_THREADS
	depends on !BR2_STATIC_LIBS
	help
	  The NORM protocol is designed to provide end-to-end reliable
	  transport of bulk data objects or streams over generic IP
	  multicast routing and forwarding services.

	  http://www.nrl.navy.mil/itd/ncs/products/norm
```

## package.bak/obsidian-cursors/Config.in
```kconfig
config BR2_PACKAGE_OBSIDIAN_CURSORS
	bool "obsidian-cursors"
	help
	  Obsidian Cursors is a shiny and clean cursor set.

	  http://kde-look.org/content/show.php/Obsidian+Cursors?content=73135
```

## package.bak/odroid-scripts/Config.in
```kconfig
config BR2_PACKAGE_ODROID_SCRIPTS
	bool "odroid-scripts"
	depends on BR2_aarch64 || BR2_arm
	select BR2_PACKAGE_FBSET # runtime
	select BR2_PACKAGE_BUSYBOX_SHOW_OTHERS # needed for fbset
	help
	  Install the scripts for the odroidc2 based systems.

	  https://github.com/mdrjr/c2_bootini
```

## package.bak/opentyrian/Config.in
```kconfig
config BR2_PACKAGE_OPENTYRIAN
	bool "OpenTyrian"
	select BR2_PACKAGE_SDL
	select BR2_PACKAGE_OPENTYRIAN_DATA
	help
	  OpenTyrian is a port of the DOS shoot-em-up Tyrian. It uses SDL,
	  making it easily cross-platform.
	  It requires the original data files to run.
	  A display with minimum 640x480 resolution and a keyboard are needed
	  to play the game.
	  If you want some sound, activate ALSA with OSS emulation.

	  https://bitbucket.org/opentyrian/opentyrian/wiki/Home

if BR2_PACKAGE_OPENTYRIAN

config BR2_PACKAGE_OPENTYRIAN_NET
	bool "network support"
	default y
	select BR2_PACKAGE_SDL_NET
	help
	  Activates network support in OpenTyrian. Will add SDL_net.

endif
```

## package.bak/openvpn/Config.in
```kconfig
config BR2_PACKAGE_OPENVPN
	bool "openvpn"
	depends on BR2_USE_MMU # fork()
	select BR2_PACKAGE_OPENSSL
	help
	  OpenVPN is a full-featured SSL VPN solution which can
	  accomodate a wide range of configurations, including road
	  warrior access, home/office/campus telecommuting, WiFi
	  security, secure branch office linking, and enterprise-scale
	  remote access solutions with load balancing, failover, and
	  fine-grained access-controls.

	  http://openvpn.net/

if BR2_PACKAGE_OPENVPN

config BR2_PACKAGE_OPENVPN_LZO
	bool "LZO compression"
	default y
	select BR2_PACKAGE_LZO
	help
	  Enable LZO compression.

config BR2_PACKAGE_OPENVPN_SMALL
	bool "Optimize for small size"
	help
	  Make OpenVPN as small as possible.
	  You loose eurephia, debugging info, help messages and more.
	  It saves around 100 KiB in binary file size.

endif
```
