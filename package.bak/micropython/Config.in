## package.bak/micropython/Config.in
```kconfig
config BR2_PACKAGE_MICROPYTHON
	bool "micropython"
	select BR2_PACKAGE_LIBFFI
	depends on BR2_TOOLCHAIN_HAS_THREADS
	depends on !BR2_STATIC_LIBS
	# libffi doesn't provide the closure implementation on Blackfin
	depends on !BR2_bfin
	help
	  Micro Python is a lean and fast implementation of the Python 3
	  programming language that is optimised to run on a microcontroller.

	  http://micropython.org

comment "micropython needs a toolchain w/ threads, dynamic library"
	depends on !BR2_TOOLCHAIN_HAS_THREADS || BR2_STATIC_LIBS
	depends on !BR2_bfin
```

## package.bak/minicom/Config.in
```kconfig
config BR2_PACKAGE_MINICOM
	bool "minicom"
	depends on BR2_USE_WCHAR
	depends on BR2_USE_MMU # fork
	select BR2_PACKAGE_LIBICONV if !BR2_ENABLE_LOCALE
	select BR2_PACKAGE_NCURSES
	help
	  Minicom is a menu driven communications program. It emulates
	  ANSI and VT102 terminals. It has a dialing directory and auto
	  zmodem download.

	  http://alioth.debian.org/projects/minicom/

comment "minicom needs a toolchain w/ wchar"
	depends on BR2_USE_MMU
	depends on !BR2_USE_WCHAR
```

## package.bak/minissdpd/Config.in
```kconfig
config BR2_PACKAGE_MINISSDPD
	bool "minissdpd"
	depends on BR2_USE_MMU # fork()
	select BR2_PACKAGE_LIBNFNETLINK
	help
	  SSDP managing daemon. Designed to work with miniupnpc,
	  miniupnpd, minidlna, etc.

	  http://miniupnp.free.fr/
```

## package.bak/mjpg-streamer/Config.in
```kconfig
config BR2_PACKAGE_MJPG_STREAMER
	bool "mjpg-streamer"
	depends on BR2_TOOLCHAIN_HEADERS_AT_LEAST_3_0 # linux/uvcvideo.h
	depends on BR2_TOOLCHAIN_HAS_THREADS
	depends on BR2_USE_MMU # fork()
	depends on !BR2_STATIC_LIBS # plugins need dlopen()
	select BR2_PACKAGE_JPEG
	help
	  MJPG-streamer takes JPGs from Linux-UVC compatible webcams,
	  filesystem or other input plugins and streams them as
	  M-JPEG via HTTP to webbrowsers, VLC and other software.

	  http://mjpg-streamer.sourceforge.net

comment "mjpg-streamer needs a toolchain w/ threads, headers >= 3.0, dynamic library"
	depends on BR2_USE_MMU
	depends on !BR2_TOOLCHAIN_HAS_THREADS || \
		!BR2_TOOLCHAIN_HEADERS_AT_LEAST_3_0 || BR2_STATIC_LIBS
```

## package.bak/mobile-broadband-provider-info/Config.in
```kconfig
config BR2_PACKAGE_MOBILE_BROADBAND_PROVIDER_INFO
	bool "mobile-broadband-provider-info"
	help
	  Mobile broadband provider database.

	  http://live.gnome.org/NetworkManager/MobileBroadband/ServiceProviders
```

## package.bak/mosquitto/Config.in
```kconfig
config BR2_PACKAGE_MOSQUITTO
	bool "mosquitto"
	depends on BR2_USE_MMU # fork()
	depends on BR2_TOOLCHAIN_HAS_SYNC_4
	depends on !BR2_STATIC_LIBS # builds .so
	help
	  Mosquitto is an open source message broker that implements
	  the MQ Telemetry Transport protocol versions 3.1 and
	  3.1.1. MQTT provides a lightweight method of carrying out
	  messaging using a publish/subscribe model. This makes it
	  suitable for "machine to machine" messaging such as with low
	  power sensors or mobile devices such as phones, embedded
	  computers or microcontrollers like the Arduino.

	  http://mosquitto.org/

comment "mosquitto needs a toolchain w/ dynamic library"
	depends on BR2_USE_MMU
	depends on BR2_TOOLCHAIN_HAS_SYNC_4
	depends on BR2_STATIC_LIBS
```

## package.bak/mpd/Config.in
```kconfig
menuconfig BR2_PACKAGE_MPD
	bool "mpd"
	depends on BR2_INSTALL_LIBSTDCPP
	depends on BR2_USE_WCHAR # flac
	depends on BR2_TOOLCHAIN_HAS_THREADS
	depends on BR2_USE_MMU # fork
	depends on BR2_TOOLCHAIN_HAS_ATOMIC
	# 0.19.x could be built with GCC 4.6, but for simplicity we require
	# the same toolchain dependencies for all versions.
	depends on BR2_TOOLCHAIN_GCC_AT_LEAST_4_9 # C++14
	select BR2_PACKAGE_BOOST
	select BR2_PACKAGE_LIBICONV if !BR2_ENABLE_LOCALE
	select BR2_PACKAGE_MPD_TREMOR if !(BR2_PACKAGE_MPD_MAD || BR2_PACKAGE_MPD_MPG123 || BR2_PACKAGE_MPD_VORBIS || BR2_PACKAGE_MPD_WAVPACK || BR2_PACKAGE_MPD_FLAC || BR2_PACKAGE_MPD_MUSEPACK || BR2_PACKAGE_MPD_FFMPEG)
	help
	  MPD is a flexible, powerful, server-side application
	  for playing music. Through plugins and libraries
	  it can play a variety of sound files while being
	  controlled by its network protocol.

	  http://www.musicpd.org

if BR2_PACKAGE_MPD

# Hidden config symbols to select the branch 0.20 by default and fallback
# to branch 0.19 for toolchains affected by GCC bug PR 64735. This way we
# keep support for mpd on some architectures, like ARMv5, until GCC 7 is
# released, which will fix this issue.
config BR2_PACKAGE_MPD_VERSION_STRING
	string
	default "0.20" if !BR2_TOOLCHAIN_HAS_GCC_BUG_64735
	default "0.19"

config BR2_PACKAGE_MPD_VERSION_0_20
	bool
	default y if BR2_PACKAGE_MPD_VERSION_STRING = "0.20"

config BR2_PACKAGE_MPD_VERSION_0_19
	bool
	default y if BR2_PACKAGE_MPD_VERSION_STRING = "0.19"
	select BR2_PACKAGE_LIBGLIB2

comment "Archive plugins"

config BR2_PACKAGE_MPD_BZIP2
	bool "bzip2"
	select BR2_PACKAGE_BZIP2
	help
	  Enable bzip2 archive support.

config BR2_PACKAGE_MPD_SQLITE
	bool "sqlite"
	select BR2_PACKAGE_SQLITE
	help
	  Enable sqlite database support.
	  If you don't use sqlite it will use an ASCII database.

comment "Converter plugins"

config BR2_PACKAGE_MPD_LIBSAMPLERATE
	bool "libsamplerate"
	select BR2_PACKAGE_LIBSAMPLERATE
	help
	  Enable libsamplerate input support.
	  Select this for software sample rate conversion.

config BR2_PACKAGE_MPD_LIBSOXR
	bool "libsoxr"
	select BR2_PACKAGE_LIBSOXR
	help
	  Enable libsoxr resampler support.
	  The SoX Resampler library performs software sample-rate
	  conversion.

comment "Decoder plugins"

config BR2_PACKAGE_MPD_AUDIOFILE
	bool "audiofile"
	select BR2_PACKAGE_AUDIOFILE
	help
	  Enable audiofile input/streaming support.
	  Select this if you want to play back WAV files.

config BR2_PACKAGE_MPD_DSD
	bool "dsd"
	help
	  Enable Digital Speech Decoder (DSD) support to play audio
	  files encoded in a digital speech format.

config BR2_PACKAGE_MPD_FAAD2
	bool "faad2"
	select BR2_PACKAGE_FAAD2
	help
	  Enable faad2 input support.
	  Select this if you want to play back MP4/AAC files.

config BR2_PACKAGE_MPD_FFMPEG
	bool "ffmpeg"
	depends on BR2_PACKAGE_FFMPEG_ARCH_SUPPORTS
	select BR2_PACKAGE_FFMPEG
	help
	  Enable ffmpeg input support.
	  Select this if you want to play back files supported by
	  ffmpeg.

config BR2_PACKAGE_MPD_FLAC
	bool "flac"
	select BR2_PACKAGE_FLAC
	help
	  Enable flac input/streaming support.
	  Select this if you want to play back FLAC files.

config BR2_PACKAGE_MPD_LIBSNDFILE
	bool "libsndfile"
	select BR2_PACKAGE_LIBSNDFILE
	help
	  Enable libsndfile input/streaming support.
	  Select this if you want to play back WAV files.

config BR2_PACKAGE_MPD_MAD
	bool "mad"
	default y
	select BR2_PACKAGE_LIBID3TAG
	select BR2_PACKAGE_LIBMAD
	help
	  Enable mad input support.
	  Select this if you want to play back MP3 files.

config BR2_PACKAGE_MPD_MPG123
	bool "mpg123"
	select BR2_PACKAGE_LIBID3TAG
	select BR2_PACKAGE_MPG123
	help
	  Enable mpg123 input support.
	  Select this if you want to play back MP3 files.

config BR2_PACKAGE_MPD_MUSEPACK
	bool "musepack"
	select BR2_PACKAGE_LIBCUEFILE
	select BR2_PACKAGE_LIBREPLAYGAIN
	select BR2_PACKAGE_MUSEPACK
	help
	  Enable musepack input support.
	  Select this if you want to play back MPC files.

config BR2_PACKAGE_MPD_OPUS
	bool "opus"
	select BR2_PACKAGE_OPUS
	select BR2_PACKAGE_LIBOGG
	help
	  Enable opus input support.
	  Select this if you want to play back OPUS encoded files.

config BR2_PACKAGE_MPD_TREMOR
	bool "tremor"
	select BR2_PACKAGE_LIBOGG
	select BR2_PACKAGE_TREMOR
	help
	  Enable vorbis input support.
	  Select this if you want to play back OGG files on softfloat
	  targets.

config BR2_PACKAGE_MPD_VORBIS
	bool "vorbis"
	select BR2_PACKAGE_LIBOGG
	select BR2_PACKAGE_LIBVORBIS
	help
	  Enable vorbis input/streaming support.
	  Select this if you want to play back OGG files on hardfloat
	  targets.

config BR2_PACKAGE_MPD_WAVPACK
	bool "wavpack"
	select BR2_PACKAGE_WAVPACK
	help
	  Enable wavpack input support.
	  Select this if you want to play back WV files.

comment "Encoder plugins"

config BR2_PACKAGE_MPD_LAME
	bool "lame"
	select BR2_PACKAGE_LAME
	help
	  Enable lame (mp3) encoding support.

config BR2_PACKAGE_MPD_TWOLAME
	bool "twolame"
	select BR2_PACKAGE_TWOLAME
	help
	  Enable TwoLAME mp2 encoding.

comment "Input plugins"

config BR2_PACKAGE_MPD_CURL
	bool "curl"
	select BR2_PACKAGE_LIBCURL
	help
	  Enable curl streaming (http) support.

config BR2_PACKAGE_MPD_LIBNFS
	bool "nfs"
	# libnfs -> libtirpc
	depends on BR2_TOOLCHAIN_HAS_NATIVE_RPC || BR2_TOOLCHAIN_HAS_THREADS
	select BR2_PACKAGE_LIBNFS
	help
	  Enable Network File System (NFS) support.

comment "nfs support needs a toolchain w/ threads support"
	depends on !(BR2_TOOLCHAIN_HAS_THREADS || BR2_TOOLCHAIN_HAS_NATIVE_RPC)

comment "samba support needs a glibc toolchain w/ dynamic library, RPC"
	depends on !BR2_nios2
	depends on !BR2_TOOLCHAIN_USES_GLIBC || BR2_STATIC_LIBS || \
		!BR2_TOOLCHAIN_HAS_NATIVE_RPC

config BR2_PACKAGE_MPD_LIBSMBCLIENT
	bool "samba"
	depends on !BR2_nios2 # samba
	depends on BR2_TOOLCHAIN_USES_GLIBC
	depends on !BR2_STATIC_LIBS
	depends on BR2_TOOLCHAIN_HAS_NATIVE_RPC
	depends on BR2_TOOLCHAIN_HAS_SYNC_4
	select BR2_PACKAGE_SAMBA4
	help
	  Enable Samba support.

config BR2_PACKAGE_MPD_SOUNDCLOUD
	bool "soundcloud"
	select BR2_PACKAGE_YAJL
	help
	  Enable soundcloud.com playlist support.

comment "Output plugins"

config BR2_PACKAGE_MPD_ALSA
	bool "alsa"
	default y
	select BR2_PACKAGE_ALSA_LIB
	select BR2_PACKAGE_ALSA_LIB_PCM
	select BR2_PACKAGE_ALSA_LIB_MIXER
	help
	  Enable alsa output support.

config BR2_PACKAGE_MPD_AO
	bool "ao"
	select BR2_PACKAGE_LIBAO
	help
	  Enable libao output support.

config BR2_PACKAGE_MPD_HTTPD_OUTPUT
	bool "httpd output"
	help
	  Enable httpd output support.

config BR2_PACKAGE_MPD_JACK2
	bool "jack2"
	depends on !BR2_STATIC_LIBS # jack2
	depends on BR2_TOOLCHAIN_HAS_SYNC_4
	select BR2_PACKAGE_JACK2
	help
	  Enable jack output support.

comment "jack support needs a toolchain w/ dynamic library"
	depends on BR2_TOOLCHAIN_HAS_SYNC_4
	depends on BR2_STATIC_LIBS

config BR2_PACKAGE_MPD_OSS
	bool "oss"
	help
	  Enable OSS (Open Sound System) output support.

config BR2_PACKAGE_MPD_PULSEAUDIO
	bool "pulseaudio"
	depends on !BR2_STATIC_LIBS # pulseaudio
	depends on BR2_TOOLCHAIN_HAS_SYNC_4 # pulseaudio -> json-c
	select BR2_PACKAGE_PULSEAUDIO
	help
	  Enable pulseaudio output support.

comment "pulseaudio support needs a toolchain w/ dynamic library"
	depends on BR2_TOOLCHAIN_HAS_SYNC_4
	depends on BR2_STATIC_LIBS

config BR2_PACKAGE_MPD_SHOUTCAST
	bool "shoutcast"
	select BR2_PACKAGE_LIBSHOUT
	help
	  Enable shoutcast streaming output support.

comment "Miscellaneous plugins"

config BR2_PACKAGE_MPD_AVAHI_SUPPORT
	bool "avahi (zeroconf) support"
	depends on !BR2_STATIC_LIBS # avahi
	select BR2_PACKAGE_AVAHI
	select BR2_PACKAGE_AVAHI_DAEMON
	select BR2_PACKAGE_AVAHI_LIBDNSSD_COMPATIBILITY
	help
	  Enable Avahi (zeroconf) support.
	  Select this for multicast DNS/DNS-SD service discovery
	  support. This allows MPD to publish service information on a
	  local network.

comment "avahi support needs a toolchain w/ dynamic library"
	depends on BR2_STATIC_LIBS

config BR2_PACKAGE_MPD_NEIGHBOR_DISCOVERY_SUPPORT
	bool "neighbor discovery support"
	depends on BR2_PACKAGE_MPD_LIBSMBCLIENT || BR2_PACKAGE_MPD_UPNP
	help
	  Enable support for neighbor discovery.
	  This option can be used in conjunction with the smbclient
	  plugin to provide a list of SMB/CIFS servers or with the
	  UPnP plugin to provide a list of UPnP servers on the local
	  network. The neighbor plugin needs configuration in
	  mpd.conf. For further information take a look at the MPD
	  documentation.

config BR2_PACKAGE_MPD_TCP
	bool "tcp sockets"
	default y
	help
	  Enable MPD to listen on tcp sockets.

	  You want this on if MPD and the client(s) work
	  on different machines (the usual scenario).

config BR2_PACKAGE_MPD_UPNP
	bool "UPnP"
	select BR2_PACKAGE_EXPAT
	select BR2_PACKAGE_LIBUPNP
	help
	  Enable MPD UPnP client support.

endif

comment "mpd needs a toolchain w/ C++, threads, wchar, gcc >= 4.9"
	depends on BR2_USE_MMU
	depends on BR2_TOOLCHAIN_HAS_ATOMIC
	depends on !BR2_INSTALL_LIBSTDCPP || !BR2_USE_WCHAR || \
		!BR2_TOOLCHAIN_HAS_THREADS || !BR2_TOOLCHAIN_GCC_AT_LEAST_4_9
```

## package.bak/mpfr/Config.in
```kconfig
config BR2_PACKAGE_MPFR
	bool "mpfr"
	select BR2_PACKAGE_GMP
	help
	  C library for multiple-precision floating-point computations
	  with exact rounding.

	  http://www.mpfr.org/
```

## package.bak/msr-tools/Config.in
```kconfig
config BR2_PACKAGE_MSR_TOOLS
	bool "msr-tools"
	depends on BR2_i386 || BR2_x86_64
	help
	  The MSR Tools project provides utilities to access x86
	  processor MSRs and CPU ID directly.

	  Those tools access the hardware through the
	  /dev/cpu/<cpu#>/msr and /dev/cpu/<cpu#>/cpuid devices. This
	  necessitates msr and cpuid support in the kernel, which
	  means you need a kernel compiled with configuration options
	  CONFIG_X86_CPUID and CONFIG_X86_MSR enabled.

	  https://01.org/msr-tools
```

## package.bak/musl/Config.in
```kconfig
config BR2_PACKAGE_MUSL
	bool
	depends on BR2_TOOLCHAIN_USES_MUSL
	default y
	select BR2_PACKAGE_LINUX_HEADERS
	# SSP broken on i386/ppc: http://www.openwall.com/lists/musl/2016/12/04/2
	select BR2_TOOLCHAIN_HAS_SSP if !(BR2_i386 || BR2_powerpc)
	# Compatibility headers: cdefs.h, queue.h
	select BR2_PACKAGE_MUSL_COMPAT_HEADERS
```

## package.bak/mxsldr/Config.in.host
```kconfig
config BR2_PACKAGE_HOST_MXSLDR
	bool "host mxsldr"
	depends on BR2_arm || BR2_armeb
	help
	  This package contains tools to download and execute code on
	  Freescale i.MX23 and i.MX28 SoC's through the Serial
	  Download Protocol.

	  git://git.denx.de/mxsldr.git
```

## package.bak/mysql/Config.in
```kconfig
config BR2_PACKAGE_MYSQL
	bool "mysql support"
	depends on BR2_INSTALL_LIBSTDCPP
	depends on BR2_USE_MMU # fork()
	depends on BR2_TOOLCHAIN_HAS_THREADS
	help
	  Select the desired mysql provider.

if BR2_PACKAGE_MYSQL

choice
	prompt "mysql variant"
	default BR2_PACKAGE_ORACLE_MYSQL
	help
	  Select either the oracle mysql server or the mariadb server

config BR2_PACKAGE_MARIADB
	bool "mariadb"
	depends on BR2_PACKAGE_LIBAIO_ARCH_SUPPORTS
	select BR2_PACKAGE_LIBAIO
	select BR2_PACKAGE_LIBXML2
	select BR2_PACKAGE_NCURSES
	select BR2_PACKAGE_OPENSSL
	select BR2_PACKAGE_READLINE
	select BR2_PACKAGE_HAS_MYSQL
	help
	  MariaDB is one of the most popular database servers in the world.
	  It's made by the original developers of MySQL and guaranteed to
	  stay open source.

	  http://www.mariadb.org/

config BR2_PACKAGE_ORACLE_MYSQL
	bool "oracle mysql"
	select BR2_PACKAGE_NCURSES
	select BR2_PACKAGE_READLINE
	select BR2_PACKAGE_HAS_MYSQL
	help
	  The MySQL Open Source Database System

	  http://www.mysql.com/

endchoice

if BR2_PACKAGE_MARIADB

config BR2_PACKAGE_MARIADB_SERVER
	bool "mariadb server"
	help
	  Install the mariadb server on the target.

endif

if BR2_PACKAGE_ORACLE_MYSQL

config BR2_PACKAGE_ORACLE_MYSQL_SERVER
	bool "oracle mysql server"
	help
	  Install the MySQL server on the target.

endif

config BR2_PACKAGE_HAS_MYSQL
	bool

config BR2_PACKAGE_PROVIDES_MYSQL
	string
	default "mariadb"      if BR2_PACKAGE_MARIADB
	default "oracle-mysql" if BR2_PACKAGE_ORACLE_MYSQL

endif

comment "mysql needs a toolchain w/ C++, threads"
	depends on BR2_USE_MMU
	depends on !BR2_INSTALL_LIBSTDCPP || !BR2_TOOLCHAIN_HAS_THREADS
```
