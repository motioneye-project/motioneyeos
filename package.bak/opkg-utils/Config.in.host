## package.bak/opkg-utils/Config.in.host
```kconfig
config BR2_PACKAGE_HOST_OPKG_UTILS
	bool "host opkg-utils"
	help
	  Helper scripts for use with the opkg package manager.

	  https://git.yoctoproject.org/cgit/cgit.cgi/opkg-utils/
```

## package.bak/orc/Config.in
```kconfig
config BR2_PACKAGE_ORC
	bool "orc"
	depends on BR2_TOOLCHAIN_HAS_THREADS
	depends on !BR2_BINFMT_FLAT # configure doesn't know uclinux
	help
	  Orc is a library and set of tools for compiling and executing
	  very simple programs that operate on arrays of data.

	  http://code.entropywave.com/projects/orc/

comment "orc needs a toolchain w/ threads"
	depends on !BR2_TOOLCHAIN_HAS_THREADS
	depends on !BR2_BINFMT_FLAT
```

## package.bak/ortp/Config.in
```kconfig
config BR2_PACKAGE_ORTP
	bool "oRTP"
	depends on BR2_INSTALL_LIBSTDCPP
	depends on BR2_TOOLCHAIN_HAS_THREADS
	select BR2_PACKAGE_BCTOOLBOX
	help
	  oRTP, a Real-time Transport Protocol (RTP,RFC3550) library

	  http://www.linphone.org/eng/documentation/dev/ortp.html

comment "ortp needs a toolchain w/ C++, threads"
	depends on !BR2_INSTALL_LIBSTDCPP || !BR2_TOOLCHAIN_HAS_THREADS
```

## package.bak/p7zip/Config.in
```kconfig
config BR2_PACKAGE_P7ZIP
	bool "p7zip"
	depends on BR2_INSTALL_LIBSTDCPP
	depends on BR2_TOOLCHAIN_HAS_THREADS
	depends on BR2_USE_WCHAR
	help
	  p7zip is a quick port of the command line version of 7-zip for Unix.
	  (see http://www.7-zip.org)

	  7-Zip is a file archiver with highest compression ratio.

	  http://sourceforge.net/projects/p7zip

comment "p7zip needs a toolchain w/ threads, wchar, C++"
	depends on !BR2_TOOLCHAIN_HAS_THREADS || !BR2_USE_WCHAR || !BR2_INSTALL_LIBSTDCPP
```

## package.bak/p910nd/Config.in
```kconfig
config BR2_PACKAGE_P910ND
	bool "p910nd"
	depends on BR2_USE_MMU # fork()
	help
	  p910nd is a small printer daemon intended for diskless
	  workstations. Using ports 9100-9102, it accepts
	  print jobs and passes them directly to a USB printer.

	  http://p910nd.sourceforge.net/
```

## package.bak/paho-mqtt-c/Config.in
```kconfig
config BR2_PACKAGE_PAHO_MQTT_C
	bool "paho-mqtt-c"
	depends on !BR2_STATIC_LIBS  # dlopen()
	depends on BR2_TOOLCHAIN_HAS_THREADS
	help
	  MQTT client C library

	  https://eclipse.org/paho/clients/c/

comment "paho-mqtt-c needs a toolchain w/ threads and dynamic library support"
	depends on BR2_STATIC_LIBS || !BR2_TOOLCHAIN_HAS_THREADS
```

## package.bak/parted/Config.in.host
```kconfig
config BR2_PACKAGE_HOST_PARTED
	bool "host parted"
	help
	  parted, the GNU partition resizing program

	  http://www.gnu.org/software/parted/
```

## package.bak/pdbg/Config.in
```kconfig
config BR2_PACKAGE_PDBG
	bool "pdbg"
	help
	  PowerPC FSI Debugger, for low level debugging of a IBM
	  Power8 CPU over FSI.

	  pdbg runs on a BMC, which is generally an ARM-powered system
	  monitoring/controlling a host CPU.

	  https://github.com/open-power/pdbg
```

## package.bak/perl-gdgraph/Config.in
```kconfig
config BR2_PACKAGE_PERL_GDGRAPH
	bool "perl-gdgraph"
	depends on !BR2_STATIC_LIBS
	select BR2_PACKAGE_PERL_GD
	select BR2_PACKAGE_PERL_GDTEXTUTIL
	help
	  Produces charts with GD

	  https://metacpan.org/release/GDGraph

comment "perl-gdgraph needs a toolchain w/ dynamic library"
	depends on BR2_STATIC_LIBS
```

## package.bak/perl-html-parser/Config.in
```kconfig
config BR2_PACKAGE_PERL_HTML_PARSER
	bool "perl-html-parser"
	depends on !BR2_STATIC_LIBS
	select BR2_PACKAGE_PERL_HTML_TAGSET
	help
	  HTML parser class

	  https://metacpan.org/release/HTML-Parser

comment "perl-html-parser needs a toolchain w/ dynamic library"
	depends on BR2_STATIC_LIBS
```

## package.bak/perl-http-negotiate/Config.in
```kconfig
config BR2_PACKAGE_PERL_HTTP_NEGOTIATE
	bool "perl-http-negotiate"
	select BR2_PACKAGE_PERL_HTTP_MESSAGE
	help
	  This module provides a complete implementation of the HTTP content
	  negotiation algorithm specified in draft-ietf-http-v11-spec-00.ps
	  chapter 12.

	  http://github.com/gisle/http-negotiate
```

## package.bak/perl-mime-base64/Config.in
```kconfig
config BR2_PACKAGE_PERL_MIME_BASE64
	bool "perl-mime-base64"
	depends on !BR2_STATIC_LIBS
	help
	  This package contains a base64 encoder/decoder and a quoted-printable
	  encoder/decoder.

	  http://github.com/gisle/mime-base64

comment "perl-mime-base64 needs a toolchain w/ dynamic library"
	depends on BR2_STATIC_LIBS
```

## package.bak/php/Config.in
```kconfig
config BR2_PACKAGE_PHP
	bool "php"
	select BR2_PACKAGE_PHP_SAPI_CGI if \
	       !BR2_PACKAGE_PHP_SAPI_APACHE && \
	       !BR2_PACKAGE_PHP_SAPI_CLI && \
	       !BR2_PACKAGE_PHP_SAPI_FPM &&  \
	       BR2_USE_MMU
	select BR2_PACKAGE_PHP_SAPI_CLI if !BR2_USE_MMU
	help
	  PHP  is a widely-used general-purpose scripting
	  language that is especially suited for Web development
	  and can be embedded into HTML.

	  http://www.php.net

if BR2_PACKAGE_PHP

config BR2_PACKAGE_PHP_SAPI_APACHE
	bool "Apache interface"
	depends on BR2_PACKAGE_APACHE
	help
	  Apache module

config BR2_PACKAGE_PHP_SAPI_CGI
	bool "CGI interface"
	# CGI uses fork()
	depends on BR2_USE_MMU
	help
	  Common Gateway Interface

config BR2_PACKAGE_PHP_SAPI_CLI
	bool "CLI interface"
	help
	  Command Line Interface

config BR2_PACKAGE_PHP_SAPI_FPM
	bool "FPM interface"
	depends on BR2_USE_MMU
	# "Sparc v8 and predecessors are not and will not be supported"
	depends on !BR2_sparc
	help
	  PHP-FPM (FastCGI Process Manager)

source "package/php/Config.ext"

endif
```

## package.bak/picocom/Config.in
```kconfig
config BR2_PACKAGE_PICOCOM
	bool "picocom"
	depends on BR2_USE_MMU # fork()
	help
	  picocom is a minimal dumb-terminal emulation program. It is, in
	  principle, very much like minicom, only it's pico instead of mini!

	  https://github.com/npat-efault/picocom/
```

## package.bak/policycoreutils/Config.in
```kconfig
comment "policycoreutils needs a glibc toolchain w/ threads, dynamic library"
	depends on !BR2_arc
	depends on BR2_PACKAGE_AUDIT_ARCH_SUPPORTS
	depends on !BR2_TOOLCHAIN_USES_GLIBC || \
		!BR2_TOOLCHAIN_HAS_THREADS || BR2_STATIC_LIBS

config BR2_PACKAGE_POLICYCOREUTILS
	bool "policycoreutils"
	select BR2_PACKAGE_LIBSEMANAGE
	select BR2_PACKAGE_LIBCAP_NG
	depends on BR2_PACKAGE_AUDIT_ARCH_SUPPORTS # libsemanage
	depends on BR2_TOOLCHAIN_HAS_THREADS # libsemanage
	depends on !BR2_STATIC_LIBS #libsemanage
	depends on !BR2_arc # libsemanage
	depends on BR2_TOOLCHAIN_USES_GLIBC # libsemanage
	help
	  Policycoreutils is a collection of policy utilities (originally
	  the "core" set of utilities needed to use SELinux, although it
	  has grown a bit over time), which have different dependencies.
	  sestatus, secon, run_init, and newrole only use libselinux.
	  load_policy and setfiles only use libselinux and libsepol.
	  semodule and semanage use libsemanage (and thus bring in
	  dependencies on libsepol and libselinux as well). setsebool
	  uses libselinux to make non-persistent boolean changes (via
	  the kernel interface) and uses libsemanage to make persistent
	  boolean changes.

	  The base package will install the following utilities:
	      load_policy
	      newrole
	      restorecond
	      run_init
	      secon
	      semodule
	      semodule_deps
	      semodule_expand
	      semodule_link
	      semodule_package
	      sepolgen-ifgen
	      sestatus
	      setfiles
	      setsebool

	  http://selinuxproject.org/page/Main_Page

if BR2_PACKAGE_POLICYCOREUTILS

config BR2_PACKAGE_POLICYCOREUTILS_RESTORECOND
	bool "restorecond"
	select BR2_PACKAGE_LIBGLIB2
	depends on BR2_USE_WCHAR # glib2
	depends on BR2_TOOLCHAIN_HAS_THREADS # glib2
	depends on BR2_USE_MMU # glib2
	help
	  Enable restorecond to be built

comment "restorecond needs a toolchain w/ wchar, threads"
	depends on BR2_USE_MMU
	depends on !BR2_USE_WCHAR || !BR2_TOOLCHAIN_HAS_THREADS

endif
```

## package.bak/portmap/Config.in
```kconfig
config BR2_PACKAGE_PORTMAP
	bool "portmap"
	depends on BR2_TOOLCHAIN_HAS_NATIVE_RPC
	# portmap and rpcbind provide the same feature, so they are
	# mutually exclusive. rpcbind is the newer, preferred
	# implementation.
	depends on !BR2_PACKAGE_RPCBIND
	help
	  The standard portmapper for RPC services.

	  Note that portmap is being deprecated in favour of rpcbind.

	  http://neil.brown.name/portmap/

comment "portmap needs a toolchain w/ RPC"
	depends on !BR2_TOOLCHAIN_HAS_NATIVE_RPC
```

## package.bak/pound/Config.in
```kconfig
config BR2_PACKAGE_POUND
	bool "pound"
	depends on !BR2_STATIC_LIBS
	depends on BR2_TOOLCHAIN_HAS_THREADS
	depends on BR2_USE_MMU # fork()
	select BR2_PACKAGE_OPENSSL
	help
	  The Pound program is a reverse proxy, load balancer and HTTPS
	  front-end for Web server(s). Pound was developed to enable
	  distributing the load among several Web-servers and to allow
	  for a convenient SSL wrapper for those Web servers that do not
	  offer it natively.

	  http://www.apsis.ch/pound

comment "pound needs a toolchain w/ dynamic library, threads"
	depends on BR2_STATIC_LIBS || !BR2_TOOLCHAIN_HAS_THREADS
	depends on BR2_USE_MMU
```

## package.bak/powerpc-utils/Config.in
```kconfig
comment "powerpc-utils tools needs a toolchain w/ dynamic library"
	depends on BR2_powerpc || BR2_powerpc64 || BR2_powerpc64le
	depends on BR2_STATIC_LIBS

config BR2_PACKAGE_POWERPC_UTILS
	bool "powerpc-utils"
	depends on !BR2_STATIC_LIBS # dlfcn.h
	depends on BR2_powerpc || BR2_powerpc64 || BR2_powerpc64le
	select BR2_PACKAGE_ZLIB
	help
	  System utilities for PowerPC machines.

	  https://github.com/nfont/powerpc-utils

if BR2_PACKAGE_POWERPC_UTILS

config BR2_PACKAGE_POWERPC_UTILS_RTAS
	bool "RTAS support"
	select BR2_PACKAGE_LIBRTAS
	depends on BR2_TOOLCHAIN_USES_GLIBC
	help
	  Enable support for functions that require RTAS.

	  This adds a dependency on librtas and provides the following
	  additional features at the cost of increasing the installed
	  package size from about 0.5MB to about 2MB:
	  ppc64_cpu --run-mode, uesensor, set_poweron_time, drmgr,
	  lsslot, activate_firmware, rtas_ibm_get_vpd, serv_config,
	  rtas_event_decode, sys_ident.

comment "RTAS support needs a glibc toolchain"
	depends on !BR2_TOOLCHAIN_USES_GLIBC

endif
```

## package.bak/pps-tools/Config.in
```kconfig
config BR2_PACKAGE_PPS_TOOLS
	bool "pps-tools"
	help
	  Pulse per second tools. Provides timepps.h and other PPS utilities.

	  https://github.com/ago/pps-tools/
```

## package.bak/procps-ng/Config.in
```kconfig
config BR2_PACKAGE_PROCPS_NG
	bool "procps-ng"
	depends on BR2_USE_MMU # fork()
	depends on BR2_PACKAGE_BUSYBOX_SHOW_OTHERS
	select BR2_PACKAGE_NCURSES
	select BR2_PACKAGE_GETTEXT if BR2_NEEDS_GETTEXT_IF_LOCALE
	help
	  Standard informational utilities and process-handling tools.
	  Provides things like kill, ps, uptime, free, top, etc...

	  http://sourceforge.net/projects/procps-ng/
```

## package.bak/python-attrs/Config.in
```kconfig
config BR2_PACKAGE_PYTHON_ATTRS
	bool "python-attrs"
	help
	  attrs is the Python package that will bring back the joy of
	  writing classes by relieving you from the drudgery of
	  implementing object protocols (aka dunder methods).

	  https://attrs.readthedocs.io/
```

## package.bak/python-backports-abc/Config.in
```kconfig
config BR2_PACKAGE_PYTHON_BACKPORTS_ABC
	bool "python-backports-abc"
	depends on BR2_PACKAGE_PYTHON
	help
	  A backport of recent additions to the 'collections.abc'
	  module.

	  https://pypi.python.org/pypi/backports_abc
```

## package.bak/python-bitstring/Config.in
```kconfig
config BR2_PACKAGE_PYTHON_BITSTRING
	bool "python-bitstring"
	help
	  Simple construction, analysis and modification of binary data.

	  https://github.com/scott-griffiths/bitstring
```

## package.bak/python-cbor/Config.in
```kconfig
config BR2_PACKAGE_PYTHON_CBOR
	bool "python-cbor"
	help
	  RFC 7049 - Concise Binary Object Representation.

	  https://pypi.python.org/pypi/cbor
```

## package.bak/python-chardet/Config.in
```kconfig
config BR2_PACKAGE_PYTHON_CHARDET
	bool "python-chardet"
	help
	  Universal encoding detector for Python 2 and 3.

	  https://github.com/chardet/chardet
```
