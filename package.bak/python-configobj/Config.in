## package.bak/python-configobj/Config.in
```kconfig
config BR2_PACKAGE_PYTHON_CONFIGOBJ
	bool "python-configobj"
	depends on BR2_PACKAGE_PYTHON
	help
	  ConfigObj is a simple but powerful config file reader and
	  writer: an ini file round tripper. Its main feature is that
	  it is very easy to use, with a straightforward programmer's
	  interface and a simple syntax for config files.

	  http://www.voidspace.org.uk/python/configobj.html
```

## package.bak/python-constantly/Config.in
```kconfig
config BR2_PACKAGE_PYTHON_CONSTANTLY
	bool "python-constantly"
	help
	  A library that provides symbolic constant support. It
	  includes collections and constants with text, numeric,
	  and bit flag values.

	  https://github.com/twisted/constantly
```

## package.bak/python-crcmod/Config.in
```kconfig
config BR2_PACKAGE_PYTHON_CRCMOD
	bool "python-crcmod"
	help
	  The software in this package is a Python module for
	  generating objects that compute the Cyclic Redundancy
	  Check (CRC).

	  http://crcmod.sourceforge.net/
```

## package.bak/python-crossbar/Config.in
```kconfig
config BR2_PACKAGE_PYTHON_CROSSBAR
	bool "python-crossbar"
	depends on !BR2_TOOLCHAIN_USES_MUSL # python-psutil
	# All the following dependencies are runtime dependencies
	select BR2_PACKAGE_PYTHON_AUTOBAHN
	select BR2_PACKAGE_PYTHON_CBOR
	select BR2_PACKAGE_PYTHON_CLICK
	select BR2_PACKAGE_PYTHON_PYCPARSER
	select BR2_PACKAGE_PYTHON_CRYPTOGRAPHY
	select BR2_PACKAGE_PYTHON_JINJA2
	select BR2_PACKAGE_PYTHON_LMDB
	select BR2_PACKAGE_PYTHON_MISTUNE
	select BR2_PACKAGE_PYTHON_NETADDR
	select BR2_PACKAGE_PYTHON_PSUTIL
	select BR2_PACKAGE_PYTHON_PYASN
	select BR2_PACKAGE_PYTHON_PYASN_MODULES
	select BR2_PACKAGE_PYTHON_PYGMENTS
	select BR2_PACKAGE_PYTHON_PYINOTIFY
	select BR2_PACKAGE_PYTHON_PYNACL
	select BR2_PACKAGE_PYTHON_PYOPENSSL
	select BR2_PACKAGE_PYTHON_PYTRIE
	select BR2_PACKAGE_PYTHON_PYYAML
	select BR2_PACKAGE_PYTHON_SDNOTIFY
	select BR2_PACKAGE_PYTHON_SETUPTOOLS
	select BR2_PACKAGE_PYTHON_SERVICE_IDENTITY
	select BR2_PACKAGE_PYTHON_SETPROCTITLE
	select BR2_PACKAGE_PYTHON_SETUPTOOLS
	select BR2_PACKAGE_PYTHON_SHUTILWHICH if BR2_PACKAGE_PYTHON
	select BR2_PACKAGE_PYTHON_TREQ
	select BR2_PACKAGE_PYTHON_TWISTED
	select BR2_PACKAGE_PYTHON_U_MSGPACK
	select BR2_PACKAGE_PYTHON_UBJSON
	select BR2_PACKAGE_PYTHON_WATCHDOG
	select BR2_PACKAGE_PYTHON_WSACCEL
	depends on BR2_INSTALL_LIBSTDCPP # python-pyasn
	help
	  Crossbar.io is an open-source WAMP application router that
	  allows to build advanced applications from loosely-coupled
	  components that can talk in real-time with each other.

	  https://pypi.python.org/pypi/crossbar

comment "python-crossbar needs a uClibc or glibc toolchain w/ C++"
	depends on !BR2_INSTALL_LIBSTDCPP || BR2_TOOLCHAIN_USES_MUSL
```

## package.bak/python-cssutils/Config.in
```kconfig
config BR2_PACKAGE_PYTHON_CSSUTILS
	bool "python-cssutils"
	select BR2_PACKAGE_PYTHON_PYEXPAT if BR2_PACKAGE_PYTHON # runtime
	select BR2_PACKAGE_PYTHON3_PYEXPAT if BR2_PACKAGE_PYTHON3 # runtime
	help
	  A CSS Cascading Style Sheets library for Python.

	  http://cthedot.de/cssutils/
```

## package.bak/python-dateutil/Config.in
```kconfig
config BR2_PACKAGE_PYTHON_DATEUTIL
	bool "python-dateutil"
	select BR2_PACKAGE_PYTHON_SIX
	help
	  Extensions to the standard Python datetime module.

	  https://dateutil.readthedocs.org
```

## package.bak/python-dicttoxml/Config.in
```kconfig
config BR2_PACKAGE_PYTHON_DICTTOXML
	bool "python-dicttoxml"
	select BR2_PACKAGE_PYTHON_PYEXPAT if BR2_PACKAGE_PYTHON
	select BR2_PACKAGE_PYTHON3_PYEXPAT if BR2_PACKAGE_PYTHON3
	help
	  Converts a Python dictionary or other native data type into a valid
	  XML string.

	  https://github.com/quandyfactory/dicttoxml
```

## package.bak/python-enum34/Config.in
```kconfig
config BR2_PACKAGE_PYTHON_ENUM34
	bool "python-enum34"
	depends on BR2_PACKAGE_PYTHON
	help
	  Python 3.4 Enum backported to 2.x.

	  An enumeration is a set of symbolic names (members) bound to
	  unique, constant values. Within an enumeration, the members
	  can be compared by identity, and the enumeration itself can
	  be iterated over.

	  https://pypi.python.org/pypi/enum34
```

## package.bak/python-flask-babel/Config.in
```kconfig
config BR2_PACKAGE_PYTHON_FLASK_BABEL
	bool "python-flask-babel"
	select BR2_PACKAGE_PYTHON_FLASK # runtime
	select BR2_PACKAGE_PYTHON_BABEL # runtime
	help
	  Flask-Babel is an extension to Flask that adds i18n and l10n
	  support to any Flask application with the help of babel,
	  pytz and speaklater. It has builtin support for date
	  formatting with timezone support as well as a very simple
	  and friendly interface to gettext translations.

	  https://pythonhosted.org/Flask-Babel/
```

## package.bak/python-flask-jsonrpc/Config.in
```kconfig
config BR2_PACKAGE_PYTHON_FLASK_JSONRPC
	bool "python-flask-jsonrpc"
	# runtime dependency
	select BR2_PACKAGE_PYTHON_FLASK
	help
	  A basic JSON-RPC implementation for your Flask-powered sites.

	  https://github.com/cenobites/flask-jsonrpc
```

## package.bak/python-flask-login/Config.in
```kconfig
config BR2_PACKAGE_PYTHON_FLASK_LOGIN
	bool "python-flask-login"
	# runtime dependency
	select BR2_PACKAGE_PYTHON_FLASK
	help
	  Flask-Login provides user session management for Flask.

	  https://github.com/maxcountryman/flask-login
```

## package.bak/python-futures/Config.in
```kconfig
config BR2_PACKAGE_PYTHON_FUTURES
	bool "python-futures"
	depends on BR2_PACKAGE_PYTHON # not needed for python3
	help
	  Backport of the concurrent.futures package from Python 3.2.

	  https://github.com/agronholm/pythonfutures
```

## package.bak/python-httplib2/Config.in
```kconfig
config BR2_PACKAGE_PYTHON_HTTPLIB2
	bool "python-httplib2"
	select BR2_PACKAGE_PYTHON_ZLIB if BR2_PACKAGE_PYTHON
	select BR2_PACKAGE_PYTHON_SSL if BR2_PACKAGE_PYTHON
	select BR2_PACKAGE_PYTHON3_ZLIB if BR2_PACKAGE_PYTHON3
	select BR2_PACKAGE_PYTHON3_SSL if BR2_PACKAGE_PYTHON3
	help
	  httplib2 is a comprehensive HTTP client library, httplib2.py
	  supports many features left out of other HTTP libraries.

	  https://pypi.python.org/pypi/httplib2
```

## package.bak/python-id3/Config.in
```kconfig
config BR2_PACKAGE_PYTHON_ID3
	bool "python-id3"
	depends on BR2_PACKAGE_PYTHON
	help
	  This module allows one to read and manipulate so-called ID3
	  informational tags on MP3 files through an object-oriented
	  Python interface.

	  http://id3-py.sourceforge.net/
```

## package.bak/python-incremental/Config.in
```kconfig
config BR2_PACKAGE_PYTHON_INCREMENTAL
	bool "python-incremental"
	help
	  A library for versioning your Python projects.

	  https://github.com/hawkowl/incremental
```

## package.bak/python-ipython/Config.in
```kconfig
config BR2_PACKAGE_PYTHON_IPYTHON
	bool "python-ipython"
	help
	  IPython is a command shell for interactive computing in multiple
	  programming languages, originally developed for the Python
	  programming language, that offers enhanced introspection, rich
	  media, additional shell syntax, tab completion, and rich history.

	  http://ipython.org/
```

## package.bak/python-json-schema-validator/Config.in
```kconfig
config BR2_PACKAGE_PYTHON_JSON_SCHEMA_VALIDATOR
	bool "python-json-schema-validator"
	depends on BR2_PACKAGE_PYTHON
	select BR2_PACKAGE_PYTHON_VERSIONTOOLS
	help
	  JSON Schema Validator

	  https://pypi.python.org/pypi/json-schema-validator
```

## package.bak/python-libconfig/Config.in
```kconfig
comment "python-libconfig needs a glibc or uClibc toolchain w/ C++, threads"
	depends on !BR2_INSTALL_LIBSTDCPP || !BR2_TOOLCHAIN_HAS_THREADS || \
		BR2_TOOLCHAIN_USES_MUSL

config BR2_PACKAGE_PYTHON_LIBCONFIG
	bool "python-libconfig"
	select BR2_PACKAGE_BOOST
	select BR2_PACKAGE_BOOST_PYTHON
	select BR2_PACKAGE_LIBCONFIG
	depends on BR2_INSTALL_LIBSTDCPP
	depends on BR2_TOOLCHAIN_HAS_THREADS
	# error: invalid use of incomplete type 'struct _IO_FILE'
	depends on !BR2_TOOLCHAIN_USES_MUSL
	help
	  Python bindings to the C++ library libconfig

	  Libconfig is a simple library for manipulating structured
	  configuration files. The file format is more compact and more
	  readable than XML. And unlike XML, it is type-aware, so it is
	  not necessary to do string parsing in application code.
	  http://www.hyperrealm.com/libconfig/

	  https://github.com/cnangel/python-libconfig
```

## package.bak/python-lxml/Config.in
```kconfig
config BR2_PACKAGE_PYTHON_LXML
	bool "python-lxml"
	select BR2_PACKAGE_LIBXML2
	select BR2_PACKAGE_LIBXSLT
	select BR2_PACKAGE_ZLIB
	help
	  The lxml XML toolkit is a Pythonic binding for the C libraries
	  libxml2 and libxslt.

	  http://lxml.de/
```

## package.bak/python-markdown2/Config.in
```kconfig
config BR2_PACKAGE_PYTHON_MARKDOWN2
	bool "python-markdown2"
	help
	  A fast and complete Python implementation of Markdown.

	  https://github.com/trentm/python-markdown2
```

## package.bak/python-mbstrdecoder/Config.in
```kconfig
config BR2_PACKAGE_PYTHON_MBSTRDECODER
	bool "python-mbstrdecoder"
	help
	  multi-byte character string decoder.

	  https://github.com/thombashi/mbstrdecoder
```

## package.bak/python-meld3/Config.in
```kconfig
config BR2_PACKAGE_PYTHON_MELD3
	bool "python-meld3"
	select BR2_PACKAGE_PYTHON_PYEXPAT if BR2_PACKAGE_PYTHON
	select BR2_PACKAGE_PYTHON3_PYEXPAT if BR2_PACKAGE_PYTHON3
	help
	  A HTML/XML templating system.

	  https://github.com/supervisor/meld3
```

## package.bak/python-mwscrape/Config.in
```kconfig
config BR2_PACKAGE_PYTHON_MWSCRAPE
	bool "python-mwscrape"
	depends on BR2_PACKAGE_PYTHON
	select BR2_PACKAGE_PYTHON_COUCHDB # runtime
	select BR2_PACKAGE_PYTHON_FUTURES # runtime
	select BR2_PACKAGE_PYTHON_MWCLIENT # runtime
	select BR2_PACKAGE_PYTHON_PYLRU # runtime
	help
	  Download rendered articles from MediaWiki API to CouchDB

	  https://github.com/itkach/mwscrape
```

## package.bak/python-nfc/Config.in
```kconfig
config BR2_PACKAGE_PYTHON_NFC
	bool "python-nfc"
	depends on BR2_PACKAGE_PYTHON
	depends on BR2_TOOLCHAIN_HAS_THREADS # libusb
	select BR2_PACKAGE_LIBUSB
	select BR2_PACKAGE_LIBUSB_COMPAT
	help
	  Python module for near field communication.

	  https://launchpad.net/nfcpy

comment "python-nfc needs a toolchain w/ threads"
	depends on BR2_PACKAGE_PYTHON
	depends on !BR2_TOOLCHAIN_HAS_THREADS
```

## package.bak/python-paramiko/Config.in
```kconfig
config BR2_PACKAGE_PYTHON_PARAMIKO
	bool "python-paramiko"
	depends on BR2_INSTALL_LIBSTDCPP # python-pyasn
	select BR2_PACKAGE_PYTHON_ZLIB if BR2_PACKAGE_PYTHON # runtime
	select BR2_PACKAGE_PYTHON3_ZLIB if BR2_PACKAGE_PYTHON3 # runtime
	select BR2_PACKAGE_PYTHON_CRYPTOGRAPHY # runtime
	select BR2_PACKAGE_PYTHON_PYASN # runtime
	help
	  SSH2 protocol library.

	  https://github.com/paramiko/paramiko/

comment "python-paramiko needs a toolchain w/ C++"
	depends on !BR2_INSTALL_LIBSTDCPP
```
