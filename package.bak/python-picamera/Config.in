## package.bak/python-prompt-toolkit/Config.in
```kconfig
config BR2_PACKAGE_PYTHON_PROMPT_TOOLKIT
	bool "python-prompt-toolkit"
	select BR2_PACKAGE_PYTHON_SIX # runtime
	select BR2_PACKAGE_PYTHON_WCWIDTH # runtime
	help
	  Library for building powerful interactive command lines in
	  Python.

	  https://github.com/jonathanslenders/python-prompt-toolkit
```

## package.bak/python-pudb/Config.in
```kconfig
config BR2_PACKAGE_PYTHON_PUDB
	bool "python-pudb"
	select BR2_PACKAGE_PYTHON_URWID # runtime
	select BR2_PACKAGE_PYTHON_PYGMENTS # runtime
	select BR2_PACKAGE_PYTHON_SETUPTOOLS # runtime
	select BR2_PACKAGE_PYTHON_CURSES if BR2_PACKAGE_PYTHON # runtime
	select BR2_PACKAGE_PYTHON3_CURSES if BR2_PACKAGE_PYTHON3 # runtime
	help
	  A full-screen, console-based Python debugger.

	  https://github.com/inducer/pudb
```

## package.bak/python-pyasn/Config.in
```kconfig
config BR2_PACKAGE_PYTHON_PYASN
	bool "python-pyasn"
	depends on BR2_INSTALL_LIBSTDCPP
	select BR2_PACKAGE_PYTHON3_ZLIB if BR2_PACKAGE_PYTHON3
	select BR2_PACKAGE_PYTHON_ZLIB if BR2_PACKAGE_PYTHON
	help
	  PyASN is a Python extension module that enables you to
	  perform very fast IP address to Autonomous System Number
	  lookups.

	  https://code.google.com/p/pyasn/

comment "python-pyasn needs a toolchain w/ C++"
	depends on !BR2_INSTALL_LIBSTDCPP
```

## package.bak/python-pyelftools/Config.in
```kconfig
config BR2_PACKAGE_PYTHON_PYELFTOOLS
	bool "python-pyelftools"
	help
	  Pyelftools is a Python library for parsing and analyzing ELF
	  files and DWARF debug information.

	  https://github.com/eliben/pyelftools
```

## package.bak/python-pyftpdlib/Config.in
```kconfig
config BR2_PACKAGE_PYTHON_PYFTPDLIB
	bool "python-pyftpdlib"
	help
	  Extremely fast and scalable Python FTP server library.

	  https://github.com/giampaolo/pyftpdlib
```

## package.bak/python-pymongo/Config.in
```kconfig
config BR2_PACKAGE_PYTHON_PYMONGO
	bool "python-pymongo"
	depends on BR2_PACKAGE_PYTHON
	help
	  Python driver for MongoDB

	  http://www.mongodb.org
```

## package.bak/python-pymysql/Config.in
```kconfig
config BR2_PACKAGE_PYTHON_PYMYSQL
	bool "python-pymysql"
	help
	  PyMySQL is a pure-Python MySQL client library. It follows
	  the DB-API 2.0.

	  https://pypi.python.org/pypi/PyMySQL/
```

## package.bak/python-pyparted/Config.in
```kconfig
config BR2_PACKAGE_PYTHON_PYPARTED
	bool "python-pyparted"
	depends on BR2_USE_WCHAR
	select BR2_PACKAGE_PYTHON_CFFI # runtime
	select BR2_PACKAGE_PARTED
	help
	  Python bindings for GNU parted (libparted).

	  https://github.com/rhinstaller/pyparted

comment "pyparted needs a toolchain w/ wchar"
	depends on !BR2_USE_WCHAR
```

## package.bak/python-pysnmp-apps/Config.in
```kconfig
config BR2_PACKAGE_PYTHON_PYSNMP_APPS
	bool "python-pysnmp-apps"
	select BR2_PACKAGE_PYTHON_PYSNMP
	depends on BR2_INSTALL_LIBSTDCPP # pysnmp -> pyasn
	help
	  A collection of command-line tools for SNMP management
	  purposes built on top of the PySNMP package.

	  http://pysnmp.sf.net

comment "python-pysnmp-apps needs a toolchain w/ C++"
	depends on !BR2_INSTALL_LIBSTDCPP
```

## package.bak/python-pytablereader/Config.in
```kconfig
config BR2_PACKAGE_PYTHON_PYTABLEREADER
	bool "python-pytablereader"
	select BR2_PACKAGE_PYTHON_BEAUTIFULSOUP4 # runtime
	select BR2_PACKAGE_PYTHON_DATAPROPERTY # runtime
	select BR2_PACKAGE_PYTHON_JSONSCHEMA # runtime
	select BR2_PACKAGE_PYTHON_LOGBOOK # runtime
	select BR2_PACKAGE_PYTHON_MARKDOWN2 # runtime
	select BR2_PACKAGE_PYTHON_MBSTRDECODER # runtime
	select BR2_PACKAGE_PYTHON_PATHVALIDATE # runtime
	select BR2_PACKAGE_PYTHON_PATHPY # runtime
	select BR2_PACKAGE_PYTHON_REQUESTS # runtime
	select BR2_PACKAGE_PYTHON_SIX # runtime
	select BR2_PACKAGE_PYTHON_XLRD # runtime
	help
	  A python library to load structured table data from
	  files/URL with various data formats:
	  CSV/Excel/HTML/JSON/LTSV/Markdown/TSV.

	  https://github.com/thombashi/pytablereader
```

## package.bak/python-requests-toolbelt/Config.in
```kconfig
config BR2_PACKAGE_PYTHON_REQUESTS_TOOLBELT
	bool "python-requests-toolbelt"
	select BR2_PACKAGE_PYTHON_REQUESTS # runtime
	help
	  A utility belt for advanced users of python-requests.

	  https://toolbelt.readthedocs.org
```

## package.bak/python-requests/Config.in
```kconfig
config BR2_PACKAGE_PYTHON_REQUESTS
	bool "python-requests"
	select BR2_PACKAGE_PYTHON_ZLIB if BR2_PACKAGE_PYTHON # runtime
	select BR2_PACKAGE_PYTHON3_ZLIB if BR2_PACKAGE_PYTHON3 # runtime
	help
	  Requests is an Apache2 Licensed HTTP library, written in
	  Python, for human beings.

	  http://www.python-requests.org/
```

## package.bak/python-rpi-gpio/Config.in
```kconfig
config BR2_PACKAGE_PYTHON_RPI_GPIO
	bool "python-rpi-gpio"
	depends on BR2_arm
	help
	  A Python module to control the GPIO on a Raspberry Pi.

	  http://sourceforge.net/p/raspberry-gpio-python
```

## package.bak/python-setuptools/Config.in
```kconfig
config BR2_PACKAGE_PYTHON_SETUPTOOLS
	bool "python-setuptools"
	select BR2_PACKAGE_PYTHON_ZLIB if BR2_PACKAGE_PYTHON # runtime
	select BR2_PACKAGE_PYTHON3_ZLIB if BR2_PACKAGE_PYTHON3 # runtime
	select BR2_PACKAGE_PYTHON_PYEXPAT if BR2_PACKAGE_PYTHON # runtime
	select BR2_PACKAGE_PYTHON3_PYEXPAT if BR2_PACKAGE_PYTHON3 # runtime
	help
	  Download, build, install, upgrade, and uninstall Python packages.

	  http://pypi.python.org/pypi/setuptools
```

## package.bak/python-singledispatch/Config.in
```kconfig
config BR2_PACKAGE_PYTHON_SINGLEDISPATCH
	bool "python-singledispatch"
	depends on BR2_PACKAGE_PYTHON
	select BR2_PACKAGE_PYTHON_SIX # runtime
	help
	  This library brings functools.singledispatch from
	  Python 3.4 to Python 2.6-3.3

	  https://pypi.python.org/pypi/singledispatch
```

## package.bak/python-slob/Config.in
```kconfig
config BR2_PACKAGE_PYTHON_SLOB
	bool "python-slob"
	depends on !BR2_BINFMT_FLAT # python-pyicu -> icu
	depends on BR2_INSTALL_LIBSTDCPP # python-pyicu -> icu
	depends on BR2_PACKAGE_PYTHON3
	select BR2_PACKAGE_PYTHON_PYICU # runtime
	# although optional, it is used as default compression
	select BR2_PACKAGE_PYTHON3_XZ # runtime
	help
	  slob.py is a reference implementation of slob format reader
	  and writer.

	  https://github.com/itkach/slob

comment "python-slob needs a toolchain w/ C++"
	depends on BR2_PACKAGE_PYTHON3 && !BR2_BINFMT_FLAT
	depends on !BR2_INSTALL_LIBSTDCPP
```

## package.bak/python-toml/Config.in
```kconfig
config BR2_PACKAGE_PYTHON_TOML
	bool "python-toml"
	help
	  Python Library for Tom's Obvious, Minimal Language.

	  https://github.com/uiri/toml
```

## package.bak/python-ujson/Config.in
```kconfig
config BR2_PACKAGE_PYTHON_UJSON
	bool "python-ujson"
	help
	  UltraJSON is an ultra fast JSON encoder and decoder written
	  in pure C with bindings for Python 2.5+ and 3.

	  https://pypi.python.org/pypi/ujson
```

## package.bak/python-wcwidth/Config.in
```kconfig
config BR2_PACKAGE_PYTHON_WCWIDTH
	bool "python-wcwidth"
	help
	  This library measures number of Terminal column cells of
	  wide-character codes.

	  https://github.com/jquast/wcwidth
```

## package.bak/python-werkzeug/Config.in
```kconfig
config BR2_PACKAGE_PYTHON_WERKZEUG
	bool "python-werkzeug"
	select BR2_PACKAGE_PYTHON_ZLIB if BR2_PACKAGE_PYTHON # runtime
	select BR2_PACKAGE_PYTHON3_ZLIB if BR2_PACKAGE_PYTHON3 # runtime
	help
	  Werkzeug is a WSGI utility library for Python. It's widely
	  used and BSD licensed.

	  http://werkzeug.pocoo.org/
```

## package.bak/python-whoosh/Config.in
```kconfig
config BR2_PACKAGE_PYTHON_WHOOSH
	bool "python-whoosh"
	select BR2_PACKAGE_PYTHON_ZLIB if BR2_PACKAGE_PYTHON # runtime
	select BR2_PACKAGE_PYTHON3_ZLIB if BR2_PACKAGE_PYTHON3 # runtime
	help
	  Whoosh is a fast, pure-Python full text indexing, search and
	  spell checking library.

	  https://pypi.python.org/pypi/Whoosh/
```

## package.bak/python-xlutils/Config.in
```kconfig
config BR2_PACKAGE_PYTHON_XLUTILS
	bool "python-xlutils"
	select BR2_PACKAGE_PYTHON_XLRD # runtime
	select BR2_PACKAGE_PYTHON_XLWT # runtime
	help
	  Utilities for working with Excel files that require both
	  xlrd and xlwt.

	  http://www.python-excel.org
```

## package.bak/qhull/Config.in
```kconfig
config BR2_PACKAGE_QHULL
	bool "qhull"
	depends on BR2_INSTALL_LIBSTDCPP
	depends on !BR2_STATIC_LIBS
	depends on BR2_TOOLCHAIN_GCC_AT_LEAST_4_4 # needs gcc >= 4.4
	help
	  Qhull computes the convex hull, Delaunay triangulation,
	  Voronoi diagram, halfspace intersection about a point,
	  furthest-site Delaunay triangulation, and furthest-site
	  Voronoi diagram. The source code runs in 2-d, 3-d, 4-d, and
	  higher dimensions. Qhull implements the Quickhull algorithm
	  for computing the convex hull. It handles roundoff errors
	  from floating point arithmetic. It computes volumes, surface
	  areas, and approximations to the convex hull.

	  http://www.qhull.org

comment "qhull needs a toolchain w/ C++, dynamic library, gcc >= 4.4"
	depends on !BR2_INSTALL_LIBSTDCPP || BR2_STATIC_LIBS || !BR2_TOOLCHAIN_GCC_AT_LEAST_4_4
```
