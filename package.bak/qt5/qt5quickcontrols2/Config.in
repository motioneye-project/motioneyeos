## package.bak/qt5/qt5quickcontrols2/Config.in
```kconfig
config BR2_PACKAGE_QT5QUICKCONTROLS2
	bool "qt5quickcontrols2"
	select BR2_PACKAGE_QT5DECLARATIVE
	select BR2_PACKAGE_QT5DECLARATIVE_QUICK
	depends on BR2_PACKAGE_QT5_GL_AVAILABLE # qt5declarative/quick
	depends on BR2_PACKAGE_QT5_JSCORE_AVAILABLE # qt5declarative/quick
	help
	  Qt is a cross-platform application and UI framework for
	  developers using C++.

	  This package corresponds to the qt5quickcontrols2 module.

	  This module was in tech preview in Qt 5.6, and promoted
	  to a core module in Qt 5.7.0.

	  https://doc.qt.io/qt-5/qtquickcontrols2-index.html

comment "qt5quickcontrols2 needs an OpenGL-capable backend"
	depends on !BR2_PACKAGE_QT5_GL_AVAILABLE
	depends on BR2_PACKAGE_QT5_JSCORE_AVAILABLE
```

## package.bak/qt5/qt5sensors/Config.in
```kconfig
config BR2_PACKAGE_QT5SENSORS
	bool "qt5sensors"
	select BR2_PACKAGE_QT5BASE
	help
	  Qt is a cross-platform application and UI framework for
	  developers using C++.

	  The Qt Sensors API provides access to sensor hardware
	  via QML and C++ interfaces.

	  http://doc.qt.io/qt-5/qtsensors-index.html
```

## package.bak/qt5/qt5webchannel/Config.in
```kconfig
config BR2_PACKAGE_QT5WEBCHANNEL
	bool "qt5webchannel"
	select BR2_PACKAGE_QT5BASE
	select BR2_PACKAGE_QT5WEBSOCKETS
	help
	  Qt is a cross-platform application and UI framework for
	  developers using C++.

	  Qt WebChannel enables peer-to-peer communication between
	  a server (QML/C++ application) and a client
	  (HTML/JavaScript or QML application).

	  http://doc.qt.io/qt-5/qtwebchannel-index.html
```

## package.bak/qt5/qt5webkit/Config.in
```kconfig
config BR2_PACKAGE_QT5WEBKIT
	bool "qt5webkit"
	select BR2_PACKAGE_QT5BASE
	select BR2_PACKAGE_QT5BASE_ICU
	select BR2_PACKAGE_QT5BASE_GUI
	select BR2_PACKAGE_SQLITE
	select BR2_PACKAGE_XLIB_LIBXEXT if BR2_PACKAGE_QT5BASE_XCB
	select BR2_PACKAGE_XLIB_LIBXRENDER if BR2_PACKAGE_QT5BASE_XCB
	depends on !BR2_STATIC_LIBS
	depends on BR2_PACKAGE_QT5_JSCORE_AVAILABLE
	depends on !BR2_BINFMT_FLAT # icu
	# assumes a FPU is available on MIPS
	depends on !BR2_MIPS_SOFT_FLOAT
	help
	  Qt is a cross-platform application and UI framework for
	  developers using C++.

	  The Qt WebKit module provides the WebView API, which
	  allows QML applications to render regions of dynamic
	  web content.

	  This package has been removed from the official release packages
	  since Qt5.6.0, but it is still available for users to build it
	  from source. This is useful for platforms without GPU since the
	  successor (QtWebEngine) requires OpenGL support.

	  http://doc.qt.io/archives/qt-5.5/qtwebkit-index.html

comment "qt5webkit needs a toolchain w/ dynamic library"
	depends on BR2_STATIC_LIBS
	depends on BR2_PACKAGE_QT5_JSCORE_AVAILABLE
	depends on !BR2_BINFMT_FLAT
	depends on !BR2_MIPS_SOFT_FLOAT
```

## package.bak/qt5/qt5x11extras/Config.in
```kconfig
config BR2_PACKAGE_QT5X11EXTRAS
	bool "qt5x11extras"
	select BR2_PACKAGE_QT5BASE_WIDGETS
	depends on BR2_PACKAGE_QT5BASE_XCB
	help
	  Qt is a cross-platform application and UI framework for
	  developers using C++.

	  Qt X11 Extras enables the Qt programmer to write
	  applications for the Linux/X11 platform.

	  http://doc.qt.io/qt-5/qtx11extras-index.html
```

## package.bak/quagga/Config.in
```kconfig
config BR2_PACKAGE_QUAGGA
	bool "quagga"
	depends on BR2_USE_MMU # fork()
	help
	  Routing software suite, providing implementations of
	  OSPFv2, OSPFv3 (IPv6), RIP v1 and v2, RIPng (IPv6) and BGPv4+.

	  http://www.quagga.net/

if BR2_PACKAGE_QUAGGA

config BR2_PACKAGE_QUAGGA_ZEBRA
	bool "zebra daemon"
	help
	  Build zebra daemon.

config BR2_PACKAGE_QUAGGA_TCP_ZEBRA
	bool "Use TCP sockets between zebra and protocol daemons"
	depends on BR2_PACKAGE_QUAGGA_ZEBRA
	help
	  Use a TCP socket to communicate between zebra (supervisor) and
	  the different protocol daemons.

	  You'll want this enabled if zebra and the protocol daemon(s) run
	  on different hosts.

config BR2_PACKAGE_QUAGGA_BGPD
	bool "BGPv4+ protocol"
	help
	  Build bgpd daemon.

config BR2_PACKAGE_QUAGGA_BGP_ANNOUNCE
	bool "BGP route announcement"
	depends on BR2_PACKAGE_QUAGGA_BGPD

config BR2_PACKAGE_QUAGGA_ISISD
	bool "IS-IS protocol"
	help
	  Enable isisd support in quagga.

config BR2_PACKAGE_QUAGGA_OSPFD
	bool "OSPFv2 protocol"
	help
	  Build ospfd daemon.

config BR2_PACKAGE_QUAGGA_OSPF6D
	bool "OSPFv3 (IPv6) protocol"
	help
	  Build ospf6d daemon.

config BR2_PACKAGE_QUAGGA_RIPD
	bool "RIPv2/v3 protocol"
	help
	  Build ripd daemon.

config BR2_PACKAGE_QUAGGA_RIPNGD
	bool "RIPng (IPv6) protocol"
	help
	  Build ripngd daemon.

config BR2_PACKAGE_QUAGGA_PIMD
	bool "PIMd protocol"
	help
	  Provides IPv4 PIM-SSM multicast routing.

config BR2_PACKAGE_QUAGGA_WATCHQUAGGA
	bool "Build watchquagga"
	help
	  Build and install watchquagga, a zebra/protocol daemon supervisor.

config BR2_PACKAGE_QUAGGA_VTYSH
	bool "Build vtysh"
	select BR2_PACKAGE_READLINE
	help
	  Build and install vtysh, a vty shell for Quagga.

config BR2_PACKAGE_QUAGGA_SNMP
	bool "SNMP support"
	depends on BR2_USE_MMU # net-snmp
	select BR2_PACKAGE_NETSNMP
	help
	  Make quagga information available via SNMP SMUX.

comment "AgentX support must be enabled in net-snmp or the build will break"
	depends on BR2_PACKAGE_QUAGGA_SNMP

endif
```

## package.bak/rabbitmq-server/Config.in
```kconfig
config BR2_PACKAGE_RABBITMQ_SERVER
	bool "rabbitmq-server"
	depends on BR2_PACKAGE_ERLANG
	select BR2_PACKAGE_LIBXSLT
	select BR2_PACKAGE_OPENSSL # Required to build Erlang's crypto and ssl
	                           # applications
	help
	  High-performance AMQP-compliant message broker written in Erlang.

	  http://www.rabbitmq.com

comment "rabbitmq-server needs erlang"
	depends on !BR2_PACKAGE_ERLANG
```

## package.bak/ramspeed/Config.in
```kconfig
config BR2_PACKAGE_RAMSPEED
	bool "ramspeed"
	help
	  RAMspeed is a free open source command line utility
	  to measure cache and memory performance.

	  http://alasir.com/software/ramspeed/
```

## package.bak/raptor/Config.in
```kconfig
config BR2_PACKAGE_RAPTOR
	bool "raptor"
	select BR2_PACKAGE_LIBXML2
	select BR2_PACKAGE_LIBXSLT
	help
	  A C library that provides a set of parsers and
	  serializers that generate Resource Description
	  Framework (RDF) triples by parsing syntaxes or
	  serialize the triples into a syntax.

	  http://librdf.org/raptor/
```

## package.bak/read-edid/Config.in
```kconfig
config BR2_PACKAGE_READ_EDID
	bool "read-edid"
	help
	  Read-edid is a pair of tools for reading the EDID from a
	  monitor. It should work with most monitors made since 1996
	  (except for newer ones with 256-byte EDID's - WiP), assuming
	  the video card supports the standard read commands (most
	  do). Read-edid is a set of two tools - get-edid, which gets
	  the raw edid information from the monitor, and parse-edid,
	  which turns the raw binary information into an
	  XF86Config-compatible monitor section.

	  http://polypux.org/projects/read-edid/
```

## package.bak/riemann-c-client/Config.in
```kconfig
config BR2_PACKAGE_RIEMANN_C_CLIENT
	bool "riemann-c-client"
	depends on BR2_INSTALL_LIBSTDCPP # protobuf-c
	depends on BR2_TOOLCHAIN_HAS_THREADS # protobuf-c
	depends on BR2_HOSTARCH = "x86_64" || BR2_HOSTARCH = "x86" # protobuf-c
	select BR2_PACKAGE_PROTOBUF_C
	help
	  Riemann-c-client is a C client library for the Riemann
	  monitoring system, providing a convenient and simple API,
	  high test coverage and a copyleft license, along with API
	  and ABI stability.

	  https://github.com/algernon/riemann-c-client

comment "riemann-c-client needs a toolchain w/ C++, threads"
	depends on !BR2_INSTALL_LIBSTDCPP || !BR2_TOOLCHAIN_HAS_THREADS
	depends on BR2_HOSTARCH = "x86_64" || BR2_HOSTARCH = "x86"
```

## package.bak/rings/Config.in
```kconfig
config BR2_PACKAGE_RINGS
	bool "rings"
	depends on BR2_PACKAGE_HAS_LUAINTERPRETER
	help
	  Provides a way to create new Lua states from within Lua.

	  http://github.com/keplerproject/rings
```

## package.bak/rpi-armmem/Config.in
```kconfig
config BR2_PACKAGE_RPI_ARMMEM
	bool "rpi-armmem"
	depends on BR2_arm && BR2_PACKAGE_RPI_FIRMWARE && BR2_PACKAGE_RPI_USERLAND
	help
	  A replacement for memcpy and memset functionality for the
	  Raspberry Pi with the intention of gaining greater performance.

	  https://github.com/bavison/arm-mem/
```

## package.bak/rs485conf/Config.in
```kconfig
config BR2_PACKAGE_RS485CONF
	bool "rs485conf"
	help
	  rs485conf is intended to be used on embedded boards with RS485
	  interface. It can show as well as modify RS485 configuration
	  parameters of TTY device with easy to use command line
	  options.

	  https://github.com/mniestroj/rs485conf
```

## package.bak/rtl8723bs/Config.in
```kconfig
config BR2_PACKAGE_RTL8723BS
	bool "rtl8723bs"
	depends on BR2_LINUX_KERNEL
	help
	  rtl8723bs wifi driver

	  https://github.com/hadess/rtl8723bs

comment "rtl8723bs needs a Linux kernel to be built"
	depends on !BR2_LINUX_KERNEL
```

## package.bak/sed/Config.in
```kconfig
config BR2_PACKAGE_SED
	bool "sed"
	depends on BR2_USE_WCHAR
	depends on BR2_PACKAGE_BUSYBOX_SHOW_OTHERS
	help
	  Super-useful stream editor.

	  http://sed.sourceforge.net/

comment "sed needs a toolchain w/ wchar"
	depends on !BR2_USE_WCHAR
	depends on BR2_PACKAGE_BUSYBOX_SHOW_OTHERS
```

## package.bak/shapelib/Config.in
```kconfig
config BR2_PACKAGE_SHAPELIB
	bool "shapelib"
	help
	  The Shapefile C Library provides the ability to write simple
	  C programs for reading, writing and updating (to a limited
	  extent) ESRI Shapefiles, and the associated attribute file
	  (.dbf).

	  http://shapelib.maptools.org/
```

## package.bak/simicsfs/Config.in
```kconfig
comment "simicsfs needs a Linux kernel to be built"
	depends on !BR2_LINUX_KERNEL

config BR2_PACKAGE_SIMICSFS
	bool "simicsfs"
	depends on BR2_LINUX_KERNEL
	help
	  A kernel driver that provides access to a host computer's local
	  filesystem when the target is executing within a SIMICS simulation.

	  http://www.cs.sfu.ca/~fedorova/Tech/simics-guides-3.0.26/simics-user-guide-unix/topic33.html
```

## package.bak/skalibs/Config.in
```kconfig
config BR2_PACKAGE_SKALIBS
	bool "skalibs"
	depends on BR2_USE_MMU # fork()
	help
	  skalibs is a package centralizing the FOSS C development
	  files used for building all software at skarnet.org:
	  it contains essentially general-purpose libraries.

	  http://skarnet.org/software/skalibs/
```

## package.bak/smstools3/Config.in
```kconfig
config BR2_PACKAGE_SMSTOOLS3
	bool "smstools3"
	depends on BR2_USE_MMU # fork()
	depends on BR2_USE_WCHAR
	depends on BR2_TOOLCHAIN_HAS_THREADS
	help
	  The SMS Server Tools 3 is a SMS Gateway software which can send and
	  receive short messages through GSM modems and mobile phones.

	  http://smstools3.kekekasvi.com/

if BR2_PACKAGE_SMSTOOLS3

config BR2_PACKAGE_SMSTOOLS3_NB_MODEMS
	int "Number of modems to support"
	default 1
	help
	  To reduce memory footprint of SMS Server Tools, you can specify the
	  exact number of modems connected to your board. By default only 1
	  modem is used.

endif

comment "smstools3 needs a toolchain w/ wchar, threads"
	depends on !BR2_USE_WCHAR || !BR2_TOOLCHAIN_HAS_THREADS
	depends on BR2_USE_MMU
```

## package.bak/sngrep/Config.in
```kconfig
comment "sngrep needs a toolchain w/ threads"
	depends on !BR2_TOOLCHAIN_HAS_THREADS

config BR2_PACKAGE_SNGREP
	bool "sngrep"
	depends on BR2_TOOLCHAIN_HAS_THREADS
	select BR2_PACKAGE_NCURSES
	select BR2_PACKAGE_LIBPCAP
	help
	  sngrep is a tool for displaying SIP calls message flows from
	  terminal.  It supports live capture to display realtime SIP
	  packets and can also be used as PCAP viewer.

	  https://github.com/irontec/sngrep
```

## package.bak/socat/Config.in
```kconfig
config BR2_PACKAGE_SOCAT
	bool "socat"
	depends on BR2_TOOLCHAIN_HAS_THREADS
	depends on BR2_USE_MMU # fork()
	help
	  Multipurpose socket relay program.

	  http://www.dest-unreach.org/socat/

comment "socat needs a toolchain w/ threads"
	depends on BR2_USE_MMU
	depends on !BR2_TOOLCHAIN_HAS_THREADS
```

## package.bak/sound-theme-borealis/Config.in
```kconfig
config BR2_PACKAGE_SOUND_THEME_BOREALIS
	bool "sound-theme-borealis"
	help
	  Borealis sound theme.

	  http://kde-look.org/content/show.php?content=12584
```

## package.bak/sshpass/Config.in
```kconfig
config BR2_PACKAGE_SSHPASS
	bool "sshpass"
	depends on BR2_USE_MMU # fork()
	help
	  Sshpass is a tool for non-interactivly performing
	  password authentication with SSH's so called
	  "interactive keyboard password authentication".

	  http://sshpass.sourceforge.net
```

## package.bak/sslh/Config.in
```kconfig
config BR2_PACKAGE_SSLH
	bool "sslh"
	depends on BR2_INSTALL_LIBSTDCPP
	# uses fork()
	depends on BR2_USE_MMU
	select BR2_PACKAGE_LIBCONFIG
	help
	  Applicative protocol multiplexer

	  http://www.rutschle.net/tech/sslh.shtml

comment "sslh needs a toolchain w/ C++"
	depends on BR2_USE_MMU
	depends on !BR2_INSTALL_LIBSTDCPP
```
