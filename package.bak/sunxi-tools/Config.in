## package.bak/sunxi-tools/Config.in
```kconfig
config BR2_PACKAGE_SUNXI_TOOLS
	bool "sunxi nand-part"
	depends on BR2_arm
	help
	  nand-part is part of sunxi-tools for Allwinner A10 (aka sun4i) and
	  A13 (aka sun5i) based devices. It is a tool to repartition the
	  internal NAND on sunxi devices.

	  http://linux-sunxi.org/Sunxi-tools
```

## package.bak/sysvinit/Config.in
```kconfig
config BR2_PACKAGE_SYSVINIT
	bool "sysvinit"
	depends on BR2_USE_MMU # fork()
	depends on BR2_INIT_SYSV
	depends on BR2_PACKAGE_BUSYBOX_SHOW_OTHERS
	help
	  /sbin/init - parent of all processes

	  http://savannah.nongnu.org/projects/sysvinit
```

## package.bak/taskd/Config.in
```kconfig
config BR2_PACKAGE_TASKD
	bool "taskd"
	depends on BR2_USE_WCHAR # gnutls
	depends on BR2_USE_MMU # fork()
	depends on BR2_INSTALL_LIBSTDCPP
	select BR2_PACKAGE_GNUTLS
	select BR2_PACKAGE_UTIL_LINUX
	select BR2_PACKAGE_UTIL_LINUX_LIBUUID
	help
	  Task management synchronization daemon.

	  http://taskwarrior.org/

comment "taskd needs a toolchain w/ C++, wchar"
	depends on BR2_USE_MMU
	depends on !BR2_USE_WCHAR || !BR2_INSTALL_LIBSTDCPP
```

## package.bak/tcping/Config.in
```kconfig
config BR2_PACKAGE_TCPING
	bool "tcping"
	help
	  tcping does a TCP connect to the given ip/port
	  combination. The user can specify a timeout in seconds. This
	  is useful in shell scripts running in firewalled
	  environments. Often SYNs are just being dropped by
	  firewalls, thus connection establishment will be retried
	  several times (for minutes) until a TCP timeout is
	  reached. With tcping it is possible to check first if the
	  desired port is reachable and then start connection
	  establishment.

	  http://linuxco.de/tcping/tcping.html
```

## package.bak/tegrarcm/Config.in.host
```kconfig
config BR2_PACKAGE_HOST_TEGRARCM
	bool "host tegrarcm"
	depends on BR2_arm || BR2_armeb
	help
	  This program is used to send code to a Tegra device in recovery
	  mode.

	  https://github.com/NVIDIA/tegrarcm
```

## package.bak/ti-cgt-pru/Config.in.host
```kconfig
config BR2_PACKAGE_HOST_TI_CGT_PRU_ARCH_SUPPORTS
	bool
	default y
	depends on BR2_HOSTARCH = "x86_64" || BR2_HOSTARCH = "x86"
	depends on BR2_arm

config BR2_PACKAGE_HOST_TI_CGT_PRU
	bool "host ti-cgt-pru"
	depends on BR2_PACKAGE_HOST_TI_CGT_PRU_ARCH_SUPPORTS
	help
	  This package provides the Code Generation Tools for the PRU
	  unit found on some TI processors e.g. AM3358.

	  Note: this is a binary cross toolchain that runs on x86 hosts
	  targeting PRU cores found alongside some ARM processors.

	  http://processors.wiki.ti.com/index.php/Programmable_Realtime_Unit_Software_Development
```

## package.bak/ti-sgx-demos/Config.in
```kconfig
config BR2_PACKAGE_TI_SGX_DEMOS
	bool "ti-sgx-demos"
	depends on BR2_PACKAGE_TI_SGX_UM
	help
	  These SGX powervr demo applications from Imagination
	  Technologies are availabe as binaries only.  The binaries
	  are compiled for the TI SGX implementation.

	  http://git.ti.com/graphics/img-pvr-sdk
```

## package.bak/ti-sgx-km/Config.in
```kconfig
comment "ti-sgx-km needs a Linux kernel to be built"
	depends on BR2_arm
	depends on !BR2_LINUX_KERNEL

config BR2_PACKAGE_TI_SGX_KM
	bool "ti-sgx-km"
	depends on BR2_LINUX_KERNEL && BR2_arm
	select BR2_LINUX_NEEDS_MODULES
	help
	  Kernel modules for TI CPUs with SGX GPU.
	  This package supports AM335x, AM437x, AM4430 and AM5430.
	  It builds the kernel module and the user space binaries.
	  For older CPUs or kernels use the ti-gfx package.

	  Note: it needs a TI specific kernel to build properly.

	  http://git.ti.com/graphics/omap5-sgx-ddk-linux

if BR2_PACKAGE_TI_SGX_KM

choice
	prompt "Target"
	default BR2_PACKAGE_TI_SGX_AM335X
	help
	  Select the SOC for which you would like to install drivers.

config BR2_PACKAGE_TI_SGX_AM335X
	bool "AM335x"
	help
	  AM335x CPU

config BR2_PACKAGE_TI_SGX_AM437X
	bool "AM437x"
	help
	  AM437x CPU

config BR2_PACKAGE_TI_SGX_AM4430
	bool "AM4430"
	help
	  AM4430 CPU

config BR2_PACKAGE_TI_SGX_AM5430
	bool "AM5430"
	help
	  AM5430 CPU

endchoice

endif
```

## package.bak/tidsp-binaries/Config.in
```kconfig
config BR2_PACKAGE_TIDSP_BINARIES
	bool "tidsp-binaries"
	depends on BR2_cortex_a8
	help
	  TI OMAP3 DSP algorithms.

	  https://gforge.ti.com/gf/project/openmax/
```

## package.bak/tiff/Config.in
```kconfig
menuconfig BR2_PACKAGE_TIFF
	bool "tiff"
	help
	  Library for handling TIFF (Tag Image File Format) images.

	  http://simplesystems.org/libtiff/

if BR2_PACKAGE_TIFF

config BR2_PACKAGE_TIFF_CCITT
	bool "CCITT Group 3 & 4 support"
	default y

config BR2_PACKAGE_TIFF_PACKBITS
	bool "Macintosh PackBits algorithm"
	default y

config BR2_PACKAGE_TIFF_LZW
	bool "LZW algorithm"
	default y

config BR2_PACKAGE_TIFF_THUNDER
	bool "ThunderScan 4-bit RLE algorithm"
	default y

config BR2_PACKAGE_TIFF_NEXT
	bool "NeXT 2-bit RLE algorithm"
	default y

config BR2_PACKAGE_TIFF_LOGLUV
	bool "LogLuv high dynamic range encoding"
	default y

config BR2_PACKAGE_TIFF_MDI
	bool "Microsoft Document Imaging"
	default y

config BR2_PACKAGE_TIFF_ZLIB
	bool "Zlib usage (required for Deflate compression)"
	select BR2_PACKAGE_ZLIB
	default y

config BR2_PACKAGE_TIFF_XZ
	bool "XZ compression"
	select BR2_PACKAGE_XZ

config BR2_PACKAGE_TIFF_PIXARLOG
	bool "Pixar log-format algorithm (requires Zlib)"
	select BR2_PACKAGE_TIFF_ZLIB
	default y

config BR2_PACKAGE_TIFF_JPEG
	bool "JPEG compression"
	select BR2_PACKAGE_JPEG
	default y

config BR2_PACKAGE_TIFF_OLD_JPEG
	bool "Old JPEG decompression"
	default y

config BR2_PACKAGE_TIFF_JBIG
	bool "JBIG compression"
	default y

config BR2_PACKAGE_TIFF_UTILITIES
	bool "tiff utilities"
	help
	  Install all tiff utilities.

endif
```

## package.bak/time/Config.in
```kconfig
config BR2_PACKAGE_TIME
	bool "time"
	depends on BR2_USE_MMU # fork()
	# See https://savannah.gnu.org/bugs/index.php?48000
	depends on !BR2_STATIC_LIBS
	depends on BR2_PACKAGE_BUSYBOX_SHOW_OTHERS
	help
	  The GNU time utility.

	  http://savannah.gnu.org/projects/time/

comment "time needs a toolchain w/ dynamic library"
	depends on BR2_USE_MMU
	depends on BR2_STATIC_LIBS
```

## package.bak/tn5250/Config.in
```kconfig
config BR2_PACKAGE_TN5250
	bool "tn5250"
	depends on BR2_USE_MMU # fork()
	select BR2_PACKAGE_NCURSES
	help
	  Telnet client that emulates 5250 terminals and printers.

	  http://tn5250.sourceforge.net/
```

## package.bak/trace-cmd/Config.in
```kconfig
config BR2_PACKAGE_TRACE_CMD
	bool "trace-cmd"
	depends on BR2_TOOLCHAIN_HAS_THREADS
	depends on BR2_USE_MMU # fork()
	depends on !BR2_STATIC_LIBS # dlopen()
	help
	  Command line reader for ftrace.

	  To use this profiling tool, you should enable ftrace in your kernel
	  configuration. This command collect traces on your target.
	  You can analyse these traces on the target or on the host via the gui
	  "kernel shark"

	  http://git.kernel.org/cgit/linux/kernel/git/rostedt/trace-cmd.git

comment "trace-cmd needs a toolchain w/ threads, dynamic library"
	depends on BR2_USE_MMU
	depends on !BR2_TOOLCHAIN_HAS_THREADS || BR2_STATIC_LIBS
```

## package.bak/trinity/Config.in
```kconfig
config BR2_PACKAGE_TRINITY_ARCH_SUPPORTS
	bool
	default y
	depends on BR2_USE_MMU # fork()
	depends on BR2_aarch64 || BR2_arm || BR2_armeb || BR2_i386 || \
		BR2_mips || BR2_mipsel || BR2_powerpc || BR2_powerpc64 || \
		BR2_powerpc64le || BR2_sparc || BR2_x86_64

config BR2_PACKAGE_TRINITY
	bool "trinity"
	depends on BR2_PACKAGE_TRINITY_ARCH_SUPPORTS
	depends on !BR2_TOOLCHAIN_USES_MUSL # FTW_ACTIONRETVAL
	depends on BR2_TOOLCHAIN_HEADERS_AT_LEAST_3_4 # IPV6_UNICAST_IF
	help
	  A Linux System call fuzz tester

	  http://codemonkey.org.uk/projects/trinity/

comment "trinity needs a uClibc or glibc toolchain w/ headers >= 3.4"
	depends on BR2_PACKAGE_TRINITY_ARCH_SUPPORTS
	depends on BR2_TOOLCHAIN_USES_MUSL || \
		!BR2_TOOLCHAIN_HEADERS_AT_LEAST_3_4
```

## package.bak/ts4900-fpga/Config.in
```kconfig
config BR2_PACKAGE_TS4900_FPGA
	bool "ts4900-fpga"
	depends on BR2_arm
	help
	  TS-4900's FPGA implements clocks, UART MUX, and GPIOs. One of these
	  GPIOs is used to enable the wifi module.

	  It is loaded by U-Boot during the boot sequence, the default U-boot
	  script expects to find it in the /boot folder.

	  http://wiki.embeddedarm.com/wiki/TS-4900#FPGA_Changelog
```

## package.bak/tslib/Config.in
```kconfig
config BR2_PACKAGE_TSLIB
	bool "tslib"
	depends on !BR2_STATIC_LIBS # dlopen
	help
	  Tslib is a filtering layer for touchscreen panel events.

	  https://github.com/kergoth/tslib

comment "tslib needs a toolchain w/ dynamic library"
	depends on BR2_STATIC_LIBS
```

## package.bak/tunctl/Config.in
```kconfig
config BR2_PACKAGE_TUNCTL
	bool "tunctl"
	help
	  Tunctl is a tool for controlling the TUN/TAP driver in Linux.

	  https://sourceforge.net/projects/tunctl/
```

## package.bak/uclibc-ng-test/Config.in
```kconfig
config BR2_PACKAGE_UCLIBC_NG_TEST
	bool "uclibc-ng-test"
	help
	  Enabling this option will compile and install the uClibc-ng
	  test suite. This is useful if you want to check if the
	  uClibc-ng library is working for your architecture and/or
	  help developing uClibc-ng.

	  The test suite will be installed into
	  /usr/lib/uclibc-ng-test directory. To run the test suite
	  enter the /usr/lib/uclibc-ng-test/test directory and type
	  "sh uclibcng-testrunner.sh".

	  See the /usr/lib/uclibc-ng-test/test/README for additional
	  information.

	  This is not needed at all for normal builds, so you can
	  safely say no if you do not plan to dig into your C library.

	  The tests can also be used for GNU libc or musl.

	  http://www.uclibc-ng.org
```

## package.bak/usbmount/Config.in
```kconfig
config BR2_PACKAGE_USBMOUNT
	bool "usbmount"
	depends on BR2_PACKAGE_HAS_UDEV
	select BR2_PACKAGE_LOCKFILE_PROGS
	help
	  The usbmount package automatically mounts USB mass storage devices
	  when they are plugged in, and unmounts them when they are removed.

	  http://usbmount.alioth.debian.org/

comment "usbmount requires udev to be enabled"
	depends on !BR2_PACKAGE_HAS_UDEV
```

## package.bak/ustr/Config.in
```kconfig
config BR2_PACKAGE_USTR
	bool "ustr"
	# unconditionally builds a shared library
	depends on !BR2_STATIC_LIBS
	depends on !BR2_TOOLCHAIN_USES_MUSL # broken vsnprintf detection
	help
	  A small, safe string library.

	  http://www.and.org/ustr/

comment "ustr needs a toolchain w/ dynamic library"
	depends on BR2_STATIC_LIBS
	depends on !BR2_TOOLCHAIN_USES_MUSL
```

## package.bak/ustream-ssl/Config.in
```kconfig
config BR2_PACKAGE_USTREAM_SSL
	bool "ustream-ssl"
	depends on !BR2_STATIC_LIBS #libubox
	select BR2_PACKAGE_LIBUBOX
	select BR2_PACKAGE_OPENSSL if !BR2_PACKAGE_MBEDTLS
	help
	  ustream SSL wrapper

	  https://git.openwrt.org/?p=project/ustream-ssl.git;a=summary

comment "ustream-ssl needs a toolchain w/ dynamic library"
	depends on BR2_STATIC_LIBS
```

## package.bak/util-linux/Config.in.host
```kconfig
config BR2_PACKAGE_HOST_UTIL_LINUX
	bool "host util-linux"
	help
	  Various useful/essential linux libraries and utilities.

	  Things like mkfs, mkswap, swapon, fdisk, mount, dmesg, etc...

	  http://www.kernel.org/pub/linux/utils/util-linux/
```

## package.bak/vorbis-tools/Config.in
```kconfig
config BR2_PACKAGE_VORBIS_TOOLS
	bool "vorbis-tools"
	select BR2_PACKAGE_LIBAO
	select BR2_PACKAGE_LIBOGG
	select BR2_PACKAGE_LIBVORBIS
	select BR2_PACKAGE_LIBCURL
	help
	  Standalone player, encoder and decoder for Ogg format files.

	  Works also as a streaming player.

	  http://www.vorbis.com/
```

## package.bak/vsftpd/Config.in
```kconfig
config BR2_PACKAGE_VSFTPD
	bool "vsftpd"
	depends on BR2_USE_MMU # fork()
	help
	  vsftpd is an ftp daemon written with security in mind.
	  http://vsftpd.beasts.org/

if BR2_PACKAGE_VSFTPD

config BR2_PACKAGE_VSFTPD_UTMPX
	bool "log vsftpd access to utmpx"
	# musl 1.1.4 has an empty utmpx implementation and no WTMPX_FILE
	depends on !BR2_TOOLCHAIN_USES_MUSL
	help
	  Enable logging of vsftpd access to utmpx.
	  Note that Buildroot does not generate utmpx by default.

endif
```

## package.bak/webp/Config.in
```kconfig
config BR2_PACKAGE_WEBP
	bool "webp"
	help
	  WebP is a new image format that provides lossless and lossy
	  compression for images on the web

	  https://developers.google.com/speed/webp/

if BR2_PACKAGE_WEBP

config BR2_PACKAGE_WEBP_DEMUX
	bool "webpdemux"
	help
	  Demux is a part of WebPMux for extraction and manipulation
	  of an extended format WebP file, which can have features
	  like color profile, metadata and animation.

endif
```
