## package.bak/wget/Config.in
```kconfig
config BR2_PACKAGE_WGET
	bool "wget"
	# fork()
	depends on BR2_USE_MMU
	depends on BR2_USE_WCHAR
	depends on BR2_PACKAGE_BUSYBOX_SHOW_OTHERS
	help
	  Network utility to retrieve files from http, https and ftp.

	  http://www.gnu.org/software/wget/

comment "wget needs a toolchain w/ wchar"
	depends on BR2_USE_MMU
	depends on !BR2_USE_WCHAR
	depends on BR2_PACKAGE_BUSYBOX_SHOW_OTHERS
```

## package.bak/wsapi/Config.in
```kconfig
config BR2_PACKAGE_WSAPI
	bool "wsapi"
	# Runtime dependency only
	select BR2_PACKAGE_COXPCALL
	select BR2_PACKAGE_LUAFILESYSTEM
	select BR2_PACKAGE_RINGS
	help
	  API that abstracts the web server from Lua web applications.

	  http://keplerproject.github.com/wsapi/
```

## package.bak/x11r7/xapp_luit/Config.in
```kconfig
config BR2_PACKAGE_XAPP_LUIT
	bool "luit"
	select BR2_PACKAGE_XLIB_LIBX11
	select BR2_PACKAGE_XLIB_LIBFONTENC
	depends on BR2_USE_MMU # fork()
	help
	  Locale and ISO 2022 support for Unicode terminals
```

## package.bak/x11r7/xapp_rgb/Config.in
```kconfig
config BR2_PACKAGE_XAPP_RGB
	bool "rgb"
	select BR2_PACKAGE_XPROTO_XPROTO
	help
	  uncompile an rgb color-name database
```

## package.bak/x11r7/xapp_smproxy/Config.in
```kconfig
config BR2_PACKAGE_XAPP_SMPROXY
	bool "smproxy"
	select BR2_PACKAGE_XLIB_LIBXMU
	select BR2_PACKAGE_XLIB_LIBXT
	help
	  Session Manager Proxy
```

## package.bak/x11r7/xapp_xedit/Config.in
```kconfig
config BR2_PACKAGE_XAPP_XEDIT
	bool "xedit"
	select BR2_PACKAGE_XLIB_LIBXAW
	depends on BR2_USE_MMU # fork()
	help
	  simple text editor for X
```

## package.bak/x11r7/xapp_xev/Config.in
```kconfig
config BR2_PACKAGE_XAPP_XEV
	bool "xev"
	select BR2_PACKAGE_XLIB_LIBX11
	select BR2_PACKAGE_XLIB_LIBXRANDR
	help
	  print contents of X events
```

## package.bak/x11r7/xapp_xfsinfo/Config.in
```kconfig
config BR2_PACKAGE_XAPP_XFSINFO
	bool "xfsinfo"
	select BR2_PACKAGE_XLIB_LIBFS
	select BR2_PACKAGE_XLIB_LIBX11
	help
	  X font server information utility
```

## package.bak/x11r7/xapp_xkbutils/Config.in
```kconfig
config BR2_PACKAGE_XAPP_XKBUTILS
	bool "xkbutils"
	select BR2_PACKAGE_XLIB_LIBXAW
	select BR2_PACKAGE_XLIB_LIBXKBFILE
	help
	  X.Org xkbutils application
```

## package.bak/x11r7/xapp_xlsclients/Config.in
```kconfig
config BR2_PACKAGE_XAPP_XLSCLIENTS
	bool "xlsclients"
	select BR2_PACKAGE_XLIB_LIBX11
	select BR2_PACKAGE_XLIB_LIBXMU
	select BR2_PACKAGE_LIBXCB
	select BR2_PACKAGE_XCB_UTIL
	help
	  X.Org xlsclients application
```

## package.bak/x11r7/xapp_xlsfonts/Config.in
```kconfig
config BR2_PACKAGE_XAPP_XLSFONTS
	bool "xlsfonts"
	select BR2_PACKAGE_XLIB_LIBX11
	help
	  X.Org xlsfonts application
```

## package.bak/x11r7/xapp_xprop/Config.in
```kconfig
config BR2_PACKAGE_XAPP_XPROP
	bool "xprop"
	select BR2_PACKAGE_XLIB_LIBX11
	select BR2_PACKAGE_XLIB_LIBXMU
	help
	  property displayer for X
```

## package.bak/x11r7/xapp_xsm/Config.in
```kconfig
config BR2_PACKAGE_XAPP_XSM
	bool "xsm"
	depends on BR2_USE_MMU # fork()
	select BR2_PACKAGE_XLIB_LIBXAW
	help
	  X Session Manager
```

## package.bak/x11r7/xapp_xvidtune/Config.in
```kconfig
config BR2_PACKAGE_XAPP_XVIDTUNE
	bool "xvidtune"
	select BR2_PACKAGE_XLIB_LIBXAW
	select BR2_PACKAGE_XLIB_LIBXXF86VM
	help
	  video mode tuner for Xorg
```

## package.bak/x11r7/xapp_xwud/Config.in
```kconfig
config BR2_PACKAGE_XAPP_XWUD
	bool "xwud"
	select BR2_PACKAGE_XLIB_LIBX11
	help
	  image displayer for X
```

## package.bak/x11r7/xcb-util/Config.in
```kconfig
config BR2_PACKAGE_XCB_UTIL
	bool "xcb-util"
	depends on BR2_PACKAGE_LIBXCB
	help
	  Libraries which sit on top of libxcb, the core X protocol library,
	  and some of the extension libraries.

	  http://xcb.freedesktop.org/
```

## package.bak/x11r7/xdriver_xf86-input-joystick/Config.in
```kconfig
config BR2_PACKAGE_XDRIVER_XF86_INPUT_JOYSTICK
	bool "xf86-input-joystick"
	select BR2_PACKAGE_XPROTO_INPUTPROTO
	select BR2_PACKAGE_XPROTO_RANDRPROTO
	select BR2_PACKAGE_XPROTO_XPROTO
	help
	  X.Org driver for joystick input devices
```

## package.bak/x11r7/xdriver_xf86-video-amdgpu/Config.in
```kconfig
config BR2_PACKAGE_XDRIVER_XF86_VIDEO_AMDGPU
	bool "xf86-video-amdgpu"
	depends on BR2_PACKAGE_MESA3D_DRI_DRIVER
	depends on BR2_PACKAGE_MESA3D_OPENGL_EGL # gbm
	select BR2_PACKAGE_LIBDRM
	select BR2_PACKAGE_LIBDRM_AMDGPU
	select BR2_PACKAGE_LIBEPOXY
	select BR2_PACKAGE_XLIB_LIBXCOMPOSITE
	select BR2_PACKAGE_XPROTO_DRI3PROTO
	select BR2_PACKAGE_XPROTO_FONTSPROTO
	select BR2_PACKAGE_XPROTO_GLPROTO
	select BR2_PACKAGE_XPROTO_RANDRPROTO
	select BR2_PACKAGE_XPROTO_VIDEOPROTO
	select BR2_PACKAGE_XPROTO_XEXTPROTO
	select BR2_PACKAGE_XPROTO_XF86DRIPROTO
	select BR2_PACKAGE_XPROTO_XPROTO
	help
	  AMD GPU video driver

comment "xf86-video-amdgpu needs egl/opengl support from mesa3d"
	depends on !BR2_PACKAGE_MESA3D_OPENGL_EGL || \
		!BR2_PACKAGE_MESA3D_DRI_DRIVER
```

## package.bak/x11r7/xdriver_xf86-video-ati/Config.in
```kconfig
config BR2_PACKAGE_XDRIVER_XF86_VIDEO_ATI
	bool "xf86-video-ati"
	depends on BR2_PACKAGE_MESA3D
	select BR2_PACKAGE_LIBDRM
	select BR2_PACKAGE_LIBDRM_RADEON
	select BR2_PACKAGE_MESA3D_DRI_DRIVER_RADEON
	select BR2_PACKAGE_XLIB_LIBXCOMPOSITE
	select BR2_PACKAGE_XPROTO_FONTSPROTO
	select BR2_PACKAGE_XPROTO_GLPROTO
	select BR2_PACKAGE_XPROTO_RANDRPROTO
	select BR2_PACKAGE_XPROTO_VIDEOPROTO
	select BR2_PACKAGE_XPROTO_XEXTPROTO
	select BR2_PACKAGE_XPROTO_XF86DRIPROTO
	select BR2_PACKAGE_XPROTO_XINERAMAPROTO
	select BR2_PACKAGE_XPROTO_XPROTO
	help
	  ATI video driver

comment "xf86-video-ati needs mesa3d"
	depends on !BR2_PACKAGE_MESA3D
```

## package.bak/x11r7/xdriver_xf86-video-imx/Config.in
```kconfig
config BR2_PACKAGE_XDRIVER_XF86_VIDEO_IMX
	bool "xf86-video-imx"
	depends on BR2_ARM_EABI # libz160
	depends on BR2_TOOLCHAIN_USES_GLIBC # libz160
	depends on BR2_LINUX_KERNEL # linux/mxcfb.h
	depends on BR2_PACKAGE_GPU_AMD_BIN_MX51_OUTPUT_X11
	select BR2_PACKAGE_LIBZ160
	select BR2_PACKAGE_XPROTO_FONTSPROTO
	select BR2_PACKAGE_XPROTO_RANDRPROTO
	select BR2_PACKAGE_XPROTO_RENDERPROTO
	select BR2_PACKAGE_XPROTO_VIDEOPROTO
	select BR2_PACKAGE_XPROTO_XF86DGAPROTO
	select BR2_PACKAGE_XPROTO_XPROTO
	help
	  X.Org driver for iMX5 GPU

	  To use this driver, add the correct configuration to your
	  /etc/X11/xorg.conf, as follows:

	  Section "Device"
	    [...]
	    Driver "imx"
	    Option "fbdev" "/dev/fb0"
	  EndSection

comment "xf86-video-imx needs an EABI toolchain w/ glibc"
	depends on BR2_arm
	depends on !BR2_ARM_EABI || !BR2_TOOLCHAIN_USES_GLIBC

comment "xf86-video-imx needs gpu-amd-bin-mx51 with X11 output and a Linux kernel to be built"
	depends on BR2_arm
	depends on !BR2_LINUX_KERNEL || !BR2_PACKAGE_GPU_AMD_BIN_MX51_OUTPUT_X11
```

## package.bak/x11r7/xdriver_xf86-video-nv/Config.in
```kconfig
config BR2_PACKAGE_XDRIVER_XF86_VIDEO_NV
	bool "xf86-video-nv"
	select BR2_PACKAGE_XPROTO_FONTSPROTO
	select BR2_PACKAGE_XPROTO_RANDRPROTO
	select BR2_PACKAGE_XPROTO_RENDERPROTO
	select BR2_PACKAGE_XPROTO_VIDEOPROTO
	select BR2_PACKAGE_XPROTO_XEXTPROTO
	select BR2_PACKAGE_XPROTO_XPROTO
	help
	  NVIDIA video driver
```

## package.bak/x11r7/xdriver_xf86-video-vesa/Config.in
```kconfig
config BR2_PACKAGE_XDRIVER_XF86_VIDEO_VESA
	bool "xf86-video-vesa"
	select BR2_PACKAGE_XPROTO_FONTSPROTO
	select BR2_PACKAGE_XPROTO_RANDRPROTO
	select BR2_PACKAGE_XPROTO_RENDERPROTO
	select BR2_PACKAGE_XPROTO_XEXTPROTO
	select BR2_PACKAGE_XPROTO_XPROTO
	help
	  Generic VESA video driver
```

## package.bak/x11r7/xdriver_xf86-video-wsfb/Config.in
```kconfig
config BR2_PACKAGE_XDRIVER_XF86_VIDEO_WSFB
	bool "xf86-video-wsfb"
	select BR2_PACKAGE_XPROTO_FONTSPROTO
	select BR2_PACKAGE_XPROTO_RANDRPROTO
	select BR2_PACKAGE_XPROTO_RENDERPROTO
	select BR2_PACKAGE_XPROTO_XEXTPROTO
	select BR2_PACKAGE_XPROTO_XPROTO
	depends on BROKEN # Fails to build. Actually this is OpenBSD/NetBSD stuff.
	help
	  WSFB based chips video driver
```

## package.bak/x11r7/xfont_encodings/Config.in
```kconfig
config BR2_PACKAGE_XFONT_ENCODINGS
	bool "encodings"
	select BR2_PACKAGE_XUTIL_UTIL_MACROS
	help
	  No description available
```

## package.bak/x11r7/xfont_font-adobe-100dpi/Config.in
```kconfig
config BR2_PACKAGE_XFONT_FONT_ADOBE_100DPI
	bool "font-adobe-100dpi"
	select BR2_PACKAGE_XFONT_FONT_UTIL
	help
	  No description available
```
