## package.bak/x11r7/xfont_font-arabic-misc/Config.in
```kconfig
config BR2_PACKAGE_XFONT_FONT_ARABIC_MISC
	bool "font-arabic-misc"
	select BR2_PACKAGE_XFONT_FONT_UTIL
	help
	  No description available
```

## package.bak/x11r7/xfont_font-bh-100dpi/Config.in
```kconfig
config BR2_PACKAGE_XFONT_FONT_BH_100DPI
	bool "font-bh-100dpi"
	select BR2_PACKAGE_XFONT_FONT_UTIL
	help
	  No description available
```

## package.bak/x11r7/xfont_font-bh-ttf/Config.in
```kconfig
config BR2_PACKAGE_XFONT_FONT_BH_TTF
	bool "font-bh-ttf"
	select BR2_PACKAGE_XFONT_FONT_UTIL
	help
	  No description available
```

## package.bak/x11r7/xfont_font-bitstream-75dpi/Config.in
```kconfig
config BR2_PACKAGE_XFONT_FONT_BITSTREAM_75DPI
	bool "font-bitstream-75dpi"
	select BR2_PACKAGE_XFONT_FONT_UTIL
	help
	  No description available
```

## package.bak/x11r7/xfont_font-cronyx-cyrillic/Config.in
```kconfig
config BR2_PACKAGE_XFONT_FONT_CRONYX_CYRILLIC
	bool "font-cronyx-cyrillic"
	select BR2_PACKAGE_XFONT_FONT_UTIL
	help
	  No description available
```

## package.bak/x11r7/xfont_font-cursor-misc/Config.in
```kconfig
config BR2_PACKAGE_XFONT_FONT_CURSOR_MISC
	bool "font-cursor-misc"
	select BR2_PACKAGE_XFONT_FONT_UTIL
	help
	  No description available
```

## package.bak/x11r7/xfont_font-isas-misc/Config.in
```kconfig
config BR2_PACKAGE_XFONT_FONT_ISAS_MISC
	bool "font-isas-misc"
	select BR2_PACKAGE_XFONT_FONT_UTIL
	help
	  No description available
```

## package.bak/x11r7/xfont_font-misc-cyrillic/Config.in
```kconfig
config BR2_PACKAGE_XFONT_FONT_MISC_CYRILLIC
	bool "font-misc-cyrillic"
	select BR2_PACKAGE_XFONT_FONT_UTIL
	help
	  No description available
```

## package.bak/x11r7/xfont_font-misc-meltho/Config.in
```kconfig
config BR2_PACKAGE_XFONT_FONT_MISC_MELTHO
	bool "font-misc-meltho"
	select BR2_PACKAGE_XFONT_FONT_UTIL
	help
	  No description available
```

## package.bak/x11r7/xfont_font-misc-misc/Config.in
```kconfig
config BR2_PACKAGE_XFONT_FONT_MISC_MISC
	bool "font-misc-misc"
	select BR2_PACKAGE_XFONT_FONT_UTIL
	help
	  No description available
```

## package.bak/x11r7/xfont_font-schumacher-misc/Config.in
```kconfig
config BR2_PACKAGE_XFONT_FONT_SCHUMACHER_MISC
	bool "font-schumacher-misc"
	select BR2_PACKAGE_XFONT_FONT_UTIL
	help
	  No description available
```

## package.bak/x11r7/xfont_font-xfree86-type1/Config.in
```kconfig
config BR2_PACKAGE_XFONT_FONT_XFREE86_TYPE1
	bool "font-xfree86-type1"
	select BR2_PACKAGE_XFONT_FONT_UTIL
	help
	  No description available
```

## package.bak/x11r7/xlib_libICE/Config.in
```kconfig
config BR2_PACKAGE_XLIB_LIBICE
	bool "libICE"
	select BR2_PACKAGE_XLIB_XTRANS
	select BR2_PACKAGE_XPROTO_XPROTO
	help
	  X.Org ICE library
```

## package.bak/x11r7/xlib_libXft/Config.in
```kconfig
config BR2_PACKAGE_XLIB_LIBXFT
	bool "libXft"
	select BR2_PACKAGE_FONTCONFIG
	select BR2_PACKAGE_FREETYPE
	select BR2_PACKAGE_XLIB_LIBX11
	select BR2_PACKAGE_XLIB_LIBXEXT
	select BR2_PACKAGE_XLIB_LIBXRENDER
	select BR2_PACKAGE_XPROTO_XPROTO
	help
	  X.Org Xft library
```

## package.bak/x11r7/xlib_libXxf86vm/Config.in
```kconfig
config BR2_PACKAGE_XLIB_LIBXXF86VM
	bool "libXxf86vm"
	select BR2_PACKAGE_XLIB_LIBX11
	select BR2_PACKAGE_XLIB_LIBXEXT
	select BR2_PACKAGE_XPROTO_XF86VIDMODEPROTO
	select BR2_PACKAGE_XPROTO_XPROTO
	help
	  X.Org Xxf86vm library
```

## package.bak/x11r7/xlib_libdmx/Config.in
```kconfig
config BR2_PACKAGE_XLIB_LIBDMX
	bool "libdmx"
	select BR2_PACKAGE_XLIB_LIBX11
	select BR2_PACKAGE_XLIB_LIBXEXT
	select BR2_PACKAGE_XPROTO_DMXPROTO
	help
	  X.Org dmx library
```

## package.bak/x11r7/xproto_presentproto/Config.in
```kconfig
config BR2_PACKAGE_XPROTO_PRESENTPROTO
	bool "presentproto"
	select BR2_PACKAGE_XUTIL_UTIL_MACROS
	help
	  X.Org Present extension headers
```

## package.bak/x11r7/xproto_renderproto/Config.in
```kconfig
config BR2_PACKAGE_XPROTO_RENDERPROTO
	bool "renderproto"
	help
	  X.Org Render protocol headers
```

## package.bak/x11r7/xproto_xcmiscproto/Config.in
```kconfig
config BR2_PACKAGE_XPROTO_XCMISCPROTO
	bool "xcmiscproto"
	help
	  X.Org XCMisc protocol headers
```

## package.bak/xterm/Config.in
```kconfig
config BR2_PACKAGE_XTERM
	bool "xterm"
	select BR2_PACKAGE_NCURSES
	select BR2_PACKAGE_XLIB_LIBXAW
	depends on BR2_PACKAGE_XORG7
	depends on BR2_USE_MMU # fork()
	# ARC toolchain issue
	depends on !BR2_TOOLCHAIN_EXTERNAL_SYNOPSYS_ARC
	help
	  xterm terminal emulator

	  http://invisible-island.net/xterm/
```

## package.bak/xvkbd/Config.in
```kconfig
config BR2_PACKAGE_XVKBD
	bool "xvkbd"
	depends on BR2_PACKAGE_XORG7
	select BR2_PACKAGE_XLIB_LIBICE
	select BR2_PACKAGE_XLIB_LIBSM
	select BR2_PACKAGE_XLIB_LIBX11
	select BR2_PACKAGE_XLIB_LIBXAW
	select BR2_PACKAGE_XLIB_LIBXEXT
	select BR2_PACKAGE_XLIB_LIBXMU
	select BR2_PACKAGE_XLIB_LIBXPM
	select BR2_PACKAGE_XLIB_LIBXT
	select BR2_PACKAGE_XLIB_LIBXTST
	help
	  on-screen keyboard for X

	  http://t-sato.in.coocan.jp/xvkbd
```

## package/18xx-ti-utils/Config.in
```kconfig
config BR2_PACKAGE_18XX_TI_UTILS
	bool "18xx-ti-utils"
	depends on BR2_TOOLCHAIN_HAS_THREADS # libnl
	select BR2_PACKAGE_LIBNL
	help
	  TI Wilink calibration utilities.

	  CONFIG_NL80211_TESTMODE must be enabled in the kernel
	  configuration for this package to work.

	  http://processors.wiki.ti.com/index.php/WL18xx_TX_Testing

comment "18xx-ti-utils needs a toolchain w/ threads"
	depends on !BR2_TOOLCHAIN_HAS_THREADS
```

## package/4th/Config.in
```kconfig
config BR2_PACKAGE_4TH
	bool "4th"
	help
	  4tH is a Forth compiler that can create bytecode,
	  C-embeddable bytecode, standalone executables, but also
	  works fine as a scripting language

	  http://thebeez.home.xs4all.nl/4tH/
```

## package/Config.in.host
```kconfig
menu "Host utilities"

	source "package/aespipe/Config.in.host"
	source "package/android-tools/Config.in.host"
	source "package/btrfs-progs/Config.in.host"
	source "package/cargo/Config.in.host"
	source "package/cbootimage/Config.in.host"
	source "package/checkpolicy/Config.in.host"
	source "package/checksec/Config.in.host"
	source "package/cmake/Config.in.host"
	source "package/cramfs/Config.in.host"
	source "package/cryptsetup/Config.in.host"
	source "package/dbus-python/Config.in.host"
	source "package/dfu-util/Config.in.host"
	source "package/dos2unix/Config.in.host"
	source "package/dosfstools/Config.in.host"
	source "package/doxygen/Config.in.host"
	source "package/dtc/Config.in.host"
	source "package/e2fsprogs/Config.in.host"
	source "package/e2tools/Config.in.host"
	source "package/eudev/Config.in.host"
	source "package/f2fs-tools/Config.in.host"
	source "package/faketime/Config.in.host"
	source "package/fatcat/Config.in.host"
	source "package/fwup/Config.in.host"
	source "package/genext2fs/Config.in.host"
	source "package/genimage/Config.in.host"
	source "package/genpart/Config.in.host"
	source "package/gnupg/Config.in.host"
	source "package/go/Config.in.host"
	source "package/go-bootstrap/Config.in.host"
	source "package/google-breakpad/Config.in.host"
	source "package/gptfdisk/Config.in.host"
	source "package/imagemagick/Config.in.host"
	source "package/imx-mkimage/Config.in.host"
	source "package/imx-usb-loader/Config.in.host"
	source "package/jq/Config.in.host"
	source "package/jsmin/Config.in.host"
	source "package/libp11/Config.in.host"
	source "package/lld/Config.in.host"
	source "package/lpc3250loader/Config.in.host"
	source "package/lttng-babeltrace/Config.in.host"
	source "package/mender-artifact/Config.in.host"
	source "package/mfgtools/Config.in.host"
	source "package/mkpasswd/Config.in.host"
	source "package/mtd/Config.in.host"
	source "package/mtools/Config.in.host"
	source "package/mxsldr/Config.in.host"
	source "package/omap-u-boot-utils/Config.in.host"
	source "package/openocd/Config.in.host"
	source "package/opkg-utils/Config.in.host"
	source "package/parted/Config.in.host"
	source "package/patchelf/Config.in.host"
	source "package/pkgconf/Config.in.host"
	source "package/pru-software-support/Config.in.host"
	source "package/pwgen/Config.in.host"
	source "package/python/Config.in.host"
	source "package/python-cython/Config.in.host"
	source "package/python-lxml/Config.in.host"
	source "package/python-six/Config.in.host"
	source "package/python-xlrd/Config.in.host"
	source "package/python3/Config.in.host"
	source "package/qemu/Config.in.host"
	source "package/raspberrypi-usbboot/Config.in.host"
	source "package/rauc/Config.in.host"
	source "package/rcw/Config.in.host"
	source "package/rustc/Config.in.host"
	source "package/s6-rc/Config.in.host"
	source "package/sam-ba/Config.in.host"
	source "package/sdbusplus/Config.in.host"
	source "package/squashfs/Config.in.host"
	source "package/sunxi-tools/Config.in.host"
	source "package/swig/Config.in.host"
	source "package/systemd/Config.in.host"
	source "package/tegrarcm/Config.in.host"
	source "package/ti-cgt-pru/Config.in.host"
	source "package/uboot-tools/Config.in.host"
	source "package/util-linux/Config.in.host"
	source "package/utp_com/Config.in.host"
	source "package/vboot-utils/Config.in.host"
	source "package/xorriso/Config.in.host"
	source "package/zip/Config.in.host"
	source "package/zstd/Config.in.host"

endmenu
```
