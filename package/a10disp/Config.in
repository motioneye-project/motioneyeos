## package/a10disp/Config.in
```kconfig
config BR2_PACKAGE_A10DISP
	bool "a10disp"
	depends on BR2_arm
	depends on BR2_LINUX_KERNEL
	help
	  Program to change the display mode of Allwinner ARM SOCs running
	  the linux-sunxi kernel (and not the mainline kernel.)

	  http://github.com/hglm/a10disp

comment "a10disp requires the linux kernel"
	depends on BR2_arm
	depends on !BR2_LINUX_KERNEL
```

## package/abootimg/Config.in
```kconfig
config BR2_PACKAGE_ABOOTIMG
	bool "abootimg"
	depends on BR2_USE_MMU	# libblkid
	select BR2_PACKAGE_UTIL_LINUX
	select BR2_PACKAGE_UTIL_LINUX_LIBBLKID
	help
	  Tool to manipulate Android Boot Images, either on files
	  or directly on /dev block devices.

	  https://github.com/ggrandou/abootimg
```

## package/ace_of_penguins/Config.in
```kconfig
config BR2_PACKAGE_ACE_OF_PENGUINS
	bool "ace_of_penguins"
	select BR2_PACKAGE_LIBPNG
	default n
	depends on BR2_PACKAGE_XORG||BR2_PACKAGE_XORG7
	help
	  The Ace of Penguins is a set of Unix/X solitaire games based
	  on the ones available for Windows but with a number of
	  enhancements.

	  http://www.delorie.com/store/ace/
```

## package/acl/Config.in
```kconfig
config BR2_PACKAGE_ACL
	bool "acl"
	select BR2_PACKAGE_ATTR
	help
	  POSIX Access Control Lists, which are used to define more
	  fine-grained discretionary access rights for files and
	  directories.
	  This package also provides libacl.

	  http://savannah.nongnu.org/projects/acl
```

## package/acpica/Config.in
```kconfig
config BR2_PACKAGE_ACPICA
	bool "acpica"
	depends on BR2_TOOLCHAIN_HAS_THREADS
	help
	  The ACPI Component Architecture (ACPICA) project provides an
	  operating system (OS)-independent reference implementation
	  of the Advanced Configuration and Power Interface
	  Specification (ACPI).

	  https://www.acpica.org

comment "acpica needs a toolchain w/ threads"
	depends on !BR2_TOOLCHAIN_HAS_THREADS
```

## package/acpid/Config.in
```kconfig
config BR2_PACKAGE_ACPID
	bool "acpid"
	depends on BR2_x86_64 || BR2_i386
	help
	  Advanced Configuration and Power Interface event daemon.

	  Acpid is designed to notify user-space programs of ACPI
	  events, and allows you to configure specific actions for
	  specific events.

	  http://sourceforge.net/projects/acpid2/
```

## package/acpitool/Config.in
```kconfig
config BR2_PACKAGE_ACPITOOL
	bool "acpitool"
	depends on !BR2_bfin
	depends on !BR2_STATIC_LIBS
	depends on BR2_TOOLCHAIN_HAS_THREADS
	depends on BR2_INSTALL_LIBSTDCPP
	help
	  A small, convenient command-line ACPI client with a lot of
	  features for Linux

	  http://acpitool.sourceforge.net

comment "acpitool needs a toolchain w/ threads, C++, dynamic library"
	depends on !BR2_bfin
	depends on BR2_STATIC_LIBS || !BR2_TOOLCHAIN_HAS_THREADS \
		|| !BR2_INSTALL_LIBSTDCPP
```

## package/acsccid/Config.in
```kconfig
config BR2_PACKAGE_ACSCCID
	bool "acsccid"
	depends on BR2_TOOLCHAIN_HAS_THREADS # pcsc-lite, libusb
	depends on BR2_USE_MMU # pcsc-lite
	depends on !BR2_STATIC_LIBS # pcsc-lite
	select BR2_PACKAGE_PCSC_LITE
	# Even though there is a --disable-libusb option, it has in
	# fact no effect, and acsccid really requires libusb.
	select BR2_PACKAGE_LIBUSB
	help
	  acsccid is a PC/SC driver for Linux/Mac OS X and it supports
	  ACS CCID smart card readers.

	  http://acsccid.sourceforge.net/

comment "acsccid needs a toolchain w/ threads, dynamic library"
	depends on BR2_USE_MMU
	depends on !BR2_TOOLCHAIN_HAS_THREADS || \
		BR2_STATIC_LIBS
```

## package/adwaita-icon-theme/Config.in
```kconfig
config BR2_PACKAGE_ADWAITA_ICON_THEME
	bool "adwaita icon theme"
	depends on BR2_PACKAGE_LIBGTK3
	help
	  Adwaita icon theme
```

## package/aer-inject/Config.in
```kconfig
config BR2_PACKAGE_AER_INJECT
	bool "aer-inject"
	help
	  aer-inject allows to inject PCIE AER errors on the software
	  level into a running Linux kernel. This is intended for
	  validation of the PCIE driver error recovery handler and
	  PCIE AER core handler.

	  Requires a new Linux kernel with PCIE AER error injection
	  patches.

	  https://git.kernel.org/cgit/linux/kernel/git/gong.chen/aer-inject.git/
```

## package/aespipe/Config.in
```kconfig
config BR2_PACKAGE_AESPIPE
	bool "aespipe"
	depends on BR2_USE_MMU # fork()
	help
	  aespipe program is AES encrypting or decrypting pipe. It reads
	  from standard input and writes to standard output. It can be
	  used to create and restore encrypted tar or cpio archives.
	  It can be used to encrypt and decrypt loop-AES compatible
	  encrypted disk images.

	  http://koti.tnnet.fi/jari.ruusu/linux/
```

## package/aespipe/Config.in.host
```kconfig
config BR2_PACKAGE_HOST_AESPIPE
	bool "host aespipe"
	help
	  aespipe program is AES encrypting or decrypting pipe. It
	  reads from standard input and writes to standard output. It
	  can be used to create and restore encrypted tar or cpio
	  archives. It can be used to encrypt and decrypt loop-AES
	  compatible encrypted disk images.

	  http://koti.tnnet.fi/jari.ruusu/linux/
```

## package/agentpp/Config.in
```kconfig
config BR2_PACKAGE_AGENTPP
	bool "agent++"
	select BR2_PACKAGE_SNMPPP
	depends on BR2_INSTALL_LIBSTDCPP
	depends on BR2_TOOLCHAIN_HAS_THREADS # snmp++
	depends on !BR2_PREFER_STATIC_LIB # snmp++
	help
	  AGENT++ is a set of C++ classes which provides a complete protocol
	  engine and dispatch table for the development of SNMP agents.
	  AGENT++ is a multilingual API which supports SNMPv1, SNMPv2c, and
	  SNMPv3. It provides various C++ classes implementing prototypes for
	  scalar and table SNMP managed objects that can be customized by
	  derivation. Additional classes support the development of proxy
	  agents as well as sending notifications.

	  SNMPv3 support is enabled if SNMP++ enables it.

	  http://www.agentpp.com/agentpp3_5/agentpp3_5.html

comment "agent++ needs a toolchain w/ threads, C++, dynamic library"
	depends on !BR2_INSTALL_LIBSTDCPP || !BR2_TOOLCHAIN_HAS_THREADS || \
		BR2_PREFER_STATIC_LIB
```

## package/aiccu/Config.in
```kconfig
config BR2_PACKAGE_AICCU
	bool "aiccu"
	depends on BR2_INET_IPV6
	depends on BR2_USE_WCHAR
	depends on BR2_TOOLCHAIN_HAS_THREADS
	depends on BR2_USE_MMU # fork()
	# Uses dn_skipname(), only available since 0.9.33
	depends on !BR2_UCLIBC_VERSION_0_9_31 && \
		!BR2_UCLIBC_VERSION_0_9_32
	# AVR32 only has uClibc 0.9.31, so there's no way it can build
	# due to the lack of dn_skipname(), even with external
	# toolchains.
	depends on !BR2_avr32
	# Triggers the _gp link issue
	depends on !BR2_nios2
	select BR2_PACKAGE_GNUTLS
	help
	  SixXS Automatic IPv6 Connectivity Client Utility

	  AICCU (Automatic IPv6 Connectivity Client Utility) makes it
	  easy for users to get IPv6 connectivity. After having
	  requested an account, tunnel and optionally a subnet, AICCU
	  can be used to automatically configure the tunnel. AICCU
	  supports TIC (Tunnel Information & Control protocol), which it
	  uses for retrieving the tunnel configuration information,
	  AYIYA, which allows tunnels to be created even behind
	  firewalls and NAT's.

	  http://www.sixxs.net/tools/aiccu/

comment "aiccu needs a toolchain w/ IPv6, wchar, threads"
	depends on BR2_USE_MMU
	depends on !(BR2_INET_IPV6 && BR2_USE_WCHAR && BR2_TOOLCHAIN_HAS_THREADS)
	depends on !BR2_avr32
	depends on !BR2_nios2
```

## package/aircrack-ng/Config.in
```kconfig
config BR2_PACKAGE_AIRCRACK_NG
	bool "aircrack-ng"
	depends on BR2_USE_MMU # uses fork()
	depends on BR2_TOOLCHAIN_HAS_THREADS
	depends on BR2_INSTALL_LIBSTDCPP
	depends on !BR2_STATIC_LIBS # dlfcn.h
	select BR2_PACKAGE_OPENSSL if !BR2_PACKAGE_LIBGCRYPT
	help
	  A set of tools for auditing wireless networks

	  For complete functionality, also select ethtool, iw,
	  util-linux (utilities and rfkill), and wireless_tools.

	  http://www.aircrack-ng.org/

comment "aircrack-ng needs a toolchain w/ dynamic library, threads, C++"
	depends on BR2_USE_MMU
	depends on BR2_STATIC_LIBS || !BR2_TOOLCHAIN_HAS_THREADS \
		|| !BR2_INSTALL_LIBSTDCPP
```

## package/alljoyn/Config.in
```kconfig
config BR2_PACKAGE_ALLJOYN
	bool "alljoyn"
	depends on BR2_USE_MMU # fork()
	depends on !BR2_STATIC_LIBS
	depends on BR2_INSTALL_LIBSTDCPP
	depends on BR2_TOOLCHAIN_HAS_SYNC_4
	depends on BR2_TOOLCHAIN_HAS_THREADS
	depends on BR2_USE_WCHAR
	select BR2_PACKAGE_LIBCAP
	select BR2_PACKAGE_OPENSSL
	help
	  The AllJoyn framework defines a common way for devices and
	  apps to communicate with one another regardless of brands,
	  categories, transports, and OSes. Developers write
	  applications that discover nearby devices, and communicate
	  with each other directly and through the cloud, unleashing
	  new possibilities in the Internet of Things.

	  https://allseenalliance.org

comment "alljoyn needs a toolchain w/ C++, threads, wchar and dynamic library"
	depends on BR2_USE_MMU
	depends on BR2_TOOLCHAIN_HAS_SYNC_4
	depends on !BR2_INSTALL_LIBSTDCPP || !BR2_TOOLCHAIN_HAS_THREADS || \
		!BR2_USE_WCHAR || BR2_STATIC_LIBS
```

## package/alsa-lib/Config.in
```kconfig
comment "alsa-lib needs a toolchain w/ threads"
	depends on !BR2_TOOLCHAIN_HAS_THREADS

menuconfig BR2_PACKAGE_ALSA_LIB
	bool "alsa-lib"
	# Even though some parts of alsa-lib use threads only when
	# available, some PCM plugins use them unconditionally. Since
	# the usage of alsa-lib on no-thread systems is pretty
	# unlikely, just require thread support globally for alsa-lib.
	depends on BR2_TOOLCHAIN_HAS_THREADS
	# Temporary until
	# https://bugtrack.alsa-project.org/alsa-bug/view.php?id=4913
	# is fixed
	select BR2_PACKAGE_ALSA_LIB_PCM
	help
	  The Advanced Linux Sound Architecture (ALSA) provides audio and MIDI
	  functionality to the Linux operating system.

	  http://www.alsa-project.org/

if BR2_PACKAGE_ALSA_LIB

config BR2_PACKAGE_ALSA_LIB_PYTHON
	bool "Python support for alsa-lib"
	depends on BR2_PACKAGE_PYTHON
	help
	  Add python support for alsa-lib.
	  Python will be built and libpython will be installed
	  in the target directory
	  http://www.alsa-project.org/

config BR2_PACKAGE_ALSA_LIB_DEVDIR
	string "directory with ALSA device files"
	default "/dev/snd"

config BR2_PACKAGE_ALSA_LIB_PCM_PLUGINS
	string "built PCM plugins"
	default "all" if BR2_USE_MMU
	default "copy linear route mulaw alaw adpcm rate plug multi file null empty share meter hooks lfloat ladspa dmix dshare dsnoop asym iec958 softvol extplug ioplug mmap_emul" if !BR2_USE_MMU

config BR2_PACKAGE_ALSA_LIB_CTL_PLUGINS
	string "built control plugins"
	default "all"

config BR2_PACKAGE_ALSA_LIB_ALOAD
	bool "aload"
	default y

config BR2_PACKAGE_ALSA_LIB_MIXER
	bool "mixer"
	default y

config BR2_PACKAGE_ALSA_LIB_PCM
	bool "pcm"
	default y

config BR2_PACKAGE_ALSA_LIB_RAWMIDI
	bool "rawmidi"
	default y

config BR2_PACKAGE_ALSA_LIB_HWDEP
	bool "hwdep"
	default y

config BR2_PACKAGE_ALSA_LIB_SEQ
	bool "seq"
	default y

config BR2_PACKAGE_ALSA_LIB_ALISP
	bool "alisp"
	default y
	depends on BR2_USE_MMU

config BR2_PACKAGE_ALSA_LIB_OLD_SYMBOLS
	bool "old-symbols"
	default y

endif
```

## package/alsa-utils/Config.in
```kconfig
comment "alsa-utils needs a toolchain w/ threads"
	depends on BR2_USE_MMU # fork
	depends on !BR2_TOOLCHAIN_HAS_THREADS

menuconfig BR2_PACKAGE_ALSA_UTILS
	bool "alsa-utils"
	depends on BR2_USE_MMU # fork
	depends on BR2_TOOLCHAIN_HAS_THREADS # alsa-lib
	select BR2_PACKAGE_ALSA_LIB
	help
	  This package contains the command line utilities for the ALSA
	  project.

	  http://www.alsa-project.org/

if BR2_PACKAGE_ALSA_UTILS

config BR2_PACKAGE_ALSA_UTILS_ALSACONF
	bool "alsaconf"

config BR2_PACKAGE_ALSA_UTILS_ACONNECT
	bool "aconnect"
	select BR2_PACKAGE_ALSA_LIB_SEQ

config BR2_PACKAGE_ALSA_UTILS_ALSACTL
	bool "alsactl"
	default y

config BR2_PACKAGE_ALSA_UTILS_ALSALOOP
	bool "alsaloop"

config BR2_PACKAGE_ALSA_UTILS_ALSAMIXER
	bool "alsamixer"
	default y
	depends on BR2_USE_WCHAR
	select BR2_PACKAGE_NCURSES
	select BR2_PACKAGE_ALSA_LIB_MIXER

comment "alsamixer needs a toolchain w/ wchar"
	depends on !BR2_USE_WCHAR

config BR2_PACKAGE_ALSA_UTILS_ALSAUCM
	bool "alsaucm"
	select BR2_PACKAGE_ALSA_LIB_UCM

config BR2_PACKAGE_ALSA_UTILS_ALSATPLG
	bool "alsatplg"

config BR2_PACKAGE_ALSA_UTILS_AMIDI
	bool "amidi"
	select BR2_PACKAGE_ALSA_LIB_RAWMIDI

config BR2_PACKAGE_ALSA_UTILS_AMIXER
	bool "amixer"
	select BR2_PACKAGE_ALSA_LIB_MIXER

config BR2_PACKAGE_ALSA_UTILS_APLAY
	bool "aplay/arecord"
	select BR2_PACKAGE_ALSA_LIB_PCM

config BR2_PACKAGE_ALSA_UTILS_APLAYMIDI
	bool "aplaymidi"
	select BR2_PACKAGE_ALSA_LIB_SEQ

config BR2_PACKAGE_ALSA_UTILS_ARECORDMIDI
	bool "arecordmidi"
	select BR2_PACKAGE_ALSA_LIB_SEQ

config BR2_PACKAGE_ALSA_UTILS_ASEQDUMP
	bool "aseqdump"
	select BR2_PACKAGE_ALSA_LIB_SEQ

config BR2_PACKAGE_ALSA_UTILS_ASEQNET
	bool "aseqnet"
	select BR2_PACKAGE_ALSA_LIB_SEQ

config BR2_PACKAGE_ALSA_UTILS_BAT
	bool "bat"
	help
	  ALSABAT (ALSA Basic Audio Tester) is a simple command-line
	  utility intended to help automate audio driver and sound
	  server testing with little human interaction.

	  Note that analysis support in alsabat requires fftw single
	  precision.

config BR2_PACKAGE_ALSA_UTILS_IECSET
	bool "iecset"
	select BR2_PACKAGE_ALSA_LIB_PCM

config BR2_PACKAGE_ALSA_UTILS_SPEAKER_TEST
	bool "speaker-test"
	select BR2_PACKAGE_ALSA_LIB_PCM

endif
```

## package/alsamixergui/Config.in
```kconfig
config BR2_PACKAGE_ALSAMIXERGUI
	depends on BR2_PACKAGE_XORG7
	depends on BR2_INSTALL_LIBSTDCPP
	select BR2_PACKAGE_FLTK
	select BR2_PACKAGE_ALSA_LIB
	select BR2_PACKAGE_ALSA_LIB_PCM
	select BR2_PACKAGE_ALSA_LIB_MIXER
	depends on BR2_TOOLCHAIN_HAS_THREADS # alsa-lib
	bool "alsamixergui"
	help
	  A nice GUI mixer for Alsa using fltk

	  http://www.iua.upf.es/~mdeboer/projects/alsamixergui/

comment "alsamixergui requires a toolchain with C++ and threads support enabled"
	depends on (!BR2_INSTALL_LIBSTDCPP || !BR2_TOOLCHAIN_HAS_THREADS) && BR2_PACKAGE_XORG7
```

## package/alure/Config.in
```kconfig
config BR2_PACKAGE_ALURE
	bool "alure"
	depends on BR2_PACKAGE_OPENAL_ARCH_SUPPORTS
	depends on BR2_TOOLCHAIN_GCC_AT_LEAST_4_9 # C++11
	depends on BR2_INSTALL_LIBSTDCPP
	depends on BR2_TOOLCHAIN_HAS_THREADS_NPTL # openal
	depends on BR2_USE_WCHAR # use wchar_t
	depends on !BR2_TOOLCHAIN_HAS_GCC_BUG_64735 # std::shared_future
	select BR2_PACKAGE_OPENAL
	help
	  Alure is a C++ 3D audio API. It uses OpenAL for audio
	  rendering, and provides common higher-level features such as
	  file loading and decoding, buffer caching, background
	  streaming, and source management for virtually unlimited
	  sound source handles.

	  https://kcat.strangesoft.net/alure.html

if BR2_PACKAGE_ALURE

config BR2_PACKAGE_ALURE_FLAC_DECODER
	bool "flac decoder"
	help
	  Enables the built-in FLAC decoder.

config BR2_PACKAGE_ALURE_MINIMP3_DECODER
	bool "minimp3 decoder"
	help
	  Enables the built-in minimp3 decoder.

config BR2_PACKAGE_ALURE_OPUS_DECODER
	bool "opus decoder"
	select BR2_PACKAGE_LIBOGG
	select BR2_PACKAGE_OPUS
	help
	  Enables the built-in libopusfile decoder.

config BR2_PACKAGE_ALURE_SNDFILE_DECODER
	bool "sndfile decoder"
	select BR2_PACKAGE_LIBSNDFILE
	help
	  Enables the built-in libsndfile decoder.

config BR2_PACKAGE_ALURE_VORBIS_DECODER
	bool "vorbis decoder"
	select BR2_PACKAGE_LIBOGG
	select BR2_PACKAGE_LIBVORBIS
	help
	  Enables the built-in libvorbis decoder.

endif

comment "alure needs a toolchain w/ C++, gcc >= 4.9, NPTL, wchar"
	depends on BR2_PACKAGE_OPENAL_ARCH_SUPPORTS
	depends on !BR2_INSTALL_LIBSTDCPP \
		|| !BR2_TOOLCHAIN_GCC_AT_LEAST_4_9 \
		|| !BR2_TOOLCHAIN_HAS_THREADS_NPTL || !BR2_USE_WCHAR

comment "alure needs a toolchain not affected by GCC bug 64735"
	depends on BR2_PACKAGE_OPENAL_ARCH_SUPPORTS
	depends on BR2_TOOLCHAIN_HAS_GCC_BUG_64735
```

## package/am335x-pru-package/Config.in
```kconfig
config BR2_PACKAGE_AM335X_PRU_PACKAGE
	bool "am335x-pru-package"
	depends on BR2_arm # only relevant for TI am335x
	help
	  TI AM335X PRU program loader

	  https://github.com/beagleboard/am335x_pru_package
```
