## package/at/Config.in
```kconfig
config BR2_PACKAGE_AT
	bool "at"
	depends on BR2_USE_MMU
	help
	  At and batch read shell commands from standard input and
	  store them as jobs to be scheduled for execution in the
	  future.

	  at    - run the job at a specified time
	  batch - run the job when system load levels permit
```

## package/atest/Config.in
```kconfig
config BR2_PACKAGE_ATEST
	bool "atest"
	depends on BR2_TOOLCHAIN_HAS_THREADS # alsa-lib
	select BR2_PACKAGE_ALSA_LIB
	select BR2_PACKAGE_LIBEV
	help
	  atest is a test software for checking ALSA Asoc drivers
	  concerning the proper frame generation and capture.

	  https://github.com/amouiche/atest

comment "atest needs a toolchain w/ threads"
	depends on !BR2_TOOLCHAIN_HAS_THREADS
```

## package/atf/Config.in
```kconfig
config BR2_PACKAGE_ATF
	bool "atf"
	depends on BR2_INSTALL_LIBSTDCPP
	help
	  ATF, or Automated Testing Framework, is a collection of
	  libraries to write test programs in C, C++ and POSIX shell.

	  https://github.com/jmmv/atf

comment "atf needs a toolchain w/ C++"
	depends on !BR2_INSTALL_LIBSTDCPP
```

## package/atftp/Config.in
```kconfig
config BR2_PACKAGE_ATFTP
	bool "atftp"
	depends on BR2_INET_IPV6
	depends on BR2_TOOLCHAIN_HAS_THREADS
	help
	  atftp is a client/server implementation of the TFTP
	  protocol that implements RFCs 1350, 2090, 2347, 2348,
	  and 2349. The server is multi-threaded and the client
	  presents a friendly interface using libreadline
	  (if enabled).

	  http://sourceforge.net/projects/atftp/

comment "atftp needs a toolchain w/ threads, IPv6"
	depends on !BR2_TOOLCHAIN_HAS_THREADS || !BR2_INET_IPV6
```

## package/atk/Config.in
```kconfig
config BR2_PACKAGE_ATK
	bool "atk"
	depends on BR2_USE_WCHAR # glib2
	depends on BR2_TOOLCHAIN_HAS_THREADS # glib2
	depends on BR2_USE_MMU # glib2
	select BR2_PACKAGE_LIBGLIB2
	help
	  The ATK accessibility toolkit, needed to build GTK+-2.x.

comment "atk needs a toolchain w/ wchar, threads"
	depends on BR2_USE_MMU
	depends on !BR2_USE_WCHAR || !BR2_TOOLCHAIN_HAS_THREADS
```
