## package/angularjs/Config.in
```kconfig
config BR2_PACKAGE_ANGULARJS
	bool "angularjs"
	help
	  AngularJS web application framework.

	  http://angularjs.org

if BR2_PACKAGE_ANGULARJS

menuconfig BR2_ANGULARJS_MODULES
	bool "angularjs modules"
	help
	  Select which modules to install. If disabled, all modules
	  will be installed.

if BR2_ANGULARJS_MODULES

config BR2_ANGULARJS_MODULE_ANIMATE
	bool "animate"
	help
	  The ngAnimate module provides support for CSS-based animations
	  (keyframes and transitions) as well as JavaScript-based animations
	  via callback hooks. Animations are not enabled by default, however,
	  by including ngAnimate then the animation hooks are enabled for an
	  Angular app.

config BR2_ANGULARJS_MODULE_ARIA
	bool "aria"
	help
	  The ngAria module provides support for common ARIA attributes that
	  convey state or semantic information about the application for users
	  of assistive technologies, such as screen readers.

config BR2_ANGULARJS_MODULE_COOKIES
	bool "cookies"
	help
	  The ngCookies module provides a convenient wrapper for reading and
	  writing browser cookies.

config BR2_ANGULARJS_MODULE_MESSAGE_FORMAT
	bool "message-format"
	help
	  The ngMessageFormat module is used recognize MessageFormat extensions
	  in interpolation expressions.

config BR2_ANGULARJS_MODULE_MESSAGES
	bool "messages"
	help
	  The ngMessages module provides enhanced support for displaying
	  messages within templates (typically within forms or when rendering
	  message objects that return key/value data).

config BR2_ANGULARJS_MODULE_RESOURCE
	bool "resource"
	help
	  The ngResource module provides interaction support with RESTful
	  services via the $resource service.

config BR2_ANGULARJS_MODULE_ROUTE
	bool "route"
	help
	  The ngRoute module provides routing and deeplinking services and
	  directives for angular apps.

config BR2_ANGULARJS_MODULE_SANITIZE
	bool "sanitize"
	help
	  The ngSanitize module provides functionality to sanitize HTML.

config BR2_ANGULARJS_MODULE_TOUCH
	bool "touch"
	help
	  The ngTouch module provides touch events and other helpers for
	  touch-enabled devices. The implementation is based on jQuery Mobile
	  touch event handling (jquerymobile.com).

endif

endif
```

## package/aoetools/Config.in
```kconfig
config BR2_PACKAGE_AOETOOLS
	bool "aoetools"
	depends on BR2_TOOLCHAIN_HAS_THREADS
	help
	  The aoetools are programs for users of the ATA over Ethernet
	  (AoE) network storage protocol, a simple protocol for using
	  storage over an ethernet LAN.

	  http://aoetools.sourceforge.net/

comment "aoetools needs a toolchain w/ threads"
	depends on !BR2_TOOLCHAIN_HAS_THREADS
```

## package/apache/Config.in
```kconfig
config BR2_PACKAGE_APACHE
	bool "apache"
	select BR2_PACKAGE_APR_UTIL
	select BR2_PACKAGE_PCRE
	depends on !BR2_STATIC_LIBS
	depends on BR2_TOOLCHAIN_HAS_THREADS
	depends on BR2_USE_MMU # apr
	help
	  The Apache HTTP Server Project is an effort to develop and maintain an
	  open-source HTTP server for modern operating systems including UNIX
	  and Windows NT. The goal of this project is to provide a secure,
	  efficient and extensible server that provides HTTP services in sync
	  with the current HTTP standards.

	  http://httpd.apache.org

comment "apache needs a toolchain w/ dynamic library, threads"
	depends on BR2_USE_MMU
	depends on BR2_STATIC_LIBS || !BR2_TOOLCHAIN_HAS_THREADS
```

## package/apcupsd/Config.in
```kconfig
config BR2_PACKAGE_APCUPSD
	bool "apcupsd"
	depends on BR2_INSTALL_LIBSTDCPP
	depends on BR2_TOOLCHAIN_HAS_THREADS
	depends on BR2_USE_MMU # fork()
	help
	  A daemon for controlling APC UPSes.

	  http://www.apcupsd.org/

if BR2_PACKAGE_APCUPSD

config BR2_PACKAGE_APCUPSD_APCSMART
	bool "apcsmart"
	help
	  Compile APC SmartUPS serial driver

config BR2_PACKAGE_APCUPSD_DUMB
	bool "dumb"
	help
	  Compile dumb UPS driver

config BR2_PACKAGE_APCUPSD_MODBUS
	bool "modbus"
	help
	  Compile MODBUS driver code

config BR2_PACKAGE_APCUPSD_MODBUS_USB
	bool "modbus usb"
	depends on BR2_TOOLCHAIN_HAS_THREADS # libusb
	select BR2_PACKAGE_LIBUSB
	select BR2_PACKAGE_LIBUSB_COMPAT
	select BR2_PACKAGE_APCUPSD_MODBUS
	help
	  Compile MODBUS/USB driver code

comment "modbus usb support needs a toolchain w/ threads"
	depends on !BR2_TOOLCHAIN_HAS_THREADS

config BR2_PACKAGE_APCUPSD_NET
	bool "net"
	help
	  Compile networking driver for slaves

config BR2_PACKAGE_APCUPSD_PCNET
	bool "pcnet"
	help
	  Compile PCNET driver code

config BR2_PACKAGE_APCUPSD_SNMP
	bool "snmp"
	help
	  Compile SNMP driver

config BR2_PACKAGE_APCUPSD_USB
	bool "usb"
	depends on BR2_TOOLCHAIN_HAS_THREADS # libusb
	select BR2_PACKAGE_LIBUSB
	select BR2_PACKAGE_LIBUSB_COMPAT
	help
	  Compile USB UPS code

comment "usb support needs a toolchain w/ threads"
	depends on !BR2_TOOLCHAIN_HAS_THREADS

endif

comment "apcupsd needs a toolchain w/ C++, threads"
	depends on BR2_USE_MMU
	depends on !BR2_INSTALL_LIBSTDCPP || !BR2_TOOLCHAIN_HAS_THREADS
```

## package/apitrace/Config.in
```kconfig
comment "apitrace needs a toolchain w/ C++, wchar, dynamic library, threads, gcc >= 4.9"
	depends on BR2_USE_MMU
	depends on !BR2_INSTALL_LIBSTDCPP || !BR2_USE_WCHAR || \
		BR2_STATIC_LIBS || !BR2_TOOLCHAIN_HAS_THREADS || \
		!BR2_TOOLCHAIN_GCC_AT_LEAST_4_9

config BR2_PACKAGE_APITRACE
	bool "apitrace"
	depends on BR2_USE_MMU # fork()
	depends on BR2_USE_WCHAR
	depends on BR2_INSTALL_LIBSTDCPP
	depends on !BR2_STATIC_LIBS # dlfcn.h
	depends on BR2_TOOLCHAIN_GCC_AT_LEAST_4_9
	depends on BR2_TOOLCHAIN_HAS_THREADS
	select BR2_PACKAGE_XLIB_LIBX11 if BR2_PACKAGE_XORG7
	select BR2_PACKAGE_LIBPNG
	help
	  Trace and replay OpenGL and OpenGL ES APIs calls to/from a
	  file. You may install apitrace GUI from your distribution to
	  inspect generated traces.

	  http://apitrace.github.io/
```

## package/apparmor/Config.in
```kconfig
config BR2_PACKAGE_APPARMOR
	bool "apparmor"
	depends on BR2_USE_MMU # fork()
	depends on BR2_INSTALL_LIBSTDCPP
	depends on BR2_TOOLCHAIN_HAS_SYNC_4 # libapparmor
	depends on BR2_TOOLCHAIN_HAS_THREADS # libapparmor
	depends on BR2_TOOLCHAIN_HEADERS_AT_LEAST_3_16 # libapparmor
	select BR2_PACKAGE_LIBAPPARMOR
	help
	  AppArmor is an effective and easy-to-use Linux application
	  security system. AppArmor proactively protects the operating
	  system and applications from external or internal threats,
	  even zero-day attacks, by enforcing good behavior and
	  preventing even unknown application flaws from being
	  exploited.

	  This package builds the parser (which can load profiles).

	  http://wiki.apparmor.net

if BR2_PACKAGE_APPARMOR

config BR2_PACKAGE_APPARMOR_BINUTILS
	bool "binutils"
	help
	  A set of utilities (written in C):
	    aa-enabled    aa-exec

comment "utils need python3"
	depends on !BR2_PACKAGE_PYTHON3

config BR2_PACKAGE_APPARMOR_UTILS
	bool "utils"
	depends on BR2_PACKAGE_PYTHON3
	select BR2_PACKAGE_BUSYBOX_SHOW_OTHERS # net-tools
	select BR2_PACKAGE_NET_TOOLS # runtime (aa-unconfined)
	select BR2_PACKAGE_PYTHON3_READLINE
	help
	  A set of utilities (written in python):
	    aa-audit          aa-disable      aa-logprof
	    aa-autodep        aa-easyprof     aa-mergeprof
	    aa-cleanprof      aa-enforce      aa-status
	    aa-complain       aa-genprof      aa-unconfined

if BR2_PACKAGE_APPARMOR_UTILS

comment "utils (extras) need bash and perl, and busybox or gawk"
	depends on !BR2_PACKAGE_BASH || !BR2_PACKAGE_PERL \
		|| !(BR2_PACKAGE_BUSYBOX || BR2_PACKAGE_GAWK)

config BR2_PACKAGE_APPARMOR_UTILS_EXTRA
	bool "utils (extras)"
	depends on BR2_PACKAGE_BASH
	depends on BR2_PACKAGE_PERL
	depends on BR2_PACKAGE_BUSYBOX || BR2_PACKAGE_GAWK
	help
	  An extra set of utilities (written in a mixture of sh,
	  bash, perl, and awk):
	    aa-decode          (bash + perl)
	    aa-notify          (perl)
	    aa-remove-unknown  (sh + awk)

endif # BR2_PACKAGE_APPARMOR_UTILS

config BR2_PACKAGE_APPARMOR_PROFILES
	bool "profiles"
	help
	  Installs server-class profiles for a wide range of
	  usual programs and daemons.

endif # BR2_PACKAGE_APPARMOR

comment "apparmor needs a toolchain w/ headers >= 3.16, threads, C++"
	depends on BR2_USE_MMU
	depends on BR2_TOOLCHAIN_HAS_SYNC_4
	depends on !BR2_INSTALL_LIBSTDCPP || !BR2_TOOLCHAIN_HAS_THREADS \
		|| !BR2_TOOLCHAIN_HEADERS_AT_LEAST_3_16
```

## package/apr-util/Config.in
```kconfig
config BR2_PACKAGE_APR_UTIL
	bool "apr-util"
	# apr really needs shared library support
	depends on !BR2_STATIC_LIBS
	depends on BR2_USE_MMU # apr
	select BR2_PACKAGE_APR
	select BR2_PACKAGE_EXPAT
	help
	  The utility library for the apache runtime project

	  http://apr.apache.org/

comment "apr-util needs a toolchain w/ dynamic library"
	depends on BR2_USE_MMU
	depends on BR2_STATIC_LIBS
```

## package/apr/Config.in
```kconfig
config BR2_PACKAGE_APR
	bool "apr"
	# apr really needs shared library support
	depends on !BR2_STATIC_LIBS
	depends on BR2_USE_MMU # fork() in apr_proc_fork()
	help
	  The mission of the Apache Portable Runtime (APR) project is to
	  create and maintain software libraries that provide a
	  predictable and consistent interface to underlying
	  platform-specific implementations

	  http://apr.apache.org/

comment "apr needs a toolchain w/ dynamic library"
	depends on BR2_USE_MMU
	depends on BR2_STATIC_LIBS
```

## package/argp-standalone/Config.in
```kconfig
config BR2_PACKAGE_ARGP_STANDALONE
	bool "argp-standalone"
	# glibc provides its own argp implementation.
	depends on !BR2_TOOLCHAIN_USES_GLIBC
	help
	  Glibc hierarchical argument parsing standalone library.

	  http://www.lysator.liu.se/~nisse/misc/
```

## package/argparse/Config.in
```kconfig
config BR2_PACKAGE_ARGPARSE
	bool "argparse"
	help
	  Argparse is a feature-rich command line parser for Lua
	  inspired by argparse for Python. Argparse supports
	  positional arguments, options, flags, optional arguments,
	  subcommands and more. Argparse automatically generates
	  usage, help and error messages.

	  https://github.com/luarocks/argparse
```

## package/argus/Config.in
```kconfig
config BR2_PACKAGE_ARGUS
	bool "argus"
	depends on BR2_TOOLCHAIN_HAS_THREADS
	depends on BR2_USE_MMU # fork()
	select BR2_PACKAGE_LIBPCAP
	select BR2_PACKAGE_LIBTIRPC if !BR2_TOOLCHAIN_HAS_NATIVE_RPC
	help
	  A Real Time Flow Monitor-based audit engine.

	  http://qosient.com/argus/

comment "argus needs a toolchain w/ threads"
	depends on !BR2_TOOLCHAIN_HAS_THREADS
	depends on BR2_USE_MMU
```

## package/armadillo/Config.in
```kconfig
comment "armadillo needs a toolchain w/ C++"
	depends on !BR2_INSTALL_LIBSTDCPP
	depends on !BR2_powerpc
	depends on !BR2_m68k_cf

comment "armadillo needs a glibc toolchain w/ C++"
	depends on BR2_powerpc
	depends on !BR2_INSTALL_LIBSTDCPP || BR2_TOOLCHAIN_USES_UCLIBC

config BR2_PACKAGE_ARMADILLO
	bool "armadillo"
	depends on BR2_INSTALL_LIBSTDCPP
	depends on !BR2_powerpc || BR2_TOOLCHAIN_USES_GLIBC # clapack
	depends on !BR2_m68k_cf # clapack
	select BR2_PACKAGE_CLAPACK
	help
	  Armadillo: An Open Source C++ Linear Algebra Library for
	  Fast Prototyping and Computationally Intensive Experiments.

	  http://arma.sourceforge.net/
```

## package/armbian-firmware/Config.in
```kconfig
config BR2_PACKAGE_ARMBIAN_FIRMWARE
	bool "armbian-firmware"
	help
	  This package enables access to various firmware
	  blobs from the Armbian firmware repository.

	  https://github.com/armbian/firmware

if BR2_PACKAGE_ARMBIAN_FIRMWARE

config BR2_PACKAGE_ARMBIAN_FIRMWARE_XR819
	bool "XR819 WiFi"
	help
	  Firmware files for XR819 WiFi SDIO chip.

config BR2_PACKAGE_ARMBIAN_FIRMWARE_AP6212
	bool "AP6212 WiFi/BT"
	help
	  Firmware files for AP6212 WiFi/BT combo chip.

endif
```

## package/arp-scan/Config.in
```kconfig
config BR2_PACKAGE_ARP_SCAN
	bool "arp-scan"
	select BR2_PACKAGE_LIBPCAP
	help
	  The ARP scanner

	  arp-scan is a command-line tool that uses the ARP protocol to
	  discover and fingerprint IP hosts on the local network.

	  https://github.com/royhills/arp-scan
```

## package/arptables/Config.in
```kconfig
config BR2_PACKAGE_ARPTABLES
	bool "arptables-legacy"
	depends on BR2_USE_MMU # needs fork()
	help
	  Legacy tool to set up, maintain, and inspect the tables of ARP
	  rules.

	  A more uptodate client of the arptables tool is provided in
	  the iptables package. The new tool was formerly known as
	  arptables-compat.

	  http://git.netfilter.org/arptables
```

## package/ascii-invaders/Config.in
```kconfig
config BR2_PACKAGE_ASCII_INVADERS
	bool "ascii_invaders"
	select BR2_PACKAGE_NCURSES
	help
	  An ASCII-art game like Space Invaders using ncurses.

	  https://github.com/macdice/ascii-invaders
```

## package/assimp/Config.in
```kconfig
config BR2_PACKAGE_ASSIMP
	bool "assimp"
	depends on BR2_INSTALL_LIBSTDCPP
	depends on BR2_USE_WCHAR
	help
	  Open Asset Import Library (assimp) is a portable Open Source
	  library to import various well-known 3D model formats in a
	  uniform manner. The most recent version also knows how to
	  export 3d files and is therefore suitable as a general-purpose
	  3D model converter.

	  http://www.assimp.org

comment "assimp needs a toolchain w/ C++, wchar"
	depends on !BR2_INSTALL_LIBSTDCPP || !BR2_USE_WCHAR
```

## package/asterisk/Config.in
```kconfig
config BR2_PACKAGE_ASTERISK
	bool "asterisk"
	depends on BR2_INSTALL_LIBSTDCPP
	depends on !BR2_STATIC_LIBS # dlfcn.h
	depends on !BR2_TOOLCHAIN_USES_MUSL
	depends on BR2_USE_MMU # libedit
	depends on BR2_TOOLCHAIN_HAS_THREADS
	depends on BR2_USE_WCHAR # libedit
	select BR2_PACKAGE_JANSSON
	select BR2_PACKAGE_LIBCURL
	select BR2_PACKAGE_LIBEDIT
	select BR2_PACKAGE_LIBILBC
	select BR2_PACKAGE_LIBXML2
	select BR2_PACKAGE_SQLITE
	select BR2_PACKAGE_UTIL_LINUX
	select BR2_PACKAGE_UTIL_LINUX_LIBUUID
	help
	  Asterisk is an open source framework for building
	  communications applications. Asterisk turns an ordinary
	  computer into a communications server. Asterisk powers IP PBX
	  systems, VoIP gateways, conference servers and other custom
	  solutions. It is used by small businesses, large businesses,
	  call centers, carriers and government agencies, worldwide.
	  Asterisk is free and open source.

	  http://www.asterisk.org/

comment "asterisk needs a glibc or uClibc toolchain w/ C++, dynamic library, threads, wchar"
	depends on BR2_USE_MMU
	depends on BR2_TOOLCHAIN_USES_MUSL || !BR2_INSTALL_LIBSTDCPP \
		|| BR2_STATIC_LIBS || !BR2_TOOLCHAIN_HAS_THREADS \
		|| !BR2_USE_WCHAR
```

## package/at-spi2-atk/Config.in
```kconfig
config BR2_PACKAGE_AT_SPI2_ATK
	bool "at-spi2-atk"
	depends on BR2_PACKAGE_XORG7 # at-spi2-core
	depends on BR2_TOOLCHAIN_HAS_THREADS # glib2
	depends on BR2_USE_MMU # glib2
	depends on BR2_USE_WCHAR # glib2
	select BR2_PACKAGE_ATK
	select BR2_PACKAGE_AT_SPI2_CORE
	select BR2_PACKAGE_LIBGLIB2
	help
	  The At-Spi2 Atk package contains a library that bridges
	  ATK to At-Spi2 D-Bus service.

	  https://www.freedesktop.org/wiki/Accessibility/AT-SPI2/

comment "at-spi2-atk needs a toolchain w/ wchar, threads"
	depends on BR2_USE_MMU
	depends on !BR2_USE_WCHAR || !BR2_TOOLCHAIN_HAS_THREADS

comment "at-spi2-atk depends on X.org"
	depends on BR2_USE_MMU
	depends on !BR2_PACKAGE_XORG7
```

## package/at-spi2-core/Config.in
```kconfig
config BR2_PACKAGE_AT_SPI2_CORE
	bool "at-spi2-core"
	depends on BR2_PACKAGE_XORG7 # xlib-libxtst
	depends on BR2_TOOLCHAIN_HAS_THREADS # dbus, glib2
	depends on BR2_USE_MMU # glib2
	depends on BR2_USE_WCHAR # glib2
	select BR2_PACKAGE_DBUS
	select BR2_PACKAGE_LIBGLIB2
	select BR2_PACKAGE_XLIB_LIBXTST
	help
	  The At-Spi2 Core package is a part of the GNOME
	  Accessibility Project. It provides a Service Provider
	  Interface for the Assistive Technologies available on the
	  GNOME platform and a library against which applications
	  can be linked.

	  https://wiki.gnome.org/Accessibility

comment "at-spi2-core needs a toolchain w/ wchar, threads"
	depends on BR2_USE_MMU
	depends on !BR2_USE_WCHAR || !BR2_TOOLCHAIN_HAS_THREADS

comment "at-spi2-core depends on X.org"
	depends on BR2_USE_MMU
	depends on !BR2_PACKAGE_XORG7
```
