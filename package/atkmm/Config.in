## package/atkmm/Config.in
```kconfig
config BR2_PACKAGE_ATKMM
	bool "atkmm"
	select BR2_PACKAGE_ATK
	select BR2_PACKAGE_GLIBMM
	select BR2_PACKAGE_LIBSIGC
	depends on BR2_INSTALL_LIBSTDCPP # glibmm
	depends on BR2_TOOLCHAIN_GCC_AT_LEAST_4_8 # C++11
	depends on BR2_TOOLCHAIN_HAS_THREADS # atk/glibmm -> libglib2
	depends on BR2_USE_MMU # atk/glibmm -> libglib2
	depends on BR2_USE_WCHAR # atk/glibmm -> libglib2

	help
	  The atkmm package is a set of C++ bindings for Atk.

	  http://www.gtkmm.org/

comment "atkmm needs a toolchain w/ C++, wchar, threads, gcc >= 4.8"
	depends on BR2_USE_MMU
	depends on !BR2_TOOLCHAIN_GCC_AT_LEAST_4_8 || !BR2_USE_WCHAR \
		|| !BR2_INSTALL_LIBSTDCPP || !BR2_TOOLCHAIN_HAS_THREADS
```

## package/atop/Config.in
```kconfig
config BR2_PACKAGE_ATOP
	bool "atop"
	depends on BR2_USE_MMU # fork()
	depends on BR2_TOOLCHAIN_HEADERS_AT_LEAST_3_14 # PERF_FLAG_FD_CLOEXEC
	select BR2_PACKAGE_NCURSES
	select BR2_PACKAGE_ZLIB
	help
	  Atop is an ASCII full-screen performance monitor for Linux
	  that is capable of reporting the activity of all processes
	  (even if processes have finished during the interval), daily
	  logging of system and process activity for long-term analysis,
	  highlighting overloaded system resources by using colors, etc.
	  At regular intervals, it shows system-level activity related
	  to the CPU, memory, swap, disks (including LVM) and network
	  layers, and for every process (and thread) it shows e.g. the
	  CPU utilization, memory growth, disk utilization, priority,
	  username, state, and exit code.

	  http://www.atoptool.nl

comment "atop needs a toolchain w/ headers >= 3.14"
	depends on BR2_USE_MMU
	depends on !BR2_TOOLCHAIN_HEADERS_AT_LEAST_3_14
```

## package/attr/Config.in
```kconfig
config BR2_PACKAGE_ATTR
	bool "attr"
	help
	  Commands for Manipulating Filesystem Extended Attributes.
	  This package also provides libattr.

	  http://savannah.nongnu.org/projects/attr
```

## package/aubio/Config.in
```kconfig
config BR2_PACKAGE_AUBIO
	bool "aubio"
	depends on !BR2_STATIC_LIBS
	depends on BR2_TOOLCHAIN_HAS_THREADS
	help
	  aubio is a tool designed for the extraction of annotations
	  from audio signals. Its features include segmenting a sound
	  file before each of its attacks, performing pitch detection,
	  tapping the beat and producing midi streams from live audio.

	  Because these tasks are difficult, we thought it was important
	  to gather them in a dedicated library. To increase the fun, we
	  have made these algorithms work in a causal way, so as to be
	  used in real time applications with as low delay as possible.
	  Functions can be used offline in sound editors and software
	  samplers, or online in audio effects and virtual instruments.

	  https://aubio.org

comment "aubio needs a toolchain w/ threads, dynamic library"
	depends on !BR2_TOOLCHAIN_HAS_THREADS || BR2_STATIC_LIBS
```

## package/audio/Config.in
```kconfig
menu "Audio libraries and applications"
source "package/audio/alsa-lib/Config.in"
source "package/audio/alsa-utils/Config.in"
source "package/audio/asterisk/Config.in"
source "package/audio/aumix/Config.in"
source "package/audio/libid3tag/Config.in"
source "package/audio/libmad/Config.in"
source "package/audio/libogg/Config.in"
source "package/audio/libsndfile/Config.in"
source "package/audio/libvorbis/Config.in"
source "package/audio/madplay/Config.in"
source "package/audio/mpg123/Config.in"
source "package/audio/speex/Config.in"
source "package/audio/festival/Config.in"
endmenu
```

## package/audio/alsa-lib/Config.in
```kconfig
config BR2_PACKAGE_ALSA_LIB
	bool "alsa-lib"
	help
	  The Advanced Linux Sound Architecture (ALSA) provides audio and MIDI
	  functionality to the Linux operating system.

	  http://www.alsa-project.org/
```

## package/audio/festival/Config.in
```kconfig
menuconfig BR2_PACKAGE_FESTIVAL
bool "festival text-to-speech system"
select BR2_PACKAGE_ALSA_LIB
select BR2_PACKAGE_SPEECH_TOOLS
help
	Text to speech system for Linux

if BR2_PACKAGE_FESTIVAL

	menu "speech tools"
		source "package/audio/festival/speech-tools/Config.in"
	endmenu

	menu "festival lexicons"
		source "package/audio/festival/lexicons/Config.in"
	endmenu

	menu "festival voices"
		source "package/audio/festival/voices/Config.in"
	endmenu

endif
```

## package/audio/festival/lexicons/Config.in
```kconfig
config BR2_PACKAGE_FESTLEX_CMU
	bool "Carnegie Mellon University"
	help
	  Lexicon for the festival text to speech system

	  http://festvox.org/packed/festival/latest

config BR2_PACKAGE_FESTLEX_OALD
	bool "Oxford Advanced Learners dictionary"
	help
	  Lexicon for the festival text to speech system

	  http://festvox.org/packed/festival/latest

config BR2_PACKAGE_FESTLEX_POS
	bool "POSLEX"
	help
	  Lexicon for the festival text to speech system

	  http://festvox.org/packed/festival/latest
```

## package/audio/festival/speech-tools/Config.in
```kconfig
 config BR2_PACKAGE_SPEECH_TOOLS
	bool "speech tools for festival"
	help
	  Speech tools for the festival text to speech system

	  http://festvox.org/packed/festival/latest
```

## package/audio/speex/Config.in
```kconfig
config BR2_PACKAGE_SPEEX
	bool "speex"
	select BR2_PACKAGE_LIBOGG
	help
	  Speex is an Open Source/Free Software patent-free
	  audio compression format designed for speech.
	  It can be used for Voice over IP

	  http://www.speex.org/

config BR2_PACKAGE_SPEEX_ARM_GENERIC
       bool
       default y
       depends on BR2_PACKAGE_SPEEX && (BR2_generic_arm || BR2_arm610 || BR2_arm710)

config BR2_PACKAGE_SPEEX_ARM4
       bool
       default y
       depends on BR2_PACKAGE_SPEEX && (BR2_arm7tdmi || BR2_arm720t || BR2_arm920t || BR2_arm922t || BR2_sa110 || BR2_sa1100)

config BR2_PACKAGE_SPEEX_ARM5E
	default y
	bool
	depends on BR2_PACKAGE_SPEEX && BR2_arm && !(BR2_PACKAGE_SPEEX_ARM_GENERIC || BR2_PACKAGE_SPEEX_ARM4)
```

## package/audiofile/Config.in
```kconfig
config BR2_PACKAGE_AUDIOFILE
	bool "audiofile"
	depends on BR2_INSTALL_LIBSTDCPP
	help
	  The Audio File Library handles reading and writing audio files
	  in many common formats.

	  http://www.68k.org/~michael/audiofile/

comment "audiofile needs a toolchain w/ C++"
	depends on !BR2_INSTALL_LIBSTDCPP
```

## package/audit/Config.in
```kconfig
# audit has some builtin per-architecture system call tables
config BR2_PACKAGE_AUDIT_ARCH_SUPPORTS
	bool
	default y if BR2_aarch64 || BR2_arm || BR2_armeb || \
		BR2_i386 || BR2_powerpc || BR2_x86_64

config BR2_PACKAGE_AUDIT
	bool "audit"
	depends on BR2_PACKAGE_AUDIT_ARCH_SUPPORTS
	depends on BR2_TOOLCHAIN_HAS_THREADS
	depends on !BR2_STATIC_LIBS
	depends on !BR2_TOOLCHAIN_USES_MUSL
	help
	  The audit package contains the user space utilities for
	  storing and searching the audit records generated by
	  the audit subsystem in the Linux 2.6 kernel

	  Note: The z/OS remote plugin is disabled in this package

	  http://people.redhat.com/sgrubb/audit/

comment "audit needs a uClibc or glibc toolchain w/ threads, dynamic library"
	depends on !BR2_TOOLCHAIN_HAS_THREADS || BR2_STATIC_LIBS \
		|| BR2_TOOLCHAIN_USES_MUSL
	depends on BR2_PACKAGE_AUDIT_ARCH_SUPPORTS
```

## package/aufs/Config.in
```kconfig
# Automatically selected by the corresponding linux extension
config BR2_PACKAGE_AUFS
	bool

if BR2_PACKAGE_AUFS

# Both come from the selection of the linux extension.
config BR2_PACKAGE_AUFS_SERIES
	int
	default BR2_LINUX_KERNEL_EXT_AUFS_SERIES

config BR2_PACKAGE_AUFS_VERSION
	string
	default BR2_LINUX_KERNEL_EXT_AUFS_VERSION

endif
```

## package/augeas/Config.in
```kconfig
config BR2_PACKAGE_AUGEAS
	bool "augeas"
	# ARC toolchain issue:
	# https://github.com/foss-for-synopsys-dwc-arc-processors/toolchain/issues/108
	depends on !BR2_arc
	depends on BR2_USE_WCHAR
	select BR2_PACKAGE_LIBXML2
	select BR2_PACKAGE_READLINE
	help
	  Augeas is a configuration editing tool. It parses
	  configuration files in their native formats and transforms
	  them into a tree. Configuration changes are made by
	  manipulating this tree and saving it back into native config
	  files.

	  http://augeas.net

comment "augeas needs a toolchain w/ wchar"
	depends on !BR2_arc
	depends on !BR2_USE_WCHAR
```

## package/aumix/Config.in
```kconfig
config BR2_PACKAGE_AUMIX
	bool "aumix"
	default n
	select BR2_PACKAGE_NCURSES
	help
	  aumix is a small, easy-to-use program to control the mixer
	  of your sound card. It runs in text mode using the ncurses
	  library, or from the command line (non-interactively).
	  It can read default settings from a file, and it can also
	  automatically save and restore the mixer settings at shutdown
	  and boot.

	  http://jpj.net/~trevor/aumix.html
```

## package/autoconf/Config.in
```kconfig
config BR2_PACKAGE_AUTOCONF
	bool "autoconf"
	# We no longer support a toolchain on the target
	depends on BR2_DEPRECATED
	select BR2_PACKAGE_PERL
	help
	  Extensible program for developing configure scripts.  These
	  scripts handle all the mundane system/feature detection.

	  http://www.gnu.org/software/autoconf/
```

## package/autofs/Config.in
```kconfig
config BR2_PACKAGE_AUTOFS
	bool "autofs"
	depends on BR2_TOOLCHAIN_HAS_THREADS
	depends on BR2_USE_MMU
	depends on BR2_TOOLCHAIN_HAS_NATIVE_RPC
	depends on !BR2_STATIC_LIBS # dlfcn
	help
	  Autofs controls the operation of the automount daemons. The
	  automount daemons automatically mount filesystems when they
	  are used and unmount them after a period of inactivity based
	  on a set of pre-configured maps defined by default in
	  /etc/auto.master. The kernel automounter implements SunOS
	  style automounter under Linux and requires a kernel version
	  of at least 2.6.17 and the autofs4 kernel module.

	  http://www.linuxfromscratch.org/blfs/view/svn/general/autofs.html

comment "autofs needs a toolchain w/ threads, RPC, dynamic library"
	depends on BR2_USE_MMU
	depends on !BR2_TOOLCHAIN_HAS_THREADS || BR2_STATIC_LIBS || \
		!BR2_TOOLCHAIN_HAS_NATIVE_RPC
```

## package/automake/Config.in
```kconfig
config BR2_PACKAGE_AUTOMAKE
	bool "automake"
	# We no longer support a toolchain on the target
	depends on BR2_DEPRECATED
	select BR2_PACKAGE_AUTOCONF
	select BR2_PACKAGE_PERL
	help
	  Tool for automatically generating Makefile's for input to
	  configure scripts (made by autoconf).

	  http://www.gnu.org/software/automake/
```

## package/autossh/Config.in
```kconfig
config BR2_PACKAGE_AUTOSSH
	bool "autossh"
	depends on BR2_USE_MMU # fork()
	depends on BR2_PACKAGE_DROPBEAR || BR2_PACKAGE_OPENSSH
	help
	  autossh is a program to start a copy of ssh and monitor it,
	  restarting it as necessary should it die or stop passing traffic.

	  http://www.harding.motd.ca/autossh/
```

## package/avahi/Config.in
```kconfig
config BR2_PACKAGE_AVAHI
	bool "avahi"
	# libdaemon uses fork()
	depends on BR2_USE_MMU
	depends on BR2_TOOLCHAIN_HAS_THREADS
	depends on !BR2_STATIC_LIBS
	help
	  Avahi is a system which facilitates service
	  discovery on a local network.

	  http://www.avahi.org/

if BR2_PACKAGE_AVAHI

config BR2_PACKAGE_AVAHI_AUTOIPD
	bool "IPv4LL network address configuration daemon"
	default y
	select BR2_PACKAGE_LIBDAEMON
	help
	  Avahi-autoipd implements IPv4LL, "Dynamic Configuration of
	  IPv4 Link-Local Addresses" (IETF RFC3927), a protocol for
	  automatic IP address configuration from the link-local
	  169.254.0.0/16 range without the need for a central server.
	  It is primarily intended to be used in ad-hoc networks which
	  lack a DHCP server.

config BR2_PACKAGE_AVAHI_DAEMON
	bool "mDNS/DNS-SD daemon"
	select BR2_PACKAGE_LIBDAEMON
	select BR2_PACKAGE_EXPAT
	help
	  The Avahi mDNS/DNS-SD daemon implementing Apple's ZeroConf
	  architecture (also known as "Rendezvous" or "Bonjour").
	  The daemon registers local IP addresses and services using
	  mDNS/DNS-SD.

config BR2_PACKAGE_AVAHI_LIBDNSSD_COMPATIBILITY
	bool "libdns_sd compatibility (Bonjour)"
	depends on BR2_PACKAGE_AVAHI_DAEMON
	select BR2_PACKAGE_DBUS
	help
	  Enable the libdns_sd (Bonjour) compatibility library support
	  for legacy applications.

endif

comment "avahi needs a toolchain w/ threads"
	depends on BR2_USE_MMU
	depends on !BR2_TOOLCHAIN_HAS_THREADS
```

## package/avrdude/Config.in
```kconfig
config BR2_PACKAGE_AVRDUDE
	bool "avrdude"
	depends on BR2_TOOLCHAIN_HAS_THREADS
	depends on BR2_USE_WCHAR # elfutils
	depends on !BR2_STATIC_LIBS # elfutils
	depends on !BR2_bfin # elfutils
	depends on BR2_TOOLCHAIN_USES_UCLIBC || BR2_TOOLCHAIN_USES_GLIBC # elfutils
	select BR2_PACKAGE_ELFUTILS
	select BR2_PACKAGE_LIBUSB
	select BR2_PACKAGE_LIBUSB_COMPAT
	select BR2_PACKAGE_NCURSES
	help
	  avrdude is a programmer for Atmel AVR microcontrollers
	  this package provides a version with new linuxspi driver

	  https://github.com/kcuzner/avrdude

comment "avrdude needs a uClibc or glibc toolchain w/ threads, wchar, dynamic library"
	depends on !BR2_TOOLCHAIN_HAS_THREADS || !BR2_USE_WCHAR || BR2_STATIC_LIBS \
		|| !(BR2_TOOLCHAIN_USES_UCLIBC || BR2_TOOLCHAIN_USES_GLIBC)
	depends on !BR2_bfin
```

## package/avro-c/Config.in
```kconfig
comment "avro-c needs a toolchain w/ dynamic library"
	depends on BR2_STATIC_LIBS
	depends on BR2_TOOLCHAIN_HAS_SYNC_4

config BR2_PACKAGE_AVRO_C
	bool "avro-c"
	depends on !BR2_STATIC_LIBS  # Avro unconditionally compiles shared libs
	depends on BR2_TOOLCHAIN_HAS_SYNC_4
	select BR2_PACKAGE_JANSSON
	help
	  Select this option to install the Avro C language bindings,
	  and the command line tools avroappend, avrocat, avromod and
	  avropipe.

	  Apache Avro is a data serialization system.
	  Avro provides:
	  - Rich data structures.
	  - A compact, fast, binary data format.
	  - A container file, to store persistent data.
	  - Remote procedure call (RPC).
	  - Simple integration with dynamic languages.
	  - Code generation is not required to read or write data
	    files nor to use or implement RPC protocols.
	  - Code generation as an optional optimization,
	    only worth implementing for statically typed languages.

	  http://avro.apache.org/
```

## package/axel/Config.in
```kconfig
config BR2_PACKAGE_AXEL
	bool "axel"
	depends on BR2_TOOLCHAIN_HAS_THREADS
	help
	  HTTP/FTP download accelerator.

	  https://github.com/axel-download-accelerator/axel/

comment "axel needs a toolchain w/ threads"
	depends on !BR2_TOOLCHAIN_HAS_THREADS
```

## package/azmq/Config.in
```kconfig
config BR2_PACKAGE_AZMQ
	bool "azmq"
	depends on BR2_INSTALL_LIBSTDCPP
	depends on BR2_TOOLCHAIN_HAS_ATOMIC
	depends on BR2_TOOLCHAIN_HAS_THREADS_NPTL # boost-log
	depends on BR2_TOOLCHAIN_GCC_AT_LEAST_4_8 # C++11
	depends on BR2_USE_WCHAR # boost
	depends on !BR2_TOOLCHAIN_HAS_GCC_BUG_64735 # exception_ptr
	select BR2_PACKAGE_ZEROMQ
	select BR2_PACKAGE_BOOST
	select BR2_PACKAGE_BOOST_CHRONO
	select BR2_PACKAGE_BOOST_DATE_TIME
	select BR2_PACKAGE_BOOST_LOG
	select BR2_PACKAGE_BOOST_RANDOM
	select BR2_PACKAGE_BOOST_REGEX
	select BR2_PACKAGE_BOOST_SYSTEM
	select BR2_PACKAGE_BOOST_THREAD
	help
	  This library provides Boost Asio style bindings for ZeroMQ.

	  https://github.com/zeromq/azmq

comment "azmq needs a toolchain w/ C++11, wchar and NPTL"
	depends on !(BR2_INSTALL_LIBSTDCPP && BR2_TOOLCHAIN_GCC_AT_LEAST_4_8 \
		&& BR2_USE_WCHAR && BR2_TOOLCHAIN_HAS_THREADS_NPTL)

comment "azmq needs exception_ptr"
	depends on BR2_TOOLCHAIN_HAS_GCC_BUG_64735
```

## package/azure-iot-sdk-c/Config.in
```kconfig
config BR2_PACKAGE_AZURE_IOT_SDK_C
	bool "azure-iot-sdk-c"
	depends on BR2_INSTALL_LIBSTDCPP
	depends on BR2_TOOLCHAIN_HAS_THREADS_NPTL
	select BR2_PACKAGE_LIBCURL
	select BR2_PACKAGE_LIBXML2
	select BR2_PACKAGE_OPENSSL
	select BR2_PACKAGE_UTIL_LINUX
	select BR2_PACKAGE_UTIL_LINUX_LIBUUID
	help
	  Microsoft Azure IoT Hub device SDK for C is used
	  to connect devices running C code to Azure IoT Hub.

	  https://github.com/Azure/azure-iot-sdk-c

comment "azure-iot-sdk-c needs a toolchain w/ C++ and NPTL"
	depends on !BR2_INSTALL_LIBSTDCPP || !BR2_TOOLCHAIN_HAS_THREADS_NPTL
```
