## package/binutils/Config.in
```kconfig
config BR2_PACKAGE_BINUTILS
	bool "binutils"
	depends on !BR2_nios2
	depends on BR2_USE_WCHAR
	help
	  Install binutils on the target

if BR2_PACKAGE_BINUTILS

config BR2_PACKAGE_BINUTILS_TARGET
	bool "binutils binaries"
	help
	  The GNU Binutils are a collection of binary tools:

	  ld - the GNU linker.
	  as - the GNU assembler.
	  and others...

	  http://www.gnu.org/software/binutils/

endif

comment "binutils needs a toolchain w/ wchar"
	depends on !BR2_nios2
	depends on !BR2_USE_WCHAR
```
