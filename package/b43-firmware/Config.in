## package/b43-firmware/Config.in
```kconfig
config BR2_PACKAGE_B43_FIRMWARE
	bool "b43-firmware"
	help
	  Firmware for the Broadcom Wifi devices supported by the b43
	  kernel driver.

if BR2_PACKAGE_B43_FIRMWARE

choice
	prompt "Kernel version"
	default BR2_PACKAGE_B43_FIRMWARE_KERNEL_AFTER_3_2
	help
	  Select the kernel version you're using. The b43 driver in
	  kernel >= 3.2 need a different firmware than the b43 drivers
	  from kernel < 3.2.

config BR2_PACKAGE_B43_FIRMWARE_KERNEL_AFTER_3_2
	bool ">= 3.2"

config BR2_PACKAGE_B43_FIRMWARE_KERNEL_BEFORE_3_2
	bool "< 3.2"

endchoice

endif
```

## package/babeld/Config.in
```kconfig
config BR2_PACKAGE_BABELD
	bool "babeld"
	depends on BR2_USE_MMU # fork()
	help
	  Babel is a loop-avoiding distance-vector routing protocol for
	  IPv6 and IPv4 with fast convergence properties.

	  http://www.pps.univ-paris-diderot.fr/~jch/software/babel/
```

## package/bandwidthd/Config.in
```kconfig
config BR2_PACKAGE_BANDWIDTHD
	bool "bandwidthd"
	depends on BR2_USE_MMU # fork()
	select BR2_PACKAGE_LIBPNG
	select BR2_PACKAGE_LIBPCAP
	select BR2_PACKAGE_GD
	help
	  BandwidthD - Bandwidth monitoring

	  Provides a method to measure the bandwidth that travels
	  through the machine, grouped by subnet and IP. This
	  information can be stored locally in /var/lib/bandwidthd and
	  can be configured to generate static HTML pages which can be
	  hosted by a web server.

	  It is highly recommended that the target has some way of
	  retaining the time between reboots. (e.g. NTP on boot or an
	  RTC)

	  It is suggested to use sqlite for logfile storage but works
	  fine without, and can be completely ignored if the
	  postgresql portion is used.

	  As upstream is no longer actively maintained, a fork is
	  available on github that works on making BandwidthD's build
	  process more compatible with buildroot's.

	  Upstream: http://bandwidthd.sourceforge.net/
	  Github fork: http://github.com/nroach44/bandwidthd

if BR2_PACKAGE_BANDWIDTHD

config BR2_PACKAGE_BANDWIDTHD_POSTGRESQL
	bool "enable postgresql log target support"
	depends on BR2_TOOLCHAIN_USES_GLIBC # postgresql
	select BR2_PACKAGE_POSTGRESQL
	help
	  Enable support for logging the bandwidthd data to a remote
	  (or local) postgresql server. This data can then be viewed
	  through a php site. See README in the source code
	  (github.com/nroach44/bandwidthd) for more information.

config BR2_PACKAGE_BANDWIDTHD_SQLITE3
	bool "enable sqlite3 log storage"
	select BR2_PACKAGE_SQLITE
	help
	  Enable support for storing the aggregated data in an sqlite
	  db instead of a plain text file.

endif
```

## package/bash-completion/Config.in
```kconfig
config BR2_PACKAGE_BASH_COMPLETION
	bool "bash completion"
	depends on BR2_PACKAGE_BASH
	help
	  Add bash completion infrastructure.

	  The bash completion infrastructure is enabled by
	  /etc/profile.d/bash_completion.sh, which is normally
	  sourced by /etc/profile.

	  If the system does not use the /etc/profile.d directory
	  mechanism, the /etc/profile.d/bash_completion.sh script can
	  be sourced from /etc/bashrc or ~/.bashrc.

	  https://github.com/scop/bash-completion
```

## package/bash/Config.in
```kconfig
config BR2_PACKAGE_BASH
	bool "bash"
	# uses fork()
	depends on BR2_USE_MMU
	depends on BR2_PACKAGE_BUSYBOX_SHOW_OTHERS
	select BR2_PACKAGE_NCURSES
	select BR2_PACKAGE_READLINE
	help
	  The standard GNU Bourne again shell.

	  http://tiswww.case.edu/php/chet/bash/bashtop.html
```

## package/batctl/Config.in
```kconfig
config BR2_PACKAGE_BATCTL
	bool "batctl"
	depends on BR2_TOOLCHAIN_HAS_THREADS # libnl
	select BR2_PACKAGE_LIBNL
	help
	  Batctl is the configuration and debugging tool for batman-adv.

	  http://www.open-mesh.org/projects/batman-adv/wiki/Using-batctl

comment "batctl needs a toolchain w/ threads"
	depends on !BR2_TOOLCHAIN_HAS_THREADS
```

## package/batman-adv/Config.in
```kconfig
comment "batman-adv needs a Linux kernel to be built"
	depends on !BR2_LINUX_KERNEL

config BR2_PACKAGE_BATMAN_ADV
	bool "batman-adv"
	depends on BR2_LINUX_KERNEL
	help
	  batman-adv mesh networking kernel module

	  https://www.open-mesh.org/projects/batman-adv/

if BR2_PACKAGE_BATMAN_ADV

config BR2_PACKAGE_BATMAN_ADV_DEBUG
	bool "enable debugging"
	help
	  Enables B.A.T.M.A.N. debugging.

config BR2_PACKAGE_BATMAN_ADV_NC
	bool "enable network coding"
	help
	  Enables B.A.T.M.A.N. network coding.
	  Note: this requires promiscuous mode on ALL nodes!

	  https://www.open-mesh.org/projects/batman-adv/wiki/NetworkCoding

config BR2_PACKAGE_BATMAN_ADV_BATMAN_V
	bool "enable B.A.T.M.A.N. V protocol (experimental)"
	help
	  Enables B.A.T.M.A.N. V network protocol.
	  This is the next-gen protocol and is experimental at this time.

	  https://www.open-mesh.org/projects/batman-adv/wiki/BATMAN_V

endif
```

## package/bats-core/Config.in
```kconfig
config BR2_PACKAGE_BATS_CORE
	bool "bats"
	depends on BR2_PACKAGE_BASH # runtime
	help
	  Bats: Bash Automated Testing System

	  Bats is a TAP-compliant testing framework for Bash. It
	  provides a simple way to verify that the UNIX programs you
	  write behave as expected.

	  https://github.com/bats-core/bats-core
```

## package/bayer2rgb-neon/Config.in
```kconfig
config BR2_PACKAGE_BAYER2RGB_NEON
	bool "bayer2rgb-neon"
	depends on BR2_arm && BR2_ARM_CPU_HAS_NEON
	depends on !BR2_STATIC_LIBS
	depends on BR2_INSTALL_LIBSTDCPP
	depends on BR2_TOOLCHAIN_GCC_AT_LEAST_4_9 # C++11
	help
	  bayer2rgb-neon is a library which allows
	  to decode raw camera bayer to RGB using
	  NEON hardware acceleration.

	  https://git.phytec.de/bayer2rgb-neon/

comment "bayer2rgb-neon needs a toolchain w/ C++, dynamic library, gcc >= 4.9"
	depends on BR2_arm && BR2_ARM_CPU_HAS_NEON
	depends on BR2_STATIC_LIBS || !BR2_INSTALL_LIBSTDCPP || \
		!BR2_TOOLCHAIN_GCC_AT_LEAST_4_9
```

## package/bc/Config.in
```kconfig
config BR2_PACKAGE_BC
	bool "bc"
	help
	  'bc' is an arbitrary precision numeric processing language
	  Its syntax is similar to C, but differs in many substantial
	  areas. It supports interactive execution of statements. 'Bc'
	  is a utility included in the POSIX P1003.2/D11 draft standard.
	  This version does not use the historical method of having bc
	  be a compiler for the dc calculator (the POSIX document
	  doesn't specify how bc must be implemented).
	  This version has a single executable that both compiles the
	  language and runs the resulting 'byte code.' The byte code is
	  not the dc language.

	  http://www.gnu.org/software/bc
```

## package/bcache-tools/Config.in
```kconfig
config BR2_PACKAGE_BCACHE_TOOLS
	bool "bcache tools"
	depends on BR2_PACKAGE_HAS_UDEV
	depends on BR2_USE_MMU # util-linux (libblkid)
	select BR2_PACKAGE_UTIL_LINUX
	select BR2_PACKAGE_UTIL_LINUX_LIBUUID
	select BR2_PACKAGE_UTIL_LINUX_LIBBLKID
	help
	  Bcache is a Linux kernel block layer cache. It allows one or
	  more fast disk drives such as flash-based solid state drives (SSDs)
	  to act as a cache for one or more slower hard disk drives.

	  http://bcache.evilpiepirate.org/

	  This is the user space bcache tools, required to setup the linux
	  bcache feature of the Linux kernel.

comment "bcache-tools needs udev /dev management"
	depends on BR2_USE_MMU
	depends on !BR2_PACKAGE_HAS_UDEV
```

## package/bcg729/Config.in
```kconfig
config BR2_PACKAGE_BCG729
	bool "bcg729"
	help
	  Bcg729 is an opensource implementation of both encoder and
	  decoder of the ITU G729 Annex A/B speech codec.

	  http://www.linphone.org/technical-corner/bcg729/overview
```

## package/bcm2835/Config.in
```kconfig
config BR2_PACKAGE_BCM2835
	bool "bcm2835"
	depends on BR2_arm
	help
	  C library for Broadcom BCM 2835 as used in Raspberry Pi.
	  It provides access to GPIO and other IO functions on the
	  Broadcom BCM 2835 chip, allowing access to the GPIO pins
	  on the 26 pin IDE plug on the RPi board so you can control
	  and interface with various external devices.

	  WARNING: the opinion of the Buildroot developers is that
	  such library is a complete abomination as it entirely works
	  around the standard Linux interfaces to access GPIOs, I2C,
	  SPI busses or other IOs. The library directly remaps the
	  hardware registers in user-space, completely bypassing what
	  the kernel drivers are doing, and potentially conflicting
	  with them.

	  http://www.airspayce.com/mikem/bcm2835
```

## package/bctoolbox/Config.in
```kconfig
config BR2_PACKAGE_BCTOOLBOX
	bool "bctoolbox"
	depends on BR2_INSTALL_LIBSTDCPP
	depends on BR2_TOOLCHAIN_HAS_THREADS
	depends on !BR2_TOOLCHAIN_HAS_GCC_BUG_64735 # exception_ptr
	select BR2_PACKAGE_LIBICONV if !BR2_ENABLE_LOCALE
	help
	  Utilities library used by Belledonne Communications
	  softwares like belle-sip, mediastreamer2 and linphone.

	  Select BR2_PACKAGE_MBEDTLS for crypto support.

	  https://github.com/BelledonneCommunications/bctoolbox

comment "bctoolbox needs a toolchain w/ C++, threads"
	depends on !BR2_INSTALL_LIBSTDCPP || !BR2_TOOLCHAIN_HAS_THREADS

comment "bctoolbox needs a toolchain not affected by GCC bug 64735"
	depends on BR2_TOOLCHAIN_HAS_GCC_BUG_64735
```

## package/bcusdk/Config.in
```kconfig
config BR2_PACKAGE_BCUSDK
	bool "bcusdk"
	depends on BR2_USE_MMU # libpthsem
	depends on BR2_INSTALL_LIBSTDCPP
	select BR2_PACKAGE_LIBPTHSEM
	select BR2_PACKAGE_ARGP_STANDALONE if BR2_TOOLCHAIN_USES_UCLIBC || BR2_TOOLCHAIN_USES_MUSL
	help
	  A free development environment for the Bus Coupling Units of
	  the European Installation Bus.

	  The European Installation Bus EIB is a home and building
	  automation bus system. It is optimized for low-speed control
	  applications like lighting and blinds control.

	  BCUs (Bus Coupling Units) are standardized, generic
	  platforms for embedded EIB devices. They include the entire
	  physical layer network interface, power supply and a
	  microcontroller with an implementation of the EIB protocol
	  stack stored in the ROM.

	  http://www.auto.tuwien.ac.at/~mkoegler/eib/

comment "bcusdk needs a toolchain w/ C++"
	depends on BR2_USE_MMU
	depends on !BR2_INSTALL_LIBSTDCPP
```

## package/bdwgc/Config.in
```kconfig
config BR2_PACKAGE_BDWGC
	bool "bdwgc"
	depends on BR2_PACKAGE_LIBATOMIC_ARCH_SUPPORTS
	select BR2_PACKAGE_LIBATOMIC_OPS
	help
	  The Boehm-Demers-Weiser conservative garbage collector can
	  be used as a garbage collecting replacement for C 'malloc'
	  or C++ 'new'.

	  http://www.hboehm.info/gc/
```

## package/bearssl/Config.in
```kconfig
config BR2_PACKAGE_BEARSSL
	bool "bearssl"
	help
	  BearSSL is an implementation of the SSL/TLS protocol
	  (RFC 5246) written in C.

	  https://bearssl.org
```

## package/beecrypt/Config.in
```kconfig
comment "beecrypt needs a toolchain w/ threads"
	depends on !BR2_TOOLCHAIN_HAS_THREADS

config BR2_PACKAGE_BEECRYPT
	bool "beecrypt"
	depends on BR2_TOOLCHAIN_HAS_THREADS
	help
	  Beecrypt is a general-purpose cryptography library.

	  http://beecrypt.sf.net
```

## package/bellagio/Config.in
```kconfig
config BR2_PACKAGE_BELLAGIO
	bool "bellagio"
	depends on BR2_INSTALL_LIBSTDCPP
	depends on BR2_TOOLCHAIN_HAS_THREADS
	depends on !BR2_STATIC_LIBS
	select BR2_PACKAGE_HAS_LIBOPENMAX
	help
	  Bellagio is an opensource implementation of the
	  OpenMAX IL API.

	  OpenMAX Integration Layer (IL) is a standard API
	  to access Multimedia Components on mobile platforms.
	  It has been defined by the Khronos group.
	  By means of the OpenMAX IL API, multimedia frameworks
	  can access hardware accelerators on platforms that
	  provide it.

	  http://omxil.sourceforge.net/

if BR2_PACKAGE_BELLAGIO

config BR2_PACKAGE_PROVIDES_LIBOPENMAX
	default "bellagio"

endif

comment "bellagio needs a toolchain w/ C++, threads, dynamic library"
	depends on !BR2_INSTALL_LIBSTDCPP || !BR2_TOOLCHAIN_HAS_THREADS || BR2_STATIC_LIBS
```

## package/belle-sip/Config.in
```kconfig
config BR2_PACKAGE_BELLE_SIP
	bool "belle-sip"
	depends on BR2_INSTALL_LIBSTDCPP
	depends on !BR2_STATIC_LIBS # dlfcn.h
	depends on BR2_TOOLCHAIN_HAS_THREADS
	depends on !BR2_TOOLCHAIN_HAS_GCC_BUG_64735 # bctoolbox
	depends on BR2_USE_WCHAR
	select BR2_PACKAGE_BCTOOLBOX
	# needs crypto support in bctoolbox
	select BR2_PACKAGE_MBEDTLS
	help
	  Belle-sip is a modern library implementing SIP (RFC 3261)
	  transport, transaction and dialog layers.

	  http://www.linphone.org/technical-corner/belle-sip

comment "belle-sip needs a toolchain w/ threads, C++, dynamic library, wchar"
	depends on !BR2_INSTALL_LIBSTDCPP || BR2_STATIC_LIBS || \
		!BR2_TOOLCHAIN_HAS_THREADS || !BR2_USE_WCHAR

comment "belle-sip needs a toolchain not affected by GCC bug 64735"
	depends on BR2_TOOLCHAIN_HAS_GCC_BUG_64735
```

## package/belr/Config.in
```kconfig
config BR2_PACKAGE_BELR
	bool "belr"
	depends on BR2_INSTALL_LIBSTDCPP
	depends on BR2_TOOLCHAIN_HAS_THREADS # bctoolbox
	depends on !BR2_TOOLCHAIN_HAS_GCC_BUG_64735 # bctoolbox
	select BR2_PACKAGE_BCTOOLBOX
	help
	  Belr is Belledonne Communications' language recognition
	  library, written in C++11. It parses text inputs formatted
	  according to a language defined by an ABNF grammar, such as
	  the protocols standardized at IETF.

	  https://gitlab.linphone.org/BC/public/belr

comment "belr needs a toolchain w/ threads, C++"
	depends on !BR2_INSTALL_LIBSTDCPP || !BR2_TOOLCHAIN_HAS_THREADS

comment "belr needs a toolchain not affected by GCC bug 64735"
	depends on BR2_TOOLCHAIN_HAS_GCC_BUG_64735
```

## package/benejson/Config.in
```kconfig
config BR2_PACKAGE_BENEJSON
	bool "benejson"
	depends on BR2_INSTALL_LIBSTDCPP
	help
	  benejson is a buffering SAX-style JSON parser library.
	  The library package contains 3 major components:

	  - benejson.js: SAX-style parser written in Javascript
	  - PullParser: A C++ class for JSON pull parsing
	  - Core: The parsing core with minimal dependencies

	  https://codehero.github.io/benejson/

comment "benejson needs a toolchain w/ C++"
	depends on !BR2_INSTALL_LIBSTDCPP
```

## package/berkeleydb/Config.in
```kconfig
config BR2_PACKAGE_BERKELEYDB
	bool "berkeleydb"
	help
	  The Berkeley database. A very common library for database
	  applications.

	  http://www.sleepycat.com/products/db.shtml

if BR2_PACKAGE_BERKELEYDB

config BR2_PACKAGE_BERKELEYDB_COMPAT185
	bool "DB 1.85 compatibility"
	help
	  Build and install DB 1.85 compatibility API.

config BR2_PACKAGE_BERKELEYDB_TOOLS
	bool "install tools"
	help
	  Install berkeleydb tools, mostly useful for debugging purposes.

endif
```

## package/bind/Config.in
```kconfig
config BR2_PACKAGE_BIND
	bool "bind"
	depends on BR2_INET_IPV6
	depends on BR2_LARGEFILE
	depends on BR2_USE_MMU # fork()
	depends on !BR2_PREFER_STATIC_LIB
	help
	  BIND (Berkeley Internet Name Domain) is an implementation of
	  the Domain Name System (DNS) protocols and provides an openly
	  redistributable reference implementation of the major
	  components of the Domain Name System, including:

	    * a Domain Name System server (named)
	    * a Domain Name System resolver library
	    * tools for verifying the proper operation of the DNS server

	  The BIND DNS Server is used on the vast majority of name
	  serving machines on the Internet, providing a robust and
	  stable architecture on top of which an organization's naming
	  architecture can be built. The resolver library included in
	  the BIND distribution provides the standard APIs for
	  translation between domain names and Internet addresses and is
	  intended to be linked with applications requiring name service.

	  http://www.isc.org/sw/bind/

if BR2_PACKAGE_BIND

config BR2_PACKAGE_BIND_SERVER
	bool "Install server components"
	default y
	help
	  Install server components (named, lwresd)

config BR2_PACKAGE_BIND_TOOLS
	bool "Install tools"
	help
	  Install tools (dig, host, nslookup, nsupdate)

endif

comment "bind needs a toolchain w/ largefile, IPv6, dynamic library"
	depends on BR2_USE_MMU
	depends on !BR2_LARGEFILE || !BR2_INET_IPV6 || BR2_PREFER_STATIC_LIB
```
