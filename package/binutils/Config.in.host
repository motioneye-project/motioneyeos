## package/binutils/Config.in.host
```kconfig
comment "Binutils Options"

config BR2_PACKAGE_HOST_BINUTILS_SUPPORTS_CFI
	bool
	default y
	depends on !BR2_microblaze

choice
	prompt "Binutils Version"
	default BR2_BINUTILS_VERSION_2_32_X if !BR2_arc && !BR2_csky
	default BR2_BINUTILS_VERSION_ARC if BR2_arc
	default BR2_BINUTILS_VERSION_CSKY if BR2_csky
	help
	  Select the version of binutils you wish to use.

config BR2_BINUTILS_VERSION_2_31_X
	bool "binutils 2.31.1"
	depends on !BR2_csky

config BR2_BINUTILS_VERSION_2_32_X
	bool "binutils 2.32"
	depends on !BR2_csky

config BR2_BINUTILS_VERSION_2_33_X
	bool "binutils 2.33.1"
	depends on !BR2_csky
	# https://github.com/uclinux-dev/elf2flt/pull/16
	# https://github.com/uclinux-dev/elf2flt/issues/12
	depends on !BR2_BINFMT_FLAT

config BR2_BINUTILS_VERSION_ARC
	bool "binutils arc (2.31)"
	depends on BR2_arc

config BR2_BINUTILS_VERSION_CSKY
	bool "binutils csky"
	depends on BR2_csky

endchoice

config BR2_BINUTILS_VERSION
	string
	default "arc-2019.09-release"	if BR2_BINUTILS_VERSION_ARC
	default "c66d8bbcebfddf713b2b436e1b135e6b125a55a5" if BR2_BINUTILS_VERSION_CSKY
	default "2.31.1"	if BR2_BINUTILS_VERSION_2_31_X
	default "2.32"		if BR2_BINUTILS_VERSION_2_32_X
	default "2.33.1"	if BR2_BINUTILS_VERSION_2_33_X

config BR2_BINUTILS_ENABLE_LTO
	bool

config BR2_BINUTILS_EXTRA_CONFIG_OPTIONS
	string "Additional binutils options"
	default ""
	help
	  Any additional binutils options you may want to include.
```

## package/biosdevname/Config.in
```kconfig
config BR2_PACKAGE_BIOSDEVNAME
	bool "biosdevname"
	depends on BR2_i386 || BR2_x86_64
	depends on BR2_PACKAGE_HAS_UDEV
	select BR2_PACKAGE_PCIUTILS
	select BR2_PACKAGE_ZLIB
	help
	  Biosdevname is a udev helper that looks at various BIOS tables to
	  figure out what the actual hardware names are for Ethernet ports
	  and renames the ports accordingly.  This has the advantage of
	  always referring to the same port regardless of system or
	  hardware changes that might otherwise alter the typical ethX
	  naming.

	  http://linux.dell.com/biosdevname/
```

## package/bird/Config.in
```kconfig
config BR2_PACKAGE_BIRD
	bool "bird"
	depends on !BR2_nios2 # relocations don't fit
	depends on BR2_USE_MMU # fork()
	help
	  BIRD Internet Routing Daemon

	  The BIRD project aims to develop a dynamic IP routing daemon
	  with full support of all modern routing protocols, easy to
	  use configuration interface and powerful route filtering
	  language

	  http://bird.network.cz/

if BR2_PACKAGE_BIRD

config BR2_PACKAGE_BIRD_CLIENT
	bool "birdc"
	select BR2_PACKAGE_NCURSES
	select BR2_PACKAGE_READLINE
	help
	  Enable the BIRD client

comment "protocol support"

config BR2_PACKAGE_BIRD_BABEL
	bool "babel"
	help
	  Enable Babel protocol.

config BR2_PACKAGE_BIRD_BFD
	bool "bfd"
	depends on BR2_TOOLCHAIN_HAS_THREADS_NPTL
	help
	  Enable BFD protocol.

comment "BFD protocol needs a toolchain w/ NPTL"
	depends on !BR2_TOOLCHAIN_HAS_THREADS_NPTL

config BR2_PACKAGE_BIRD_BGP
	bool "bgp"
	default y
	help
	  Enable BGP protocol.

config BR2_PACKAGE_BIRD_MRT
	bool "mrt"
	help
	  Enable MRT protocol.

config BR2_PACKAGE_BIRD_OSPF
	bool "ospf"
	help
	  Enable OSPFv2 and OSPFv3 protocol.

config BR2_PACKAGE_BIRD_PERF
	bool "perf"
	help
	  Enable Perf protocol.

config BR2_PACKAGE_BIRD_PIPE
	bool "pipe"
	help
	  Enable Pipe protocol.

config BR2_PACKAGE_BIRD_RADV
	bool "radv"
	help
	  Enable RAdv protocol.

config BR2_PACKAGE_BIRD_RIP
	bool "rip"
	help
	  Enable RIP protocol.

config BR2_PACKAGE_BIRD_STATIC
	bool "static"
	help
	  Enable Static protocol.

endif
```

## package/bison/Config.in
```kconfig
config BR2_PACKAGE_BISON
	bool "bison"
	depends on BR2_USE_WCHAR
	select BR2_PACKAGE_M4
	# m4 uses fork()
	depends on BR2_USE_MMU
	# development tool, useless on the target
	depends on BR2_DEPRECATED_SINCE_2014_02
	help
	  General-purpose parser generator that converts a
	  grammar description for an LALR context-free grammar into a C
	  program to parse that grammar.

	  http://www.gnu.org/software/bison/

comment "bison needs a toolchain w/ wchar"
	depends on BR2_DEPRECATED_SINCE_2014_02
	depends on BR2_USE_MMU
	depends on !BR2_USE_WCHAR
```

## package/bitcoin/Config.in
```kconfig
config BR2_PACKAGE_BITCOIN_ARCH_SUPPORTS
	bool
	default y if BR2_TOOLCHAIN_HAS_ATOMIC
	# bitcoin uses 8-byte __atomic intrinsics, which are not
	# available on ARM noMMU platforms that we
	# support. BR2_TOOLCHAIN_HAS_ATOMIC does not provide a
	# size-level granularity to express this dependency.
	depends on !(BR2_arm || BR2_armeb) || BR2_USE_MMU

config BR2_PACKAGE_BITCOIN
	bool "bitcoin"
	depends on BR2_INSTALL_LIBSTDCPP
	depends on !BR2_TOOLCHAIN_HAS_GCC_BUG_64735 # std::future
	depends on BR2_PACKAGE_BITCOIN_ARCH_SUPPORTS
	depends on BR2_TOOLCHAIN_HAS_THREADS # boost
	depends on BR2_USE_WCHAR
	select BR2_PACKAGE_BOOST
	select BR2_PACKAGE_BOOST_SYSTEM
	select BR2_PACKAGE_BOOST_FILESYSTEM
	select BR2_PACKAGE_BOOST_THREAD
	select BR2_PACKAGE_BOOST_CHRONO
	select BR2_PACKAGE_BOOST_PROGRAM_OPTIONS
	select BR2_PACKAGE_OPENSSL
	select BR2_PACKAGE_LIBEVENT
	help
	  Bitcoin Core is an open source project which maintains and
	  releases Bitcoin client software called “Bitcoin Core”.

	  It is a direct descendant of the original Bitcoin software
	  client released by Satoshi Nakamoto after he published the
	  famous Bitcoin whitepaper.

	  Bitcoin Core consists of both "full-node" software for fully
	  validating the blockchain as well as a bitcoin wallet. The
	  project also currently maintains related software such as
	  the cryptography library libsecp256k1 and others located at
	  GitHub.

	  https://bitcoincore.org

comment "bitcoin needs a toolchain w/ C++, threads, wchar"
	depends on BR2_PACKAGE_BITCOIN_ARCH_SUPPORTS
	depends on !BR2_INSTALL_LIBSTDCPP || \
		!BR2_TOOLCHAIN_HAS_THREADS || !BR2_USE_WCHAR

comment "bitcoin needs a toolchain not affected by GCC bug 64735"
	depends on BR2_PACKAGE_BITCOIN_ARCH_SUPPORTS
	depends on BR2_TOOLCHAIN_HAS_GCC_BUG_64735
```

## package/bitstream-vera/Config.in
```kconfig
config BR2_PACKAGE_BITSTREAM_VERA
	bool "Bitstream Vera"
	help
	  Bitstream Vera font family.

	  https://www.gnome.org/fonts/
```

## package/bitstream/Config.in
```kconfig
config BR2_PACKAGE_BITSTREAM
	bool "bitstream"
	help
	  biTStream is a set of C headers allowing a simpler access to
	  binary structures such as specified by MPEG, DVB, IETF,
	  SMPTE, IEEE, SCTE, etc.

	  http://www.videolan.org/developers/bitstream.html
```

## package/blackbox/Config.in
```kconfig
config BR2_PACKAGE_BLACKBOX
	bool "blackbox"
	depends on BR2_PACKAGE_XORG7
	depends on BR2_INSTALL_LIBSTDCPP
	depends on BR2_USE_MMU # fork()
	# upstream dead since 2005
	depends on BR2_DEPRECATED_SINCE_2014_08
	select BR2_PACKAGE_LIBICONV if !BR2_ENABLE_LOCALE
	select BR2_PACKAGE_XLIB_LIBX11
	help
	  Blackbox is a fast, lightweight window manager for the X
	  Window System.

	  http://blackboxwm.sourceforge.net/

comment "blackbox needs a toolchain w/ C++"
	depends on BR2_PACKAGE_XORG7 && BR2_USE_MMU
	depends on !BR2_INSTALL_LIBSTDCPP
```

## package/blktrace/Config.in
```kconfig
config BR2_PACKAGE_BLKTRACE
	bool "blktrace"
	depends on BR2_TOOLCHAIN_HAS_THREADS
	depends on BR2_USE_MMU # system()
	select BR2_PACKAGE_LIBAIO
	help
	  blktrace is a block layer IO tracing mechanism which provides
	  detailed information about request queue operations
	  up to user space.

	  http://git.kernel.dk/?p=blktrace.git;a=summary

comment "blktrace needs a toolchain w/ threads"
	depends on BR2_USE_MMU
	depends on !BR2_TOOLCHAIN_HAS_THREADS
```

## package/bluez-alsa/Config.in
```kconfig
config BR2_PACKAGE_BLUEZ_ALSA
	bool "bluez-alsa"
	depends on !BR2_STATIC_LIBS # bluez5
	depends on BR2_TOOLCHAIN_HAS_THREADS_NPTL
	depends on BR2_TOOLCHAIN_HEADERS_AT_LEAST_3_4 # bluez5
	depends on BR2_TOOLCHAIN_HAS_SYNC_4 # bluez5
	depends on BR2_USE_MMU # bluez5 -> dbus
	depends on BR2_USE_WCHAR # libglib2
	select BR2_PACKAGE_ALSA_LIB
	select BR2_PACKAGE_BLUEZ5_UTILS
	select BR2_PACKAGE_LIBGLIB2
	select BR2_PACKAGE_SBC
	help
	  Bluetooth Audio ALSA Backend.

	  https://github.com/Arkq/bluez-alsa

if BR2_PACKAGE_BLUEZ_ALSA

config BR2_PACKAGE_BLUEZ_ALSA_HCITOP
	bool "hcitop"
	depends on BR2_PACKAGE_LIBBSD_ARCH_SUPPORTS
	select BR2_PACKAGE_LIBBSD
	select BR2_PACKAGE_NCURSES
	help
	  Enable top-like monitoring tool for HCI.

config BR2_PACKAGE_BLUEZ_ALSA_RFCOMM
	bool "rfcomm"
	select BR2_PACKAGE_READLINE
	help
	  Simple tool for sending RFCOMM commands.

endif

comment "bluez-alsa needs a toolchain w/ wchar, NPTL, headers >= 3.4, dynamic library"
	depends on !BR2_USE_WCHAR || !BR2_TOOLCHAIN_HAS_THREADS_NPTL || \
		!BR2_TOOLCHAIN_HEADERS_AT_LEAST_3_4 || BR2_STATIC_LIBS
	depends on BR2_TOOLCHAIN_HAS_SYNC_4
	depends on BR2_USE_MMU
```

## package/bluez-tools/Config.in
```kconfig
config BR2_PACKAGE_BLUEZ_TOOLS
	bool "bluez-tools"
	depends on BR2_PACKAGE_BLUEZ5_UTILS
	depends on BR2_USE_MMU # dbus, libglib2
	depends on BR2_USE_WCHAR # libglib2
	depends on BR2_TOOLCHAIN_HAS_THREADS # dbus, libglib2
	select BR2_PACKAGE_DBUS
	select BR2_PACKAGE_DBUS_GLIB
	select BR2_PACKAGE_LIBGLIB2
	select BR2_PACKAGE_READLINE if BR2_PACKAGE_BLUEZ5_UTILS
	help
	  A set of tools to manage bluetooth devices for linux

	  https://github.com/khvzak/bluez-tools

comment "bluez-tools needs a toolchain w/ wchar, threads"
	depends on BR2_PACKAGE_BLUEZ5_UTILS
	depends on BR2_USE_MMU
	depends on !BR2_USE_WCHAR || !BR2_TOOLCHAIN_HAS_THREADS
```

## package/bluez5_utils-headers/Config.in
```kconfig
config BR2_PACKAGE_BLUEZ5_UTILS_HEADERS
	bool
	help
	  Header files from bluez utils version 5.x

	  http://www.bluez.org
	  http://www.kernel.org/pub/linux/bluetooth
```

## package/bluez5_utils/Config.in
```kconfig
config BR2_PACKAGE_BLUEZ5_UTILS
	bool "bluez-utils 5.x"
	depends on BR2_USE_WCHAR # libglib2
	depends on BR2_TOOLCHAIN_HAS_THREADS # dbus, libglib2
	depends on BR2_USE_MMU # dbus
	depends on !BR2_STATIC_LIBS # uses dlfcn
	depends on !BR2_PACKAGE_BLUEZ_UTILS # conflicts with 4.x version
	depends on BR2_TOOLCHAIN_HEADERS_AT_LEAST_3_4
	depends on BR2_TOOLCHAIN_HAS_SYNC_4
	select BR2_PACKAGE_DBUS
	select BR2_PACKAGE_LIBGLIB2
	help
	  bluez utils version 5.x

	  With this release BlueZ only supports the new Bluetooth
	  Management kernel interface (introduced in Linux 3.4).

	  For Low Energy support at least kernel version 3.5 is
	  needed.

	  The API is not backward compatible with BlueZ 4.

	  Bluez utils will use systemd and/or udev if enabled.

	  http://www.bluez.org
	  http://www.kernel.org/pub/linux/bluetooth

if BR2_PACKAGE_BLUEZ5_UTILS

config BR2_PACKAGE_BLUEZ5_UTILS_OBEX
	bool "build OBEX support"
	depends on BR2_INSTALL_LIBSTDCPP
	select BR2_PACKAGE_LIBICAL
	help
	  Enable the OBEX support in Bluez 5.x.

comment "OBEX support needs a toolchain w/ C++"
	depends on !BR2_INSTALL_LIBSTDCPP

config BR2_PACKAGE_BLUEZ5_UTILS_CLIENT
	bool "build CLI client"
	select BR2_PACKAGE_READLINE
	help
	  Enable the Bluez 5.x command line client.

config BR2_PACKAGE_BLUEZ5_UTILS_DEPRECATED
	bool "install deprecated tool"
	depends on BR2_PACKAGE_BLUEZ5_UTILS_CLIENT
	help
	  Build BlueZ 5.x deprecated tools. These currently include:
	  hciattach, hciconfig, hcitool, hcidump, rfcomm, sdptool,
	  ciptool, gatttool.

config BR2_PACKAGE_BLUEZ5_UTILS_EXPERIMENTAL
	bool "build experimental obexd plugin"
	help
	  Build BlueZ 5.x experimental Nokia OBEX PC Suite plugin

config BR2_PACKAGE_BLUEZ5_UTILS_PLUGINS_HEALTH
	bool "build health plugin"
	help
	  Build BlueZ 5.x health plugin

config BR2_PACKAGE_BLUEZ5_UTILS_PLUGINS_MIDI
	bool "build midi profile"
	select BR2_PACKAGE_ALSA_LIB
	select BR2_PACKAGE_ALSA_LIB_SEQ
	help
	  Build BlueZ 5.x midi plugin

config BR2_PACKAGE_BLUEZ5_UTILS_PLUGINS_NFC
	bool "build nfc plugin"
	help
	  Build BlueZ 5.x nfc plugin

config BR2_PACKAGE_BLUEZ5_UTILS_PLUGINS_SAP
	bool "build sap plugin"
	help
	  Build BlueZ 5.x sap plugin

config BR2_PACKAGE_BLUEZ5_UTILS_PLUGINS_SIXAXIS
	bool "build sixaxis plugin"
	depends on BR2_PACKAGE_HAS_UDEV
	help
	  Build BlueZ 5.x sixaxis plugin (support Sony Dualshock
	  controller)

comment "sixaxis plugin needs udev /dev management"
	depends on !BR2_PACKAGE_HAS_UDEV

config BR2_PACKAGE_BLUEZ5_UTILS_TEST
	bool "build tests"
	help
	  Build BlueZ 5.x tests

endif

comment "bluez5-utils needs a toolchain w/ wchar, threads, headers >= 3.4, dynamic library"
	depends on !BR2_USE_WCHAR || !BR2_TOOLCHAIN_HAS_THREADS || \
		!BR2_TOOLCHAIN_HEADERS_AT_LEAST_3_4 || BR2_STATIC_LIBS
	depends on BR2_TOOLCHAIN_HAS_SYNC_4
	depends on BR2_USE_MMU

comment "bluez5-utils conflicts with older bluez-utils version"
	depends on BR2_PACKAGE_BLUEZ_UTILS
```

## package/bluez_utils/Config.in
```kconfig
config BR2_PACKAGE_BLUEZ_UTILS
	bool "bluez-utils"
	depends on !BR2_STATIC_LIBS
	depends on BR2_USE_WCHAR # libglib2
	depends on BR2_TOOLCHAIN_HAS_THREADS # dbus, alsa-lib, libglib2
	depends on BR2_USE_MMU # dbus, libglib2
	select BR2_PACKAGE_DBUS
	select BR2_PACKAGE_LIBGLIB2
	help
	  bluez utils

	  http://www.kernel.org/pub/linux/bluetooth

if BR2_PACKAGE_BLUEZ_UTILS

config BR2_PACKAGE_BLUEZ_UTILS_COMPAT
	bool "BlueZ 3.x compatibility binaries"
	help
	  BlueZ 3.x compatibility binaries like pand, hidd, sdp

config BR2_PACKAGE_BLUEZ_UTILS_AUDIO
	bool "audio support"
	select BR2_PACKAGE_ALSA_LIB
	select BR2_PACKAGE_LIBSNDFILE
	help
	  Audio support

config BR2_PACKAGE_BLUEZ_UTILS_USB
	bool "USB support"
	depends on BR2_TOOLCHAIN_HAS_THREADS # libusb
	select BR2_PACKAGE_LIBUSB
	help
	  USB support

config BR2_PACKAGE_BLUEZ_UTILS_GATT
	bool "GATT support"
	select BR2_PACKAGE_READLINE
	help
	  Generic Attribute Profile (GATT) support. This provides profile
	  discovery and description services for Bluetooth Low Energy.
	  This will install the gatttool utility.
endif

comment "bluez-utils needs a toolchain w/ wchar, threads, dynamic library"
	depends on BR2_USE_MMU
	depends on !BR2_USE_WCHAR || !BR2_TOOLCHAIN_HAS_THREADS || BR2_STATIC_LIBS
```

## package/bmon/Config.in
```kconfig
config BR2_PACKAGE_BMON
	bool "bmon"
	depends on BR2_TOOLCHAIN_HAS_THREADS # libnl
	select BR2_PACKAGE_LIBCONFUSE
	select BR2_PACKAGE_LIBNL
	select BR2_PACKAGE_NCURSES
	help
	  bmon is a bandwidth monitor capable of retrieving statistics
	  from various input modules. It provides various output methods
	  including a curses based interface.

	  https://github.com/tgraf/bmon/

comment "bmon needs a toolchain w/ threads"
	depends on !BR2_TOOLCHAIN_HAS_THREADS
```

## package/boa/Config.in
```kconfig
config BR2_PACKAGE_BOA
	bool "boa"
	depends on BR2_USE_MMU # uses fork()
	help
	  A very small and very fast http daemon.  Not intended as
	  a feature-packed server.

	  http://www.boa.org/
```

## package/boinc/Config.in
```kconfig
config BR2_PACKAGE_BOINC
	bool "boinc"
	depends on BR2_USE_MMU # fork()
	depends on !BR2_STATIC_LIBS # dlfcn.h
	depends on BR2_TOOLCHAIN_HAS_THREADS
	depends on BR2_INSTALL_LIBSTDCPP
	select BR2_PACKAGE_LIBCURL
	select BR2_PACKAGE_OPENSSL
	help
	  Open-source software for volunteer computing and grid
	  computing.

	  Use the idle time on your computer to cure diseases, study
	  global warming, discover pulsars, and do many other types of
	  scientific research.

	  https://boinc.berkeley.edu

comment "boinc needs a toolchain w/ dynamic library, C++, threads"
	depends on BR2_USE_MMU
	depends on BR2_STATIC_LIBS || !BR2_INSTALL_LIBSTDCPP \
		|| !BR2_TOOLCHAIN_HAS_THREADS
```

## package/bonnie/Config.in
```kconfig
config BR2_PACKAGE_BONNIE
	bool "bonnie++"
	depends on BR2_INSTALL_LIBSTDCPP
	depends on BR2_USE_MMU # fork()
	help
	  Filesystem tester

	  http://www.coker.com.au/bonnie++/

comment "bonnie++ needs a toolchain w/ C++"
	depends on BR2_USE_MMU
	depends on !BR2_INSTALL_LIBSTDCPP
```
