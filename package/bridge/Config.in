## package/bridge/Config.in
```kconfig
config BR2_PACKAGE_BRIDGE
	bool "bridge"
	default n
	depends BR2_PACKAGE_LINUX
	help
	  Manage ethernet bridging; a way to connect networks together to
	  form a larger network.

	  http://bridge.sourceforge.net/
```

## package/brltty/Config.in
```kconfig
config BR2_PACKAGE_BRLTTY
	bool "brltty"
	depends on BR2_USE_WCHAR
	depends on BR2_TOOLCHAIN_HAS_THREADS
	depends on !BR2_STATIC_LIBS
	depends on BR2_USE_MMU # fork()
	help
	  A daemon providing access to the Linux console for a blind
	  person using a refreshable braille display.

	  http://brltty.com/

if BR2_PACKAGE_BRLTTY

config BR2_PACKAGE_BRLTTY_TEXT_TABLE
	string "text-table"

endif

comment "brltty needs a toolchain w/ dynamic lib, threads, wchar"
	depends on BR2_USE_MMU
	depends on BR2_STATIC_LIBS || !BR2_TOOLCHAIN_HAS_THREADS || !BR2_USE_WCHAR
```

## package/brotli/Config.in
```kconfig
config BR2_PACKAGE_BROTLI
	bool "brotli"
	help
	  Generic-purpose lossless compression library. The algorithm
	  compresses data using a combination of a modern variant of
	  the LZ77 algorithm, Huffman coding and 2nd order context
	  modeling, with a compression ratio comparable to the best
	  currently available general-purpose compression methods. It
	  is similar in speed with deflate but offers more dense
	  compression.

	  https://github.com/google/brotli
```

## package/bsdiff/Config.in
```kconfig
config BR2_PACKAGE_BSDIFF
	bool "bsdiff"
	select BR2_PACKAGE_BZIP2
	help
	  Binary patch/diff like xdelta but creates smaller diffs.
	  Needs bzip2 support.

	  http://www.daemonology.net/bsdiff/
```

## package/btrfs-progs/Config.in
```kconfig
config BR2_PACKAGE_BTRFS_PROGS
	bool "btrfs-progs"
	depends on BR2_USE_MMU # util-linux
	depends on BR2_TOOLCHAIN_HAS_THREADS
	select BR2_PACKAGE_E2FSPROGS
	select BR2_PACKAGE_LZO
	select BR2_PACKAGE_UTIL_LINUX
	select BR2_PACKAGE_UTIL_LINUX_LIBBLKID
	select BR2_PACKAGE_UTIL_LINUX_LIBUUID
	select BR2_PACKAGE_ZLIB
	help
	  Btrfs filesystem utilities

	  https://btrfs.wiki.kernel.org/index.php/Main_Page

comment "btrfs-progs needs a toolchain w/ threads"
	depends on BR2_USE_MMU
	depends on !BR2_TOOLCHAIN_HAS_THREADS
```

## package/btrfs-progs/Config.in.host
```kconfig
config BR2_PACKAGE_HOST_BTRFS_PROGS
	bool "host btrfs-progs"
	help
	  Btrfs filesystem utilities

	  https://btrfs.wiki.kernel.org/index.php/Main_Page
```

## package/bubblewrap/Config.in
```kconfig
config BR2_PACKAGE_BUBBLEWRAP
	bool "bubblewrap"
	depends on BR2_USE_MMU # fork()
	select BR2_PACKAGE_LIBCAP
	help
	  Unprivileged sandbox tool based on Linux namespaces.

	  https://github.com/projectatomic/bubblewrap
```

## package/bullet/Config.in
```kconfig
config BR2_PACKAGE_BULLET
	bool "bullet"
	depends on BR2_INSTALL_LIBSTDCPP
	help
	  Bullet is a Collision Detection and Rigid Body Dynamics
	  Library.

	  http://bulletphysics.org

comment "bullet needs a toolchain w/ C++"
	depends on !BR2_INSTALL_LIBSTDCPP
```

## package/bustle/Config.in
```kconfig
config BR2_PACKAGE_BUSTLE
	bool "bustle"
	depends on BR2_USE_WCHAR # libglib2
	depends on BR2_TOOLCHAIN_HAS_THREADS # libglib2
	depends on BR2_USE_MMU # libglib2
	depends on BR2_PACKAGE_DBUS # runtime
	select BR2_PACKAGE_LIBPCAP
	select BR2_PACKAGE_LIBGLIB2
	help
	  Bustle is a better dbus-monitor! It records and draws
	  sequence diagrams of D-Bus activity, showing signal
	  emissions, method calls and their corresponding returns,
	  with timestamps for each individual event and the duration
	  of each method call. This can help you check for unwanted
	  D-Bus traffic, and pinpoint why your D-Bus-based application
	  isn't performing as well as you like.

	  This only installs the command line bustle-pcap tool, not
	  the graphical viewer.

	  https://gitlab.freedesktop.org/bustle/bustle/

comment "bustle needs a toolchain w/ wchar, threads"
	depends on BR2_USE_MMU
	depends on BR2_PACKAGE_DBUS
	depends on !BR2_USE_WCHAR || !BR2_TOOLCHAIN_HAS_THREADS
```

## package/busybox/Config.in
```kconfig
config BR2_PACKAGE_BUSYBOX
	bool "BusyBox"
	default y
	help
	  The Swiss Army Knife of embedded Linux. It slices, it dices,
	  it makes Julian Fries.

	  http://busybox.net/

	  Most people will answer Y.

if BR2_PACKAGE_BUSYBOX

config BR2_PACKAGE_BUSYBOX_CONFIG
	string "BusyBox configuration file to use?"
	default "package/busybox/busybox.config"
	help
	  Some people may wish to use their own modified BusyBox
	  configuration file, and will specify their config file
	  location with this option.

	  Most people will just use the default BusyBox configuration
	  file.

config BR2_PACKAGE_BUSYBOX_CONFIG_FRAGMENT_FILES
	string "Additional BusyBox configuration fragment files"
	help
	  A space-separated list of configuration fragment files,
	  that will be merged to the main BusyBox configuration file.

# This option is not an option of Busybox, it can be selected even
# if Busybox is not enabled.
config BR2_PACKAGE_BUSYBOX_SHOW_OTHERS
	bool "Show packages that are also provided by busybox"
	help
	  Show packages in menuconfig that are potentially also provided
	  by busybox.

config BR2_PACKAGE_BUSYBOX_SELINUX
	bool "Enable SELinux support"
	depends on BR2_TOOLCHAIN_HAS_THREADS
	depends on !BR2_STATIC_LIBS
	depends on BR2_TOOLCHAIN_USES_GLIBC
	depends on !BR2_arc
	select BR2_PACKAGE_LIBSELINUX
	help
	  Enable SELinux support in BusyBox. Please note that
	  depending on your BusyBox configuration and the SELinux
	  policy implementation, you may want to also enable
	  BR2_PACKAGE_BUSYBOX_INDIVIDUAL_BINARIES.

	  For instance, if your BusyBox configuration only uses a
	  couple of minor BusyBox features, such as simple command
	  line utilities, the symlinked version of BusyBox can be used
	  to save space. If BusyBox provides more features, such as
	  crond, then individual binaries have to be enabled for the
	  SELinux type transitions to occur properly.

config BR2_PACKAGE_BUSYBOX_INDIVIDUAL_BINARIES
	bool "Individual binaries"
	depends on !BR2_STATIC_LIBS
	depends on !BR2_bfin # libbusybox.so link issue
	help
	  By default (i.e with this option disabled), Busybox is
	  installed as a single binary in /bin/busybox and all applets
	  are a symbolic link to /bin/busybox.

	  With this option enabled, each applet is a separate binary,
	  which is needed for proper operation with SELinux.

comment "Busybox individual binaries need a toolchain w/ dynamic library"
	depends on BR2_STATIC_LIBS
	depends on !BR2_bfin

config BR2_PACKAGE_BUSYBOX_WATCHDOG
	bool "Install the watchdog daemon startup script"
	help
	  Install the watchdog daemon startup script,
	  that just start at the boot the busybox watchdog daemon.

if BR2_PACKAGE_BUSYBOX_WATCHDOG

config BR2_PACKAGE_BUSYBOX_WATCHDOG_PERIOD
	string "Delay between reset"
	default "5"
	help
	  Select the number of seconds between each
	  reset of the watchdog (default 5)

	  Use ms suffix to specify milliseconds (e.g. 500ms)

endif

endif

if !BR2_PACKAGE_BUSYBOX # kconfig doesn't support else

comment "You may need to enable other packages to get a working system"
comment "You better know what you're doing!"

# This option is not an option of Busybox, it can be selected even if
# Busybox is not enabled. This dummy option ensures that packages that
# depend on BR2_PACKAGE_BUSYBOX_SHOW_OTHERS are visible when Busybox
# is disabled.
config BR2_PACKAGE_BUSYBOX_SHOW_OTHERS
	default y
endif
```

## package/bwm-ng/Config.in
```kconfig
config BR2_PACKAGE_BWM_NG
	bool "bwm-ng"
	help
	  Bandwidth Monitor NG is a small and console-based live
	  network and disk-io bandwidth monitor for Linux, BSD,
	  Solaris, Mac OS X and others.

	  http://sourceforge.net/projects/bwmng/
```

## package/bzip2/Config.in
```kconfig
config BR2_PACKAGE_BZIP2
	bool "bzip2"
	help
	  Freely available, patent free, high-quality data compressor.
	  It typically compresses files to within 10% to 15% of the best
	  available techniques, while being around twice as fast at
	  compression and six times faster at decompression.

	  https://sourceware.org/bzip2/
```

## package/c-ares/Config.in
```kconfig
config BR2_PACKAGE_C_ARES
	bool "c-ares"
	help
	  C library for asynchronous DNS requests.

	  http://c-ares.haxx.se/
```

## package/c-capnproto/Config.in
```kconfig
config BR2_PACKAGE_C_CAPNPROTO
	bool "c-capnproto"
	depends on BR2_USE_MMU # capnproto
	depends on BR2_HOST_GCC_AT_LEAST_5 # capnproto
	depends on BR2_TOOLCHAIN_GCC_AT_LEAST_5 # capnproto
	depends on BR2_INSTALL_LIBSTDCPP # capnproto
	depends on BR2_TOOLCHAIN_HAS_THREADS # capnproto
	depends on BR2_TOOLCHAIN_HAS_ATOMIC # capnproto
	select BR2_PACKAGE_CAPNPROTO
	help
	  A C plugin for Cap'n Proto. Generates the code generator
	  plugin for C. Requires regular Cap'n Proto and only
	  provides serialization (no RPC).

	  https://github.com/opensourcerouting/c-capnproto

comment "c-capnproto needs host and target gcc >= 5 w/ C++14, threads, atomic"
	depends on BR2_USE_MMU
	depends on!BR2_HOST_GCC_AT_LEAST_5 || \
		!BR2_TOOLCHAIN_GCC_AT_LEAST_5 || \
		!BR2_INSTALL_LIBSTDCPP || \
		!BR2_TOOLCHAIN_HAS_THREADS || \
		!BR2_TOOLCHAIN_HAS_ATOMIC
```

## package/c-icap-modules/Config.in
```kconfig
config BR2_PACKAGE_C_ICAP_MODULES
	bool "c-icap-modules"
	depends on BR2_PACKAGE_C_ICAP
	help
	  Additionals modules for c-icap server.

	  http://c-icap.sourceforge.net/
```

## package/c-periphery/Config.in
```kconfig
config BR2_PACKAGE_C_PERIPHERY
	bool "c-periphery"
	depends on BR2_TOOLCHAIN_HEADERS_AT_LEAST_4_8
	help
	  c-periphery is a set of C wrapper functions for GPIO, SPI,
	  I2C, MMIO, and Serial peripheral I/O interface access in
	  userspace Linux. The c-periphery wrappers simplify and
	  consolidate the native Linux APIs to these
	  interfaces. c-periphery is useful in embedded Linux
	  environments (including BeagleBone, Raspberry Pi,
	  etc. platforms) for interfacing with external
	  peripherals. c-periphery is re-entrant, uses static
	  allocations, has no dependencies outside the standard C
	  library and Linux, compiles into a static library for easy
	  integration with other projects, and is MIT licensed.

	  https://github.com/vsergeev/c-periphery

comment "c-periphery needs a toolchain w/ kernel headers >= 4.8"
	depends on !BR2_TOOLCHAIN_HEADERS_AT_LEAST_4_8
```

## package/ca-certificates/Config.in
```kconfig
config BR2_PACKAGE_CA_CERTIFICATES
	bool "CA Certificates"
	help
	  This package includes PEM files of CA certificates to allow
	  SSL-based applications to check for the authenticity of SSL
	  connections.

	  It includes, among others, certificate authorities used by the
	  Debian infrastructure and those shipped with Mozilla's
	  browsers.

	  https://salsa.debian.org/debian/ca-certificates
```

## package/cache-calibrator/Config.in
```kconfig
config BR2_PACKAGE_CACHE_CALIBRATOR
	bool "cache-calibrator"
	help
	  Cache calibrator is a small C program that is supposed to
	  analyze a computers (cache-) memory system and extract
	  useful information

	  http://homepages.cwi.nl/~manegold/Calibrator/

	  It is also recommended as a load generator for realtime
	  testing in:

	  https://rt.wiki.kernel.org/index.php/RT_PREEMPT_HOWTO
```

## package/cage/Config.in
```kconfig
comment "cage needs udev, mesa3d w/ EGL and GLES support"
	depends on !BR2_PACKAGE_MESA3D_OPENGL_EGL || \
		!BR2_PACKAGE_MESA3D_OPENGL_ES || \
		!BR2_PACKAGE_HAS_UDEV

comment "cage needs a toolchain w/ threads, locale, dynamic library"
	depends on !BR2_TOOLCHAIN_HAS_THREADS || \
		!BR2_ENABLE_LOCALE || \
		BR2_STATIC_LIBS

config BR2_PACKAGE_CAGE
	bool "cage"
	depends on !BR2_STATIC_LIBS # wlroots
	depends on BR2_TOOLCHAIN_HAS_THREADS # wlroots
	depends on BR2_ENABLE_LOCALE # wlroots
	depends on BR2_PACKAGE_HAS_UDEV # wlroots
	depends on BR2_PACKAGE_MESA3D_OPENGL_EGL # wlroots
	depends on BR2_PACKAGE_MESA3D_OPENGL_ES # wlroots
	select BR2_PACKAGE_WLROOTS
	help
	  Kiosk compositor for Wayland, which displays a single
	  maximized application at a time.

	  https://www.hjdskes.nl/projects/cage/
```

## package/cairo/Config.in
```kconfig
config BR2_PACKAGE_CAIRO
	bool "cairo"
	depends on BR2_ARCH_HAS_ATOMICS
	select BR2_PACKAGE_PIXMAN
	select BR2_PACKAGE_FONTCONFIG
	select BR2_PACKAGE_XLIB_LIBX11 if BR2_PACKAGE_XORG7
	select BR2_PACKAGE_XLIB_LIBXEXT if BR2_PACKAGE_XORG7
	help
	  Cairo is a 2D graphics library with support for multiple
	  output devices. Currently supported output targets include
	  the X Window System, Win32, image buffers, and PostScript,
	  PDF, and SVG file output. Experimental backends include
	  OpenGL (through glitz), Quartz, and XCB.

	  http://cairographics.org/

if BR2_PACKAGE_CAIRO

config BR2_PACKAGE_CAIRO_PS
	bool "postscript support"
	select BR2_PACKAGE_ZLIB
	select BR2_PACKAGE_CAIRO_PDF

config BR2_PACKAGE_CAIRO_PDF
	bool "pdf support"
	select BR2_PACKAGE_ZLIB

config BR2_PACKAGE_CAIRO_PNG
	bool "png support"
	select BR2_PACKAGE_LIBPNG
	select BR2_PACKAGE_ZLIB

config BR2_PACKAGE_CAIRO_SCRIPT
	bool "script support"
	select BR2_PACKAGE_CAIRO_PNG

config BR2_PACKAGE_CAIRO_SVG
	bool "svg support"
	select BR2_PACKAGE_CAIRO_PNG
	select BR2_PACKAGE_CAIRO_PDF

config BR2_PACKAGE_CAIRO_TEE
	bool "tee support"

config BR2_PACKAGE_CAIRO_XML
	bool "xml support"
	select BR2_PACKAGE_CAIRO_PNG

endif
```

## package/cairomm/Config.in
```kconfig
config BR2_PACKAGE_CAIROMM
	bool "cairomm"
	select BR2_PACKAGE_CAIRO
	select BR2_PACKAGE_LIBGLIB2
	select BR2_PACKAGE_LIBSIGC
	depends on BR2_TOOLCHAIN_GCC_AT_LEAST_4_8 # C++11
	depends on BR2_TOOLCHAIN_HAS_THREADS # libglib2
	depends on BR2_USE_WCHAR # libglib2
	depends on BR2_USE_MMU # libglib2
	depends on BR2_INSTALL_LIBSTDCPP
	help
	  The cairomm package is a set of C++ bindings for Cairo.

	  http://www.gtkmm.org/

comment "cairomm needs a toolchain w/ C++, wchar, threads, gcc >= 4.8"
	depends on BR2_USE_MMU
	depends on !BR2_TOOLCHAIN_GCC_AT_LEAST_4_8 || !BR2_USE_WCHAR \
		|| !BR2_TOOLCHAIN_HAS_THREADS || !BR2_INSTALL_LIBSTDCPP
```

## package/can-utils/Config.in
```kconfig
config BR2_PACKAGE_CAN_UTILS
	bool "can-utils"
	depends on BR2_USE_MMU # fork()
	depends on !BR2_TOOLCHAIN_USES_MUSL # error()
	help
	  SocketCAN is a set of open source CAN drivers and a
	  networking stack.
	  This package provides various tools for this stack.

	  https://github.com/linux-can/can-utils

comment "can-utils needs a glibc or uClibc toolchain"
	depends on BR2_TOOLCHAIN_USES_MUSL
	depends on BR2_USE_MMU
```
