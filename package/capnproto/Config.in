## package/capnproto/Config.in
```kconfig
config BR2_PACKAGE_CAPNPROTO
	bool "capnproto"
	depends on BR2_USE_MMU
	depends on BR2_HOST_GCC_AT_LEAST_5 # C++14
	depends on BR2_TOOLCHAIN_GCC_AT_LEAST_5 # C++14
	depends on BR2_INSTALL_LIBSTDCPP
	depends on BR2_TOOLCHAIN_HAS_THREADS
	depends on BR2_TOOLCHAIN_HAS_ATOMIC
	help
	  Cap'n Proto is an insanely fast data interchange format
	  and capability-based RPC system. Think JSON, except
	  binary. Or think Protocol Buffers, except faster. In
	  fact, in benchmarks, Cap'n Proto is INFINITY TIMES
	  faster than Protocol Buffers.

	  https://capnproto.org/index.html

comment "capnproto needs host and target gcc >= 5 w/ C++14, threads, atomic"
	depends on BR2_USE_MMU
	depends on !BR2_HOST_GCC_AT_LEAST_5 || \
		!BR2_TOOLCHAIN_GCC_AT_LEAST_5 || \
		!BR2_INSTALL_LIBSTDCPP || \
		!BR2_TOOLCHAIN_HAS_THREADS || \
		!BR2_TOOLCHAIN_HAS_ATOMIC
```

## package/caps/Config.in
```kconfig
config BR2_PACKAGE_CAPS
	bool "caps"
	depends on BR2_INSTALL_LIBSTDCPP
	depends on !BR2_STATIC_LIBS
	help
	  CAPS is a collection of audio plugins comprising virtual
	  guitar amplification and a small range of basic classic
	  effects, signal processors and generators of often
	  elementary and occasionally exotic nature.

	  The plugins aim to satisfy the highest demands in sound
	  quality with maximal computational efficiency and zero
	  latency.

	  http://quitte.de/dsp/caps.html

comment "caps needs a toolchain w/ C++, dynamic library"
	depends on !BR2_INSTALL_LIBSTDCPP || BR2_STATIC_LIBS
```

## package/cargo/Config.in.host
```kconfig
config BR2_PACKAGE_HOST_CARGO
	bool "host cargo"
	depends on BR2_PACKAGE_HOST_RUSTC_ARCH_SUPPORTS
	select BR2_PACKAGE_HOST_RUSTC
	help
	  Cargo is the package manager for the Rust programming
	  language.

	  https://crates.io/
```

## package/cbootimage/Config.in
```kconfig
config BR2_PACKAGE_CBOOTIMAGE
	bool "cbootimage"
	depends on BR2_arm || BR2_armeb
	# uses non-standard u_intXX_t types
	# https://github.com/NVIDIA/cbootimage/pull/7
	depends on !BR2_TOOLCHAIN_USES_MUSL
	help
	  This project provides a tool which compiles BCT (Boot
	  Configuration Table) images to place into the boot flash of
	  a Tegra-based device.

	  https://github.com/NVIDIA/cbootimage

comment "cbootimage needs a glibc or uClibc toolchain"
	depends on BR2_arm || BR2_armeb
	depends on BR2_TOOLCHAIN_USES_MUSL
```

## package/cbootimage/Config.in.host
```kconfig
config BR2_PACKAGE_HOST_CBOOTIMAGE
	bool "host cbootimage"
	depends on BR2_arm || BR2_armeb
	help
	  This project provides a tool which compiles BCT (Boot
	  Configuration Table) images to place into the boot flash of
	  a Tegra-based device.

	  https://github.com/NVIDIA/cbootimage
```

## package/cc-tool/Config.in
```kconfig
config BR2_PACKAGE_CC_TOOL
	bool "cc-tool"
	depends on BR2_INSTALL_LIBSTDCPP
	depends on BR2_TOOLCHAIN_HAS_THREADS
	depends on BR2_USE_WCHAR # boost-filesystem
	select BR2_PACKAGE_LIBUSB
	select BR2_PACKAGE_BOOST
	select BR2_PACKAGE_BOOST_PROGRAM_OPTIONS
	select BR2_PACKAGE_BOOST_SYSTEM
	select BR2_PACKAGE_BOOST_REGEX
	select BR2_PACKAGE_BOOST_FILESYSTEM
	help
	  cc-tool provides support for Texas Instruments CC Debugger
	  for Linux OS in order to program 8051-based System-On-Chip
	  devices: CC254x CC253x CC243x CC251x CC111x

	  http://sourceforge.net/projects/cctool/

comment "cc-tool needs a toolchain w/ C++, threads, wchar"
	depends on !BR2_INSTALL_LIBSTDCPP || !BR2_TOOLCHAIN_HAS_THREADS || !BR2_USE_WCHAR
```

## package/ccache/Config.in
```kconfig
config BR2_PACKAGE_CCACHE
	bool "ccache"
	# needs fork()
	depends on BR2_USE_MMU
	# We no longer support a toolchain on the target
	depends on BR2_DEPRECATED_SINCE_2013_02
	help
	  ccache is a compiler cache. It speeds up recompilation by
	  caching previous compilations and detecting when the same
	  compilation is being done again

	  http://ccache.samba.org
```

## package/ccid/Config.in
```kconfig
config BR2_PACKAGE_CCID
	bool "ccid"
	depends on BR2_TOOLCHAIN_HAS_THREADS # libusb
	depends on BR2_USE_MMU # pcsc-lite
	depends on !BR2_STATIC_LIBS # pcsc-lite
	select BR2_PACKAGE_PCSC_LITE
	select BR2_PACKAGE_LIBUSB
	help
	  PC/SC driver for USB CCID smart card readers

	  http://pcsclite.alioth.debian.org/ccid.html

comment "ccid needs a toolchain w/ threads, dynamic library"
	depends on BR2_USE_MMU
	depends on !BR2_TOOLCHAIN_HAS_THREADS || BR2_STATIC_LIBS
```

## package/ccrypt/Config.in
```kconfig
config BR2_PACKAGE_CCRYPT
	bool "ccrypt"
	help
	  ccrypt is a utility for encrypting and decrypting files and
	  streams.

	  http://ccrypt.sourceforge.net/
```

## package/cctz/Config.in
```kconfig
config BR2_PACKAGE_CCTZ
	bool "cctz"
	depends on BR2_INSTALL_LIBSTDCPP
	depends on BR2_TOOLCHAIN_HAS_THREADS
	depends on BR2_TOOLCHAIN_GCC_AT_LEAST_4_8 # C++11
	select BR2_TARGET_TZ_INFO # runtime dependency
	help
	  CCTZ is a C++ library for translating between absolute
	  and civil times using the rules of a time zone.

	  https://github.com/google/cctz

if BR2_PACKAGE_CCTZ

config BR2_PACKAGE_CCTZ_INSTALL_TOOLS
	bool "Install tools"
	help
	  This option allows installing CCTZ tools.

config BR2_PACKAGE_CCTZ_INSTALL_EXAMPLES
	bool "Install example programs"
	help
	  This option allows installing CCTZ example programs.

endif

comment "cctz needs a toolchain w/ C++, threads, gcc >= 4.8"
	depends on !BR2_INSTALL_LIBSTDCPP || \
		!BR2_TOOLCHAIN_HAS_THREADS || !BR2_TOOLCHAIN_GCC_AT_LEAST_4_8
```

## package/cdrkit/Config.in
```kconfig
config BR2_PACKAGE_CDRKIT
	bool "cdrkit"
	depends on BR2_USE_MMU # fork
	# Needed for libbz
	select BR2_PACKAGE_BZIP2
	select BR2_PACKAGE_LIBCAP
	select BR2_PACKAGE_ZLIB
	help
	  cdrkit is a suite of programs for recording CDs and DVDs,
	  blanking CD-RW media, creating ISO-9660 filesystem images,
	  extracting audio CD data, and more.

	  http://www.cdrkit.org/
```

## package/cegui/Config.in
```kconfig
comment "cegui needs a toolchain w/ C++, threads, dynamic library, wchar"
	depends on !BR2_TOOLCHAIN_HAS_THREADS || !BR2_INSTALL_LIBSTDCPP \
			|| BR2_STATIC_LIBS || !BR2_USE_WCHAR

config BR2_PACKAGE_CEGUI
	bool "cegui"
	depends on BR2_INSTALL_LIBSTDCPP
	depends on !BR2_STATIC_LIBS
	depends on BR2_TOOLCHAIN_HAS_THREADS
	depends on BR2_USE_WCHAR
	select BR2_PACKAGE_GLM
	select BR2_PACKAGE_LIBICONV if !BR2_ENABLE_LOCALE
	help
	  Crazy Eddie's GUI System is a free library providing windowing
	  and widgets for graphics APIs / engines where such
	  functionality is not natively available, or severely lacking.
	  The library is object orientated, written in C++, and targeted
	  at games developers who should be spending their time creating
	  great games, not building GUI sub-systems!

	  http://www.cegui.org.uk/
```

## package/cegui06/Config.in
```kconfig
comment "cegui06 needs a toolchain w/ C++, threads, dynamic library"
	depends on !BR2_TOOLCHAIN_HAS_THREADS || !BR2_INSTALL_LIBSTDCPP || BR2_STATIC_LIBS

config BR2_PACKAGE_CEGUI06
	bool "cegui06"
	depends on BR2_TOOLCHAIN_HAS_THREADS
	depends on BR2_INSTALL_LIBSTDCPP
	depends on !BR2_STATIC_LIBS
	select BR2_PACKAGE_EXPAT
	select BR2_PACKAGE_FREETYPE
	select BR2_PACKAGE_PCRE
	help
	  Crazy Eddie's GUI System is a free library providing windowing
	  and widgets for graphics APIs / engines where such
	  functionality is not natively available, or severely lacking.
	  The library is object orientated, written in C++, and targeted
	  at games developers who should be spending their time creating
	  great games, not building GUI sub-systems!

	  http://www.cegui.org.uk/
```

## package/celt051/Config.in
```kconfig
config BR2_PACKAGE_CELT051
	bool "celt051"
	select BR2_PACKAGE_LIBOGG
	help
	  The CELT ultra-low delay audio codec
	  
	  The CELT codec is a compression algorithm for audio. Like MP3,
	  Vorbis, and AAC it is suitable for transmitting music with high
	  quality. Unlike these formats CELT imposes very little delay on
	  the signal, even less than is typical for speech centric formats
	  like Speex, GSM, or G.729.
	  
	  Note: this is version 0.5.1.3 of celt.
	  
	  http://www.celt-codec.org/
```

## package/cereal/Config.in
```kconfig
config BR2_PACKAGE_CEREAL
	bool "cereal"
	depends on BR2_USE_WCHAR
	depends on BR2_INSTALL_LIBSTDCPP
	depends on BR2_TOOLCHAIN_HAS_THREADS
	depends on BR2_TOOLCHAIN_GCC_AT_LEAST_4_7 # C++11
	help
	  cereal is a header-only C++11 serialization library.
	  cereal takes arbitrary data types and reversibly turns them
	  into different representations, such as compact binary
	  encodings, XML or JSON. cereal was designed to be fast,
	  light-weight, and easy to extend - it has no external
	  dependencies and can be easily bundled with other code or used
	  standalone.

	  https://github.com/USCiLab/cereal

comment "cereal needs a toolchain w/ C++, gcc >= 4.7, threads, wchar"
	depends on !BR2_INSTALL_LIBSTDCPP  || !BR2_TOOLCHAIN_HAS_THREADS || \
		!BR2_USE_WCHAR || !BR2_TOOLCHAIN_GCC_AT_LEAST_4_7
```

## package/cgic/Config.in
```kconfig
config BR2_PACKAGE_CGIC
	bool "cgic"
	help
	  C CGI library

	  http://www.boutell.com/cgic/
```

## package/cgilua/Config.in
```kconfig
config BR2_PACKAGE_CGILUA
	bool "cgilua"
	select BR2_PACKAGE_LUAFILESYSTEM
	help
	  CGILua is a tool for creating dynamic HTML pages
	  and manipulating input data from Web forms.

	  http://keplerproject.github.com/cgilua
```

## package/cgroupfs-mount/Config.in
```kconfig
config BR2_PACKAGE_CGROUPFS_MOUNT
	bool "cgroupfs-mount"
	depends on !BR2_INIT_SYSTEMD
	help
	  cgroupfs mount and umount scripts.

	  requires a Linux kernel >= 3.0 with the following options
	  enabled:

	  - CONFIG_BLK_CGROUP
	  - CONFIG_CGROUPS
	  - CONFIG_CGROUP_CPUACCT
	  - CONFIG_CGROUP_DEVICE
	  - CONFIG_CGROUP_FREEZER
	  - CONFIG_CGROUP_WRITEBACK
	  - CONFIG_CGROUP_SCHED
	  - CONFIG_CGROUP_PIDS

	  https://github.com/tianon/cgroupfs-mount
```

## package/chartjs/Config.in
```kconfig
config BR2_PACKAGE_CHARTJS
	bool "chartjs"
	help
	  Chart.js, a simple yet flexible JavaScript charting library
	  for designers & developers

	  https://www.chartjs.org/
```

## package/check/Config.in
```kconfig
config BR2_PACKAGE_CHECK
	bool "check"
	help
	  Check is a unit testing framework for C.

	  http://check.sourceforge.net/
```

## package/checkpolicy/Config.in
```kconfig
config BR2_PACKAGE_CHECKPOLICY
	bool "checkpolicy"
	depends on BR2_TOOLCHAIN_HAS_THREADS # libselinux
	depends on !BR2_STATIC_LIBS # libselinux
	select BR2_PACKAGE_LIBSELINUX
	select BR2_PACKAGE_FLEX
	help
	  checkpolicy is the SELinux policy compiler. It uses libsepol
	  to generate the binary policy. checkpolicy uses the static
	  libsepol since it deals with low level details of the policy
	  that have not been encapsulated/abstracted by a proper
	  shared library interface.

	  http://selinuxproject.org/page/Main_Page

comment "checkpolicy needs a toolchain w/ threads, dynamic library"
	depends on !BR2_TOOLCHAIN_HAS_THREADS || BR2_STATIC_LIBS
```

## package/checkpolicy/Config.in.host
```kconfig
config BR2_PACKAGE_HOST_CHECKPOLICY
	bool "host checkpolicy"
	help
	  checkpolicy is the SELinux policy compiler. It uses libsepol
	  to generate the binary policy. checkpolicy uses the static
	  libsepol since it deals with low level details of the policy
	  that have not been encapsulated/abstracted by a proper
	  shared library interface.

	  http://selinuxproject.org/page/Main_Page
```

## package/checksec/Config.in.host
```kconfig
config BR2_PACKAGE_HOST_CHECKSEC
	bool "host checksec"
	help
	  This tool provides a shell script to check the
	  properties of executables
	  (PIE,RELRO,Stack Canaries,Fortify Source).
	  It also has a kernel test mode that can run on target
	  for testing of PaX, ASLR, heap and config hardening.

	  NOTE: when using this tool as a host tool, the tool
	  can offline check a target folder of elf files for
	  hardening features enabled in those elf files.  There
	  are other features of this tool, like the kernel test
	  feature that are not functional offline, but require the
	  user to execute in a chroot or on target.

	  https://github.com/slimm609/checksec.sh.git
```

## package/chipmunk/Config.in
```kconfig
comment "chipmunk needs an OpenGL backend"
	depends on !BR2_PACKAGE_HAS_LIBGL

config BR2_PACKAGE_CHIPMUNK
	bool "chipmunk"
	depends on BR2_PACKAGE_HAS_LIBGL
	help
	  Chipmunk2D is a simple, lightweight, fast and portable 2D
	  rigid body physics library written in C.

	  http://chipmunk-physics.net/
```
