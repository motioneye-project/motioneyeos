## package/connman-gtk/Config.in
```kconfig
comment "connman-gtk needs libgtk3 and a glibc or uClibc toolchain w/ wchar, threads, resolver, dynamic library"
	depends on BR2_USE_MMU
	depends on BR2_TOOLCHAIN_HAS_SYNC_4
	depends on !BR2_USE_WCHAR || !BR2_TOOLCHAIN_HAS_THREADS || \
		BR2_STATIC_LIBS || !BR2_PACKAGE_LIBGTK3 || \
		BR2_TOOLCHAIN_USES_MUSL

config BR2_PACKAGE_CONNMAN_GTK
	bool "connman-gtk"
	depends on BR2_USE_WCHAR # libglib2, connman
	depends on BR2_TOOLCHAIN_HAS_THREADS # libglib2, connman
	depends on BR2_USE_MMU # libglib2
	depends on !BR2_STATIC_LIBS # connman
	depends on BR2_TOOLCHAIN_HAS_SYNC_4 # connman
	depends on !BR2_TOOLCHAIN_USES_MUSL # connman
	depends on BR2_PACKAGE_LIBGTK3
	select BR2_PACKAGE_CONNMAN
	select BR2_PACKAGE_LIBGLIB2
	help
	  GTK GUI for ConnMan.

	  https://github.com/jgke/connman-gtk
```

## package/connman/Config.in
```kconfig
config BR2_PACKAGE_CONNMAN
	bool "connman"
	depends on BR2_USE_WCHAR # libglib2
	depends on BR2_TOOLCHAIN_HAS_THREADS # dbus, libglib2
	depends on BR2_USE_MMU # dbus, libglib2
	depends on !BR2_STATIC_LIBS # needs dlopen()
	depends on BR2_TOOLCHAIN_HAS_SYNC_4
	depends on !BR2_TOOLCHAIN_USES_MUSL # missing res_ninit()
	select BR2_PACKAGE_DBUS
	select BR2_PACKAGE_LIBGLIB2
	select BR2_PACKAGE_IPTABLES
	help
	  The Connection Manager (ConnMan) project provides a daemon
	  for managing internet connections within embedded devices
	  running the Linux operating system.

	  https://01.org/connman

if BR2_PACKAGE_CONNMAN

config BR2_PACKAGE_CONNMAN_ETHERNET
	bool "enable Ethernet support"
	default y

config BR2_PACKAGE_CONNMAN_WIFI
	bool "enable WiFi support"
	select BR2_PACKAGE_WPA_SUPPLICANT # runtime
	select BR2_PACKAGE_WPA_SUPPLICANT_DBUS_NEW # runtime
	help
	  Enable WiFi support (scan and static/dhcp interface
	  setup). ConnMan detects the start of wpa_supplicant
	  automatically.

config BR2_PACKAGE_CONNMAN_WISPR
	bool "enable WISPr support"
	depends on !BR2_STATIC_LIBS # gnutls
	select BR2_PACKAGE_GNUTLS
	help
	  Enable support for Wireless Internet Service Provider
	  roaming (WISPr). A RADIUS server is used to authenticate the
	  subscriber's credentials.

comment "connman WISPr needs a toolchain w/ dynamic library"
	depends on BR2_STATIC_LIBS

config BR2_PACKAGE_CONNMAN_BLUETOOTH
	bool "enable Bluetooth support"
	help
	  Enable Bluetooth support. The start of bluetoothd is
	  automatically detected and only a runtime dependency.

config BR2_PACKAGE_CONNMAN_LOOPBACK
	bool "enable loopback support"

config BR2_PACKAGE_CONNMAN_NEARD
	bool "enable neard support"
	depends on BR2_TOOLCHAIN_HAS_SYNC_4 # neard
	select BR2_PACKAGE_NEARD

config BR2_PACKAGE_CONNMAN_OFONO
	bool "enable ofono support"
	depends on BR2_TOOLCHAIN_HAS_SYNC_4 # ofono
	select BR2_PACKAGE_OFONO

config BR2_PACKAGE_CONNMAN_DEBUG
	bool "enable compiling with debugging information"

config BR2_PACKAGE_CONNMAN_CLIENT
	bool "enable command line client"
	select BR2_PACKAGE_READLINE

endif # BR2_PACKAGE_CONNMAN

comment "connman needs a glibc or uClibc toolchain w/ wchar, threads, resolver, dynamic library"
	depends on BR2_USE_MMU
	depends on BR2_TOOLCHAIN_HAS_SYNC_4
	depends on !BR2_USE_WCHAR || !BR2_TOOLCHAIN_HAS_THREADS || BR2_STATIC_LIBS \
		|| BR2_TOOLCHAIN_USES_MUSL
```

## package/conntrack-tools/Config.in
```kconfig
config BR2_PACKAGE_CONNTRACK_TOOLS
	bool "conntrack-tools"
	depends on BR2_USE_MMU # fork()
	depends on BR2_TOOLCHAIN_HAS_NATIVE_RPC || BR2_TOOLCHAIN_HAS_THREADS # libtirpc
	depends on !BR2_STATIC_LIBS # dlopen()
	select BR2_PACKAGE_LIBNETFILTER_CONNTRACK
	select BR2_PACKAGE_LIBNETFILTER_CTHELPER
	select BR2_PACKAGE_LIBNETFILTER_CTTIMEOUT
	select BR2_PACKAGE_LIBNETFILTER_QUEUE
	select BR2_PACKAGE_LIBTIRPC if !BR2_TOOLCHAIN_HAS_NATIVE_RPC
	help
	  The conntrack-tools are a set of tools targeted at
	  system administrators.
	  They are conntrack, the userspace command line interface,
	  and conntrackd, the userspace daemon.

	  http://www.netfilter.org/projects/conntrack-tools/

comment "conntrack-tools needs a toolchain w/ threads, dynamic library"
	depends on BR2_USE_MMU
	depends on !(BR2_TOOLCHAIN_HAS_THREADS || BR2_TOOLCHAIN_HAS_NATIVE_RPC) || \
		BR2_STATIC_LIBS
```

## package/copas/Config.in
```kconfig
config BR2_PACKAGE_COPAS
	bool "copas"
	select BR2_PACKAGE_COXPCALL if BR2_PACKAGE_LUA_5_1 # runtime
	select BR2_PACKAGE_LUASOCKET # runtime
	help
	  Copas is a dispatcher based on coroutines that can be used
	  for asynchronous networking. For example TCP or UDP based
	  servers. But it also features timers and client support for
	  http(s), ftp and smtp requests.

	  http://keplerproject.github.io/copas/
```

## package/coreutils/Config.in
```kconfig
config BR2_PACKAGE_COREUTILS
	bool "coreutils"
	depends on BR2_USE_WCHAR
	depends on BR2_USE_MMU # fork()
	depends on BR2_PACKAGE_BUSYBOX_SHOW_OTHERS
	help
	  All of the basic file/text/shell utilities. These are the
	  core utilities which are expected to exist on every system.
	  BusyBox implements many of the most common.

	  Things like:
	  - chmod, cp, dd, dir, ls, etc...
	  - sort, tr, head, tail, wc, etc...
	  - whoami, who, etc...

	  http://www.gnu.org/software/coreutils/

if BR2_PACKAGE_COREUTILS

config BR2_PACKAGE_COREUTILS_INDIVIDUAL_BINARIES
	bool "Individual binaries"
	depends on !BR2_STATIC_LIBS
	help
	  By default (i.e. with this option disabled), coreutils is
	  installed as a single binary (Busybox style) called
	  /usr/bin/coreutils, and all core utilities are symbolic
	  links to this binary.

	  With this option enabled, each utility is a separate binary.

comment "coreutils individual binaries need a toolchain w/ dynamic library"
	depends on BR2_STATIC_LIBS

endif

comment "coreutils needs a toolchain w/ wchar"
	depends on BR2_USE_MMU
	depends on !BR2_USE_WCHAR
	depends on BR2_PACKAGE_BUSYBOX_SHOW_OTHERS
```

## package/corkscrew/Config.in
```kconfig
config BR2_PACKAGE_CORKSCREW
	bool "corkscrew"
	help
	  Corkscrew is a tool for tunneling SSH through HTTP proxies,
	  but... you might find another use for it.

	  https://github.com/bryanpkc/corkscrew
```
