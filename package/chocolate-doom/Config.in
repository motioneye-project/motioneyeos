## package/chocolate-doom/Config.in
```kconfig
config BR2_PACKAGE_CHOCOLATE_DOOM
	bool "chocolate-doom"
	depends on BR2_USE_MMU # fork()
	depends on !BR2_STATIC_LIBS # sdl2
	select BR2_PACKAGE_SDL2
	select BR2_PACKAGE_SDL2_MIXER
	select BR2_PACKAGE_SDL2_NET
	help
	  Chocolate Doom is a set of conservative source ports for Doom,
	  Heretic, Hexen and Strife, with a philosophy of preserving the
	  look, feel, and bugs of the vanilla versions of each.

	  http://www.chocolate-doom.org

comment "chocolate-doom needs a toolchain w/ dynamic library"
	depends on BR2_USE_MMU
	depends on BR2_STATIC_LIBS
```

## package/chrony/Config.in
```kconfig
config BR2_PACKAGE_CHRONY
	bool "chrony"
	depends on BR2_USE_MMU # fork()
	help
	  Chrony is a pair of programs which are used to maintain the
	  accuracy of the system clock.

	  http://chrony.tuxfamily.org/

config BR2_PACKAGE_CHRONY_DEBUG_LOGGING
	bool "enable debug logging support"
	depends on BR2_PACKAGE_CHRONY
	help
	  Enable support for debug logging output from Chrony when
	  enabled at runtime. If disabled, code for debug logging will
	  not be compiled in.
```

## package/cifs-utils/Config.in
```kconfig
config BR2_PACKAGE_CIFS_UTILS
	bool "cifs-utils"
	# uses fork()
	depends on BR2_USE_MMU
	help
	  The in-kernel CIFS filesystem is generally the preferred
	  method for mounting SMB/CIFS shares on Linux. The in-kernel
	  CIFS filesystem relies on a set of user-space tools. That
	  package of tools is called cifs-utils. Although not really
	  part of Samba proper, these tools were originally part of
	  the Samba package. For several reasons, shipping these tools
	  as part of Samba was problematic and it was deemed better to
	  split them off into their own package.

	  http://wiki.samba.org/index.php/LinuxCIFS_utils
```

## package/circus/Config.in
```kconfig
config BR2_PACKAGE_CIRCUS
	bool "circus"
	depends on BR2_PACKAGE_PYTHON3 # python-tornado
	depends on BR2_INSTALL_LIBSTDCPP # pyzmq -> zeromq
	depends on BR2_TOOLCHAIN_HAS_THREADS # pyzmq -> zeromq
	select BR2_PACKAGE_PYTHON_IOWAIT # runtime
	select BR2_PACKAGE_PYTHON_PSUTIL # runtime
	select BR2_PACKAGE_PYTHON_PYZMQ # runtime
	select BR2_PACKAGE_PYTHON_TORNADO # runtime
	select BR2_PACKAGE_PYTHON_SETUPTOOLS # runtime
	help
	  Circus is a program that will let you run and watch multiple
	  processes and sockets.

	  https://circus.readthedocs.org/en/latest/

comment "circus needs Python 3 and a toolchain w/ C++, threads"
	depends on !BR2_INSTALL_LIBSTDCPP || !BR2_TOOLCHAIN_HAS_THREADS || \
		!BR2_PACKAGE_PYTHON3
```

## package/civetweb/Config.in
```kconfig
config BR2_PACKAGE_CIVETWEB
	bool "civetweb"
	depends on BR2_TOOLCHAIN_HAS_THREADS
	depends on BR2_USE_MMU # fork()
	select BR2_PACKAGE_CIVETWEB_SERVER if !BR2_PACKAGE_CIVETWEB_LIB
	help
	  Full featured embedded web server with Lua support.

	  https://sourceforge.net/projects/civetweb

if BR2_PACKAGE_CIVETWEB

config BR2_PACKAGE_CIVETWEB_SERVER
	bool "enable the web server application"
	help
	  Include the web server and its config files.

config BR2_PACKAGE_CIVETWEB_LIB
	bool "enable library for embedding"
	help
	  Enable the civetweb library for embedding in another
	  application.

config BR2_PACKAGE_CIVETWEB_WITH_LUA
	bool "enable Lua support"
	# required by the bundled Sqlite3 and Lua code
	depends on !BR2_STATIC_LIBS
	help
	  Enable Lua support in Civetweb. Note that this will use a
	  version of Lua and Sqlite bundled within the Civetweb
	  sources, and not the packages from Buildroot.

comment "lua support needs a toolchain w/ dynamic library"
	depends on BR2_STATIC_LIBS

endif

comment "civetweb needs a toolchain w/ threads"
	depends on BR2_USE_MMU
	depends on !BR2_TOOLCHAIN_HAS_THREADS
```

## package/cjson/Config.in
```kconfig
config BR2_PACKAGE_CJSON
	bool "cJSON"
	help
	  An ultra-lightweight, portable, single-file, simple-as-can-be
	  ANSI-C compliant JSON parser, under MIT license.

	  https://github.com/DaveGamble/cJSON
```

## package/clamav/Config.in
```kconfig
config BR2_PACKAGE_CLAMAV
	bool "clamav"
	depends on BR2_INSTALL_LIBSTDCPP
	depends on BR2_TOOLCHAIN_HAS_THREADS
	depends on BR2_USE_MMU # fork()
	depends on BR2_USE_WCHAR
	select BR2_PACKAGE_LIBTOOL
	select BR2_PACKAGE_OPENSSL
	select BR2_PACKAGE_ZLIB
	help
	  ClamAV is an open source antivirus engine for detecting
	  trojans, viruses, malware & other malicious threats.

	  http://www.clamav.net

comment "clamav needs a toolchain w/ C++, threads, wchar"
	depends on !BR2_INSTALL_LIBSTDCPP \
		|| !BR2_TOOLCHAIN_HAS_THREADS || !BR2_USE_WCHAR
	depends on BR2_USE_MMU
```

## package/clang/Config.in
```kconfig
config BR2_PACKAGE_CLANG
	bool "clang"
	depends on BR2_PACKAGE_LLVM_ARCH_SUPPORTS
	depends on BR2_HOST_GCC_AT_LEAST_4_8
	depends on BR2_TOOLCHAIN_GCC_AT_LEAST_4_8
	depends on BR2_TOOLCHAIN_HAS_THREADS
	depends on BR2_INSTALL_LIBSTDCPP
	depends on !BR2_TOOLCHAIN_HAS_GCC_BUG_64735 # std::shared_future
	depends on !BR2_STATIC_LIBS
	depends on BR2_USE_WCHAR # std::wstring
	select BR2_PACKAGE_LLVM
	help
	  Clang is a C/C++, Objective C/C++ and OpenCL C front-end
	  for the LLVM compiler.

	  http://clang.llvm.org

comment "clang needs a toolchain w/ wchar, threads, C++, gcc >= 4.8, host gcc >= 4.8, dynamic library"
	depends on BR2_PACKAGE_LLVM_ARCH_SUPPORTS
	depends on !BR2_TOOLCHAIN_HAS_THREADS || !BR2_INSTALL_LIBSTDCPP || \
		!BR2_HOST_GCC_AT_LEAST_4_8 || !BR2_TOOLCHAIN_GCC_AT_LEAST_4_8 \
		|| BR2_STATIC_LIBS || !BR2_USE_WCHAR

comment "clang needs a toolchain not affected by GCC bug 64735"
	depends on BR2_PACKAGE_LLVM_ARCH_SUPPORTS
	depends on BR2_TOOLCHAIN_HAS_GCC_BUG_64735
```

## package/clapack/Config.in
```kconfig
comment "clapack needs an (e)glibc toolchain"
	depends on BR2_powerpc
	depends on !BR2_TOOLCHAIN_USES_GLIBC

config BR2_PACKAGE_CLAPACK
	bool "cblas/clapack"
	depends on !(BR2_mips || BR2_mipsel || BR2_mips64 || BR2_mips64el)
	# _fpu_control is used on PowerPC, but not available with
	# uClibc or musl
	depends on !BR2_powerpc || BR2_TOOLCHAIN_USES_GLIBC
	# disable clapack on blackfin, it triggers "undefined symbol" failure
	# because of the "_" symbol prefix:
	# http://autobuild.buildroot.net/results/a28df0ba10803e6e54c2f8160bbd8190cba4d690/
	depends on !BR2_bfin
	help
	  BLAS and LAPACK C implementation (f2c'ed version of).

	  http://www.netlib.org/clapack/

config BR2_PACKAGE_CLAPACK_ARITH_H
	string "Custom BLAS arith.h"
	depends on BR2_PACKAGE_CLAPACK
	help
	  To optimize BLAS library for the hardware, an 'arith.h' header should
	  be provided.

	  If empty, the library will not be optimized by the compiler.

	  In any case an 'arithchk' program is built (but not installed), to be run
	  on the target to generate this arith.h header.
```

## package/classpath/Config.in
```kconfig
config BR2_PACKAGE_CLASSPATH
	bool "classpath"
	select BR2_NEEDS_HOST_JAR
	select BR2_NEEDS_HOST_JAVAC
	depends on BR2_PACKAGE_JAMVM
	help
	  GNU Classpath, Essential Libraries for Java, is a GNU
	  project to create free core class libraries for use with
	  virtual machines and compilers for the java programming
	  language.

	  http://classpath.org
```

## package/clinfo/Config.in
```kconfig
config BR2_PACKAGE_CLINFO
	bool "clinfo"
	depends on BR2_PACKAGE_HAS_LIBOPENCL
	help
	  clinfo is a simple command-line application that enumerates
	  all possible (known) properties of the OpenCL platform and
	  devices available on the system.

	  https://github.com/Oblomov/clinfo

comment "clinfo needs an OpenCL provider"
	depends on !BR2_PACKAGE_HAS_LIBOPENCL
```

## package/cmake/Config.in
```kconfig
config BR2_PACKAGE_CMAKE_ARCH_SUPPORTS
	bool
	default y
	depends on BR2_arm    || BR2_armeb       || BR2_aarch64  || \
		BR2_m68k      || BR2_mips        || BR2_mips64   || \
		BR2_mipsel    || BR2_mips64el    || BR2_powerpc  || \
		BR2_powerpc64 || BR2_powerpc64le || BR2_sparc    || \
		BR2_i386      || BR2_x86_64      || BR2_xtensa

config BR2_PACKAGE_CMAKE
	bool

config BR2_PACKAGE_CMAKE_CTEST
	bool "ctest"
	select BR2_PACKAGE_CMAKE
	select BR2_PACKAGE_ZLIB
	select BR2_PACKAGE_JSONCPP
	select BR2_PACKAGE_LIBCURL
	select BR2_PACKAGE_LIBARCHIVE
	select BR2_PACKAGE_EXPAT
	select BR2_PACKAGE_BZIP2
	select BR2_PACKAGE_XZ
	select BR2_PACKAGE_LIBUV
	depends on BR2_PACKAGE_CMAKE_ARCH_SUPPORTS
	depends on BR2_TOOLCHAIN_GCC_AT_LEAST_4_7 # from jsoncpp
	depends on BR2_USE_WCHAR # libarchive
	depends on BR2_INSTALL_LIBSTDCPP
	depends on !BR2_STATIC_LIBS
	depends on BR2_TOOLCHAIN_HAS_THREADS # libuv
	depends on BR2_USE_MMU # libuv
	help
	  CTest is a testing tool distributed as a part of CMake. It
	  can be used to automate updating (using CVS for example),
	  configuring, building, testing, performing memory checking,
	  performing coverage, and submitting results to a CDash or
	  Dart dashboard system.

	  http://www.cmake.org/

comment "ctest needs a toolchain w/ C++, wchar, dynamic library, gcc >= 4.7, threads"
	depends on BR2_PACKAGE_CMAKE_ARCH_SUPPORTS
	depends on BR2_USE_MMU
	depends on !BR2_INSTALL_LIBSTDCPP || !BR2_USE_WCHAR || \
		BR2_STATIC_LIBS || !BR2_TOOLCHAIN_GCC_AT_LEAST_4_7 || \
		!BR2_TOOLCHAIN_HAS_THREADS
```

## package/cmake/Config.in.host
```kconfig
config BR2_PACKAGE_HOST_CMAKE
	bool "host cmake"
	help
	  CMake is an open-source, cross-platform family of tools
	  designed to build, test and package software. CMake is used
	  to control the software compilation process using simple
	  platform and compiler independent configuration files, and
	  generate native makefiles and workspaces that can be used in
	  the compiler environment of your choice.

	  http://www.cmake.org/
```

## package/cmocka/Config.in
```kconfig
config BR2_PACKAGE_CMOCKA
	bool cmocka
	depends on !BR2_STATIC_LIBS
	help
	  cmocka is an elegant unit testing framework for C with support
	  for mock objects. It only requires the standard C library,
	  works on a range of computing platforms (including embedded)
	  and with different compilers. It is a fork of Google's very
	  popular cmockery unit testing framework to fix bugs and
	  support it in the future.

	  https://cmocka.org

comment "cmocka needs a toolchain w/ dynamic library"
	depends on BR2_STATIC_LIBS
```

## package/cog/Config.in
```kconfig
comment "cog needs wpewebkit and a toolchain w/ threads"
	depends on BR2_USE_MMU
	depends on !BR2_PACKAGE_WPEWEBKIT || !BR2_TOOLCHAIN_HAS_THREADS

config BR2_PACKAGE_COG
	bool "cog"
	depends on BR2_PACKAGE_WPEWEBKIT
	depends on BR2_TOOLCHAIN_HAS_THREADS # dbus
	depends on BR2_USE_MMU # dbus
	select BR2_PACKAGE_DBUS
	select BR2_PACKAGE_WAYLAND
	help
	  Single "window" launcher for the WebKit WPE port, and
	  helper library for implementing WPE launcher. It does
	  not provide any chrome, and is suitable to be used
	  as a Web application container.

	  https://github.com/Igalia/cog

if BR2_PACKAGE_COG

config BR2_PACKAGE_COG_PROGRAMS_HOME_URI
	string "home uri"
	default "https://wpewebkit.org"
	help
	  Default URI to open when "cog" is launched. If an empty
	  string is used, there is no default and the URI to open
	  must be always specified in the command line.

config BR2_PACKAGE_COG_PLATFORM_FDO
	bool "FreeDesktop.org backend"
	default y
	select BR2_PACKAGE_LIBXKBCOMMON
	select BR2_PACKAGE_WAYLAND_PROTOCOLS
	help
	  Enable the FreeDesktop.org backend. Cog will interface with
	  a compositor over the Wayland protocol.

config BR2_PACKAGE_COG_PLATFORM_DRM
	bool "DRM backend"
	depends on BR2_PACKAGE_HAS_UDEV # libinput
	depends on BR2_PACKAGE_MESA3D_OPENGL_EGL # gbm
	select BR2_PACKAGE_LIBDRM
	select BR2_PACKAGE_LIBINPUT
	help
	  Enable the DRM platform backend. Cog will interface directly
	  with video drivers that support kernel mode-setting (KMS)
	  via the DRM user-space API.

comment "DRM platform needs mesa3d w/ EGL driver and GBM"
	depends on !BR2_PACKAGE_MESA3D_OPENGL_EGL

endif
```
