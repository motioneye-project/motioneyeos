## package/cosmo/Config.in
```kconfig
config BR2_PACKAGE_COSMO
	bool "cosmo"
	# run-time dependency
	select BR2_PACKAGE_LPEG
	# upstream site does not provide a valid archive
	depends on BROKEN
	help
	  Cosmo is a "safe templates" engine for Lua.

	  http://mascarenhas.github.io/cosmo/
```

## package/coxpcall/Config.in
```kconfig
config BR2_PACKAGE_COXPCALL
	bool "coxpcall"
	help
	  Coxpcall encapsulates the protected calls with a coroutine
	  based loop, so errors can be handled without the usual
	  pcall/xpcall issues with coroutines for Lua 5.1.

	  http://keplerproject.github.io/coxpcall/
```

## package/cpanminus/Config.in
```kconfig
config BR2_PACKAGE_CPANMINUS
	bool "cpanminus"
	# Requires host-qemu, which cannot work properly due to kernel
	# headers mismatch between the build environment and the
	# target.
	depends on BR2_BROKEN
	help
	  cpanminus is a script to get, unpack, build and install Perl modules
	  from CPAN.

	  Why? It's dependency free, requires zero configuration, and stands
	  alone. When running, it requires only 10MB of RAM.

	  http://github.com/miyagawa/cpanminus

if BR2_PACKAGE_CPANMINUS

config BR2_PACKAGE_CPANMINUS_MIRROR
	string "mirror"
	help
	  Specifies the base URL for the CPAN mirror to use,
	  such as http://cpan.cpantesters.org/.

config BR2_PACKAGE_CPANMINUS_MODULES
	string "Perl modules from CPAN"
	default "Curses::UI"
	help
	  List of space-separated Perl modules to install from CPAN.

	  Examples: Try::Tiny Dancer YAML Moo

	  Install the listed modules and their dependencies.

config BR2_PACKAGE_CPANMINUS_NATIVE_DEPENDENCIES
	string "native dependencies"
	default "ncurses"
	help
	  Some XS modules require native libraries.

endif
```

## package/cpio/Config.in
```kconfig
config BR2_PACKAGE_CPIO
	bool "cpio"
	# Need argp.h support
	select BR2_PACKAGE_ARGP_STANDALONE if BR2_TOOLCHAIN_USES_UCLIBC || BR2_TOOLCHAIN_USES_MUSL
	depends on BR2_USE_WCHAR
	help
	  cpio archive utility for creation and extraction.

	  https://www.gnu.org/software/cpio/

comment "cpio needs a toolchain w/ wchar"
	depends on !BR2_USE_WCHAR
```

## package/cppcms/Config.in
```kconfig
config BR2_PACKAGE_CPPCMS
	bool "cppcms"
	depends on BR2_INSTALL_LIBSTDCPP
	depends on BR2_PACKAGE_LIBGPG_ERROR_ARCH_SUPPORTS # libgcrypt
	depends on BR2_TOOLCHAIN_HAS_THREADS_NPTL
	depends on !BR2_STATIC_LIBS # dlopen()
	depends on BR2_USE_WCHAR
	select BR2_PACKAGE_ZLIB
	select BR2_PACKAGE_PCRE
	select BR2_PACKAGE_LIBGCRYPT
	help
	  CppCMS is a Free High Performance Web Development Framework
	  (not a CMS) aimed for Rapid Web Application Development. It
	  differs from most of other web development frameworks like:
	  Python Django or Java Servlets on  the following aspects:

	   - It is designed and tuned to handle extremely high loads.
	   - It uses modern C++ as primary development language in
	     order to achieve the above goal.
	   - It is aimed on development of both Web Sites and Web
	     Services.

	  http://cppcms.com

if BR2_PACKAGE_CPPCMS

config BR2_PACKAGE_CPPCMS_ICU
	bool "enable icu support"
	depends on !BR2_BINFMT_FLAT # icu
	select BR2_PACKAGE_ICU
	help
	  Using ICU allows advanced localization features into CppCMS,
	  in another hand ICU is heavier than iconv.

endif

comment "cppcms needs a toolchain w/ C++, NPTL, wchar, dynamic library"
	depends on !BR2_INSTALL_LIBSTDCPP || !BR2_TOOLCHAIN_HAS_THREADS_NPTL || \
		!BR2_USE_WCHAR || BR2_STATIC_LIBS
```

## package/cppdb/Config.in
```kconfig
config BR2_PACKAGE_CPPDB
	bool "cppdb"
	# dlfcn.h
	depends on !BR2_STATIC_LIBS
	depends on BR2_INSTALL_LIBSTDCPP
	depends on BR2_TOOLCHAIN_HAS_THREADS
	# Can be built without them but it's useless
	depends on BR2_PACKAGE_MYSQL || BR2_PACKAGE_POSTGRESQL || BR2_PACKAGE_SQLITE
	help
	  CppDB is an SQL connectivity library that is designed to
	  provide platform and Database independent connectivity API
	  similarly to what JDBC, ODBC and other connectivity libraries
	  do.

	  http://cppcms.com/sql/cppdb/

comment "cppdb needs a toolchain w/ C++, threads, dynamic library"
	depends on BR2_PACKAGE_MYSQL || BR2_PACKAGE_POSTGRESQL || BR2_PACKAGE_SQLITE
	depends on !BR2_INSTALL_LIBSTDCPP || !BR2_TOOLCHAIN_HAS_THREADS || \
		BR2_STATIC_LIBS
```

## package/cppunit/Config.in
```kconfig
config BR2_PACKAGE_CPPUNIT
	bool "cppunit"
	depends on BR2_INSTALL_LIBSTDCPP
	# currently the static situation is not correctly detected.
	depends on !BR2_STATIC_LIBS
	help
	  CppUnit is the C++ port of the famous JUnit framework for
	  unit testing.  Test output is in XML or text format for
	  automatic testing and GUI based for supervised tests.

	  http://www.freedesktop.org/wiki/Software/cppunit/

comment "cppunit needs a toolchain w/ C++, dynamic library"
	depends on !BR2_INSTALL_LIBSTDCPP || BR2_STATIC_LIBS
```

## package/cppzmq/Config.in
```kconfig
config BR2_PACKAGE_CPPZMQ
	bool "cppzmq"
	depends on BR2_INSTALL_LIBSTDCPP
	depends on BR2_TOOLCHAIN_HAS_THREADS_NPTL # zeromq
	select BR2_PACKAGE_ZEROMQ
	help
	  C++ binding for zeromq (ZeroMQ, 0MQ, zmq).

	  http://github.com/zeromq/cppzmq

comment "cppzmq needs a toolchain w/ C++, NPTL"
	depends on !(BR2_INSTALL_LIBSTDCPP && BR2_TOOLCHAIN_HAS_THREADS_NPTL)
```

## package/cpuburn-arm/Config.in
```kconfig
config BR2_PACKAGE_CPUBURN_ARM_ARCH_SUPPORTS
	bool
	default y if BR2_cortex_a7
	default y if BR2_cortex_a8
	default y if BR2_cortex_a9
	default y if BR2_cortex_a53

config BR2_PACKAGE_CPUBURN_ARM
	bool "cpuburn-arm"
	depends on BR2_PACKAGE_CPUBURN_ARM_ARCH_SUPPORTS
	help
	  Make ARM cores generate as much heat as possible. Supports
	  Cortex A7/A8/A9/A53.

	  https://github.com/ssvb/cpuburn-arm
```

## package/cpuload/Config.in
```kconfig
config BR2_PACKAGE_CPULOAD
	bool "cpuload"
	help
	  cpuload is a simple tool to obtain intuitive vision of CPU
	  load (including total, user, system, irq and softirq) within a
	  certain time, which is especially useful for embedded system
	  without GUI.

	  https://github.com/kelvincheung/cpuload
```

## package/cracklib/Config.in
```kconfig
config BR2_PACKAGE_CRACKLIB
	bool "cracklib"
	help
	  CrackLib tests passwords to determine whether they match
	  certain security-oriented characteristics, with the purpose
	  of stopping users from choosing passwords that are easy to
	  guess. CrackLib performs several tests on passwords: it
	  tries to generate words from a username and gecos entry and
	  checks those words against the password; it checks for
	  simplistic patterns in passwords; and it checks for the
	  password in a dictionary.

	  https://github.com/cracklib/cracklib

if BR2_PACKAGE_CRACKLIB

config BR2_PACKAGE_CRACKLIB_TOOLS
	bool "install tools"
	help
	  Install cracklib command line tools for creating dicts.

config BR2_PACKAGE_CRACKLIB_FULL_DICT
	bool "full dict"
	help
	  Install the full cracklib dict (requires about 8Mb extra
	  target space).

endif
```

## package/cramfs/Config.in
```kconfig
config BR2_PACKAGE_CRAMFS
	bool "cramfs"
	select BR2_PACKAGE_ZLIB
	help
	  cramfs is a compressed read-only filesystem. This package
	  contains the tools to generate and check a cramfs filesystem.

	  https://github.com/npitre/cramfs-tools
```

## package/cramfs/Config.in.host
```kconfig
config BR2_PACKAGE_HOST_CRAMFS
	bool "host cramfs"
	help
	  cramfs is a compressed read-only filesystem. This package
	  contains the tools to generate and check a cramfs filesystem.

	  http://sourceforge.net/projects/cramfs/
```

## package/crda/Config.in
```kconfig
config BR2_PACKAGE_CRDA
	bool "crda"
	depends on BR2_TOOLCHAIN_HAS_THREADS # libnl
	depends on !BR2_STATIC_LIBS
	select BR2_PACKAGE_LIBGCRYPT
	select BR2_PACKAGE_LIBNL
	# regdb is a runtime dependency
	select BR2_PACKAGE_WIRELESS_REGDB
	help
	  Central Regulatory Domain Agent.

	  This package provides a Central Regulatory Domain Agent (CRDA)
	  to be used by the Linux kernel cf80211 wireless subsystem to
	  query and apply the regulatory domain settings wireless devices
	  may operate within for a given location.

	  http://linuxwireless.org/en/developers/Regulatory/CRDA

comment "crda needs a toolchain w/ threads, dynamic library"
	depends on !BR2_TOOLCHAIN_HAS_THREADS || BR2_STATIC_LIBS
```

## package/crudini/Config.in
```kconfig
config BR2_PACKAGE_CRUDINI
	bool "crudini"
	depends on BR2_PACKAGE_PYTHON
	select BR2_PACKAGE_PYTHON_INIPARSE # runtime
	help
	  A utility for handling ini files from the command line and
	  shell scripts

	  https://pypi.python.org/pypi/crudini
```

## package/cryptodev/Config.in
```kconfig
comment "cryptodev needs a Linux kernel to be built"
	depends on !BR2_LINUX_KERNEL

config BR2_PACKAGE_CRYPTODEV
	bool "cryptodev"
	depends on BR2_LINUX_KERNEL
	help
	  Select the desired cryptodev implementation.

if BR2_PACKAGE_CRYPTODEV

choice
	prompt "cryptodev variant"
	default BR2_PACKAGE_CRYPTODEV_LINUX if !BR2_microblaze
	help
	  Select the cryptodev implementation.

config BR2_PACKAGE_CRYPTODEV_LINUX
	bool "cryptodev-linux"
	depends on !BR2_microblaze
	select BR2_PACKAGE_HAS_CRYPTODEV
	help
	  Cryptodev-linux is a device that allows access to Linux kernel
	  cryptographic drivers; thus allowing userspace applications
	  to take advantage of hardware accelerators.

	  http://cryptodev-linux.org/index.html

config BR2_PACKAGE_OCF_LINUX
	bool "ocf-linux"
	select BR2_PACKAGE_HAS_CRYPTODEV
	help
	  OCF-Linux is a Linux port of the OpenBSD/FreeBSD Cryptographic
	  Framework (OCF). This port aims to bring full asynchronous HW/SW
	  crypto acceleration to the Linux kernel and applications
	  running under Linux.

	  http://ocf-linux.sourceforge.net/

endchoice

config BR2_PACKAGE_HAS_CRYPTODEV
	bool

config BR2_PACKAGE_PROVIDES_CRYPTODEV
	string
	default "cryptodev-linux" if BR2_PACKAGE_CRYPTODEV_LINUX
	default "ocf-linux"       if BR2_PACKAGE_OCF_LINUX

endif
```

## package/cryptsetup/Config.in
```kconfig
config BR2_PACKAGE_CRYPTSETUP
	bool "cryptsetup"
	depends on BR2_TOOLCHAIN_HAS_THREADS # lvm2
	depends on BR2_USE_MMU # lvm2, libargon2
	depends on !BR2_STATIC_LIBS # lvm2, libargon2
	depends on BR2_TOOLCHAIN_HAS_SYNC_4 # json-c
	select BR2_PACKAGE_POPT
	select BR2_PACKAGE_LVM2
	select BR2_PACKAGE_UTIL_LINUX
	select BR2_PACKAGE_UTIL_LINUX_LIBUUID
	select BR2_PACKAGE_UTIL_LINUX_LIBBLKID
	select BR2_PACKAGE_JSON_C
	select BR2_PACKAGE_LIBARGON2
	help
	  This tool helps manipulate dm-crypt and luks partitions for
	  on-disk encryption.

	  https://gitlab.com/cryptsetup/cryptsetup

comment "cryptsetup needs a toolchain w/ threads, dynamic library"
	depends on BR2_USE_MMU
	depends on BR2_TOOLCHAIN_HAS_SYNC_4
	depends on BR2_STATIC_LIBS || !BR2_TOOLCHAIN_HAS_THREADS
```

## package/cryptsetup/Config.in.host
```kconfig
config BR2_PACKAGE_HOST_CRYPTSETUP
	bool "host cryptsetup"
	select BR2_PACKAGE_HOST_UTIL_LINUX
	help
	  This tool helps manipulate dm-crypt and luks partitions for
	  on-disk encryption.

	  https://gitlab.com/cryptsetup/cryptsetup
```

## package/ctorrent/Config.in
```kconfig
comment "ctorrent requires a toolchain with C++ support enabled"
	depends on !BR2_INSTALL_LIBSTDCPP

config BR2_PACKAGE_CTORRENT
	bool "ctorrent"
	depends on BR2_INSTALL_LIBSTDCPP
	help
	  CTorrent is a BitTorrent client implemented in C++
	  to be lightweight and quick.
	  http://ctorrent.sourceforge.net/

	  This is the enhanced version from
	  http://www.rahul.net/dholmes/ctorrent/
```

## package/cunit/Config.in
```kconfig
config BR2_PACKAGE_CUNIT
	bool "cunit"
	help
	  An automated testing framework in 'C'.

	  http://cunit.sourceforge.net/
```

## package/cups-filters/Config.in
```kconfig
config BR2_PACKAGE_CUPS_FILTERS
	bool "cups-filters"
	# needs fork()
	depends on BR2_USE_MMU
	depends on BR2_INSTALL_LIBSTDCPP # qpdf
	depends on !BR2_STATIC_LIBS
	depends on BR2_USE_WCHAR # libglib2, qpdf
	depends on BR2_TOOLCHAIN_HAS_THREADS # libglib2
	depends on BR2_PACKAGE_CUPS
	depends on BR2_TOOLCHAIN_GCC_AT_LEAST_4_8 # C++11
	select BR2_PACKAGE_JPEG
	select BR2_PACKAGE_FONTCONFIG
	select BR2_PACKAGE_FREETYPE
	select BR2_PACKAGE_LCMS2
	select BR2_PACKAGE_LIBGLIB2
	select BR2_PACKAGE_QPDF
	help
	  This project provides backends, filters, and other software
	  that was once part of the core CUPS distribution but is no
	  longer maintained by Apple Inc. In addition it contains
	  additional filters and software developed independently of
	  Apple, especially filters for the PDF-centric printing
	  workflow introduced by OpenPrinting and a daemon to browse
	  Bonjour broadcasts of remote CUPS printers to make these
	  printers available locally and to provide backward
	  compatibility to the old CUPS broadcasting and browsing of
	  CUPS 1.5.x and older.  From CUPS 1.6.0 on, this package is
	  required for using printer drivers with CUPS under Linux.
	  With CUPS 1.5.x and earlier this package can be used
	  optionally to switch over to PDF-based printing.

	  http://www.linuxfoundation.org/collaborate/workgroups/openprinting/cups-filters

comment "cups-filters needs a toolchain w/ wchar, C++, threads and dynamic library, gcc >= 4.8"
	depends on BR2_USE_MMU
	depends on !BR2_INSTALL_LIBSTDCPP || !BR2_TOOLCHAIN_HAS_THREADS || \
		!BR2_USE_WCHAR || BR2_STATIC_LIBS || \
		!BR2_TOOLCHAIN_GCC_AT_LEAST_4_8
```

## package/cups/Config.in
```kconfig
config BR2_PACKAGE_CUPS
	bool "cups"
	# needs libstdcpp for ppdc
	depends on BR2_INSTALL_LIBSTDCPP
	# needs threads for ippserver
	depends on BR2_TOOLCHAIN_HAS_THREADS
	# needs fork()
	depends on BR2_USE_MMU
	help
	  The Common Unix Printing System

	  http://www.cups.org

comment "cups needs a toolchain w/ C++, threads"
	depends on !BR2_INSTALL_LIBSTDCPP || !BR2_TOOLCHAIN_HAS_THREADS
```

## package/curl/Config.in
```kconfig
config BR2_PACKAGE_CURL
	bool "curl"
	default n
	help
	  cURL is a tool for getting files from FTP, HTTP, Gopher, Telnet,
	  and Dict servers, using any of the supported protocols.

	  http://curl.haxx.nu/

config BR2_PACKAGE_LIBCURL
	bool "libcurl"
	default n
	help
	  cURL is a tool for getting files from FTP, HTTP, Gopher, Telnet,
	  and Dict servers, using any of the supported protocols.

	  http://curl.haxx.nu/
```

## package/curlftpfs/Config.in
```kconfig
config BR2_PACKAGE_CURLFTPFS
	bool "curlftpfs (FUSE)"
	depends on BR2_USE_WCHAR # glib2
	depends on BR2_TOOLCHAIN_HAS_THREADS # libfuse, glib2
	depends on BR2_USE_MMU # libfuse, glib2
	depends on !BR2_STATIC_LIBS # libfuse
	select BR2_PACKAGE_LIBFUSE
	select BR2_PACKAGE_LIBGLIB2
	select BR2_PACKAGE_GETTEXT if BR2_NEEDS_GETTEXT_IF_LOCALE
	select BR2_PACKAGE_LIBICONV if !BR2_ENABLE_LOCALE
	select BR2_PACKAGE_OPENSSL
	select BR2_PACKAGE_LIBCURL
	help
	  CurlFtpFS is a filesystem for accessing FTP hosts based on
	  FUSE and libcurl.

	  http://curlftpfs.sourceforge.net/

comment "curlftpfs needs a toolchain w/ wchar, threads, dynamic library"
	depends on BR2_USE_MMU
	depends on !BR2_USE_WCHAR || !BR2_TOOLCHAIN_HAS_THREADS || BR2_STATIC_LIBS
```

## package/curlpp/Config.in
```kconfig
config BR2_PACKAGE_CURLPP
	bool "curlpp"
	depends on BR2_INSTALL_LIBSTDCPP
	depends on !BR2_STATIC_LIBS
	select BR2_PACKAGE_LIBCURL
	help
	  cURLpp is a C++ wrapper for libcURL.

	  http://www.curlpp.org/

comment "curlpp needs a toolchain w/ C++, dynamic library"
	depends on !BR2_INSTALL_LIBSTDCPP || BR2_STATIC_LIBS
```
