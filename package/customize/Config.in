## package/customize/Config.in
```kconfig
config BR2_PACKAGE_CUSTOMIZE
	bool "customize"
	depends on BR2_DEPRECATED
	help
	  Add custom stuff to your buildroot.

	  (edit package/customize/customize.mk)
```

## package/cutelyst/Config.in
```kconfig
config BR2_PACKAGE_CUTELYST
	bool "cutelyst"
	depends on BR2_PACKAGE_QT5
	depends on BR2_INSTALL_LIBSTDCPP
	depends on BR2_TOOLCHAIN_GCC_AT_LEAST_4_8 # C++11
	depends on BR2_TOOLCHAIN_HEADERS_AT_LEAST_3_3
	select BR2_PACKAGE_QT5BASE_GUI
	help
	  A C++ Web Framework built on top of Qt, using
	  the simple approach of Catalyst (Perl) framework.

	  https://cutelyst.org

comment "cutelyst needs a toolchain w/ C++, gcc >= 4.8, headers >= 3.3"
	depends on BR2_PACKAGE_QT5
	depends on !BR2_INSTALL_LIBSTDCPP || !BR2_TOOLCHAIN_GCC_AT_LEAST_4_8
	depends on !BR2_TOOLCHAIN_HEADERS_AT_LEAST_3_3
```

## package/cvs/Config.in
```kconfig
config BR2_PACKAGE_CVS
	bool "cvs"
	depends on BR2_USE_WCHAR
	# needs fork()
	depends on BR2_USE_MMU
	select BR2_PACKAGE_NCURSES
	help
	  Concurrent Versions System - source code revision control
	  tools.

	  http://www.nongnu.org/cvs/

if BR2_PACKAGE_CVS

config BR2_PACKAGE_CVS_SERVER
	bool "server support"
	help
	  Enable cvs server code

endif

comment "cvs needs a toolchain w/ wchar"
	depends on BR2_USE_MMU
	depends on !BR2_USE_WCHAR
```

## package/cwiid/Config.in
```kconfig
config BR2_PACKAGE_CWIID
	bool "cwiid"
	depends on !BR2_STATIC_LIBS # bluez5_utils
	depends on BR2_USE_WCHAR # bluez5_utils -> libglib2
	depends on BR2_TOOLCHAIN_HAS_THREADS # bluez5_utils -> dbus, alsa-lib, libglib2
	depends on BR2_USE_MMU # bluez5_utils -> dbus, libglib2
	depends on BR2_TOOLCHAIN_HEADERS_AT_LEAST_3_4 # bluez5_utils
	depends on BR2_TOOLCHAIN_HAS_SYNC_4 # bluez5_utils
	select BR2_PACKAGE_BLUEZ5_UTILS
	help
	  A collection of Linux tools written in C for interfacing to
	  the Nintendo Wiimote.

	  http://abstrakraft.org/cwiid/

if BR2_PACKAGE_CWIID
config BR2_PACKAGE_CWIID_WMGUI
	bool "wmgui"
	depends on BR2_TOOLCHAIN_HAS_SYNC_4 # libgtk2 -> pango -> harfbuzz
	depends on BR2_TOOLCHAIN_GCC_AT_LEAST_4_8 # libgtk2 -> pango -> harfbuzz
	depends on BR2_PACKAGE_XORG7 # libgtk2
	depends on BR2_USE_WCHAR # libgtk2 -> libglib2
	depends on BR2_TOOLCHAIN_HAS_THREADS # libgtk2 -> libglib2
	depends on BR2_USE_MMU # libgtk2 -> libglib2
	depends on BR2_INSTALL_LIBSTDCPP # libgtk2 -> pango
	select BR2_PACKAGE_LIBGLIB2
	select BR2_PACKAGE_LIBGTK2
endif

comment "cwiid needs a toolchain w/ dynamic lib, threads, wchar, headers >= 3.4"
	depends on BR2_TOOLCHAIN_HAS_SYNC_4
	depends on BR2_STATIC_LIBS || !BR2_USE_WCHAR || \
		!BR2_TOOLCHAIN_HAS_THREADS || \
		!BR2_TOOLCHAIN_HEADERS_AT_LEAST_3_4
	depends on !BR2_USE_MMU
```

## package/cxxtest/Config.in
```kconfig
config BR2_PACKAGE_CXXTEST
	bool "cxxtest"
	depends on BR2_INSTALL_LIBSTDCPP
	help
	  CxxTest is a unit testing framework for C++

	  http://cxxtest.com/

comment "cxxtest needs a toolchain w/ C++ support"
	depends on !BR2_INSTALL_LIBSTDCPP
```

## package/czmq/Config.in
```kconfig
config BR2_PACKAGE_CZMQ
	bool "czmq"
	depends on BR2_USE_MMU # fork()
	depends on BR2_INSTALL_LIBSTDCPP # zeromq
	depends on BR2_TOOLCHAIN_HAS_THREADS # zeromq
	select BR2_PACKAGE_ZEROMQ
	help
	  High-level C Binding for 0MQ

	  http://czmq.zeromq.org/

comment "czmq needs a toolchain w/ C++, threads"
	depends on BR2_USE_MMU
	depends on !(BR2_INSTALL_LIBSTDCPP && BR2_TOOLCHAIN_HAS_THREADS)
```

## package/dacapo/Config.in
```kconfig
config BR2_PACKAGE_DACAPO
	bool "dacapo"
	depends on BR2_PACKAGE_OPENJDK
	help
	  The DaCapo benchmark suite is intended as a tool for Java
	  benchmarking by the programming language, memory
	  management and computer architecture communities.

	  http://dacapobench.org/

comment "dacapo needs OpenJDK"
	depends on !BR2_PACKAGE_OPENJDK
```

## package/dado/Config.in
```kconfig
config BR2_PACKAGE_DADO
	bool "dado"
	help
	  Database Facilities for LuaSQL.

	  http://www.ccpa.puc-rio.br/software/dado/
```

## package/daemon/Config.in
```kconfig
config BR2_PACKAGE_DAEMON
	bool "daemon"
	depends on BR2_USE_MMU # fork()
	depends on BR2_TOOLCHAIN_HAS_THREADS
	help
	  Daemon turns other process into daemons.

	  http://www.libslack.org/daemon/

comment "daemon needs a toolchain w/ threads"
	depends on BR2_USE_MMU
	depends on !BR2_TOOLCHAIN_HAS_THREADS
```

## package/dahdi-linux/Config.in
```kconfig
config BR2_PACKAGE_DAHDI_LINUX
	bool "dhadi-linux"
	depends on BR2_LINUX_KERNEL
	help
	  DAHDI (Digium/Asterisk Hardware Device Interface) is the open
	  source device interface technology used to control Digium and
	  other legacy telephony interface cards.

	  DAHDI Linux is the open source device driver framework used to
	  interface Asterisk with telephony hardware.

	  http://www.asterisk.org/downloads/dahdi

	  Note: DAHDI Linux drivers won't build on a kernel v4.0 or more
	  recent, because they use internals that have been removed in
	  v4.0.

comment "dahdi-linux needs a Linux kernel to be built"
	depends on !BR2_LINUX_KERNEL
```

## package/dahdi-tools/Config.in
```kconfig
config BR2_PACKAGE_DAHDI_TOOLS
	bool "dahdi-tools"
	depends on BR2_TOOLCHAIN_HAS_THREADS
	depends on BR2_LINUX_KERNEL # dahdi-linux
	depends on BR2_USE_MMU # perl
	select BR2_PACKAGE_DAHDI_LINUX
	select BR2_PACKAGE_PERL
	help
	  DAHDI (Digium/Asterisk Hardware Device Interface) is the open
	  source device interface technology used to control Digium and
	  other legacy telephony interface cards.

	  DAHDI Tools is a package of utilities for managing and
	  monitoring DAHDI devices.

	  http://www.asterisk.org/downloads/dahdi

# Two comments, otherwise it may not fit in menuconfig for narrow terminals
comment "dahdi-tools needs a toolchain w/ threads"
	depends on !BR2_TOOLCHAIN_HAS_THREADS || !BR2_LINUX_KERNEL

comment "dahdi-tools needs a Linux kernel to be built"
	depends on !BR2_LINUX_KERNEL
```

## package/dante/Config.in
```kconfig
config BR2_PACKAGE_DANTE
	bool "dante"
	depends on BR2_USE_MMU # fork()
	help
	  Dante is a product developed by Inferno Nettverk A/S. It
	  consists of a SOCKS server and a SOCKS client, implementing
	  RFC 1928 and related standards. It is a flexible product
	  that can be used to provide convenient and secure network
	  connectivity.

	  http://www.inet.no/dante/
```

## package/daq/Config.in
```kconfig
config BR2_PACKAGE_DAQ
	bool "daq"
	depends on !BR2_STATIC_LIBS # dlfcn.h
	help
	  DAQ is a Data Acquisition library for packet I/O from the
	  Snort project.

	  https://www.snort.org

comment "daq needs a toolchain w/ dynamic library"
	depends on BR2_STATIC_LIBS
```

## package/darkhttpd/Config.in
```kconfig
config BR2_PACKAGE_DARKHTTPD
	bool "darkhttpd"
	depends on BR2_USE_MMU # fork()
	help
	  Darkhttpd is a simple, fast HTTP 1.1 web server which only
	  serves static content. It does not support PHP or CGI.

	  The behavior of darkhttpd can be altered by setting some
	  variables in /etc/default/darkhttpd:

	  - DARKHTTPD_ROOT: path to the server document root.
	  - DARKHTTPD_FLAGS: options to pass to darkhttpd.

	  https://unix4lyfe.org/darkhttpd/
```

## package/dash/Config.in
```kconfig
config BR2_PACKAGE_DASH
	bool "dash"
	depends on BR2_USE_MMU # fork()
	depends on BR2_PACKAGE_BUSYBOX_SHOW_OTHERS
	help
	  DASH is a POSIX-compliant implementation of /bin/sh that
	  aims to be as small as possible. It does this without
	  sacrificing speed where possible. In fact, it is
	  significantly faster than bash (the GNU Bourne-Again SHell)
	  for most tasks.

	  http://gondor.apana.org.au/~herbert/dash
```

## package/database/Config.in
```kconfig
menu "Database"
source "package/database/mysql_client/Config.in"
source "package/database/sqlite/Config.in"
endmenu
```

## package/database/sqlite/Config.in
```kconfig
config BR2_PACKAGE_SQLITE
	bool "sqlite"
	help
	  SQLite is a small C library that implements a self-contained,
	  embeddable, zero-configuration SQL database engine.

	  http://www.sqlite.org/

config BR2_PACKAGE_SQLITE_READLINE
	bool "Command-line editing"
	depends on BR2_PACKAGE_SQLITE
	select BR2_PACKAGE_NCURSES
	select BR2_PACKAGE_READLINE
	help
	  Enable command-line editing. This requires ncurses and readline.
```

## package/dav1d/Config.in
```kconfig
config BR2_PACKAGE_DAV1D
	bool "dav1d"
	depends on !BR2_STATIC_LIBS # dlfcn.h
	depends on BR2_TOOLCHAIN_HAS_THREADS # pthread
	help
	  dav1d is a new AV1 cross-platform decoder, open-source, and
	  focused on speed and correctness.

	  https://code.videolan.org/videolan/dav1d

comment "dav1d needs a toolchain w/ threads, dynamic library"
	depends on !BR2_TOOLCHAIN_HAS_THREADS || BR2_STATIC_LIBS
```

## package/davfs2/Config.in
```kconfig
comment "davfs2 needs a glibc or uClibc toolchain"
	depends on BR2_USE_MMU
	depends on BR2_TOOLCHAIN_USES_MUSL

config BR2_PACKAGE_DAVFS2
	bool "davfs2"
	depends on !BR2_TOOLCHAIN_USES_MUSL # error.h
	depends on BR2_USE_MMU # fork()
	select BR2_PACKAGE_NEON
	select BR2_PACKAGE_NEON_XML
	help
	  davfs2 is a Linux file system driver that allows to
	  mount a WebDAV resource. WebDAV is an extension to HTTP/1.1
	  that allows remote collaborative authoring of Web resources.
	  To use davfs2 via /etc/fstab, FEATURE_MOUNT_HELPERS
	  must be selected in busybox configuration.

	  http://savannah.nongnu.org/projects/davfs2
```

## package/davici/Config.in
```kconfig
comment "davici needs a toolchain w/ threads, dynamic library"
	depends on BR2_USE_MMU
	depends on BR2_TOOLCHAIN_HAS_ATOMIC
	depends on !BR2_TOOLCHAIN_HAS_THREADS || BR2_STATIC_LIBS

config BR2_PACKAGE_DAVICI
	bool "davici"
	depends on BR2_USE_MMU # fork()
	depends on BR2_TOOLCHAIN_HAS_THREADS
	depends on BR2_TOOLCHAIN_HAS_ATOMIC
	depends on !BR2_STATIC_LIBS
	select BR2_PACKAGE_STRONGSWAN
	help
	  davici is an alternative implementation of the VICI
	  client protocol, targeting better integration in other
	  software stacks.

	  https://github.com/strongswan/davici
```

## package/dawgdic/Config.in
```kconfig
config BR2_PACKAGE_DAWGDIC
	bool "dawgdic"
	depends on BR2_INSTALL_LIBSTDCPP
	# needs std::strtoll
	depends on BR2_TOOLCHAIN_GCC_AT_LEAST_4_6
	help
	  dawgdic provides a library for building and accessing
	  dictionaries implemented with directed acyclic word graphs
	  (DAWG). A dawg is constructed by minimizing a trie as a
	  deterministic finite automaton (DFA), and thus the dawg has
	  an advantage in memory usage. In addition, dawgdic uses a
	  double-array as a base data structure, so its retrieval
	  speed is as fast as that of Darts, a library for building
	  and accessing double-array tries.

	  https://github.com/stil/dawgdic

comment "dawgdic needs a toolchain w/ C++, gcc >= 4.6"
	depends on !BR2_INSTALL_LIBSTDCPP || !BR2_TOOLCHAIN_GCC_AT_LEAST_4_6
```

## package/dbus-cpp/Config.in
```kconfig
config BR2_PACKAGE_DBUS_CPP
	bool "dbus-c++"
	depends on BR2_PACKAGE_DBUS
	depends on BR2_TOOLCHAIN_HAS_THREADS # dbus
	depends on BR2_USE_MMU # dbus
	depends on BR2_INSTALL_LIBSTDCPP
	select BR2_PACKAGE_EXPAT
	help
	  dbus-c++ attempts to provide a C++ API for D-BUS.
	  The library has a glib/gtk and an Ecore mainloop integration.
	  It also offers an optional own main loop.

	  http://sourceforge.net/projects/dbus-cplusplus/

comment "dbus-c++ needs a toolchain w/ C++, threads"
	depends on BR2_USE_MMU
	depends on BR2_PACKAGE_DBUS
	depends on !BR2_INSTALL_LIBSTDCPP || !BR2_TOOLCHAIN_HAS_THREADS
```

## package/dbus-glib/Config.in
```kconfig
config BR2_PACKAGE_DBUS_GLIB
	bool "dbus-glib"
	depends on BR2_PACKAGE_DBUS
	depends on BR2_USE_WCHAR # glib2
	depends on BR2_TOOLCHAIN_HAS_THREADS # glib2
	depends on BR2_USE_MMU # glib2
	select BR2_PACKAGE_LIBGLIB2
	help
	  GLib bindings for D-Bus.

	  http://www.freedesktop.org/software/dbus

comment "dbus-glib needs a toolchain w/ wchar, threads"
	depends on BR2_USE_MMU
	depends on BR2_PACKAGE_DBUS
	depends on !BR2_USE_WCHAR || !BR2_TOOLCHAIN_HAS_THREADS
```

## package/dbus-python/Config.in
```kconfig
config BR2_PACKAGE_DBUS_PYTHON
	bool "dbus-python"
	depends on BR2_USE_WCHAR # glib2
	depends on BR2_TOOLCHAIN_HAS_THREADS # glib2
	depends on BR2_PACKAGE_DBUS
	depends on BR2_PACKAGE_PYTHON
	select BR2_PACKAGE_DBUS_GLIB
	# pyexpat: runtime dependency only
	select BR2_PACKAGE_PYTHON_PYEXPAT
	help
	  Python bindings for D-Bus

	  http://dbus.freedesktop.org/doc/dbus-python/

comment "dbus-python needs a toolchain w/ wchar, threads"
	depends on BR2_PACKAGE_DBUS && BR2_PACKAGE_PYTHON
	depends on !BR2_USE_WCHAR || !BR2_TOOLCHAIN_HAS_THREADS
```
