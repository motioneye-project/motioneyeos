## package/dbus-python/Config.in.host
```kconfig
config BR2_PACKAGE_HOST_DBUS_PYTHON
	bool "host dbus-python"
	help
	  Python bindings for D-Bus

	  http://dbus.freedesktop.org/doc/dbus-python/
```

## package/dbus-triggerd/Config.in
```kconfig
config BR2_PACKAGE_DBUS_TRIGGERD
	bool "dbus-triggerd"
	depends on BR2_USE_MMU # fork(), dbus
	depends on BR2_TOOLCHAIN_HAS_THREADS # dbus
	depends on BR2_PACKAGE_DBUS
	help
	  dbus-triggerd is a tool to trigger shell-commands upon
	  receiving a given dbus-signal.

	  http://gareus.org/oss/dbustriggerd/start

comment "dbus-triggerd needs a toolchain w/ threads"
	depends on BR2_USE_MMU
	depends on BR2_PACKAGE_DBUS
	depends on !BR2_TOOLCHAIN_HAS_THREADS
```

## package/dbus/Config.in
```kconfig
config BR2_PACKAGE_DBUS
	bool "dbus"
	depends on BR2_TOOLCHAIN_HAS_THREADS
	# uses fork()
	depends on BR2_USE_MMU
	help
	  The D-Bus message bus system.

	  http://www.freedesktop.org/wiki/Software/dbus

if BR2_PACKAGE_DBUS

choice
	prompt "XML library to use"
	default BR2_DBUS_EXPAT
	help
	  Select the XML library to use with D-Bus. Select Expat
	  unless you have specific reasons for using libxml2 as
	  Expat is significant smaller.

	config BR2_DBUS_EXPAT
		bool "Expat"
		select BR2_PACKAGE_EXPAT

	config BR2_DBUS_LIBXML2
		bool "libxml2"
		select BR2_PACKAGE_LIBXML2

endchoice

endif

comment "dbus needs a toolchain w/ threads"
	depends on BR2_USE_MMU
	depends on !BR2_TOOLCHAIN_HAS_THREADS
```

## package/dc3dd/Config.in
```kconfig
config BR2_PACKAGE_DC3DD
	bool "dc3dd"
	depends on BR2_TOOLCHAIN_HAS_THREADS
	depends on !BR2_TOOLCHAIN_USES_MUSL
	help
	  dc3dd is a patch to the GNU dd program, this version has
	  several features intended for forensic acquisition of data.
	  Highlights include hashing on-the-fly, split output files,
	  pattern writing, a progress meter, and file verification.

	  https://sourceforge.net/projects/dc3dd/

comment "dc3dd needs a glibc or uClibc toolchain w/ threads"
	depends on !BR2_TOOLCHAIN_HAS_THREADS || \
		BR2_TOOLCHAIN_USES_MUSL
```

## package/dcron/Config.in
```kconfig
config BR2_PACKAGE_DCRON
	bool "dcron"
	depends on BR2_USE_MMU # fork()
	help
	  dcron is a time-based job scheduler with anacron-like
	  features. It works as a background daemon that parses
	  individual crontab files and executes commands on behalf of
	  the users in question.

	  Upon installation, this package will enable a system level
	  cron daemon with hourly, daily, weekly and monthly crontabs.

	  However, it doesn't allow non root users to create their own
	  crontab file. This is because /var/spool/cron/crontabs is
	  non user writable.

	  Typically, a crontab group is created on the system and
	  users allowed to create crontab entries are added into this
	  group, while crontab executable is owned by root:crontab
	  with sgid bit enabled.

	  http://www.jimpryor.net/linux/dcron.html
```

## package/ddrescue/Config.in
```kconfig
config BR2_PACKAGE_DDRESCUE
	bool "ddrescue"
	depends on BR2_INSTALL_LIBSTDCPP
	help
	  GNU ddrescue is a data recovery tool. It copies data from one
	  file or block device (hard disc, cdrom, etc) to another,
	  trying to rescue the good parts first in case of read errors.

	  http://www.gnu.org/software/ddrescue/ddrescue.html

comment "ddrescue needs a toolchain w/ C++"
	depends on !BR2_INSTALL_LIBSTDCPP
```

## package/debianutils/Config.in
```kconfig
config BR2_PACKAGE_DEBIANUTILS
	bool "debianutils"
	depends on BR2_USE_MMU # fork()
	help
	  Miscellaneous utilities specific to Debian.

	  The specific utilities included are: add-shell installkernel
	  ischroot remove-shell run-parts savelog tempfile which.

	  https://tracker.debian.org/pkg/debianutils
```

## package/dehydrated/Config.in
```kconfig
config BR2_PACKAGE_DEHYDRATED
	bool "dehydrated"
	depends on BR2_USE_MMU # bash
	select BR2_PACKAGE_BASH
	select BR2_PACKAGE_BUSYBOX_SHOW_OTHERS # bash
	select BR2_PACKAGE_LIBCURL
	select BR2_PACKAGE_CURL
	select BR2_PACKAGE_OPENSSL
	select BR2_PACKAGE_LIBOPENSSL_BIN if BR2_PACKAGE_LIBOPENSSL
	select BR2_PACKAGE_LIBRESSL_BIN if BR2_PACKAGE_LIBRESSL
	help
	  Dehydrated is a client for signing certificates with an
	  ACME-server (e.g. Let's Encrypt) implemented as a relatively
	  simple (zsh-compatible) bash-script. This client supports
	  both ACME v1 and the new ACME v2 including support for
	  wildcard certificates!

	  To use this script in Buildroot:
	    - Create /etc/dehydrated/domains.txt
	    - Make sure that "dehydrated -c" is called regularly, e.g.
	      from cron.
	    - Make sure /etc/dehydrated is writable.
	    - Configure the webserver to export the WELLKNOWN directory
	      (/var/www/dehydrated) as /.well-known/acme-challenge
	    - Configure the webserver to use the certificates under
	      /etc/dehydrated/certs/<domain>
	    - Register a HOOK to reload the webserver after the
	      certificates have been renewed.

	  You probably need to install a custom /etc/dehydrated/config
	  with the rootfs overlay.

	  https://github.com/lukas2511/dehydrated
```

## package/devmem2/Config.in
```kconfig
config BR2_PACKAGE_DEVMEM2
	bool "devmem2"
	depends on BR2_PACKAGE_BUSYBOX_SHOW_OTHERS
	help
	  Simple program to read/write from/to any location in memory.

	  http://free-electrons.com/pub/mirror/devmem2.c
```

## package/dfu-util/Config.in
```kconfig
config BR2_PACKAGE_DFU_UTIL
	bool "dfu-util"
	select BR2_PACKAGE_LIBUSB
	depends on BR2_TOOLCHAIN_HAS_THREADS
	help
	  Dfu-util is the host side implementation of the DFU 1.0
	  specification of the USB forum. DFU is intended to download
	  and upload firmware to devices connected over USB.

	  http://dfu-util.sourceforge.net/

comment "dfu-util needs a toolchain w/ threads"
	depends on !BR2_TOOLCHAIN_HAS_THREADS
```

## package/dfu-util/Config.in.host
```kconfig
config BR2_PACKAGE_HOST_DFU_UTIL
	bool "host dfu-util"
	help
	  Dfu-util is the host side implementation of the DFU 1.0
	  specification of the USB forum. DFU is intended to download
	  and upload firmware to devices connected over USB.

	  http://dfu-util.sourceforge.net/
```

## package/dhcp/Config.in
```kconfig
config BR2_PACKAGE_DHCP
	bool "dhcp (ISC)"
	# fork()
	depends on BR2_USE_MMU
	depends on BR2_PACKAGE_BUSYBOX_SHOW_OTHERS
	select BR2_PACKAGE_BIND
	help
	  DHCP relay agent from the ISC DHCP distribution.

	  https://www.isc.org/downloads/dhcp/

if BR2_PACKAGE_DHCP

config BR2_PACKAGE_DHCP_SERVER
	bool "dhcp server"
	select BR2_PACKAGE_SYSTEMD_TMPFILES if BR2_PACKAGE_SYSTEMD
	help
	  DHCP server from the ISC DHCP distribution.

	  This also installs omshell, an interactive tool to connect to,
	  query, and possibly change, the server's state via the Object
	  Management API (OMAPI).

config BR2_PACKAGE_DHCP_SERVER_DELAYED_ACK
	bool "Enable delayed ACK feature"
	depends on BR2_PACKAGE_DHCP_SERVER
	help
	  Enable delayed ACK feature in the ISC DHCP server.

config BR2_PACKAGE_DHCP_RELAY
	bool "dhcp relay"
	help
	  DHCP relay agent from the ISC DHCP distribution.

config BR2_PACKAGE_DHCP_CLIENT
	bool "dhcp client"
	help
	  DHCP client from the ISC DHCP distribution.

endif
```

## package/dhcp_relay/Config.in
```kconfig
config BR2_PACKAGE_DHCP_RELAY
	bool "dhcp_relay"
	default n
	help
	  DHCP relay agent from the ISC DHCP distribution.

	  http://www.isc.org/products/DHCP
```

## package/dhcpcd/Config.in
```kconfig
comment "dhcpcd needs a toolchain w/ headers >= 3.1"
	depends on !BR2_TOOLCHAIN_HEADERS_AT_LEAST_3_1

config BR2_PACKAGE_DHCPCD
	bool "dhcpcd"
	depends on BR2_TOOLCHAIN_HEADERS_AT_LEAST_3_1 # sa_family_t in linux/socket.h
	help
	  An RFC2131 compliant DHCP client

	  http://roy.marples.name/projects/dhcpcd/
```

## package/dhcpdump/Config.in
```kconfig
config BR2_PACKAGE_DHCPDUMP
	bool "dhcpdump"
	select BR2_PACKAGE_LIBPCAP
	help
	  A tool for monitoring dhcp requests using tcpdump.
```

## package/dhrystone/Config.in
```kconfig
config BR2_PACKAGE_DHRYSTONE
	bool "dhrystone"
	help
	  easy-to-use integer benchmark

	  http://www.netlib.org/benchmark/dhry-c
```

## package/dialog/Config.in
```kconfig
config BR2_PACKAGE_DIALOG
	bool "dialog"
	select BR2_PACKAGE_NCURSES
	select BR2_PACKAGE_LIBICONV if !BR2_ENABLE_LOCALE
	help
	  dialog - display dialog boxes from shell scripts

	  This application provides a method of displaying several different
	  types of dialog boxes from shell scripts.  This allows a developer
	  of a script to interact with the user in a much friendlier manner.
```

## package/dieharder/Config.in
```kconfig
config BR2_PACKAGE_DIEHARDER
	bool "dieharder"
	select BR2_PACKAGE_GSL
	help
	  dieharder is a fairly involved random number/uniform deviate
	  generator tester. It is thus suitable for use in testing
	  both software RNG's and hardware RNG's.

	  http://www.phy.duke.edu/~rgb/General/dieharder.php
```

## package/diffutils/Config.in
```kconfig
config BR2_PACKAGE_DIFFUTILS
	bool "diffutils"
	depends on BR2_USE_WCHAR
	depends on BR2_PACKAGE_BUSYBOX_SHOW_OTHERS
	help
	  GNU diff. Compare files per line.

	  http://www.gnu.org/software/diffutils/diffutils.html

comment "diffutils needs a toolchain w/ wchar"
	depends on !BR2_USE_WCHAR
	depends on BR2_PACKAGE_BUSYBOX_SHOW_OTHERS
```

## package/dillo/Config.in
```kconfig
config BR2_PACKAGE_DILLO
	bool "dillo"
	depends on BR2_PACKAGE_XORG7
	depends on BR2_INSTALL_LIBSTDCPP
	depends on BR2_USE_MMU # fltk fork()
	select BR2_PACKAGE_FLTK
	select BR2_PACKAGE_LIBICONV if !BR2_ENABLE_LOCALE
	select BR2_PACKAGE_ZLIB
	help
	  Dillo is a multi-platform graphical web browser known
	  for its speed and small footprint.

	  Enable openssl package to gain https support.

	  http://www.dillo.org

comment "dillo needs a toolchain w/ C++"
	depends on BR2_PACKAGE_XORG7 && BR2_USE_MMU
	depends on !BR2_INSTALL_LIBSTDCPP
```

## package/ding-libs/Config.in
```kconfig
config BR2_PACKAGE_DING_LIBS
	bool "ding-libs"
	select BR2_PACKAGE_LIBICONV if !BR2_ENABLE_LOCALE
	help
	  The ding-libs packages contain a set of libraries used by
	  the System Security Services Daemon (SSSD) and other
	  projects and provide functions to manipulate filesystem
	  pathnames (libpath_utils), a hash table to manage storage
	  and access time properties (libdhash), a data type to
	  collect data in a hierarchical structure (libcollection), a
	  dynamically growing, reference-counted array (libref_array),
	  and a library to process configuration files in
	  initialization format (INI) into a library collection data
	  structure (libini_config).

	  https://pagure.io/SSSD/ding-libs
```

## package/directfb-examples/Config.in
```kconfig
config BR2_PACKAGE_DIRECTFB_EXAMPLES
	bool "directfb examples"
	depends on BR2_PACKAGE_DIRECTFB
	help
	  The DirectFB-examples package contains a set of simple DirectFB
	  applications that can be used to test and demonstrate various
	  DirectFB features.

	  http://directfb.org/downloads/Extras/README.DirectFB-examples
```

## package/directfb/Config.in
```kconfig
config BR2_PACKAGE_DIRECTFB
	bool "directfb"
	depends on BR2_TOOLCHAIN_HAS_THREADS
	depends on BR2_INSTALL_LIBSTDCPP
	select BR2_PACKAGE_FREETYPE
	select BR2_PACKAGE_ZLIB
	help
	  http://www.directfb.org/

if BR2_PACKAGE_DIRECTFB

config BR2_PACKAGE_DIRECTFB_MULTI
	bool "directfb multi application"
	select BR2_PACKAGE_LINUX_FUSION
	depends on BR2_USE_MMU # madvise()
	depends on BR2_LINUX_KERNEL
	help
	  Enable use of multiple concurrent DirectFB applications

comment "directfb multi application needs a Linux kernel to be built"
	depends on !BR2_LINUX_KERNEL

config BR2_PACKAGE_DIRECTFB_DEBUG_SUPPORT
	bool "directfb debugging support"
	default y
	help
	  Compile DirectFB with debugging support. It provides
	  functions to print debug information, for DirectFB as well as
	  external DirectFB drivers.

	  When disabled, DirectFB does not print any debug information.
	  The drivers will be installed to and loaded from
	  /usr/lib/directfb-<version>-pure instead of
	  /usr/lib/directfb-<version>.

config BR2_PACKAGE_DIRECTFB_DEBUG
	bool "directfb debugging"
	depends on BR2_PACKAGE_DIRECTFB_DEBUG_SUPPORT
	help
	  Compile DirectFB with lots of debug output

config BR2_PACKAGE_DIRECTFB_TRACE
	bool "directfb call trace support"
	help
	  Enable call tracing for DirectFB applications

config BR2_PACKAGE_DIRECTFB_XSERVER
	bool "build with X server backend"
	depends on BR2_PACKAGE_XORG7

config BR2_PACKAGE_DIRECTFB_UNIQUE
	bool "enable unique window manager"
	depends on BR2_UNIMPLEMENTED

config BR2_PACKAGE_DIRECTFB_ATI128
	bool "compile ati128 graphics driver"
	depends on BR2_i386 || BR2_x86_64

config BR2_PACKAGE_DIRECTFB_CLE266
	bool "compile cle266 graphics driver"
	default y
	depends on BR2_i386 || BR2_x86_64

config BR2_PACKAGE_DIRECTFB_MATROX
	bool "compile matrox graphics driver"
	depends on BR2_i386 || BR2_x86_64

config BR2_PACKAGE_DIRECTFB_PXA3XX
	bool "compile pxa3xx graphics driver"
	depends on BR2_arm
	help
	  The Marvell PXA3xx Processor Family is a system-on-chip based
	  on XScale® microarchitecture. This option enables the graphic
	  driver support for the PXA3xx processor family.

	  http://www.marvell.com/application-processors/pxa-family/

config BR2_PACKAGE_DIRECTFB_EP9X
	bool "compile ep9x graphics driver"
	depends on BR2_arm
	help
	  Enable the graphic driver support for the EP93xx ARMv9 based
	  processors from Cirrus Logic.

	  http://cirrus.com/en/products/arm9.html

config BR2_PACKAGE_DIRECTFB_UNICHROME
	bool "compile unichrome graphics driver"
	default y
	depends on BR2_i386 || BR2_x86_64

config BR2_PACKAGE_DIRECTFB_I830
	bool "compile i830 graphics driver"
	depends on BR2_i386 || BR2_x86_64

config BR2_PACKAGE_DIRECTFB_LINUXINPUT
	bool "compile /dev/input/eventX input driver"
	default y

config BR2_PACKAGE_DIRECTFB_KEYBOARD
	bool "compile keyboard input driver"
	default y

config BR2_PACKAGE_DIRECTFB_PS2MOUSE
	bool "compile PS2 mouse input driver"
	default y

config BR2_PACKAGE_DIRECTFB_SERIALMOUSE
	bool "compile serial mouse input driver"
	default y

config BR2_PACKAGE_DIRECTFB_TSLIB
	bool "enable touchscreen support"
	depends on !BR2_STATIC_LIBS # tslib
	default y
	select BR2_PACKAGE_TSLIB

comment "touchscreen support needs a toolchain w/ dynamic library"
	depends on BR2_STATIC_LIBS

config BR2_PACKAGE_DIRECTFB_GIF
	bool "enable GIF support"
	default y

config BR2_PACKAGE_DIRECTFB_IMLIB2
	bool "enable IMLIB2 support"
	select BR2_PACKAGE_IMLIB2
	depends on !BR2_STATIC_LIBS

comment "imlib2 support needs a toolchain w/ dynamic library"
	depends on BR2_STATIC_LIBS

config BR2_PACKAGE_DIRECTFB_JPEG
	bool "enable JPEG support"
	default y
	select BR2_PACKAGE_JPEG

config BR2_PACKAGE_DIRECTFB_PNG
	bool "enable PNG support"
	default y
	select BR2_PACKAGE_LIBPNG

config BR2_PACKAGE_DIRECTFB_SVG
	bool "enable SVG support"
	depends on BR2_ARCH_HAS_ATOMICS # cairo
	default y
	select BR2_PACKAGE_LIBSVG_CAIRO

config BR2_PACKAGE_DIRECTFB_DITHER_RGB16
	bool "enable advanced dithering of RGB16 surfaces"
	help
	  Enable dithering when loading images to RGB16 surfaces.
	  This increases the data section by 64 KBytes.

config BR2_PACKAGE_DIRECTFB_TESTS
	bool "build directfb tests"

endif # BR2_PACKAGE_DIRECTFB

comment "directfb needs a toolchain w/ C++, threads"
	depends on !BR2_TOOLCHAIN_HAS_THREADS || !BR2_INSTALL_LIBSTDCPP
```

## package/distcc/Config.in
```kconfig
config BR2_PACKAGE_DISTCC
	bool "distcc"
	# needs fork()
	depends on BR2_USE_MMU
	depends on BR2_DEPRECATED_SINCE_2014_02
	help
	  Distributed compiler client and server.  Allows you to
	  distribute compilation of C code across several machines
	  on a network.

	  http://distcc.samba.org/
```

## package/divine/Config.in
```kconfig
config BR2_PACKAGE_DIVINE
	bool "directfb virtual input extension"
	depends on BR2_PACKAGE_DIRECTFB
	help
	  DiVine provides a DirectFB input driver that reads input
	  events from a pipe and dispatches them via a virtual input
	  device. It also installs the tool 'spooky' that allows to
	  send input events to DirectFB applications.
```
