## package/dropbear/Config.in
```kconfig
config BR2_PACKAGE_DROPBEAR
	bool "dropbear"
	select BR2_PACKAGE_ZLIB if !BR2_PACKAGE_DROPBEAR_SMALL
	select BR2_PACKAGE_LIBTOMCRYPT if !BR2_PACKAGE_DROPBEAR_SMALL
	help
	  A small SSH 2 server designed for small memory environments.

	  Note that dropbear requires a per-device unique host key. The
	  key will be generated when dropbear starts, but it is not
	  persistent over reboot (if you have a read-only rootfs) or
	  upgrade (if you have a read-write rootfs). To make the key
	  persistent, replace /etc/dropbear with a symlink to a
	  directory on a persistent, writeable filesystem.
	  Alternatively, mount a persistent unionfs over your root
	  filesystem.

	  https://matt.ucc.asn.au/dropbear/dropbear.html

if BR2_PACKAGE_DROPBEAR

config BR2_PACKAGE_DROPBEAR_CLIENT
	bool "client programs"
	default y
	help
	  Provides the programs: dbclient, ssh

	  Note that the following programs are also used server-side
	  and are therefore always build regardless this setting:
	  dropbear, dropbearkey, dropbearconvert, scp

config BR2_PACKAGE_DROPBEAR_DISABLE_REVERSEDNS
	bool "disable reverse DNS lookups"
	help
	  Disable reverse DNS lookups on connection. This can be handy
	  on systems without working DNS, as connections otherwise
	  stall until DNS times out.

config BR2_PACKAGE_DROPBEAR_SMALL
	bool "optimize for size"
	default y
	help
	  Compile dropbear for the smallest possible binary size.

	  Tradeoffs are slower hashes and ciphers, and disabling of the
	  blowfish cipher and zlib.

config BR2_PACKAGE_DROPBEAR_WTMP
	bool "log dropbear access to wtmp"
	help
	  Enable logging of dropbear access to wtmp. Notice that
	  Buildroot does not generate wtmp by default.

config BR2_PACKAGE_DROPBEAR_LASTLOG
	bool "log dropbear access to lastlog"
	help
	  Enable logging of dropbear access to lastlog. Notice that
	  Buildroot does not generate lastlog by default.

endif
```

## package/dropbear_sshd/Config.in
```kconfig
config BR2_PACKAGE_DROPBEAR_SSHD
	bool "dropbear_sshd"
	default n
	help
	  A small SSH 2 server designed for small memory environments.

	  http://matt.ucc.asn.au/dropbear/

config BR2_PACKAGE_DROPBEAR_SSHD_URANDOM
	bool "  Use /dev/urandom (low entropy systems only)?"
	default n
	depends on BR2_PACKAGE_DROPBEAR_SSHD
	help
	  By default, dropbear uses the much more secure /dev/random.  If you
	  are using a system lacking usable entropy sources, this could cause
	  the dropbear ssh daemon to block forever waiting for entropy that
	  will never arrive.  By making dropbear use /dev/urandom, you can
	  prevent Dropbear from blocking while waiting on the random device.
	  This could however significantly reduce the security of your ssh
	  connections.  Make sure you know what you are doing if you enable
	  this option -- most people should answer N.
```

## package/dropwatch/Config.in
```kconfig
config BR2_PACKAGE_DROPWATCH
	bool "dropwatch"
	depends on BR2_TOOLCHAIN_HAS_THREADS # libnl
	select BR2_PACKAGE_READLINE
	select BR2_PACKAGE_LIBNL
	select BR2_PACKAGE_LIBPCAP
	help
	  Dropwatch is an interactive utility for monitoring and
	  recording packets that are dropped by the kernel

	  https://github.com/nhorman/dropwatch

comment "dropwatch needs a toolchain w/ threads"
	depends on !BR2_TOOLCHAIN_HAS_THREADS
```

## package/dstat/Config.in
```kconfig
config BR2_PACKAGE_DSTAT
	bool "dstat"
	depends on BR2_USE_WCHAR # python
	depends on BR2_USE_MMU # python
	depends on BR2_TOOLCHAIN_HAS_THREADS # python
	depends on !BR2_STATIC_LIBS # python
	select BR2_PACKAGE_PYTHON
	help
	  Dstat, written in Python, is a versatile replacement for
	  vmstat, iostat, netstat and ifstat. Dstat overcomes some of
	  their limitations and adds some extra features, more counters
	  and flexibility. Dstat is handy for monitoring systems during
	  performance tuning tests, benchmarks or troubleshooting.
	  Dstat allows you to view all of your system resources in
	  real-time, you can e.g. compare disk utilization in
	  combination with interrupts from your IDE controller, or
	  compare the network bandwidth numbers directly with the disk
	  throughput (in the same interval).

	  Note that to get proper output, your terminal size should be
	  known by the termios subsystem. This can be done by running
	  the 'resize' utility of busybox.

	  http://dag.wieers.com/home-made/dstat/

comment "dstat needs a toolchain w/ wchar, threads, dynamic library"
	depends on BR2_USE_MMU
	depends on !BR2_USE_WCHAR || !BR2_TOOLCHAIN_HAS_THREADS || BR2_STATIC_LIBS
```

## package/dt-utils/Config.in
```kconfig
config BR2_PACKAGE_DT_UTILS
	bool "dt-utils"
	depends on BR2_PACKAGE_HAS_UDEV
	help
	  Tools for flattened device-tree dumping and barebox state
	  manipulation.

	  https://git.pengutronix.de/cgit/tools/dt-utils/

comment "dt-utils needs udev /dev management"
	depends on !BR2_PACKAGE_HAS_UDEV
```
