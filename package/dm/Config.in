## package/dm/Config.in
```kconfig
config BR2_PACKAGE_DM
	bool "dm"
	depends on BR2_LARGEFILE
	help
	  The Device-mapper is a new component of the linux kernel that
	  supports logical volume management. It is required by LVM2 and EVMS.

comment "dm requires a toolchain with LARGEFILE support"
	depends on !BR2_LARGEFILE
```

## package/dmalloc/Config.in
```kconfig
config BR2_PACKAGE_DMALLOC
	bool "dmalloc"
	# On some packages, Microblaze gcc has issues when debugging
	# symbols are enabled: "Error: operation combines symbols in
	# different segments".
	depends on !(BR2_microblaze && BR2_ENABLE_DEBUG)
	help
	  A debug memory allocation library which is a drop in replacement for
	  the system's malloc, realloc, calloc, free and other memory management
	  routines while providing powerful debugging facilities configurable at
	  runtime.

	  http://dmalloc.com/
```

## package/dmidecode/Config.in
```kconfig
config BR2_PACKAGE_DMIDECODE
	bool "dmidecode"
	depends on BR2_i386 || BR2_x86_64
	help
	  Dmidecode reports information about your system's hardware
	  as described in your system BIOS according to the SMBIOS/DMI
	  standard.

	  http://www.nongnu.org/dmidecode/
```

## package/dmraid/Config.in
```kconfig
config BR2_PACKAGE_DMRAID
	bool "dmraid"
	depends on BR2_TOOLCHAIN_HAS_THREADS # lvm2
	depends on BR2_USE_MMU # lvm2
	depends on !BR2_STATIC_LIBS # lvm2
	depends on !BR2_TOOLCHAIN_USES_MUSL # lvm2
	select BR2_PACKAGE_LVM2
	help
	  dmraid discovers, activates, deactivates and displays
	  properties of software RAID sets (eg, ATARAID) and contained
	  DOS partitions.

	  dmraid uses the Linux device-mapper to create devices with
	  respective mappings for the ATARAID sets discovered.

comment "dmraid needs a glibc or uClibc toolchain w/ threads, dynamic library"
	depends on BR2_USE_MMU
	depends on BR2_STATIC_LIBS || !BR2_TOOLCHAIN_HAS_THREADS \
		|| BR2_TOOLCHAIN_USES_MUSL
```

## package/dnsmasq/Config.in
```kconfig
config BR2_PACKAGE_DNSMASQ
	bool "dnsmasq"
	help
	  A lightweight DNS and DHCP server.  It is intended to provide
	  coupled DNS and DHCP service to a LAN.

	  http://www.thekelleys.org.uk/dnsmasq/

if BR2_PACKAGE_DNSMASQ

config BR2_PACKAGE_DNSMASQ_TFTP
	bool "tftp support"
	default y
	help
	  Enable TFTP support in dnsmasq.

config BR2_PACKAGE_DNSMASQ_DHCP
	bool "dhcp support"
	default y
	help
	  Enable DHCP server support in dnsmasq.

config BR2_PACKAGE_DNSMASQ_IDN
	bool "IDN support"
	depends on BR2_USE_WCHAR
	select BR2_PACKAGE_LIBIDN
	select BR2_PACKAGE_GETTEXT if BR2_NEEDS_GETTEXT_IF_LOCALE
	select BR2_PACKAGE_LIBINTL if BR2_NEEDS_GETTEXT_IF_LOCALE
	help
	  Enable IDN support in dnsmasq.
	  This option is a big space taker since it pulls in many libraries.

config BR2_PACKAGE_DNSMASQ_LUA
	bool "Lua scripting support"
	select BR2_PACKAGE_LUA
	help
	  Enable lua scripting for dnsmasq

config BR2_PACKAGE_DNSMASQ_CONNTRACK
	bool "conntrack marking support"
	select BR2_PACKAGE_LIBNETFILTER_CONNTRACK
	help
	  Enable DNS query connection marking in netfilter.

endif
```

## package/docker-cli/Config.in
```kconfig
config BR2_PACKAGE_DOCKER_CLI
	bool "docker-cli"
	depends on BR2_PACKAGE_HOST_GO_TARGET_ARCH_SUPPORTS
	depends on BR2_PACKAGE_HOST_GO_TARGET_CGO_LINKING_SUPPORTS
	depends on BR2_TOOLCHAIN_HAS_THREADS
	help
	  Docker is a platform to build, ship,
	  and run applications as lightweight containers.

	  https://github.com/docker/cli

if BR2_PACKAGE_DOCKER_CLI

config BR2_PACKAGE_DOCKER_CLI_STATIC
	bool "build static client"
	depends on !BR2_STATIC_LIBS
	help
	  Build a static docker client.

endif

comment "docker-cli needs a toolchain w/ threads"
	depends on BR2_PACKAGE_HOST_GO_TARGET_ARCH_SUPPORTS
	depends on BR2_PACKAGE_HOST_GO_TARGET_CGO_LINKING_SUPPORTS
	depends on !BR2_TOOLCHAIN_HAS_THREADS
```

## package/docker-compose/Config.in
```kconfig
config BR2_PACKAGE_DOCKER_COMPOSE
	bool "docker-compose"
	depends on BR2_USE_MMU # python
	depends on BR2_USE_WCHAR # python
	depends on BR2_TOOLCHAIN_HAS_THREADS # python
	depends on !BR2_STATIC_LIBS # python
	depends on BR2_INSTALL_LIBSTDCPP # python-paramiko -> python-cryptography
	select BR2_PACKAGE_PYTHON3 if !BR2_PACKAGE_PYTHON
	select BR2_PACKAGE_PYTHON_BACKPORTS_SSL_MATCH_HOSTNAME \
	       if BR2_PACKAGE_PYTHON # runtime
	select BR2_PACKAGE_PYTHON_ENUM34 if BR2_PACKAGE_PYTHON # runtime
	select BR2_PACKAGE_PYTHON_IPADDRESS if BR2_PACKAGE_PYTHON # runtime
	select BR2_PACKAGE_PYTHON_CACHED_PROPERTY # runtime
	select BR2_PACKAGE_PYTHON_DOCOPT # runtime
	select BR2_PACKAGE_PYTHON_PARAMIKO # runtime
	select BR2_PACKAGE_PYTHON_PYYAML # runtime
	select BR2_PACKAGE_PYTHON_REQUESTS # runtime
	select BR2_PACKAGE_PYTHON_TEXTTABLE # runtime
	select BR2_PACKAGE_PYTHON_WEBSOCKET_CLIENT # runtime
	select BR2_PACKAGE_PYTHON_DOCKER # runtime
	select BR2_PACKAGE_PYTHON_DOCKERPTY # runtime
	select BR2_PACKAGE_PYTHON_SIX # runtime
	select BR2_PACKAGE_PYTHON_JSONSCHEMA # runtime
	help
	  Multi-container orchestration for Docker.

	  https://www.docker.com/

comment "docker-compose needs a toolchain w/ C++, wchar, threads, dynamic library"
	depends on BR2_USE_MMU
	depends on !BR2_USE_WCHAR || !BR2_TOOLCHAIN_HAS_THREADS || \
		BR2_STATIC_LIBS || !BR2_INSTALL_LIBSTDCPP
```

## package/docker-containerd/Config.in
```kconfig
config BR2_PACKAGE_DOCKER_CONTAINERD
	bool "docker-containerd"
	depends on BR2_PACKAGE_HOST_GO_ARCH_SUPPORTS
	depends on BR2_PACKAGE_HOST_GO_CGO_LINKING_SUPPORTS
	depends on BR2_TOOLCHAIN_HAS_THREADS
	depends on BR2_TOOLCHAIN_HEADERS_AT_LEAST_3_11 # runc
	depends on !BR2_TOOLCHAIN_USES_UCLIBC # runc
	depends on !BR2_TOOLCHAIN_EXTERNAL_CODESOURCERY_ARM # runc
	depends on BR2_USE_MMU # util-linux
	select BR2_PACKAGE_RUNC # runtime dependency
	select BR2_PACKAGE_UTIL_LINUX # runtime dependency
	select BR2_PACKAGE_UTIL_LINUX_BINARIES
	select BR2_PACKAGE_UTIL_LINUX_PIVOT_ROOT
	select BR2_PACKAGE_UTIL_LINUX_MOUNTPOINT
	select BR2_PACKAGE_UTIL_LINUX_MOUNT
	help
	  containerd is a daemon to control runC.

	  https://github.com/docker/containerd

if BR2_PACKAGE_DOCKER_CONTAINERD

config BR2_PACKAGE_DOCKER_CONTAINERD_DRIVER_BTRFS
	bool "btrfs snapshot driver"
	depends on BR2_USE_MMU # btrfs-progs
	depends on BR2_TOOLCHAIN_HAS_THREADS # btrfs-progs
	select BR2_PACKAGE_BTRFS_PROGS
	help
	  Build the btrfs snapshot driver for containerd.

endif

comment "docker-containerd needs a glibc or musl toolchain w/ threads"
	depends on BR2_PACKAGE_HOST_GO_ARCH_SUPPORTS
	depends on BR2_PACKAGE_HOST_GO_CGO_LINKING_SUPPORTS
	depends on BR2_USE_MMU
	depends on !BR2_TOOLCHAIN_HAS_THREADS || \
		!BR2_TOOLCHAIN_HEADERS_AT_LEAST_3_11 || BR2_TOOLCHAIN_USES_UCLIBC
	depends on !BR2_TOOLCHAIN_EXTERNAL_CODESOURCERY_ARM
```

## package/docker-engine/Config.in
```kconfig
config BR2_PACKAGE_DOCKER_ENGINE
	bool "docker-engine"
	depends on BR2_PACKAGE_HOST_GO_ARCH_SUPPORTS
	depends on BR2_PACKAGE_HOST_GO_CGO_LINKING_SUPPORTS
	depends on BR2_TOOLCHAIN_HAS_THREADS
	depends on BR2_TOOLCHAIN_HEADERS_AT_LEAST_3_11 # docker-containerd -> runc
	depends on !BR2_TOOLCHAIN_USES_UCLIBC # docker-containerd -> runc
	depends on !BR2_TOOLCHAIN_EXTERNAL_CODESOURCERY_ARM # docker-containerd -> runc
	depends on BR2_USE_MMU # docker-containerd
	select BR2_PACKAGE_DOCKER_CONTAINERD # runtime dependency
	select BR2_PACKAGE_DOCKER_PROXY # runtime dependency
	select BR2_PACKAGE_IPTABLES # runtime dependency
	select BR2_PACKAGE_SQLITE # runtime dependency
	help
	  Docker is a platform to build, ship,
	  and run applications as lightweight containers.

	  https://github.com/docker/docker

if BR2_PACKAGE_DOCKER_ENGINE

config BR2_PACKAGE_DOCKER_ENGINE_EXPERIMENTAL
	bool "build experimental features"

config BR2_PACKAGE_DOCKER_ENGINE_DRIVER_BTRFS
	bool "btrfs filesystem driver"
	depends on BR2_USE_MMU # btrfs-progs
	depends on BR2_TOOLCHAIN_HAS_THREADS # btrfs-progs
	select BR2_PACKAGE_BTRFS_PROGS
	help
	  Build the btrfs filesystem driver for Docker.

config BR2_PACKAGE_DOCKER_ENGINE_DRIVER_DEVICEMAPPER
	bool "devicemapper filesystem driver"
	depends on BR2_TOOLCHAIN_HAS_THREADS # lvm2
	depends on BR2_USE_MMU # lvm2
	depends on !BR2_STATIC_LIBS # lvm2
	depends on !BR2_TOOLCHAIN_USES_MUSL # lvm2
	select BR2_PACKAGE_LVM2
	select BR2_PACKAGE_LVM2_APP_LIBRARY
	help
	  Build the devicemapper filesystem driver for Docker.

config BR2_PACKAGE_DOCKER_ENGINE_DRIVER_VFS
	bool "vfs filesystem driver"
	depends on BR2_USE_WCHAR # gvfs
	depends on BR2_USE_MMU # gvfs
	depends on BR2_TOOLCHAIN_HAS_THREADS # gvfs
	select BR2_PACKAGE_GVFS
	help
	  Build the vfs filesystem driver for Docker.

endif

comment "docker-engine needs a glibc or musl toolchain w/ threads, headers >= 3.11"
	depends on BR2_PACKAGE_HOST_GO_ARCH_SUPPORTS
	depends on BR2_PACKAGE_HOST_GO_CGO_LINKING_SUPPORTS
	depends on !BR2_TOOLCHAIN_HAS_THREADS || \
		!BR2_TOOLCHAIN_HEADERS_AT_LEAST_3_11 || BR2_TOOLCHAIN_USES_UCLIBC
	depends on !BR2_TOOLCHAIN_EXTERNAL_CODESOURCERY_ARM
	depends on BR2_USE_MMU
```

## package/docker-proxy/Config.in
```kconfig
config BR2_PACKAGE_DOCKER_PROXY
	bool "docker-proxy"
	depends on BR2_PACKAGE_HOST_GO_ARCH_SUPPORTS
	depends on BR2_PACKAGE_HOST_GO_CGO_LINKING_SUPPORTS
	depends on BR2_TOOLCHAIN_HAS_THREADS
	help
	  Libnetwork is a Container Network Model that provides a
	  consistent programming interface and the required network
	  abstractions for applications.

	  This package provides docker-proxy, a run-time dependency of
	  Docker.

	  https://github.com/docker/libnetwork

comment "docker-proxy needs a toolchain w/ threads"
	depends on BR2_PACKAGE_HOST_GO_ARCH_SUPPORTS
	depends on BR2_PACKAGE_HOST_GO_CGO_LINKING_SUPPORTS
	depends on !BR2_TOOLCHAIN_HAS_THREADS
```

## package/docker/Config.in
```kconfig
config BR2_PACKAGE_DOCKER
	bool "docker"
	depends on BR2_PACKAGE_XORG7
	depends on BR2_USE_WCHAR # glib2
	depends on BR2_TOOLCHAIN_HAS_THREADS # glib2
	depends on BR2_USE_MMU # glib2
	select BR2_PACKAGE_LIBGLIB2
	select BR2_PACKAGE_XLIB_LIBX11
	help
	  a system tray dock for X

	  http://icculus.org/openbox/2/docker

comment "docker needs a toolchain w/ wchar, threads"
	depends on BR2_USE_MMU
	depends on BR2_PACKAGE_XORG7
	depends on !BR2_USE_WCHAR || !BR2_TOOLCHAIN_HAS_THREADS
```

## package/domoticz/Config.in
```kconfig
config BR2_PACKAGE_DOMOTICZ
	bool "domoticz"
	depends on BR2_USE_MMU # mosquitto
	depends on BR2_TOOLCHAIN_HAS_SYNC_4 # mosquitto
	depends on !BR2_STATIC_LIBS # mosquitto
	depends on BR2_TOOLCHAIN_GCC_AT_LEAST_4_8 # sleep_for
	# pthread_condattr_setclock
	depends on BR2_TOOLCHAIN_HAS_THREADS_NPTL
	depends on BR2_INSTALL_LIBSTDCPP
	depends on BR2_USE_WCHAR
	depends on BR2_PACKAGE_LUA_5_3
	depends on !BR2_TOOLCHAIN_HAS_GCC_BUG_64735 # exception_ptr
	select BR2_PACKAGE_BOOST
	select BR2_PACKAGE_BOOST_DATE_TIME
	select BR2_PACKAGE_BOOST_SYSTEM
	select BR2_PACKAGE_BOOST_THREAD
	select BR2_PACKAGE_LIBCURL
	select BR2_PACKAGE_MOSQUITTO
	select BR2_PACKAGE_OPENSSL
	select BR2_PACKAGE_SQLITE
	select BR2_PACKAGE_ZLIB
	help
	  Domoticz is a Home Automation System that lets you monitor
	  and configure various devices like: Lights, Switches,
	  various sensors/meters like Temperature, Rain, Wind, UV,
	  Electra, Gas, Water and much more. Notifications/Alerts can
	  be sent to any mobile device.

	  http://domoticz.com

comment "domoticz needs lua 5.3 and a toolchain w/ C++, gcc >= 4.8, NPTL, wchar, dynamic library"
	depends on BR2_USE_MMU
	depends on BR2_TOOLCHAIN_HAS_SYNC_4
	depends on !BR2_INSTALL_LIBSTDCPP || \
		!BR2_TOOLCHAIN_GCC_AT_LEAST_4_8 || \
		!BR2_TOOLCHAIN_HAS_THREADS_NPTL || \
		!BR2_USE_WCHAR || BR2_STATIC_LIBS || \
		!BR2_PACKAGE_LUA_5_3

comment "domoticz needs exception_ptr"
	depends on BR2_TOOLCHAIN_HAS_GCC_BUG_64735
```

## package/doom-wad/Config.in
```kconfig
config BR2_PACKAGE_DOOM_WAD
	bool "shareware Doom WAD file"
	depends on BR2_PACKAGE_CHOCOLATE_DOOM || BR2_PACKAGE_PRBOOM
	help
	  This will install the shareware wad data file for the doom
	  game.

	  The wad file will be placed in the /usr/share/games/doom
	  directory.

	  https://doomwiki.org/wiki/DOOM1.WAD
```

## package/dos2unix/Config.in
```kconfig
config BR2_PACKAGE_DOS2UNIX
	bool "dos2unix"
	depends on BR2_PACKAGE_BUSYBOX_SHOW_OTHERS
	help
	  dos2unix converts text file line endings between CRLF and LF

	  http://waterlan.home.xs4all.nl/dos2unix.html
```

## package/dosfstools/Config.in
```kconfig
config BR2_PACKAGE_DOSFSTOOLS
	bool "dosfstools"
	depends on BR2_USE_WCHAR
	select BR2_PACKAGE_LIBICONV if !BR2_ENABLE_LOCALE
	help
	  Tools for creating and checking DOS FAT filesystems.

	  http://www.daniel-baumann.ch/software/dosfstools/

if BR2_PACKAGE_DOSFSTOOLS

config BR2_PACKAGE_DOSFSTOOLS_FATLABEL
	bool "fatlabel"
	help
	  Get or set the DOS FAT filesystem label.

config BR2_PACKAGE_DOSFSTOOLS_FSCK_FAT
	bool "fsck.fat"
	help
	  Check a DOS FAT filesystem.

config BR2_PACKAGE_DOSFSTOOLS_MKFS_FAT
	bool "mkfs.fat"
	help
	  Creates a DOS FAT filesystem on a device.

endif

comment "dosfstools needs a toolchain w/ wchar"
	depends on !BR2_USE_WCHAR
```

## package/dosfstools/Config.in.host
```kconfig
config BR2_PACKAGE_HOST_DOSFSTOOLS
	bool "host dosfstools"
	help
	  Tools for creating and checking DOS FAT filesystems.

	  https://github.com/dosfstools/dosfstools
```

## package/dovecot-pigeonhole/Config.in
```kconfig
config BR2_PACKAGE_DOVECOT_PIGEONHOLE
	bool "dovecot-pigeonhole"
	help
	  Pigeonhole is the name of the project that adds support for the Sieve
	  language (RFC 5228) and the ManageSieve protocol (RFC 5804) to the
	  Dovecot Secure IMAP Server.

	  http://pigeonhole.dovecot.org
```

## package/dovecot/Config.in
```kconfig
config BR2_PACKAGE_DOVECOT
	bool "dovecot"
	depends on !BR2_STATIC_LIBS
	depends on BR2_USE_MMU # fork()
	help
	  Dovecot is an open source IMAP and POP3 email server for Linux/UNIX-
	  like systems, written with security primarily in mind. Dovecot is an
	  excellent choice for both small and large installations. It's fast,
	  simple to set up, requires no special administration and it uses very
	  little memory.

	  http://www.dovecot.org

if BR2_PACKAGE_DOVECOT

config BR2_PACKAGE_DOVECOT_BZIP2
	bool "bzip2 support"
	select BR2_PACKAGE_BZIP2
	help
	  Enable bzip2 support.

config BR2_PACKAGE_DOVECOT_MYSQL
	bool "mysql support"
	select BR2_PACKAGE_MYSQL
	depends on BR2_INSTALL_LIBSTDCPP # mysql
	depends on BR2_TOOLCHAIN_HAS_THREADS # mysql
	help
	  Enable MySQL support.

comment "mysql support needs a toolchain w/ C++, threads"
	depends on !BR2_INSTALL_LIBSTDCPP || !BR2_TOOLCHAIN_HAS_THREADS

config BR2_PACKAGE_DOVECOT_OPENSSL
	bool "openssl support"
	select BR2_PACKAGE_OPENSSL
	select BR2_PACKAGE_ZLIB
	help
	  Enable OpenSSL support.

config BR2_PACKAGE_DOVECOT_SQLITE
	bool "sqlite support"
	select BR2_PACKAGE_SQLITE
	help
	  Enable SQLite support.

config BR2_PACKAGE_DOVECOT_ZLIB
	bool "zlib support"
	select BR2_PACKAGE_ZLIB
	help
	  Enable zlib support.

source package/dovecot-pigeonhole/Config.in

endif # BR2_PACKAGE_DOVECOT

comment "dovecot needs a toolchain w/ dynamic library"
	depends on BR2_USE_MMU
	depends on BR2_STATIC_LIBS
```

## package/doxygen/Config.in.host
```kconfig
config BR2_PACKAGE_HOST_DOXYGEN
	bool "host doxygen"
	depends on BR2_HOST_GCC_AT_LEAST_4_9 # C++14
	help
	  Doxygen is the de facto standard tool for generating
	  documentation from annotated C++ sources, but it also
	  supports other popular programming languages such as C,
	  Objective-C, C#, PHP, Java, Python, IDL (Corba, Microsoft,
	  and UNO/OpenOffice flavors), Fortran, VHDL, Tcl, and to some
	  extent D.

	  http://www.doxygen.nl/
```

## package/drbd-utils/Config.in
```kconfig
config BR2_PACKAGE_DRBD_UTILS
	bool "drbd-utils"
	depends on BR2_USE_MMU # needs fork()
	help
	  DRBD utilities to manage the DRBD kernel module.

	  http://oss.linbit.com/drbd/
```
