## package/dt/Config.in
```kconfig
comment "dt needs a glibc or uClibc toolchain w/ threads"
	depends on BR2_USE_MMU
	depends on !BR2_TOOLCHAIN_HAS_THREADS || BR2_TOOLCHAIN_USES_MUSL

config BR2_PACKAGE_DT
	bool "dt"
	depends on BR2_USE_MMU # fork()
	depends on BR2_TOOLCHAIN_HAS_THREADS
	# Build fails because of several BSDisms
	depends on !BR2_TOOLCHAIN_USES_MUSL
	help
	  dt is a generic data test program used to verify proper
	  operation of peripherals, file systems, device drivers,
	  or any data stream supported by the operating system.
	  In its' simplest mode of operation, dt writes and then
	  verifys its' default data pattern, then displays
	  performance statisics and other test parameters
	  before exiting. Since verification of data is performed,
	  dt can be thought of as a generic diagnostic tool.

	  http://www.scsifaq.org/RMiller_Tools/dt.html
```

## package/dtc/Config.in
```kconfig
config BR2_PACKAGE_DTC
	bool "dtc (libfdt)"
	depends on !BR2_STATIC_LIBS
	help
	  The Device Tree Compiler, dtc, takes as input a device-tree in
	  a given format and outputs a device-tree in another format.

	  Note that only the library is installed.
	  If you want the programs, say 'y' here, and to "dtc programs",
	  below.

	  https://git.kernel.org/cgit/utils/dtc/dtc.git

if BR2_PACKAGE_DTC

config BR2_PACKAGE_DTC_PROGRAMS
	bool "dtc programs"
	help
	  Say 'y' here if you also want the programs on the target:
	    - convert-dtsv0     convert from version 0 to version 1
	    - dtc               the device tree compiler
	    - dtdiff            compare two device trees (needs bash)
	    - fdtdump           print a readable version of a
	                        flat device tree
	    - fdtget            read values from device tree
	    - fdtput            write a property value to a device tree

	  Note: dtdiff requires bash, so if bash is not selected, dtdiff
	  will be removed from the target file system. Enable bash if
	  you need dtdiff on the target.

comment "dtdiff will not be installed: it requires bash"
	depends on BR2_PACKAGE_DTC_PROGRAMS
	depends on !BR2_PACKAGE_BASH

endif

comment "dtc needs a toolchain w/ dynamic library"
	depends on BR2_STATIC_LIBS
```

## package/dtc/Config.in.host
```kconfig
config BR2_PACKAGE_HOST_DTC
	bool "host dtc"
	help
	  The Device Tree Compiler, dtc, takes as input a device-tree in
	  a given format and outputs a device-tree in another format.

	  Install host tools: dtc, convert-dtsv0, fdtdump, fdtget and fdtput.

	  https://git.kernel.org/cgit/utils/dtc/dtc.git
```

## package/dtv-scan-tables/Config.in
```kconfig
config BR2_PACKAGE_DTV_SCAN_TABLES
	bool "dtv-scan-tables"
	help
	  The Digital TV scan tables.

	  http://git.linuxtv.org/dtv-scan-tables.git
```

## package/duktape/Config.in
```kconfig
config BR2_PACKAGE_DUKTAPE
	bool "duktape"
	depends on !BR2_STATIC_LIBS
	help
	  Duktape is an embeddable Javascript engine, with a focus on
	  portability and compact footprint.

	  Duktape is easy to integrate into a C/C++ project: add
	  duktape.c, duktape.h, and duk_config.h to your build, and use
	  the Duktape API to call Ecmascript functions from C code and
	  vice versa.

	  http://www.duktape.org

comment "duktape needs a toolchain w/ dynamic library"
	depends on BR2_STATIC_LIBS
```

## package/duma/Config.in
```kconfig
config BR2_PACKAGE_DUMA
	bool "duma"
	depends on BR2_INSTALL_LIBSTDCPP
	depends on BR2_TOOLCHAIN_HAS_THREADS
	# By design, duma uses page mapping to isolate
	# allocations. Non-MMU platforms cannot perform such
	# things.
	depends on BR2_USE_MMU
	help
	  D.U.M.A. - Detect Unintended Memory Access. A fork of the
	  Electric Fence library. Detects buffer overflow and
	  underflow, and also memory leaks.

	  http://duma.sourceforge.net

if BR2_PACKAGE_DUMA

config BR2_PACKAGE_DUMA_NO_LEAKDETECTION
	bool "disable memory leak detection"

endif # BR2_PACKAGE_DUMA

comment "duma needs a toolchain w/ C++, threads"
	depends on BR2_USE_MMU
	depends on !BR2_INSTALL_LIBSTDCPP || !BR2_TOOLCHAIN_HAS_THREADS
```

## package/dummy/Config.in
```kconfig
config BR2_PACKAGE_DUMMY
	bool "dummy"
	help
	  This is a dummy package to show how to integrate a new package into
	  Buildroot. The syntax for this file is the default kbuild from the
	  Linux kernel, more information at
	  http://git.kernel.org/?p=linux/kernel/git/torvalds/linux-2.6.git;a=tree;f=Documentation/kbuild
```

## package/dump1090/Config.in
```kconfig
config BR2_PACKAGE_DUMP1090
	bool "dump1090"
	depends on BR2_TOOLCHAIN_HAS_THREADS # librtlsdr
	select BR2_PACKAGE_LIBRTLSDR
	help
	  Dump1090 is a simple Mode S decoder for RTLSDR devices

	  https://github.com/MalcolmRobb/dump1090

comment "dump1090 needs a toolchain w/ threads"
	depends on !BR2_TOOLCHAIN_HAS_THREADS
```

## package/dvb-apps/Config.in
```kconfig
config BR2_PACKAGE_DVB_APPS
	bool "dvb-apps"
	depends on BR2_TOOLCHAIN_HAS_THREADS
	depends on BR2_TOOLCHAIN_HEADERS_AT_LEAST_3_3
	select BR2_PACKAGE_LIBICONV if !BR2_ENABLE_LOCALE
	help
	  Install a small number of DVB test and utility programs,
	  including szap and dvbscan.

	  http://linuxtv.org/projects.php
	  http://linuxtv.org/hg/dvb-apps

comment "dvb-apps utils needs a toolchain w/ threads, headers >= 3.3"
	depends on !BR2_TOOLCHAIN_HAS_THREADS || !BR2_TOOLCHAIN_HEADERS_AT_LEAST_3_3
```

## package/dvblast/Config.in
```kconfig
config BR2_PACKAGE_DVBLAST
	bool "dvblast"
	depends on BR2_TOOLCHAIN_HAS_THREADS
	select BR2_PACKAGE_BITSTREAM
	select BR2_PACKAGE_LIBEV
	select BR2_PACKAGE_LIBICONV if !BR2_ENABLE_LOCALE
	help
	  DVBlast is a simple and powerful MPEG-2/TS demux and
	  streaming application.

	  http://www.videolan.org/projects/dvblast.html

comment "dvblast needs a toolchain w/ threads"
	depends on !BR2_TOOLCHAIN_HAS_THREADS
```

## package/dvbsnoop/Config.in
```kconfig
config BR2_PACKAGE_DVBSNOOP
	bool "dvbsnoop"
	help
	  Dvbsnoop is just a simple tool to analyze, view or debug a
	  transport stream (TS), program elementary stream (PES) or even
	  a program stream (PS). Dvbsnoop is trying to get input mostly
	  direct from a frontend (satellite or cable tuner inside a
	  set-top box for example) via DVB APIv3 to view into a TS, or a
	  demux to view PES or PS (also mostly inside the set-top box or
	  even PCI Card or USB Plug) but also from a file (recorded TS).
	  Dvbsnoop is working well on SD transport streams but may have
	  some limited functionality on HD transport streams
	  (DVB-{C,S,T}2 because of missing knowledge how to handle it.

	  Dvbsnoop itself doesn't do the tuning on the frontend, this
	  has to be done by external helpers or manually driver call.
	  The dvbsnoop tool was written while developing the software
	  Neutrino on the set-top box DBox2.

	  http://dvbsnoop.sourceforge.net
	  http://en.wikipedia.org/wiki/DBox2
```

## package/dvdauthor/Config.in
```kconfig
config BR2_PACKAGE_DVDAUTHOR
	bool "dvdauthor"
	select BR2_PACKAGE_LIBXML2
	select BR2_PACKAGE_FREETYPE
	select BR2_PACKAGE_LIBPNG
	help
	  DVDAuthor is a set of tools to help you author the file and directory
	  structure of a DVD-Video disc, including programmatic commands for
	  implementing interactive behaviour. It is driven by command lines and
	  XML control files, though there are other programs that provide
	  GUI-based front ends if you prefer

	  http://dvdauthor.sourceforge.net

if BR2_PACKAGE_DVDAUTHOR

config BR2_PACKAGE_DVDAUTHOR_DVDUNAUTHOR
	bool "dvdunauthor"
	select BR2_PACKAGE_LIBDVDREAD
	depends on BR2_LARGEFILE # libdvdread
	depends on !BR2_STATIC_LIBS # libdvdread
	help
	  This option enables the dvdunauthor program, which requires
	  libdvdread.

comment "dvdunauthor needs a toolchain w/ dynamic library, largefile"
	depends on !BR2_LARGEFILE || BR2_STATIC_LIBS

endif
```

## package/dvdrw-tools/Config.in
```kconfig
comment "dvdrw-tools needs a toolchain w/ threads, C++, wchar"
	depends on BR2_USE_MMU
	depends on !BR2_TOOLCHAIN_HAS_THREADS || !BR2_INSTALL_LIBSTDCPP || \
		!BR2_USE_WCHAR

config BR2_PACKAGE_DVDRW_TOOLS
	bool "dvdrw-tools"
	depends on BR2_USE_MMU # fork()
	depends on BR2_TOOLCHAIN_HAS_THREADS
	depends on BR2_INSTALL_LIBSTDCPP
	depends on BR2_USE_WCHAR
	help
	  The dvd+rw-tools are used to master Blu-ray Disc
	  and DVD Disc media, both +RW/+R and -RW/-R. Note:
	  The +RW in the name is a historical artifact. This
	  package contains the widely used growisofs program.

	  Buildroot does not support packages with a '+' sign
	  in their name, which explains why it is named
	  dvdrw-tools and not dvd+rw-tools.

	  Because dvd+rw-tools does not directly interact with
	  disc media it uses a separate media backend program.
	  The usual backend is mkisofs from the cdrtools package.
	  However, cdrtools is not currently part of buildroot.

	  The Linux From Scratch project uses uses xorriso for the
	  media backend and Ubuntu uses cdrkit for the backend.
	  Choose the one which seems most appropriate for your use.
	  NOTE: xorriso does not currently support UDF.

	  http://fy.chalmers.se/~appro/linux/DVD+RW/tools

if BR2_PACKAGE_DVDRW_TOOLS
choice
	prompt "Media Backend"
	help
	  Choose which media backend program to use.

config BR2_PACKAGE_DVDRW_TOOLS_CDRKIT_BACKEND
	bool "cdrkit"
	select BR2_PACKAGE_CDRKIT
	help
	  Symlink mkisofs to genisoimage from the cdrkit package.

config BR2_PACKAGE_DVDRW_TOOLS_XORRISO_BACKEND
	bool "xorriso"
	select BR2_PACKAGE_XORRISO
	help
	  Symlink mkisofs to xorrisofs from the xorriso package.

endchoice
endif
```

## package/e2fsprogs/Config.in
```kconfig
menuconfig BR2_PACKAGE_E2FSPROGS
	bool "e2fsprogs"
	depends on BR2_USE_MMU # util-linux/libblkid
	select BR2_PACKAGE_UTIL_LINUX
	select BR2_PACKAGE_UTIL_LINUX_LIBBLKID
	select BR2_PACKAGE_UTIL_LINUX_LIBUUID
	help
	  The EXT2 file system utilities.

	  The following programs are always built and installed:
	  badblocks chattr debugfs dumpe2fs e2freefrag e2fsck e2image
	  e2undo e4crypt e4defrag filefrag fsck fuse2fs logsave lsattr
	  mke2fs mklost+found resize2fs tune2fs

	  The uuid utilities (uuidd, uuidgen) are not built. Use the
	  ones from util-linux, instead.

	  Other programs can be selected individually.

	  http://e2fsprogs.sourceforge.net

if BR2_PACKAGE_E2FSPROGS

config BR2_PACKAGE_E2FSPROGS_DEBUGFS
	bool "debugfs"
	help
	  ext2/ext3/ext4 file system debugger

config BR2_PACKAGE_E2FSPROGS_E2IMAGE
	bool "e2image"
	help
	  Save critical ext2/ext3/ext4 filesystem metadata to a file

config BR2_PACKAGE_E2FSPROGS_E4DEFRAG
	bool "e4defrag"
	depends on !BR2_nios2 # fallocate not implemented
	depends on !BR2_TOOLCHAIN_USES_UCLIBC # sync_file_range not impl
	help
	  Online defragmenter for ext4 filesystem

comment "e4defrag needs a glibc or musl toolchain"
	depends on !BR2_nios2
	depends on BR2_TOOLCHAIN_USES_UCLIBC

config BR2_PACKAGE_E2FSPROGS_FSCK
	bool "fsck"
	default y
	depends on !BR2_PACKAGE_UTIL_LINUX_FSCK
	help
	  Check and repair a Linux file system. This is a wrapper around
	  the filesystem-specific fsck tools.

config BR2_PACKAGE_E2FSPROGS_FUSE2FS
	bool "fuse2fs"
	depends on !BR2_STATIC_LIBS # libfuse
	depends on BR2_TOOLCHAIN_HAS_THREADS # libfuse
	select BR2_PACKAGE_LIBFUSE
	help
	  FUSE file system client for ext2/ext3/ext4 file systems

comment "fuse2fs needs a toolchain w/ threads, dynamic library"
	depends on !BR2_TOOLCHAIN_HAS_THREADS || BR2_STATIC_LIBS

config BR2_PACKAGE_E2FSPROGS_RESIZE2FS
	bool "resize2fs"
	help
	  ext2/ext3/ext4 file system resizer

endif
```

## package/e2fsprogs/Config.in.host
```kconfig
config BR2_PACKAGE_HOST_E2FSPROGS
	bool "host e2fsprogs"
	help
	  The EXT2/3/4 file system utilities.
	  
	  http://e2fsprogs.sf.net
```

## package/e2tools/Config.in
```kconfig
config BR2_PACKAGE_E2TOOLS
	bool "e2tools"
	select BR2_PACKAGE_E2FSPROGS
	depends on BR2_TOOLCHAIN_HAS_THREADS
	depends on BR2_USE_WCHAR # e2fsprogs
	depends on BR2_USE_MMU # e2fsprogs
	help
	  E2tools is a simple set of GPL'ed utilities to read, write,
	  and manipulate files in an ext2/ext3 filesystem. These
	  utilities access a filesystem directly using the ext2fs
	  library.

	  https://github.com/ndim/e2tools

comment "e2tools needs a toolchain w/ threads, wchar"
	depends on !BR2_TOOLCHAIN_HAS_THREADS || !BR2_USE_WCHAR
	depends on BR2_USE_MMU
```

## package/e2tools/Config.in.host
```kconfig
config BR2_PACKAGE_HOST_E2TOOLS
	bool "host e2tools"
	select BR2_PACKAGE_HOST_E2FSPROGS
	help
	  E2tools is a simple set of GPL'ed utilities to read, write,
	  and manipulate files in an ext2/ext3 filesystem.  These
	  utilities access a filesystem directly using the ext2fs
	  library.

	  https://github.com/ndim/e2tools
```

## package/easy-rsa/Config.in
```kconfig
config BR2_PACKAGE_EASY_RSA
	bool "easy-rsa"
	select BR2_PACKAGE_OPENSSL # runtime
	select BR2_PACKAGE_LIBOPENSSL_BIN if BR2_PACKAGE_LIBOPENSSL
	select BR2_PACKAGE_LIBRESSL_BIN if BR2_PACKAGE_LIBRESSL
	help
	  Simple shell based CA utility

	  This package eases the creation of certificates, for example
	  for openvpn clients.

	  This was formerly part of the openvpn package.

	  easy-rsa is a wrapper script around OpenSSL binaries.

	  https://github.com/OpenVPN/easy-rsa
```

## package/easydbus/Config.in
```kconfig
config BR2_PACKAGE_EASYDBUS
	bool "easydbus"
	depends on BR2_USE_WCHAR # libglib2
	depends on BR2_TOOLCHAIN_HAS_THREADS # libglib2
	depends on BR2_USE_MMU # libglib2
	select BR2_PACKAGE_LIBGLIB2
	help
	  Easy to use DBus library for Lua.

	  https://github.com/mniestroj/easydbus

comment "easydbus needs a toolchain w/ wchar, threads"
	depends on BR2_USE_MMU
	depends on !BR2_USE_WCHAR || !BR2_TOOLCHAIN_HAS_THREADS
```

## package/ebtables/Config.in
```kconfig
config BR2_PACKAGE_EBTABLES
	bool "ebtables"
	depends on BR2_USE_MMU # fork()
	help
	  Ethernet bridge frame table administration

	  http://ebtables.netfilter.org/

if BR2_PACKAGE_EBTABLES

config BR2_PACKAGE_EBTABLES_UTILS_SAVE
	bool "ebtables save"
	depends on BR2_PACKAGE_BASH # runtime
	help
	  Install the ebtables-save tool

config BR2_PACKAGE_EBTABLES_UTILS_RESTORE
	bool "ebtables restore"
	depends on !BR2_STATIC_LIBS
	help
	  Install the ebtables-restore tool

comment "ebtables-restore needs a toolchain w/ dynamic library"
	depends on BR2_STATIC_LIBS

endif
```

## package/ecryptfs-utils/Config.in
```kconfig
config BR2_PACKAGE_ECRYPTFS_UTILS
	bool "ecryptfs-utils"
	depends on BR2_USE_WCHAR # gettext
	depends on BR2_USE_MMU # keyutils
	depends on !BR2_microblaze # keyutils
	depends on BR2_TOOLCHAIN_HAS_THREADS # libnss -> libnspr
	depends on BR2_PACKAGE_LIBNSPR_ARCH_SUPPORT # libnss -> libnspr
	depends on !BR2_MIPS_NABI32 # libnss
	depends on !BR2_STATIC_LIBS # libnss, keyutils
	depends on !BR2_TOOLCHAIN_HAS_GCC_BUG_85862 # microblaze specific & GCC < 7.x
	select BR2_PACKAGE_KEYUTILS
	select BR2_PACKAGE_LIBNSS
	# runtime dependency only, some scripts are using the
	# 'gettext' program to get translations
	select BR2_PACKAGE_GETTEXT
	# runtime dependency only
	select BR2_PACKAGE_GETENT
	help
	  eCryptfs is a POSIX-compliant enterprise cryptographic
	  filesystem for Linux. It is stacked on top of any other
	  Linux filesystem, it stores cryptographic metadata in the
	  header of each file written.

	  The eCryptfs kernel module is available in all Linux kernels
	  since version 2.6.19. This package provides userspace
	  utilities needed to mount eCryptfs.

	  Files are encrypted using a passphrase. Consider building
	  openssl for another method.

	  http://ecryptfs.org

comment "ecryptfs-utils needs a toolchain w/ threads, wchar, dynami library"
	depends on !BR2_microblaze
	depends on BR2_PACKAGE_LIBNSPR_ARCH_SUPPORT
	depends on BR2_USE_MMU
	depends on !BR2_TOOLCHAIN_HAS_THREADS || !BR2_USE_WCHAR || \
		BR2_STATIC_LIBS

comment "ecryptfs needs a toolchain not affected by GCC bug 85862"
	depends on BR2_TOOLCHAIN_HAS_GCC_BUG_85862 # libnss
```
