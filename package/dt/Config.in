## package/ed/Config.in
```kconfig
config BR2_PACKAGE_ED
	bool "ed"
	help
	  A line-oriented text editor. Used to create, display, modify,
	  and otherwise manipulate text files. Often used in scripts
	  rather than invoked directly.

	  http://www.gnu.org/software/ed/
```

## package/edid-decode/Config.in
```kconfig
config BR2_PACKAGE_EDID_DECODE
	bool "edid-decode"
	help
	  Decode EDID data in human-readable format.

	  https://git.linuxtv.org/edid-decode.git/
```

## package/editors/Config.in
```kconfig
menu "Text editors"
source "package/editors/ed/Config.in"
source "package/editors/nano/Config.in"
source "package/editors/uemacs/Config.in"
if BR2_PACKAGE_BUSYBOX_SHOW_OTHERS
# busybox has vi
source "package/editors/vim/Config.in"
endif
endmenu
```

## package/editors/nano/Config.in
```kconfig
config BR2_PACKAGE_NANO
	bool "nano"
	select BR2_PACKAGE_NCURSES
	help
	  A nice ncurses-based editor.  Started out as a clone of pico.
	  Great editor for new users.

	  http://www.nano-editor.org/
```
