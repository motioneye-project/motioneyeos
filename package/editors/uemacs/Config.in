## package/efl/libedbus/Config.in
```kconfig
config BR2_PACKAGE_LIBEDBUS
	bool "libedbus"
	select BR2_PACKAGE_LIBEINA
	select BR2_PACKAGE_LIBECORE
	select BR2_PACKAGE_DBUS
	depends on BR2_TOOLCHAIN_HAS_THREADS # dbus
	depends on BR2_USE_MMU # dbus
	help
	  E_Dbus is a set of wrappers around D-Bus APIs so they can be
	  easily used by EFL applications, automatically providing
	  Ecore/main loop integration, as well as Eina data types.

	  http://trac.enlightenment.org/e/wiki/E_Dbus

if BR2_PACKAGE_LIBEDBUS

config BR2_PACKAGE_LIBEDBUS_BLUEZ
	bool "bluez support"
	depends on !BR2_STATIC_LIBS # bluez_utils
	depends on BR2_USE_WCHAR # bluez_utils -> glib2
	depends on BR2_TOOLCHAIN_HAS_THREADS # bluez_utils -> glib2
	select BR2_PACKAGE_BLUEZ_UTILS
	help
	  Bluetooth support.

comment "bluez support needs a toolchain w/ wchar, threads, dynamic library"
	depends on !BR2_USE_WCHAR || !BR2_TOOLCHAIN_HAS_THREADS || BR2_STATIC_LIBS

config BR2_PACKAGE_LIBEDBUS_CONNMAN
	bool "connman support"
	depends on BR2_PACKAGE_CONNMAN
	help
	  Connection manager support.

config BR2_PACKAGE_LIBEDBUS_NOTIFY
	bool "notify support"
	help
	  Notify support.

endif

comment "libedbus needs a toolchain w/ threads"
	depends on BR2_USE_MMU
	depends on !BR2_TOOLCHAIN_HAS_THREADS
```

## package/efl/libedje/Config.in
```kconfig
comment "libedje needs a toolchain w/ threads"
	depends on !BR2_avr32
	depends on !BR2_TOOLCHAIN_HAS_THREADS

config BR2_PACKAGE_LIBEDJE
	bool "libedje"
	select BR2_PACKAGE_LIBEINA
	select BR2_PACKAGE_LIBEET
	select BR2_PACKAGE_LIBECORE
	select BR2_PACKAGE_LIBECORE_EVAS
	select BR2_PACKAGE_LIBEMBRYO
	select BR2_PACKAGE_LIBEVAS
	select BR2_PACKAGE_LUA
	depends on !BR2_avr32 # libevas
	depends on BR2_TOOLCHAIN_HAS_THREADS # libevas
	help
	  A graphical layout and animation library for animated
	  resizable, compressed and scalable themes.

	  http://trac.enlightenment.org/e/wiki/Edje

if BR2_PACKAGE_LIBEDJE

config BR2_PACKAGE_LIBEDJE_CC
	bool "build edje_cc"
	help
	  Build and install the Edje compiler for the target. Normally this
	  is not required.

endif
```

## package/efl/libeet/Config.in
```kconfig
config BR2_PACKAGE_LIBEET
	bool "libeet"
	select BR2_PACKAGE_ZLIB
	select BR2_PACKAGE_JPEG
	select BR2_PACKAGE_LIBEINA
	help
	  Eet is a tiny library designed to write an arbitary set of
	  chunks of data to a file and optionally compress each chunk
	  (very much like a zip file).

	  http://trac.enlightenment.org/e/wiki/Eet
```

## package/efl/libefreet/Config.in
```kconfig
config BR2_PACKAGE_LIBEFREET
	bool "libefreet"
	select BR2_PACKAGE_LIBEINA
	select BR2_PACKAGE_LIBEET
	select BR2_PACKAGE_LIBECORE
	help
	  Efreet is a library designed to help apps work with several of the
	  Freedesktop.org standards regarding Icons, Desktop files and Menus.

	  http://trac.enlightenment.org/e/wiki/Efreet
```

## package/efl/libeina/Config.in
```kconfig
config BR2_PACKAGE_LIBEINA
	bool "libeina"
	help
	  Eina is a tiny library to handle data types (list, hash, etc.)

	  http://trac.enlightenment.org/e/wiki/Eina
```

## package/efl/libeio/Config.in
```kconfig
config BR2_PACKAGE_LIBEIO
	bool "libeio"
	select BR2_PACKAGE_LIBEET
	select BR2_PACKAGE_LIBEINA
	select BR2_PACKAGE_LIBECORE
	help
	  Eio integrates with EFL (Ecore, Eina) to provide efficient
	  filesystem Input/Output (I/O). It use the best techniques to
	  achieve such purpose, like using at-variants, splice,
	  properly handling errors and doing it in an asynchronous
	  fashion by means of worker threads. It is also ported to
	  Windows, so multi-platform.

	  Whenever you need to list a directory, copy, move or delete
	  files, Eio will do that task better than you'd achieve with
	  naive implementations, and it is easy to use.

	  http://trac.enlightenment.org/e/wiki/Eio
```

## package/efl/libelementary/Config.in
```kconfig
config BR2_PACKAGE_LIBELEMENTARY
	bool "libelementary"
	select BR2_PACKAGE_LIBEFL
	depends on BR2_TOOLCHAIN_HAS_THREADS # elm_store.c
	depends on !BR2_STATIC_LIBS
	help
	  Elementary is a widget toolkit and EFL wrapper and convenience
	  library to make it easy to build applications and tools with UIs
	  with less code.

	  https://enlightenment.org

comment "libelementary needs a toolchain w/ threads, dynamic library"
	depends on !BR2_TOOLCHAIN_HAS_THREADS || BR2_STATIC_LIBS
```

## package/efl/libembryo/Config.in
```kconfig
config BR2_PACKAGE_LIBEMBRYO
	bool "libembryo"
	select BR2_PACKAGE_LIBEINA
	help
	  Embryo is primarily a shared library that gives you an API
	  to load and control interpreted programs compiled into an
	  abstract machine bytecode that it understands.

	  http://trac.enlightenment.org/e/wiki/Embryo
```

## package/efl/libethumb/Config.in
```kconfig
comment "libethumb needs a toolchain w/ threads"
	depends on !BR2_TOOLCHAIN_HAS_THREADS

config BR2_PACKAGE_LIBETHUMB
	bool "libethumb"
	select BR2_PACKAGE_LIBEINA
	select BR2_PACKAGE_LIBEVAS
	select BR2_PACKAGE_LIBECORE
	select BR2_PACKAGE_LIBECORE_EVAS
	select BR2_PACKAGE_LIBEDJE
	depends on BR2_TOOLCHAIN_HAS_THREADS # libevas
	help
	  Ethumb is a library for generating thumbnail images of documents.

	  http://trac.enlightenment.org/e/wiki/Ethumb
```

## package/efl/libevas-generic-loaders/Config.in
```kconfig
config BR2_PACKAGE_LIBEVAS_GENERIC_LOADERS
	bool "libevas generic loaders"
	select BR2_PACKAGE_LIBEINA
	help
	  These are additional "generic" loaders for Evas that are
	  stand-alone executables that evas may run from its generic
	  loader module.

	  http://trac.enlightenment.org/e/wiki/Evas_Generic_Loaders

if BR2_PACKAGE_LIBEVAS_GENERIC_LOADERS

config BR2_PACKAGE_LIBEVAS_GENERIC_LOADERS_SVG
	bool "SVG loader"
	select BR2_PACKAGE_LIBRSVG
	select BR2_PACKAGE_CAIRO
	depends on BR2_USE_WCHAR # librsvg -> glib2
	depends on BR2_TOOLCHAIN_HAS_THREADS # librsvg -> glib2
	depends on BR2_INSTALL_LIBSTDCPP # librsvg -> pango
	help
	  This option enables the Evas generic SVG loader

comment "SVG loader needs a toolchain w/ wchar, threads, C++"
	depends on !BR2_USE_WCHAR || !BR2_TOOLCHAIN_HAS_THREADS || !BR2_INSTALL_LIBSTDCPP

endif
```

## package/efl/libevas/Config.in
```kconfig
config BR2_PACKAGE_LIBEVAS
	bool "libevas"
	select BR2_PACKAGE_FREETYPE
	select BR2_PACKAGE_LIBEINA
	# required to build so far
	select BR2_PACKAGE_LIBEVAS_SCALE_SMOOTH
	help
	  Evas is a clean display canvas API for several target
	  display systems that can draw anti-aliased text, smooth
	  super and sub-sampled scaled images, alpha-blend objects
	  much and more.

	  http://trac.enlightenment.org/e/wiki/Evas

if BR2_PACKAGE_LIBEVAS

comment "libevas rendering options"

config BR2_PACKAGE_LIBEVAS_SCALE_SAMPLE
	bool "libevas sampling scaler"
	help
	  This enables the sampling scaler code. This is the fastest
	  image scaling code, but also the lowest quality.

config BR2_PACKAGE_LIBEVAS_SCALE_SMOOTH
	bool "libevas smooth scaler"
	help
	  This is the nicest looking scaler that is not that much
	  slower than tri-linear, but it looks really good.

config BR2_PACKAGE_LIBEVAS_SMALL_DITHERING
	bool "libevas small dithering"
	help
	  This uses a 4x4 dither mask instead of 128x128. On desktop
	  boxes these days (Pentium, Pentium2, amd etc.) the speed
	  difference is not really measurable, but the quality of the
	  128x128 dither mask is quite a lot better.

config BR2_PACKAGE_LIBEVAS_LINE_DITHERING
	bool "libevas line dithering"

config BR2_PACKAGE_LIBEVAS_NO_DITHERING
	bool "libevas no dithering"


comment "libevas backends"

config BR2_PACKAGE_LIBEVAS_BUFFER
	bool "libevas buffer backend"
	help
	  This enables the software buffer rendering engine. There is
	  no hardware assist here.

config BR2_PACKAGE_LIBEVAS_DIRECTFB
	bool "libevas DirectFB backend"
	depends on BR2_PACKAGE_DIRECTFB
	default y
	help
	  This is the DirectFB engine that uses the DirectFB library
	  (http://www.directfb.org) on Linux to access the framebuffer
	  with (or maybe without) acceleration.

config BR2_PACKAGE_LIBEVAS_FB
	bool "libevas frame buffer backend"
	help
	  This is the software framebuffer driving engine. this uses
	  the linux framebuffer device (/dev/fb<x>) and will currently
	  just inherit the current framebuffer settings on the fb
	  device and use them to run in.

config BR2_PACKAGE_LIBEVAS_SDL
	bool "libevas SDL backend"
	select BR2_PACKAGE_SDL
	help
	  This is the software SDL engine that uses SDL library
	  (http://www.libsdl.org). This library should work on many
	  operating systems.

config BR2_PACKAGE_LIBEVAS_SDL_GL
	bool "libevas SDL OpenGL backend"
	depends on BR2_PACKAGE_SDL_X11
	depends on BR2_PACKAGE_XSERVER_XORG_SERVER_MODULAR # mesa needs big X
	help
	  This is the SDL OpenGL engine that uses SDL library
	  and OpenGL to render. This may be hardware accelerated.

comment "SDL OpenGL backend needs modular X.org and X11 support in SDL"
	depends on !(BR2_PACKAGE_SDL_X11 && BR2_PACKAGE_XSERVER_XORG_SERVER_MODULAR)

config BR2_PACKAGE_LIBEVAS_X11
	bool "libevas X11 backend"
	depends on BR2_PACKAGE_XORG7
	select BR2_PACKAGE_XLIB_LIBX11
	select BR2_PACKAGE_XLIB_LIBXEXT
	help
	  This enables the software X11 rendering engine that renders
	  to X drawable targets using highly optimised software
	  routines. There is no hardware assist here.

config BR2_PACKAGE_LIBEVAS_X11_GLX
	bool "libevas X11 GLX backend"
	depends on BR2_PACKAGE_XSERVER_XORG_SERVER_MODULAR # mesa needs big X
	select BR2_PACKAGE_XLIB_LIBX11
	select BR2_PACKAGE_XLIB_LIBXRENDER
	select BR2_PACKAGE_XLIB_LIBXEXT
	select BR2_PACKAGE_XPROTO_GLPROTO
	help
	  This enables the OpenGL X11 rendering engine that renders
	  using GLX which may be hardware accelerated.

config BR2_PACKAGE_LIBEVAS_XCB
	bool "libevas XCB backend"
	depends on BR2_PACKAGE_XORG7
	select BR2_PACKAGE_LIBXCB
	select BR2_PACKAGE_XCB_UTIL
	select BR2_PACKAGE_XCB_PROTO
	select BR2_PACKAGE_PIXMAN
	help
	  This enable the software XCB rendering engine. It allows the
	  same features than the software X11 engine.

config BR2_PACKAGE_LIBEVAS_XCB_GLX
	bool "libevas XCB GLX backend"
	depends on BR2_PACKAGE_XSERVER_XORG_SERVER_MODULAR # mesa needs big X
	select BR2_PACKAGE_LIBXCB
	select BR2_PACKAGE_XCB_UTIL
	select BR2_PACKAGE_XCB_PROTO
	select BR2_PACKAGE_XPROTO_GLPROTO
	help
	  This enables the OpenGL X11 XCB rendering engine that renders
	  using GLX which may be hardware accelerated.

choice
	prompt "libevas OpenGL flavor"
	depends on BR2_PACKAGE_LIBEVAS_SDL_GL || BR2_PACKAGE_LIBEVAS_X11_GLX || BR2_PACKAGE_LIBEVAS_XCB_GLX
	default BR2_PACKAGE_LIBEVAS_GL

config BR2_PACKAGE_LIBEVAS_GL
	bool "generic OpenGL"
	select BR2_PACKAGE_MESA3D
	select BR2_PACKAGE_LIBEET

config BR2_PACKAGE_LIBEVAS_GLES_SGX
       bool "OpenGL-ES SGX"

config BR2_PACKAGE_LIBEVAS_GLES_S3C6410
       bool "OpenGL-ES S3C6410"
endchoice


comment "libevas loaders"

config BR2_PACKAGE_LIBEVAS_PNG
	bool "libevas png loader"
	select BR2_PACKAGE_LIBPNG
	help
	  This enables the loader code that loads png files using
	  libpng.

config BR2_PACKAGE_LIBEVAS_JPEG
	bool "libevas jpeg loader"
	select BR2_PACKAGE_JPEG
	help
	  This enables the loader code that loads jpeg files using
	  libjpeg.

config BR2_PACKAGE_LIBEVAS_GIF
	bool "libevas gif loader"
	select BR2_PACKAGE_LIBUNGIF
	help
	  This enables the loader code that loads gif files using
	  libungif.

config BR2_PACKAGE_LIBEVAS_PMAPS
	bool "libevas pmaps loader"
	help
	  This enables the loader code that loads pmaps files.

config BR2_PACKAGE_LIBEVAS_TIFF
	bool "libevas tiff loader"
	select BR2_PACKAGE_TIFF
	help
	  This enables the loader code that loads tiff files.

config BR2_PACKAGE_LIBEVAS_XPM
	bool "libevas xpm loader"
	help
	  This enables the loader code that loads xpm files.

config BR2_PACKAGE_LIBEVAS_EET
	bool "libevas eet image loader"
	select BR2_PACKAGE_LIBEET
	help
	  This enables the loader code that loads images using libeet.

config BR2_PACKAGE_LIBEVAS_EET_FONT
	bool "libevas eet font loader"
	select BR2_PACKAGE_LIBEET
	help
	  This enables the loader code that loads fonts using libeet.

endif # BR2_PACKAGE_LIBEVAS
```

## package/eigen/Config.in
```kconfig
config BR2_PACKAGE_EIGEN
	bool "eigen"
	depends on BR2_INSTALL_LIBSTDCPP
	help
	  Eigen is a C++ template library for linear algebra: vectors,
	  matrices, and related algorithms. It is versatile, fast,
	  elegant and works on many platforms (OS/Compilers).

	  This package only installs header files to the include path.
	  If you just want to use Eigen, you can use the header files
	  right away. There is no binary to link to. Eigen is a pure
	  template library defined in the headers.

	  http://eigen.tuxfamily.org/

if BR2_PACKAGE_EIGEN

config BR2_PACKAGE_EIGEN_UNSUPPORTED_MODULES
	bool "unsupported modules"
	help
	  Install eigen unsupported modules
endif

comment "eigen needs a toolchain w/ C++"
	depends on !BR2_INSTALL_LIBSTDCPP
```

## package/ejabberd/Config.in
```kconfig
config BR2_PACKAGE_EJABBERD
	bool "ejabberd"
	depends on BR2_PACKAGE_ERLANG
	depends on BR2_INSTALL_LIBSTDCPP # jiffy, stringprep
	select BR2_PACKAGE_ERLANG_EIMP
	select BR2_PACKAGE_ERLANG_IDNA # runtime
	select BR2_PACKAGE_ERLANG_JIFFY # runtime
	select BR2_PACKAGE_ERLANG_JOSE # runtime
	select BR2_PACKAGE_ERLANG_LAGER
	select BR2_PACKAGE_ERLANG_P1_ACME # runtime
	select BR2_PACKAGE_ERLANG_P1_CACHE_TAB
	select BR2_PACKAGE_ERLANG_P1_MQTREE # runtime
	select BR2_PACKAGE_ERLANG_P1_OAUTH2 # runtime
	select BR2_PACKAGE_ERLANG_P1_PKIX # runtime
	select BR2_PACKAGE_ERLANG_P1_SIP
	select BR2_PACKAGE_ERLANG_P1_STRINGPREP
	select BR2_PACKAGE_ERLANG_P1_STUN
	select BR2_PACKAGE_ERLANG_P1_TLS
	select BR2_PACKAGE_ERLANG_P1_UTILS
	select BR2_PACKAGE_ERLANG_P1_XML
	select BR2_PACKAGE_ERLANG_P1_XMPP
	select BR2_PACKAGE_ERLANG_P1_YAML
	select BR2_PACKAGE_ERLANG_P1_YCONF # runtime
	select BR2_PACKAGE_ERLANG_P1_ZLIB
	select BR2_PACKAGE_GETENT
	select BR2_PACKAGE_OPENSSL
	help
	  Ejabberd is a Jabber/XMPP instant messaging server, written
	  in Erlang/OTP. Among other features, ejabberd is
	  cross-platform, fault-tolerant, clusterable and modular.

	  http://www.ejabberd.im

comment "ejabberd needs erlang, toolchain w/ C++"
	depends on !BR2_PACKAGE_ERLANG || !BR2_INSTALL_LIBSTDCPP
```

## package/elementary/Config.in
```kconfig
config BR2_PACKAGE_ELEMENTARY
	bool "elementary"
	depends on BR2_PACKAGE_EFL
	depends on BR2_TOOLCHAIN_HAS_THREADS # elm_store.c
	depends on !BR2_STATIC_LIBS
	help
	  Elementary is a widget toolkit and EFL wrapper and convenience
	  library to make it easy to build applications and tools with UIs
	  with less code.

	  https://enlightenment.org

comment "elementary needs a toolchain w/ threads, dynamic library"
	depends on BR2_PACKAGE_EFL
	depends on !BR2_TOOLCHAIN_HAS_THREADS || BR2_STATIC_LIBS
```

## package/elf2flt/Config.in.host
```kconfig
config BR2_PACKAGE_HOST_ELF2FLT
	bool "Enable elf2flt support?"
	depends on BR2_arm || BR2_bfin || BR2_sh || BR2_sparc
	depends on !BR2_USE_MMU
	help
	  uCLinux uses a Binary Flat format commonly known as BFLT. It
	  is a relatively simple and lightweight executable format
	  based on the original a.out format.

	  This option compiles the required tools and makes the required
	  modifications on your toolchain (linker).
```
