## package/emlog/Config.in
```kconfig
config BR2_PACKAGE_EMLOG
	bool "emlog"
	depends on BR2_LINUX_KERNEL
	help
	  emlog is a Linux kernel module that makes it easy to access
	  the most recent (and only the most recent) output from a
	  process. It works just like "tail -f" on a log file, except
	  that the storage required never grows. This can be useful in
	  embedded systems where there isn't enough memory or disk
	  space for keeping complete log files, but the most recent
	  debugging messages are sometimes needed (e.g., after an
	  error is observed).

	  https://github.com/nicupavel/emlog

comment "emlog needs a Linux kernel to be built"
	depends on !BR2_LINUX_KERNEL
```

## package/empty/Config.in
```kconfig
config BR2_PACKAGE_EMPTY
	bool "empty"
	depends on BR2_USE_MMU # uses fork()
	help
	  Run processes and applications under pseudo-terminal (PTY)
	  sessions.

	  http://empty.sourceforge.net/
```

## package/enchant/Config.in
```kconfig
config BR2_PACKAGE_ENCHANT
	bool "enchant"
	depends on BR2_INSTALL_LIBSTDCPP
	depends on BR2_USE_WCHAR # glib2
	depends on BR2_TOOLCHAIN_HAS_THREADS # glib2
	depends on BR2_USE_MMU # glib2
	select BR2_PACKAGE_LIBGLIB2
	help
	  Enchant is a spell-checking library that provides a consistent
	  API across a number of spell-checking system backends.

	  http://www.abisource.com/projects/enchant/

comment "enchant needs a toolchain w/ C++, threads, wchar"
	depends on BR2_USE_MMU
	depends on !BR2_INSTALL_LIBSTDCPP || !BR2_USE_WCHAR || \
		!BR2_TOOLCHAIN_HAS_THREADS
```

## package/enet/Config.in
```kconfig
config BR2_PACKAGE_ENET
	bool "enet"
	help
	  ENet's purpose is to provide a relatively thin, simple
	  and robust network communication layer on top of UDP
	  (User Datagram Protocol).The primary feature it
	  provides is optional reliable, in-order delivery of
	  packets.

	  ENet omits certain higher level networking features
	  such as authentication, lobbying, server discovery,
	  encryption, or other similar tasks that are
	  particularly application specific so that the library
	  remains flexible, portable, and easily embeddable.

	  http://enet.bespin.org
```

## package/enlightenment/Config.in
```kconfig
config BR2_PACKAGE_ENLIGHTENMENT
	bool "enlightenment"
	# libevas-generic-loaders-svg -> librsvg -> glib2 / pango
	depends on BR2_USE_WCHAR
	depends on BR2_INSTALL_LIBSTDCPP
	# libedbus -> dbus
	# libedbus -> glib2, libevas
	depends on BR2_TOOLCHAIN_HAS_THREADS
	# libedbus -> dbus, efl libraries
	depends on BR2_USE_MMU
	depends on BR2_PACKAGE_EFL
	depends on BR2_PACKAGE_HAS_UDEV # efl (eeze) -> libudev
	depends on BR2_PACKAGE_XORG7
	# libevas-generic-loaders-svg -> librsvg -> pango -> harfbuzz
	depends on BR2_TOOLCHAIN_HAS_SYNC_4
	depends on BR2_TOOLCHAIN_GCC_AT_LEAST_4_8
	select BR2_PACKAGE_EFL_X_XLIB
	select BR2_PACKAGE_EFL_EEZE
	select BR2_PACKAGE_EFL_JPEG # needed at runtime by enlightenment_start
	select BR2_PACKAGE_EFL_PNG # needed at runtime by enlightenment_start
	select BR2_PACKAGE_EFL_SVG
	select BR2_PACKAGE_XCB_UTIL_KEYSYMS
	help
	  Enlightenment, also known simply as E, is a stacking window
	  manager for the X Window System which can be used alone or
	  in conjunction with a desktop environment such as GNOME or
	  KDE. Enlightenment can be used as a substitute for a full
	  desktop environment.

	  http://www.enlightenment.org/

comment "enlightenment needs udev /dev management and a toolchain w/ wchar, C++, threads, gcc >= 4.8"
	depends on BR2_PACKAGE_EFL && BR2_PACKAGE_XORG7 && BR2_USE_MMU
	depends on !BR2_USE_WCHAR || !BR2_TOOLCHAIN_HAS_THREADS || !BR2_INSTALL_LIBSTDCPP || \
		!BR2_TOOLCHAIN_GCC_AT_LEAST_4_8 || \
		!BR2_PACKAGE_HAS_UDEV
	depends on BR2_TOOLCHAIN_HAS_SYNC_4
```

## package/enscript/Config.in
```kconfig
config BR2_PACKAGE_ENSCRIPT
	bool "enscript"
	help
	  GNU Enscript is a free replacement for Adobe's enscript
	  program.

	  GNU Enscript converts ASCII files to PostScript, HTML, or RTF
	  and stores generated output to a file or sends it directly to
	  the printer. It includes features for `pretty-printing'
	  (language-sensitive code highlighting) in several programming
	  languages.

	  http://www.gnu.org/software/enscript
```

## package/erlang-base64url/Config.in
```kconfig
config BR2_PACKAGE_ERLANG_BASE64URL
	bool "erlang-base64url"
	help
	  URL safe base64-compatible codec.

	  https://github.com/dvv/base64url
```

## package/erlang-eimp/Config.in
```kconfig
config BR2_PACKAGE_ERLANG_EIMP
	bool "erlang-eimp"
	select BR2_PACKAGE_ERLANG_P1_UTILS
	select BR2_PACKAGE_GD
	select BR2_PACKAGE_GD_WEBPNG
	select BR2_PACKAGE_JPEG
	select BR2_PACKAGE_LIBPNG
	select BR2_PACKAGE_WEBP
	help
	  Erlang Image Manipulation Process

	  https://github.com/processone/eimp
```

## package/erlang-fast_tls/Config.in
```kconfig
config BR2_PACKAGE_ERLANG_FAST_TLS
	bool "erlang-fast_tls"
	select BR2_PACKAGE_ERLANG_P1_UTILS
	select BR2_PACKAGE_OPENSSL
	help
	  TLS / SSL OpenSSL-based native driver for Erlang / Elixir

	  https://github.com/processone/fast_tls
```

## package/erlang-goldrush/Config.in
```kconfig
config BR2_PACKAGE_ERLANG_GOLDRUSH
	bool "erlang-goldrush"
	help
	  Goldrush is a small Erlang app that provides fast event
	  stream processing.

	  https://github.com/DeadZen/goldrush
```

## package/erlang-idna/Config.in
```kconfig
config BR2_PACKAGE_ERLANG_IDNA
	bool "erlang-idna"
	help
	  A pure Erlang IDNA implementation that follows RFC5891.

	  https://github.com/benoitc/erlang-idna
```

## package/erlang-jiffy/Config.in
```kconfig
comment "erlang-jiffy needs a toolchain w/ C++"
	depends on !BR2_INSTALL_LIBSTDCPP

config BR2_PACKAGE_ERLANG_JIFFY
	bool "erlang-jiffy"
	depends on BR2_INSTALL_LIBSTDCPP
	help
	  JSON NIFs for Erlang.

	  https://github.com/davisp/jiffy
```

## package/erlang-jose/Config.in
```kconfig
config BR2_PACKAGE_ERLANG_JOSE
	bool "erlang-jose"
	select BR2_PACKAGE_ERLANG_BASE64URL
	help
	  JSON Object Signing and Encryption (JOSE) for Erlang and
	  Elixir.

	  https://github.com/potatosalad/erlang-jose
```

## package/erlang-p1-acme/Config.in
```kconfig
config BR2_PACKAGE_ERLANG_P1_ACME
	bool "erlang-p1-acme"
	depends on BR2_INSTALL_LIBSTDCPP # erlang-jiffy
	select BR2_PACKAGE_ERLANG_IDNA
	select BR2_PACKAGE_ERLANG_JIFFY
	select BR2_PACKAGE_ERLANG_JOSE
	select BR2_PACKAGE_ERLANG_P1_YCONF
	help
	  ACME client library for Erlang.

	  https://github.com/processone/p1_acme

comment "erlang-p1-acme needs a toolchain w/ C++"
	depends on !BR2_INSTALL_LIBSTDCPP
```

## package/erlang-p1-cache-tab/Config.in
```kconfig
config BR2_PACKAGE_ERLANG_P1_CACHE_TAB
	bool "erlang-p1-cache-tab"
	select BR2_PACKAGE_ERLANG_P1_UTILS
	help
	  Erlang library implementing cache tables

	  https://github.com/processone/cache_tab
```

## package/erlang-p1-iconv/Config.in
```kconfig
config BR2_PACKAGE_ERLANG_P1_ICONV
	bool "erlang-p1-iconv"
	select BR2_PACKAGE_LIBICONV if !BR2_ENABLE_LOCALE
	help
	  Erlang interface to libiconv

	  https://github.com/processone/eiconv
```

## package/erlang-p1-mqtree/Config.in
```kconfig
config BR2_PACKAGE_ERLANG_P1_MQTREE
	bool "erlang-p1-mqtree"
	select BR2_PACKAGE_ERLANG_P1_UTILS
	help
	  Index tree for MQTT topic filters.

	  https://github.com/processone/mqtree
```

## package/erlang-p1-oauth2/Config.in
```kconfig
config BR2_PACKAGE_ERLANG_P1_OAUTH2
	bool "erlang-p1-oauth2"
	help
	  OAuth2 library for Erlang

	  https://github.com/processone/p1_oauth2
```

## package/erlang-p1-pkix/Config.in
```kconfig
config BR2_PACKAGE_ERLANG_P1_PKIX
	bool "erlang-p1-pkix"
	help
	  PKIX certificates management library for Erlang.

	  https://github.com/processone/pkix
```

## package/erlang-p1-sip/Config.in
```kconfig
config BR2_PACKAGE_ERLANG_P1_SIP
	bool "erlang-p1-sip"
	select BR2_PACKAGE_ERLANG_P1_STUN
	select BR2_PACKAGE_ERLANG_P1_TLS
	select BR2_PACKAGE_ERLANG_P1_UTILS
	help
	  SIP library for Erlang

	  https://github.com/processone/p1_sip
```

## package/erlang-p1-stringprep/Config.in
```kconfig
comment "erlang-p1-stringprep needs a toolchain w/ C++"
	depends on !BR2_INSTALL_LIBSTDCPP

config BR2_PACKAGE_ERLANG_P1_STRINGPREP
	bool "erlang-p1-stringprep"
	depends on BR2_INSTALL_LIBSTDCPP
	help
	  Erlang interface to stringprep

	  https://github.com/processone/stringprep
```

## package/erlang-p1-stun/Config.in
```kconfig
config BR2_PACKAGE_ERLANG_P1_STUN
	bool "erlang-p1-stun"
	select BR2_PACKAGE_ERLANG_P1_TLS
	select BR2_PACKAGE_ERLANG_P1_UTILS
	help
	  STUN library for Erlang

	  https://github.com/processone/stun
```

## package/erlang-p1-tls/Config.in
```kconfig
config BR2_PACKAGE_ERLANG_P1_TLS
	bool "erlang-p1-tls"
	select BR2_PACKAGE_OPENSSL
	help
	  Erlang interface to OpenSSL

	  https://github.com/processone/tls
```

## package/erlang-p1-xml/Config.in
```kconfig
config BR2_PACKAGE_ERLANG_P1_XML
	bool "erlang-p1-xml"
	select BR2_PACKAGE_EXPAT
	help
	  XML utilities for Erlang

	  https://github.com/processone/xml
```

## package/erlang-p1-xmpp/Config.in
```kconfig
comment "erlang-p1-xmpp needs a toolchain w/ C++"
	depends on !BR2_INSTALL_LIBSTDCPP

config BR2_PACKAGE_ERLANG_P1_XMPP
	bool "erlang-p1-xmpp"
	depends on BR2_INSTALL_LIBSTDCPP # erlang-p1-stringprep
	select BR2_PACKAGE_ERLANG_P1_XML
	select BR2_PACKAGE_ERLANG_P1_STRINGPREP
	select BR2_PACKAGE_ERLANG_P1_TLS
	select BR2_PACKAGE_ERLANG_P1_UTILS
	select BR2_PACKAGE_ERLANG_P1_ZLIB
	help
	  XMPP library for Erlang.

	  https://github.com/processone/xmpp
```
