## package/erlang-p1-yaml/Config.in
```kconfig
config BR2_PACKAGE_ERLANG_P1_YAML
	bool "erlang-p1-yaml"
	select BR2_PACKAGE_ERLANG_P1_UTILS
	select BR2_PACKAGE_LIBYAML
	help
	  Erlang wrapper for libyaml C library

	  https://github.com/processone/p1_yaml
```

## package/erlang-p1-yconf/Config.in
```kconfig
config BR2_PACKAGE_ERLANG_P1_YCONF
	bool "erlang-p1-yconf"
	select BR2_PACKAGE_ERLANG_P1_YAML
	help
	  YAML configuration processor.
```

## package/erlang-p1-zlib/Config.in
```kconfig
config BR2_PACKAGE_ERLANG_P1_ZLIB
	bool "erlang-p1-zlib"
	select BR2_PACKAGE_ZLIB
	help
	  Erlang interface to zlib

	  https://github.com/processone/zlib
```

## package/erlang/Config.in
```kconfig
config BR2_PACKAGE_HOST_ERLANG_ARCH_SUPPORTS
	bool
	default y if BR2_HOSTARCH = "x86_64"
	default y if BR2_HOSTARCH = "x86"

config BR2_PACKAGE_ERLANG_ARCH_SUPPORTS
	bool
	# see HOWTO/INSTALL.md for Erlang's supported platforms
	# when using its native atomic ops implementation
	default y if BR2_i386 || BR2_x86_64 || BR2_powerpc || \
		BR2_sparc_v9 || BR2_arm || BR2_aarch64 || BR2_mipsel
	# erlang needs host-erlang
	depends on BR2_PACKAGE_HOST_ERLANG_ARCH_SUPPORTS

comment "erlang needs a toolchain w/ dynamic library"
	depends on BR2_USE_MMU # fork()
	depends on BR2_PACKAGE_ERLANG_ARCH_SUPPORTS
	depends on BR2_STATIC_LIBS

config BR2_PACKAGE_ERLANG
	bool "erlang"
	depends on BR2_USE_MMU # fork()
	depends on !BR2_STATIC_LIBS
	depends on BR2_PACKAGE_ERLANG_ARCH_SUPPORTS
	help
	  Erlang is a programming language used to build massively
	  scalable soft real-time systems with requirements on high
	  availability. Some of its uses are in telecoms, banking,
	  e-commerce, computer telephony and instant messaging.
	  Erlang's runtime system has built-in support for
	  concurrency, distribution and fault tolerance.

	  http://www.erlang.org

if BR2_PACKAGE_ERLANG

config BR2_PACKAGE_ERLANG_MEGACO
	bool "install megaco application"
	help
	  The Megaco application is a framework for building
	  applications on top of the Megaco/H.248 protocol. It is
	  approximately 14MB in size so if you do not need it then
	  it is recommended not to enable it.

endif # BR2_PACKAGE_ERLANG
```

## package/erofs-utils/Config.in
```kconfig
config BR2_PACKAGE_EROFS_UTILS
	bool "erofs-utils"
	help
	  Userspace utilities for EROFS filesystem

	  https://git.kernel.org/pub/scm/linux/kernel/git/xiang/erofs-utils.git

if BR2_PACKAGE_EROFS_UTILS

config BR2_PACKAGE_EROFS_UTILS_LZ4
	bool "lz4 support"
	select BR2_PACKAGE_LZ4
	help
	  Support LZ4 compression algorithm

endif
```

## package/erofs-utils/Config.in.host
```kconfig
config BR2_PACKAGE_HOST_EROFS_UTILS
	bool "host erofs-utils"
	help
	  Userspace utilities for EROFS filesystem

	  https://git.kernel.org/pub/scm/linux/kernel/git/xiang/erofs-utils.git
```

## package/espeak/Config.in
```kconfig
comment "espeak needs a toolchain w/ C++, wchar, threads, dynamic library"
	depends on !BR2_TOOLCHAIN_HAS_THREADS || !BR2_INSTALL_LIBSTDCPP || !BR2_USE_WCHAR || BR2_STATIC_LIBS
	depends on BR2_USE_MMU

config BR2_PACKAGE_ESPEAK
	bool "espeak"
	depends on BR2_INSTALL_LIBSTDCPP
	depends on BR2_USE_WCHAR
	depends on BR2_TOOLCHAIN_HAS_THREADS
	depends on BR2_USE_MMU # fork()
	# does not properly support building only a static version
	depends on !BR2_STATIC_LIBS
	help
	  espeak is a speech synthesizer software for English and
	  other languages.

	  http://espeak.sourceforge.net/

if BR2_PACKAGE_ESPEAK

choice
	prompt "choose audio backend"
	default BR2_PACKAGE_ESPEAK_AUDIO_BACKEND_NONE

config BR2_PACKAGE_ESPEAK_AUDIO_BACKEND_NONE
	bool "No sound backend, only produce wav files"

config BR2_PACKAGE_ESPEAK_AUDIO_BACKEND_ALSA
	bool "alsa via portaudio"
	# Selecting portaudio generates spurious "unmet dependencies"
	# warnings. Unless you are changing the dependencies of espeak
	# or portaudio, just ignore those spurious warnings.
	select BR2_PACKAGE_PORTAUDIO
	select BR2_PACKAGE_PORTAUDIO_CXX

config BR2_PACKAGE_ESPEAK_AUDIO_BACKEND_PULSEAUDIO
	bool "pulseaudio"
	select BR2_PACKAGE_PULSEAUDIO

endchoice

endif # BR2_PACKAGE_ESPEAK
```

## package/ethtool/Config.in
```kconfig
config BR2_PACKAGE_ETHTOOL
	bool "ethtool"
	help
	  ethtool is a small utility for examining and tuning your
	  ethernet-based network interface.

	  https://www.kernel.org/pub/software/network/ethtool/
```

## package/eudev/Config.in
```kconfig
config BR2_PACKAGE_EUDEV
	bool "eudev"
	depends on BR2_ROOTFS_DEVICE_CREATION_DYNAMIC_EUDEV
	depends on BR2_USE_MMU # uses fork()
	depends on BR2_USE_WCHAR # needs C99 compiler
	depends on !BR2_STATIC_LIBS # kmod
	select BR2_PACKAGE_HAS_UDEV
	select BR2_PACKAGE_UTIL_LINUX
	select BR2_PACKAGE_UTIL_LINUX_LIBBLKID
	select BR2_PACKAGE_KMOD
	help
	  eudev is a fork of systemd-udev with the goal of obtaining better
	  compatibility with existing software such as OpenRC and Upstart,
	  older kernels, various toolchains and anything else required by
	  users and various distributions.

	  https://wiki.gentoo.org/wiki/Project:Eudev

if BR2_PACKAGE_EUDEV

config BR2_PACKAGE_PROVIDES_UDEV
	default "eudev"

config BR2_PACKAGE_EUDEV_RULES_GEN
	bool "enable rules generator"
	help
	  Enable persistent rules generator

config BR2_PACKAGE_EUDEV_ENABLE_HWDB
	bool "enable hwdb installation"
	default y
	help
	  Enables hardware database installation to /etc/udev/hwdb.d

endif

comment "eudev needs eudev /dev management"
	depends on BR2_USE_MMU
	depends on !BR2_ROOTFS_DEVICE_CREATION_DYNAMIC_EUDEV

comment "eudev needs a toolchain w/ wchar, dynamic library"
	depends on BR2_USE_MMU
	depends on !BR2_USE_WCHAR || BR2_STATIC_LIBS
```

## package/eudev/Config.in.host
```kconfig
# Select this if you need host eudev tools (e.g. udevadm)
config BR2_PACKAGE_HOST_EUDEV
	bool
```

## package/ev3dev-linux-drivers/Config.in
```kconfig
# Prompt-less option, because this package is not doing anything except
# downloading the ev3dev driver sources. The real work is done by a Linux
# extension.
config BR2_PACKAGE_EV3DEV_LINUX_DRIVERS
	bool
	depends on BR2_LINUX_KERNEL
	help
	  Linux drivers for LEGO MINDSTORMS EV3

	  This is only the download helper for the kernel patch.

	  https://github.com/ev3dev/lego-linux-drivers
```

## package/evemu/Config.in
```kconfig
config BR2_PACKAGE_EVEMU
	bool "evemu"
	select BR2_PACKAGE_LIBEVDEV
	help
	  evemu records and replays device descriptions and events

	  http://www.freedesktop.org/wiki/Evemu/
```

## package/evtest/Config.in
```kconfig
config BR2_PACKAGE_EVTEST
	bool "evtest"
	help
	  evtest displays information on the input device specified on
	  the command line, including all the events supported by the
	  device. It then monitors the device and displays all the
	  events layer events generated.

	  http://cgit.freedesktop.org/evtest
```

## package/execline/Config.in
```kconfig
config BR2_PACKAGE_EXECLINE
	bool "execline"
	depends on BR2_USE_MMU # skalibs
	select BR2_PACKAGE_SKALIBS
	help
	  execline is a (non-interactive) scripting language, like sh;
	  but its syntax is quite different from a traditional shell
	  syntax. The execlineb program is meant to be used as an
	  interpreter for a text file; the other commands are
	  essentially useful inside an execlineb script.

	  http://skarnet.org/software/execline/
```

## package/exempi/Config.in
```kconfig
config BR2_PACKAGE_EXEMPI
	bool "exempi"
	depends on !BR2_STATIC_LIBS # dlfcn.h
	depends on BR2_INSTALL_LIBSTDCPP
	depends on BR2_TOOLCHAIN_HAS_THREADS
	depends on BR2_USE_WCHAR
	select BR2_PACKAGE_EXPAT
	select BR2_PACKAGE_LIBICONV if !BR2_ENABLE_LOCALE
	select BR2_PACKAGE_ZLIB
	help
	  Exempi is an implementation of XMP (Extensible Metadata
	  Platform). Version 2.x is based on Adobe XMP SDK.

	  http://libopenraw.freedesktop.org/wiki/Exempi

comment "exempi needs a toolchain w/ C++, dynamic library, threads, wchar"
	depends on BR2_STATIC_LIBS || !BR2_INSTALL_LIBSTDCPP || \
		!BR2_TOOLCHAIN_HAS_THREADS || !BR2_USE_WCHAR
```

## package/exfat-utils/Config.in
```kconfig
config BR2_PACKAGE_EXFAT_UTILS
	bool "exfat-utils"
	depends on BR2_USE_WCHAR
	help
	  exFAT filesystem utilities.

	  This is the set of user-space utilities that go together
	  with the FUSE-based exfat driver from package/exfat.

	  If you're using the exfat driver from the official Linux
	  kernel (merged as of Linux 5.7), you must use the user-space
	  utilities from package/exfatprogs.

	  https://github.com/relan/exfat

comment "exfat-utils needs a toolchain w/ wchar"
	depends on !BR2_USE_WCHAR
```

## package/exfat/Config.in
```kconfig
config BR2_PACKAGE_EXFAT
	bool "exFAT (FUSE)"
	depends on BR2_LARGEFILE # libfuse
	depends on BR2_TOOLCHAIN_HAS_THREADS # libfuse
	depends on BR2_USE_MMU # libfuse
	depends on BR2_USE_WCHAR
	depends on !BR2_PREFER_STATIC_LIB # libfuse
	select BR2_PACKAGE_LIBFUSE
	help
	  A full-featured exFAT file system implementation for GNU/Linux
	  and other Unix-like systems as a FUSE module.

	  http://code.google.com/p/exfat/

comment "exfat requires a toolchain with LARGEFILE, WCHAR, threads and dynamic library support"
	depends on !BR2_LARGEFILE || !BR2_TOOLCHAIN_HAS_THREADS || !BR2_USE_WCHAR || BR2_PREFER_STATIC_LIB
```

## package/exfatprogs/Config.in
```kconfig
config BR2_PACKAGE_EXFATPROGS
	bool "exfatprogs"
	depends on BR2_USE_WCHAR
	help
	  exFAT filesystem userspace utilities.

	  This is the set of tools that works together with the exfat
	  driver in the official Linux kernel (merged in Linux 5.7).

	  If you're using the FUSE-based exfat support (from
	  package/exfat), you must use the corresponding user-space
	  programs in package/exfat-utils.

	  https://github.com/exfatprogs/exfatprogs

comment "exfatprogs needs a toolchain w/ wchar"
	depends on !BR2_USE_WCHAR
```

## package/exfatprogs/Config.in.host
```kconfig
config BR2_PACKAGE_HOST_EXFATPROGS
	bool "host exfatprogs"
	help
	  exFAT filesystem userspace utilities

	  This is the set of tools that works together with the exfat
	  driver in the official Linux kernel (merged in Linux 5.7).

	  If you're using the FUSE-based exfat support (from
	  package/exfat), you must use the corresponding user-space
	  programs in package/exfat-utils.

	  https://github.com/exfatprogs/exfatprogs
```

## package/exim/Config.in
```kconfig
config BR2_PACKAGE_EXIM
	bool "exim"
	depends on BR2_USE_MMU # fork()
	select BR2_PACKAGE_PCRE
	select BR2_PACKAGE_BERKELEYDB
	help
	  Exim is a message transfer agent (MTA) developed at the University of
	  Cambridge for use on Unix systems connected to the Internet.

	  http://www.exim.org/

if BR2_PACKAGE_EXIM

config BR2_PACKAGE_EXIM_CUSTOM_CONFIG_FILE
	string "Custom configuration file"
	help
	  By default, when this option is left empty, Buildroot
	  generates a configuration file for exim with reasonable
	  settings.

	  If you want to override the configuration file generated by
	  Buildroot with a customized file, set here the path to your
	  configuration file with this option.

	  This file shall comply with the syntax defined in the exim
	  documentation (http://www.exim.org/docs.html).
	  Buildroot will generate a configuration file composed of the
	  content of the file you provide plus the toolchain-related
	  settings needed for cross-compilation.

endif
```

## package/exiv2/Config.in
```kconfig
comment "exiv2 needs a uClibc or glibc toolchain w/ C++, wchar, dynamic library, threads"
	depends on BR2_STATIC_LIBS || !BR2_INSTALL_LIBSTDCPP \
		|| !BR2_USE_WCHAR || !BR2_TOOLCHAIN_HAS_THREADS \
		|| BR2_TOOLCHAIN_USES_MUSL

config BR2_PACKAGE_EXIV2
	bool "exiv2"
	depends on !BR2_STATIC_LIBS
	depends on BR2_INSTALL_LIBSTDCPP
	depends on BR2_TOOLCHAIN_HAS_THREADS
	depends on !BR2_TOOLCHAIN_USES_MUSL # PTHREAD_RECURSIVE_MUTEX_INITIALIZER_NP
	depends on BR2_USE_WCHAR
	help
	  Exiv2 is a C++ library and a command line utility to manage
	  image metadata. It provides fast and easy read and write
	  access to the Exif, IPTC and XMP metadata of images in
	  various formats.

	  http://www.exiv2.org/

if BR2_PACKAGE_EXIV2

config BR2_PACKAGE_EXIV2_PNG
	bool "PNG image support"
	select BR2_PACKAGE_ZLIB
	help
	  Build with PNG image support

config BR2_PACKAGE_EXIV2_XMP
	bool "XMP support"
	select BR2_PACKAGE_EXPAT
	help
	  Build with XMP support

config BR2_PACKAGE_EXIV2_LENSDATA
	bool "Nikon lens name database"
	help
	  Integrate Nikon lens name database.

	  This database comes from a thirdparty and is free to use in
	  non-commercial, GPL or open source software only.
	  For more informations src/nikonmn_int.cpp.

endif
```

## package/expect/Config.in
```kconfig
config BR2_PACKAGE_EXPECT
	bool "expect"
	help
	  Expect is a tool for automating interactive applications
	  such as telnet, ftp, passwd, fsck, rlogin, ssh, tip, etc.

	  http://expect.sourceforge.net/
```

## package/expedite/Config.in
```kconfig
config BR2_PACKAGE_EXPEDITE
	bool "expedite"
	depends on BR2_PACKAGE_EFL
	depends on BR2_INSTALL_LIBSTDCPP
	help
	  Expedite is the official Evas benchmark tool. It can test
	  different engines, such as X11, XRender, OpenGL (also ES
	  variant), SDL, DirectFB and so on. Its tests are quite
	  extensive, trying to reproduce real world usage cases.

comment "expedite needs a toolchain w/ C++"
	depends on !BR2_INSTALL_LIBSTDCPP
```

## package/ezxml/Config.in
```kconfig
config BR2_PACKAGE_EZXML
	bool "ezxml"
	help
	  ezXML is a XML parser C library that is simple and easy to
	  use.

	  http://ezxml.sf.net
```
