## package/f2fs-tools/Config.in
```kconfig
config BR2_PACKAGE_F2FS_TOOLS
	bool "f2fs-tools"
	depends on BR2_USE_WCHAR # uses wchar_t
	select BR2_PACKAGE_UTIL_LINUX
	select BR2_PACKAGE_UTIL_LINUX_LIBUUID
	help
	  Tools for Flash-Friendly File System (F2FS)

	  https://git.kernel.org/pub/scm/linux/kernel/git/jaegeuk/f2fs-tools.git

comment "f2fs-tools needs a toolchain w/ wchar"
	depends on !BR2_USE_WCHAR
```

## package/f2fs-tools/Config.in.host
```kconfig
config BR2_PACKAGE_HOST_F2FS_TOOLS
	bool "host f2fs-tools"
	select BR2_PACKAGE_HOST_UTIL_LINUX
	help
	  Tools for Flash-Friendly File System (F2FS)

	  https://git.kernel.org/pub/scm/linux/kernel/git/jaegeuk/f2fs-tools.git
```

## package/faifa/Config.in
```kconfig
config BR2_PACKAGE_FAIFA
	bool "faifa"
	select BR2_PACKAGE_LIBPCAP
	depends on !BR2_STATIC_LIBS
	depends on BR2_TOOLCHAIN_HAS_THREADS
	help
	  Faifa can configure any Intellon-based Power Line
	  Communication device using Intellon INT5000 and INT6000
	  series chips (6000 and 6300 chips). It supports all
	  Intellon-specific management and control frames as well as
	  standard management frames.

	  https://dev.open-plc.org

comment "faifa needs a toolchain w/ dynamic library, threads"
	depends on BR2_STATIC_LIBS || !BR2_TOOLCHAIN_HAS_THREADS
```

## package/fail2ban/Config.in
```kconfig
config BR2_PACKAGE_FAIL2BAN
	bool "fail2ban"
	depends on BR2_PACKAGE_PYTHON || BR2_PACKAGE_PYTHON3
	select BR2_PACKAGE_PYTHON_SYSTEMD if BR2_PACKAGE_SYSTEMD
	help
	  Fail2ban scans log files (e.g. /var/log/apache/error_log) and
	  bans IPs that show the malicious signs -- too many password
	  failures, seeking for exploits, etc. Out of the box Fail2Ban
	  comes with filters for various services (apache, courier,
	  ssh, etc).

	  Fail2Ban is able to reduce the rate of incorrect
	  authentications attempts however it cannot eliminate the risk
	  that weak authentication presents.

	  https://www.fail2ban.org
```

## package/fakeroot/Config.in
```kconfig
config BR2_PACKAGE_FAKEROOT
	bool "fakeroot"
	help
	  Run commands in an environment faking root privileges.

	  http://joostje.op.het.net/fakeroot/
```

## package/faketime/Config.in.host
```kconfig
config BR2_PACKAGE_HOST_FAKETIME
	bool "host faketime"
	help
	  Faketime reports faked system time to programs without
	  having to change the system-wide time.

	  https://github.com/wolfcw/libfaketime
```

## package/fan-ctrl/Config.in
```kconfig
config BR2_PACKAGE_FAN_CTRL
	bool "fan-ctrl"
	depends on BR2_USE_MMU # fork()
	help
	  Fan-ctrl is a little daemon that controls the speed of one
	  or more system or CPU fans. It does so by monitoring
	  temperature inputs and selecting a fan speed from an array
	  of available speeds based on a set of temperature
	  thresholds.

	  http://fan-ctrl.sourceforge.net/
```

## package/fastd/Config.in
```kconfig
config BR2_PACKAGE_FASTD
	bool "fastd"
	depends on BR2_USE_MMU # fork()
	depends on BR2_TOOLCHAIN_HAS_THREADS
	depends on BR2_TOOLCHAIN_HEADERS_AT_LEAST_3_0 # libcap
	depends on !BR2_STATIC_LIBS # libuecc
	select BR2_PACKAGE_LIBUECC
	select BR2_PACKAGE_LIBSODIUM
	select BR2_PACKAGE_LIBCAP
	help
	  Fast and Secure Tunneling Daemon

	  https://projects.universe-factory.net/projects/fastd/wiki

if BR2_PACKAGE_FASTD

config BR2_PACKAGE_FASTD_STATUS_SOCKET
	bool "status socket support"
	default y
	select BR2_PACKAGE_JSON_C
	help
	  Enable support for a socket to get fastd's status.

endif

comment "fastd needs a toolchain w/ threads, headers >= 3.0, dynamic library"
	depends on BR2_USE_MMU
	depends on !BR2_TOOLCHAIN_HAS_THREADS \
		|| !BR2_TOOLCHAIN_HEADERS_AT_LEAST_3_0 \
		|| BR2_STATIC_LIBS
```

## package/fatcat/Config.in.host
```kconfig
config BR2_PACKAGE_HOST_FATCAT
	bool "host fatcat"
	help
	  Fatcat is designed to manipulate FAT filesystems, in order
	  to explore, extract, repair, recover and forensic them. It
	  currently supports FAT12, FAT16 and FAT32.

	  https://github.com/Gregwar/fatcat
```

## package/fb-test-app/Config.in
```kconfig
config BR2_PACKAGE_FB_TEST_APP
	bool "fb-test-app"
	help
	  Test suite for Linux framebuffer.

	  https://github.com/prpplague/fb-test-app
```

## package/fbdump/Config.in
```kconfig
config BR2_PACKAGE_FBDUMP
	bool "fbdump (Framebuffer Capture Tool)"
	help
	  fbdump is a simple tool to capture snapshots from the Linux kernel
	  framebuffer  device and write them out as a PPM file. Currently,
	  most packed-pixel framebuffer formats and the vga16 framebuffer
	  are supported.

	  http://www.rcdrummond.net/fbdump
```

## package/fbgrab/Config.in
```kconfig
config BR2_PACKAGE_FBGRAB
	bool "fbgrab"
	select BR2_PACKAGE_LIBPNG
	help
	  FBGrab is a framebuffer screenshot program, capturing the
	  linux frambuffer and converting it to a png-picture.

	  https://github.com/GunnarMonell/fbgrab
```

## package/fbset/Config.in
```kconfig
config BR2_PACKAGE_FBSET
	bool "fbset"
	depends on BR2_PACKAGE_BUSYBOX_SHOW_OTHERS
	help
	  Fbset is a system utility to show or change the settings of
	  the frame buffer device. The frame buffer device provides a
	  simple and unique interface to access different kinds of
	  graphic displays.

	  http://users.telenet.be/geertu/Linux/fbdev/
```

## package/fbterm/Config.in
```kconfig
config BR2_PACKAGE_FBTERM
	bool "fbterm"
	depends on (BR2_INSTALL_LIBSTDCPP && BR2_ENABLE_LOCALE && BR2_USE_WCHAR)
	select BR2_PACKAGE_FONTCONFIG
	select BR2_PACKAGE_LIBERATION
	help
	  fbterm is a fast terminal emulator for Linux with frame buffer
	  device or VESA video card.

	  http://code.google.com/p/fbterm/

comment "fbterm needs a toolchain w/ C++, wchar, locale"
	depends on !(BR2_INSTALL_LIBSTDCPP && BR2_ENABLE_LOCALE && BR2_USE_WCHAR)
```

## package/fbtft/Config.in
```kconfig
# Prompt-less option, because this package is not doing anything
# except downloading the FB TFT sources. The real work is done by a
# Linux extension.
config BR2_PACKAGE_FBTFT
	bool
	depends on BR2_LINUX_KERNEL
	help
	  Linux Framebuffer drivers for small TFT LCD display modules,
	  e.g. Adafruit PiTFT displays for Raspberry Pi.

	  This is only the download helper for the kernel patch.

	  https://github.com/notro/fbtft
```

## package/fbv/Config.in
```kconfig
config BR2_PACKAGE_FBV
	bool "fbv"
	help
	  fbv is a very simple graphic file viewer for the framebuffer
	  console, capable of displaying GIF, JPEG, PNG and BMP files
	  using libungif, libjpeg and libpng.

	  http://freshmeat.net/projects/fbv/

if BR2_PACKAGE_FBV

config BR2_PACKAGE_FBV_PNG
	bool "PNG support"
	default y
	select BR2_PACKAGE_LIBPNG
	help
	  Enable support for PNG using libpng.

config BR2_PACKAGE_FBV_JPEG
	bool "JPEG support"
	default y
	select BR2_PACKAGE_JPEG
	help
	  Enable support for JPEG using IJG's libjpeg.

config BR2_PACKAGE_FBV_GIF
	bool "GIF support"
	default y
	select BR2_PACKAGE_GIFLIB
	help
	  Enable support for GIF using giflib.

endif # BR2_PACKAGE_FBV
```

## package/fcgiwrap/Config.in
```kconfig
config BR2_PACKAGE_FCGIWRAP
	bool "fcgiwrap"
	depends on BR2_USE_MMU # libfcgi
	select BR2_PACKAGE_LIBFCGI
	help
	  fcgiwrap is a simple server for running CGI applications
	  over FastCGI. It hopes to provide clean CGI support to Nginx
	  (and other web servers that may need it).

	  https://nginx.localdomain.pl/wiki/FcgiWrap
```

## package/fconfig/Config.in
```kconfig
config BR2_PACKAGE_FCONFIG
	bool "fconfig"
	help
	  fconfig - get/set RedBoot configuration parameters from Linux.
```

## package/fdk-aac/Config.in
```kconfig
# These are the architectures supported by FDK AAC
config BR2_PACKAGE_FDK_AAC_ARCH_SUPPORTS
	bool
	default y if BR2_aarch64
	default y if BR2_arm || BR2_armeb
	default y if BR2_i386 || BR2_x86_64
	default y if BR2_mips || BR2_mipsel || BR2_mips64 || BR2_mips64el
	default y if BR2_powerpc
	default y if BR2_sh

config BR2_PACKAGE_FDK_AAC
	bool "fdk-aac"
	depends on BR2_PACKAGE_FDK_AAC_ARCH_SUPPORTS
	depends on BR2_INSTALL_LIBSTDCPP
	help
	  The Fraunhofer FDK AAC Codec Library for Android ("FDK AAC
	  Codec") is software that implements the MPEG Advanced Audio
	  Coding ("AAC") encoding and decoding scheme for digital audio

	  http://sourceforge.net/projects/opencore-amr/files/fdk-aac/

comment "fdk-aac needs a toolchain w/ C++"
	depends on BR2_PACKAGE_FDK_AAC_ARCH_SUPPORTS
	depends on !BR2_INSTALL_LIBSTDCPP
```

## package/feh/Config.in
```kconfig
config BR2_PACKAGE_FEH
	bool "feh"
	depends on BR2_PACKAGE_XORG7
	depends on BR2_USE_MMU # fork()
	select BR2_PACKAGE_XLIB_LIBXT
	select BR2_PACKAGE_IMLIB2
	select BR2_PACKAGE_IMLIB2_PNG
	select BR2_PACKAGE_IMLIB2_JPEG
	select BR2_PACKAGE_IMLIB2_X
	help
	  feh is an X11 image viewer aimed mostly at console users.

	  http://feh.finalrewind.org/
```

## package/festival/Config.in
```kconfig
menuconfig BR2_PACKAGE_FESTIVAL
bool "festival text-to-speech system"
default n
select BR2_PACKAGE_ALSA_LIB
select BR2_PACKAGE_SPEECH_TOOLS
help
	Text to speech system for Linux

if BR2_PACKAGE_FESTIVAL

	menu "speech tools"
		source "package/festival/speech-tools/Config.in"
	endmenu

	menu "festival lexicons"
		source "package/festival/lexicons/Config.in"
	endmenu

	menu "festival voices"
		source "package/festival/voices/Config.in"
	endmenu

endif
```

## package/festival/lexicons/Config.in
```kconfig
config BR2_PACKAGE_FESTLEX_CMU
	bool "Carnegie Mellon University"
	default n
	help
	  Lexicon for the festival text to speech system

	  http://festvox.org/packed/festival/latest

config BR2_PACKAGE_FESTLEX_OALD
	bool "Oxford Advanced Learners dictionary"
	default n
	help
	  Lexicon for the festival text to speech system

	  http://festvox.org/packed/festival/latest

config BR2_PACKAGE_FESTLEX_POS
	bool "POSLEX"
	default n
	help
	  Lexicon for the festival text to speech system

	  http://festvox.org/packed/festival/latest
```

## package/festival/speech-tools/Config.in
```kconfig
 config BR2_PACKAGE_SPEECH_TOOLS
	bool "speech tools for festival"
	default n
	help
	  Speech tools for the festival text to speech system

	  http://festvox.org/packed/festival/latest
```

## package/festival/voices/Config.in
```kconfig
config BR2_PACKAGE_FESTVOX_AWB
	bool "Alan Scottish English"
	help
	  Scottish English voice for the festival text to speech system

	  http://festvox.org/packed/festival/latest

config BR2_PACKAGE_FESTVOX_BDL
	bool "Brian US English"
	help
	  US English male voice for the festival text to speech system

	  http://festvox.org/packed/festival/latest

config BR2_PACKAGE_FESTVOX_JMK
	bool "John Canadian English"
	help
	  Canadian English voice for the festival text to speech system

	  http://festvox.org/packed/festival/latest

config BR2_PACKAGE_FESTVOX_SLT
	bool "Stephanie US English"
	help
	  US English female voice for the festival text to speech system

	  http://festvox.org/packed/festival/latest

config BR2_PACKAGE_FESTVOX_AWB_MULTISYN
	bool "Alan multisyn (big file)"
	help
	  voice for the festival text to speech system

	  http://festvox.org/packed/festival/latest

config BR2_PACKAGE_FESTVOX_JMK_MULTISYN
	bool "John multisyn (big file)"
	help
	  voice for the festival text to speech system

	  http://festvox.org/packed/festival/latest

config BR2_PACKAGE_FESTVOX_KAL_SIXTEENK
	bool "Kevin diphone US English 16k"
	help
	  diphone voice for the festival text to speech system

	  http://festvox.org/packed/festival/latest

config BR2_PACKAGE_FESTVOX_KED_EIGHTK
	bool "Kurt diphone American English 8k"
	help
	  diphone voice for the festival text to speech system

	  http://festvox.org/packed/festival/latest

config BR2_PACKAGE_FESTVOX_KED_SIXTEENK
	bool "Kurt diphone American English 16k"
	help
	  diphone voice for the festival text to speech system

	  http://festvox.org/packed/festival/latest
```

## package/fetchmail/Config.in
```kconfig
config BR2_PACKAGE_FETCHMAIL
	bool "fetchmail"
	depends on BR2_USE_MMU # fork()
	select BR2_PACKAGE_CA_CERTIFICATES
	select BR2_PACKAGE_OPENSSL
	help
	  Fetchmail - the mail-retrieval daemon
	  Client daemon to move mail from POP and IMAP to your local computer

	  http://www.fetchmail.info/
```
