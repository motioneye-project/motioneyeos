## package/ffmpeg/Config.in
```kconfig
config BR2_PACKAGE_FFMPEG_ARCH_SUPPORTS
	bool
	# fenv.h lacks FE_INVALID, FE_OVERFLOW & FE_UNDERFLOW on nios2
	# No support for ARMv7-M in the ARM assembly logic
	# Microblaze build affected by gcc PR71124 (infinite loop)
	# m68k coldfire causes a build failure, because the check for
	# atomics (atomic_store) succeeds, which causes ffmpeg to
	# think atomic intrinsics are available, while they are
	# not. See https://patchwork.ozlabs.org/patch/756664/ and
	# https://gcc.gnu.org/bugzilla/show_bug.cgi?id=68467 for more
	# details.
	default y if !BR2_nios2 && !BR2_ARM_CPU_ARMV7M && !BR2_microblaze && !BR2_m68k_cf

menuconfig BR2_PACKAGE_FFMPEG
	bool "ffmpeg"
	depends on BR2_PACKAGE_FFMPEG_ARCH_SUPPORTS
	help
	  FFmpeg is a complete, cross-platform solution to record, convert
	  and stream audio and video.

	  http://www.ffmpeg.org

if BR2_PACKAGE_FFMPEG

config BR2_PACKAGE_FFMPEG_GPL
	bool "Enable GPL code"
	help
	  allow use of GPL code, the resulting libs and binaries will
	  be under GPL

config BR2_PACKAGE_FFMPEG_NONFREE
	bool "Enable nonfree code"
	help
	  allow use of nonfree code, the resulting libs and binaries
	  will be unredistributable

config BR2_PACKAGE_FFMPEG_FFMPEG
	bool "Build ffmpeg (the command line application)"
	default y
	help
	  FFmpeg is a very fast video and audio converter.
	  It can also grab from a live audio/video source.

	  It is not needed if you want to link the FFmpeg libraries
	  to your application.

config BR2_PACKAGE_FFMPEG_FFPLAY
	bool "Build ffplay"
	depends on !BR2_STATIC_LIBS # sdl2
	select BR2_PACKAGE_FFMPEG_SWSCALE
	select BR2_PACKAGE_SDL2
	help
	  FFplay is a very simple and portable media player using the
	  FFmpeg libraries and the SDL library.
	  It is mostly used as a testbed for the various FFmpeg APIs.

comment "ffplay needs a toolchain w/ dynamic library"
	depends on BR2_STATIC_LIBS

config BR2_PACKAGE_FFMPEG_FFSERVER
	bool "Build ffserver"
	depends on BR2_USE_MMU # fork()
	help
	  FFserver is a streaming server for both audio and video.

config BR2_PACKAGE_FFMPEG_FFPROBE
	bool "Build ffprobe"
	help
	  FFprobe is a utility to determine the audio and video
	  characteristics of a container file.

config BR2_PACKAGE_FFMPEG_AVRESAMPLE
	bool "Build libavresample"
	help
	  Avresample is a audio conversion library for compatibility.

config BR2_PACKAGE_FFMPEG_POSTPROC
	bool "Build libpostproc"
	depends on BR2_PACKAGE_FFMPEG_GPL
	help
	  Postproc is a library of video postprocessing routines.

config BR2_PACKAGE_FFMPEG_SWSCALE
	bool "Build libswscale"
	help
	  Swscale is a library of video scaling routines.

config BR2_PACKAGE_FFMPEG_ENCODERS
	string "Enabled encoders"
	default "all"
	help
	  Space-separated list of encoders to build in FFmpeg,
	  or "all" to build all of them.

	  Run ./configure --list-encoders in the ffmpeg sources
	  directory to know the available options.

config BR2_PACKAGE_FFMPEG_DECODERS
	string "Enabled decoders"
	default "all"
	help
	  Space-separated list of decoders to build in FFmpeg,
	  or "all" to build all of them.

	  Run ./configure --list-decoders in the ffmpeg sources
	  directory to know the available options.

config BR2_PACKAGE_FFMPEG_MUXERS
	string "Enabled muxers"
	default "all"
	help
	  Space-separated list of muxers to build in FFmpeg,
	  or "all" to build all of them.

	  Run ./configure --list-muxers in the ffmpeg sources
	  directory to know the available options.

config BR2_PACKAGE_FFMPEG_DEMUXERS
	string "Enabled demuxers"
	default "all"
	help
	  Space-separated list of demuxers to build in FFmpeg,
	  or "all" to build all of them.

	  Run ./configure --list-demuxers in the ffmpeg sources
	  directory to know the available options.

config BR2_PACKAGE_FFMPEG_PARSERS
	string "Enabled parsers"
	default "all"
	help
	  Space-separated list of parsers to build in FFmpeg,
	  or "all" to build all of them.

	  Run ./configure --list-parsers in the ffmpeg sources
	  directory to know the available options.

config BR2_PACKAGE_FFMPEG_BSFS
	string "Enabled bitstreams"
	default "all"
	help
	  Space-separated list of bitstream filters to build in FFmpeg,
	  or "all" to build all of them.

	  Run ./configure --list-bsfs in the ffmpeg sources
	  directory to know the available options.

config BR2_PACKAGE_FFMPEG_PROTOCOLS
	string "Enabled protocols"
	default "all"
	help
	  Space-separated list of protocols to build in FFmpeg,
	  or "all" to build all of them.

	  Run ./configure --list-protocols in the ffmpeg sources
	  directory to know the available options.

config BR2_PACKAGE_FFMPEG_FILTERS
	string "Enabled filters"
	default "all"
	help
	  Space-separated list of filters to build in FFmpeg,
	  or "all" to build all of them.

	  Run ./configure --list-filters in the ffmpeg sources
	  directory to know the available options.

config BR2_PACKAGE_FFMPEG_INDEVS
	bool "Enable input devices"
	default y

config BR2_PACKAGE_FFMPEG_OUTDEVS
	bool "Enable output devices"
	default y

config BR2_PACKAGE_FFMPEG_EXTRACONF
	string "Additional parameters for ./configure"
	default ""
	help
	  Extra parameters that will be appended to FFmpeg's
	  ./configure commandline.

endif
```

## package/fftw/Config.in
```kconfig
config BR2_PACKAGE_FFTW
	bool "fftw"
	select BR2_PACKAGE_FFTW_DOUBLE if !BR2_PACKAGE_FFTW_SINGLE \
		&& !BR2_PACKAGE_FFTW_LONG_DOUBLE && !BR2_PACKAGE_FFTW_QUAD
	help
	  Library for computing Fast Fourier Transforms.

	  This library computes Fast Fourier Transforms (FFT) in one
	  or more dimensions. It is extremely fast. This package
	  contains the shared library version of the fftw libraries in
	  double precision.

	  http://www.fftw.org

if BR2_PACKAGE_FFTW

source "package/fftw/fftw-single/Config.in"
source "package/fftw/fftw-double/Config.in"
source "package/fftw/fftw-long-double/Config.in"
source "package/fftw/fftw-quad/Config.in"

config BR2_PACKAGE_FFTW_FAST
	bool "optimise for speed over accuracy"
	help
	  Optimise for fast math functions, at the expense of accuracy.

	  Say 'y' if you need speed and can live with inaccuracies in
	  the results. Say 'n' (the default) if accuracy is of utmost
	  importance.

	  This basically uses gcc's -Ofast optimisation level, which in
	  turn is basically using gcc's -ffast-math. See the gcc manual
	  for what this means.

endif
```

## package/fftw/fftw-double/Config.in
```kconfig
config BR2_PACKAGE_FFTW_DOUBLE
	bool "fftw-double"
	help
	  Compile fftw in double precision (the default), i.e. use
	  'double' for floating point type.
```

## package/fftw/fftw-long-double/Config.in
```kconfig
config BR2_PACKAGE_FFTW_LONG_DOUBLE
	bool "fftw-long-double"
	# long-double precision require long-double trigonometric routines
	depends on !(BR2_TOOLCHAIN_USES_UCLIBC && \
		(BR2_arm || BR2_mips || BR2_mipsel))
	help
	  Compile fftw in long double precision, i.e. use 'long double'
	  for floating point type.
```

## package/fftw/fftw-quad/Config.in
```kconfig
config BR2_PACKAGE_FFTW_QUAD
	bool "fftw-quad"
	# quad-precision needs to have a gcc with libquadmath
	depends on BR2_TOOLCHAIN_HAS_LIBQUADMATH && BR2_USE_WCHAR
	help
	  Compile fftw in quadruple precision, i.e. use '__float128' for
	  floating point type.
```

## package/fftw/fftw-single/Config.in
```kconfig
config BR2_PACKAGE_FFTW_SINGLE
	bool "fftw-single"
	help
	  Compile fftw in single precision, i.e. use 'float'
	  for floating point type.
```

## package/ficl/Config.in
```kconfig
config BR2_PACKAGE_FICL
	bool "ficl"
	help
	  Ficl is a programming language interpreter designed to be
	  embedded into other systems as a command, macro, and
	  development prototyping language.
	  Ficl is an acronym for "Forth Inspired Command Language".

	  http://ficl.sourceforge.net
```

## package/file/Config.in
```kconfig
config BR2_PACKAGE_FILE
	bool "file"
	help
	  Program to identify a file's format by scanning binary data
	  for known patterns.

	  http://www.darwinsys.com/file/
```

## package/filemq/Config.in
```kconfig
config BR2_PACKAGE_FILEMQ
	bool "filemq"
	depends on BR2_INSTALL_LIBSTDCPP # zeromq
	depends on BR2_TOOLCHAIN_HAS_THREADS_NPTL # zeromq
	depends on BR2_USE_MMU # czmq
	select BR2_PACKAGE_OPENSSL
	select BR2_PACKAGE_CZMQ
	select BR2_PACKAGE_ZEROMQ
	help
	  FileMQ is a publish-subscribe file service based on 0MQ.

	  http://github.com/zeromq/filemq

comment "filemq needs a toolchain w/ C++, NPTL"
	depends on BR2_USE_MMU
	depends on !(BR2_INSTALL_LIBSTDCPP && BR2_TOOLCHAIN_HAS_THREADS_NPTL)
```

## package/findutils/Config.in
```kconfig
config BR2_PACKAGE_FINDUTILS
	bool "findutils"
	depends on BR2_USE_WCHAR
	help
	  Basic directory searching utilities.  Provides the
	  common 'find', 'xargs', 'locate', and 'updatedb' binaries.

	  http://www.gnu.org/software/findutils/findutils.html

comment "findutils requires a toolchain with WCHAR support"
	depends on !BR2_USE_WCHAR
```

## package/fio/Config.in
```kconfig
config BR2_PACKAGE_FIO
	bool "fio"
	depends on BR2_USE_MMU # fork()
	depends on !BR2_STATIC_LIBS
	depends on BR2_TOOLCHAIN_HAS_SYNC_4
	depends on BR2_TOOLCHAIN_HAS_THREADS
	# fio uses fallocate() which becomes fallocate64() while compiling with
	# largefile support, but fallocate64() is not available on nios2
	depends on !BR2_nios2
	help
	  fio is an I/O tool meant to be used both for benchmark
	  and stress/hardware verification.

	  http://git.kernel.dk/?p=fio.git;a=summary

comment "fio needs a toolchain w/ dynamic library, threads"
	depends on !BR2_TOOLCHAIN_HAS_THREADS || BR2_STATIC_LIBS
	depends on BR2_TOOLCHAIN_HAS_SYNC_4
	depends on !BR2_nios2
	depends on BR2_USE_MMU
```

## package/firejail/Config.in
```kconfig
config BR2_PACKAGE_FIREJAIL
	bool "firejail"
	depends on BROKEN # does not cross-compile at all
	depends on BR2_USE_MMU # fork()
	depends on BR2_TOOLCHAIN_HAS_THREADS
	# uClibc: error: ‘EM_ARM’ undeclared
	depends on !BR2_TOOLCHAIN_USES_UCLIBC
	help
	  Firejail is a SUID program that reduces the risk of security
	  breaches by restricting the running environment of untrusted
	  applications using Linux namespaces and seccomp-bpf. It
	  allows a process and all its descendants to have their own
	  private view of the globally shared kernel resources, such
	  as the network stack, process table, mount table.

	  https://firejail.wordpress.com/

comment "firejail needs a glibc or musl toolchain w/ threads"
	depends on BR2_USE_MMU
	depends on BROKEN
	depends on BR2_TOOLCHAIN_USES_UCLIBC || !BR2_TOOLCHAIN_HAS_THREADS
```

## package/firmware-imx/Config.in
```kconfig
config BR2_PACKAGE_FIRMWARE_IMX
	bool "firmware-imx"
	depends on BR2_arm # Only relevant for i.MX
	help
	  Firmware blobs for the Freescale i.MX SoCs.

	  It contains blobs for Atheros AR6003, SDMA and VPU.

	  Note: it also contains a blob for ar3k/30101 but upstream
	  linux-firmware has that as well.

	  This library is provided by Freescale as-is and doesn't have
	  an upstream.
```

## package/fis/Config.in
```kconfig
config BR2_PACKAGE_FIS
	bool "fis"
	help
	  fis - manipulate RedBoot partition table from Linux.
```

## package/flac/Config.in
```kconfig
config BR2_PACKAGE_FLAC
	bool "flac"
	depends on BR2_USE_WCHAR
	help
	  FLAC is an Open Source lossless audio codec.

	  http://flac.sourceforge.net/

comment "flac needs a toolchain w/ wchar"
	depends on !BR2_USE_WCHAR
```

## package/flann/Config.in
```kconfig
config BR2_PACKAGE_FLANN
	bool "flann"
	depends on BR2_INSTALL_LIBSTDCPP
	depends on !BR2_STATIC_LIBS
	# all gcc versions fail to build flann on Microblaze due to
	# gcc bug https://gcc.gnu.org/bugzilla/show_bug.cgi?id=69401
	depends on !BR2_microblaze
	help
	  FLANN is a library for performing fast approximate nearest
	  neighbor searches in high dimensional spaces. It contains a
	  collection of algorithms we found to work best for nearest
	  neighbor search and a system for automatically choosing the
	  best algorithm and optimum parameters depending on the
	  dataset.

	  http://www.cs.ubc.ca/research/flann/

if BR2_PACKAGE_FLANN

config BR2_PACKAGE_FLANN_EXAMPLES
	bool "flann examples"
	help
	  Build and install flann example applications.

endif

comment "flann needs a toolchain w/ C++, dynamic library"
	depends on !BR2_microblaze
	depends on !BR2_INSTALL_LIBSTDCPP || BR2_STATIC_LIBS
```

## package/flannel/Config.in
```kconfig
comment "flannel needs a toolchain w/ threads"
	depends on BR2_PACKAGE_HOST_GO_TARGET_ARCH_SUPPORTS
	depends on BR2_PACKAGE_HOST_GO_TARGET_CGO_LINKING_SUPPORTS
	depends on !BR2_TOOLCHAIN_HAS_THREADS

config BR2_PACKAGE_FLANNEL
	bool "flannel"
	depends on BR2_PACKAGE_HOST_GO_TARGET_ARCH_SUPPORTS
	depends on BR2_PACKAGE_HOST_GO_TARGET_CGO_LINKING_SUPPORTS
	depends on BR2_TOOLCHAIN_HAS_THREADS
	help
	  Flannel is a virtual network that gives a subnet to each
	  host for use with container runtimes.

	  https://github.com/coreos/flannel
```

## package/flare-engine/Config.in
```kconfig
config BR2_PACKAGE_FLARE_ENGINE
	bool "flare-engine"
	depends on BR2_INSTALL_LIBSTDCPP
	depends on !BR2_STATIC_LIBS # SDL2
	select BR2_PACKAGE_SDL2
	select BR2_PACKAGE_SDL2_IMAGE
	select BR2_PACKAGE_SDL2_MIXER
	select BR2_PACKAGE_SDL2_TTF
	help
	  Flare (Free Libre Action Roleplaying Engine) is a simple game
	  engine built to handle a very specific kind of game:
	  single-player 2D action RPGs.
	  Flare is not a reimplementation of an existing game or engine.
	  It is a tribute to and exploration of the action RPG genre.

	  http://flarerpg.org

comment "flare-engine needs a toolchain w/ C++, dynamic library"
	depends on !BR2_INSTALL_LIBSTDCPP || BR2_STATIC_LIBS
```

## package/flare-game/Config.in
```kconfig
config BR2_PACKAGE_FLARE_GAME
	bool "flare-game"
	depends on BR2_PACKAGE_FLARE_ENGINE
	help
	  Flare is an open source, 2D action RPG licensed under the
	  GPL3 license. Its game play can be likened to the games in
	  the Diablo series.

	  This package, flare-game, only contains the game data. The
	  game engine itself is part of a separate package,
	  flame-engine.

	  http://flarerpg.org
```

## package/flashbench/Config.in
```kconfig
config BR2_PACKAGE_FLASHBENCH
	bool "flashbench"
	help
	  Flashbench - Identify characteristics of flash media.

	  This is the tool used to identify the properties of
	  SD cards and other media for the Linaro flash memory
	  survey.

	  https://wiki.linaro.org/WorkingGroups/KernelConsolidation/Projects/FlashCardSurvey
```

## package/flashrom/Config.in
```kconfig
config BR2_PACKAGE_FLASHROM_ARCH_SUPPORTS
	bool
	default y if BR2_aarch64 || BR2_aarch64_be
	default y if BR2_arm || BR2_armeb
	default y if BR2_i386 || BR2_x86_64
	default y if BR2_m68k
	default y if BR2_mips || BR2_mipsel || BR2_mips64 || BR2_mips64el
	default y if BR2_powerpc || BR2_powerpc64 || BR2_powerpc64le
	default y if BR2_riscv
	default y if BR2_sh
	default y if BR2_sparc || BR2_sparc64

config BR2_PACKAGE_FLASHROM
	bool "flashrom"
	depends on BR2_PACKAGE_FLASHROM_ARCH_SUPPORTS
	help
	  flashrom is a utility for identifying, reading, writing,
	  verifying and erasing flash chips. It is designed to flash
	  BIOS/EFI/coreboot/firmware/optionROM images on mainboards,
	  network/graphics/storage controller cards, and various other
	  programmer devices.

	  http://flashrom.org/
```

## package/flatbuffers/Config.in
```kconfig
config BR2_PACKAGE_FLATBUFFERS
	bool "flatbuffers"
	depends on BR2_TOOLCHAIN_GCC_AT_LEAST_4_7 # C++11
	depends on BR2_INSTALL_LIBSTDCPP
	help
	  FlatBuffers is an efficient cross platform serialization
	  library for C++, C#, C, Go, Java, JavaScript, PHP, and
	  Python. It was originally created at Google for game
	  development and other performance-critical applications.

	  http://google.github.io/flatbuffers/

comment "flatbuffers needs a toolchain w/ C++, gcc >= 4.7"
	depends on !BR2_INSTALL_LIBSTDCPP || !BR2_TOOLCHAIN_GCC_AT_LEAST_4_7
```
