## package/flatcc/Config.in
```kconfig
config BR2_PACKAGE_FLATCC
	bool "flatcc"
	help
	  flatcc is C language implementation of Google Flatbuffers. It
	  consists of both a library for the target as well as a
	  flatbuffer compiler tool for the host.

	  https://github.com/dvidelabs/flatcc
```

## package/flex/Config.in
```kconfig
config BR2_PACKAGE_FLEX
	bool "flex"
	help
	  A fast lexical analyser generator. A tool for generating
	  programs that perform pattern-matching on text.

	  Only the library is available.

	  https://github.com/westes/flex/
```

## package/flickcurl/Config.in
```kconfig
config BR2_PACKAGE_FLICKCURL
	bool "flickcurl"
	select BR2_PACKAGE_LIBCURL
	select BR2_PACKAGE_LIBXML2
	# Ensure that libcurl is built with crypto support, since
	# flickcurl must access https:// URLs.
	select BR2_PACKAGE_OPENSSL if !(BR2_PACKAGE_GNUTLS || BR2_PACKAGE_LIBNSS)
	select BR2_PACKAGE_CA_CERTIFICATES # runtime
	help
	  Flickcurl is a C library for the Flickr API, handling
	  creating the requests, signing, token management, calling
	  the API, marshalling request parameters and decoding
	  responses.

	  http://librdf.org/flickcurl/

config BR2_PACKAGE_FLICKCURL_UTILS
	bool "flickcurl utilities"
	depends on BR2_PACKAGE_FLICKCURL
	help
	  Install flickcurl utilites (flickcurl + flickrdf) to target.
```
