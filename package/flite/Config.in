## package/freescale-imx/Config.in
```kconfig
menuconfig BR2_PACKAGE_FREESCALE_IMX
	bool "Freescale i.MX libraries"
	depends on BR2_arm || BR2_aarch64
	help
	  Those packages provide hardware acceleration for GPU or VPU,
	  hardware optimization or some hardware tools for Freescale
	  i.MX platforms.

if BR2_PACKAGE_FREESCALE_IMX
choice
	prompt "i.MX platform"

config BR2_PACKAGE_FREESCALE_IMX_PLATFORM_IMX25_3STACK
	bool "imx25-3stack"

config BR2_PACKAGE_FREESCALE_IMX_PLATFORM_IMX27ADS
	bool "imx27ads"

config BR2_PACKAGE_FREESCALE_IMX_PLATFORM_IMX37_3STACK
	bool "imx37-3stack"

config BR2_PACKAGE_FREESCALE_IMX_PLATFORM_IMX50
	bool "imx50"

config BR2_PACKAGE_FREESCALE_IMX_PLATFORM_IMX51
	bool "imx51"

config BR2_PACKAGE_FREESCALE_IMX_PLATFORM_IMX53
	bool "imx53"

config BR2_PACKAGE_FREESCALE_IMX_PLATFORM_IMX6Q
	bool "imx6q/imx6dl"

config BR2_PACKAGE_FREESCALE_IMX_PLATFORM_IMX6S
	bool "imx6sl/imx6sx"

config BR2_PACKAGE_FREESCALE_IMX_PLATFORM_IMX6UL
	bool "imx6ul/imx6ull"

config BR2_PACKAGE_FREESCALE_IMX_PLATFORM_IMX7
	bool "imx7d/imx7ulp"

config BR2_PACKAGE_FREESCALE_IMX_PLATFORM_IMX8
	bool "imx8"

config BR2_PACKAGE_FREESCALE_IMX_PLATFORM_IMX8M
	bool "imx8m"

config BR2_PACKAGE_FREESCALE_IMX_PLATFORM_IMX8MM
	bool "imx8mm"

config BR2_PACKAGE_FREESCALE_IMX_PLATFORM_IMX8MN
	bool "imx8mn"

config BR2_PACKAGE_FREESCALE_IMX_PLATFORM_IMX8X
	bool "imx8x"
endchoice

config BR2_PACKAGE_FREESCALE_IMX_PLATFORM
	string
	default "IMX25_3STACK" if BR2_PACKAGE_FREESCALE_IMX_PLATFORM_IMX25_3STACK
	default "IMX27ADS" if BR2_PACKAGE_FREESCALE_IMX_PLATFORM_IMX27ADS
	default "IMX37_3STACK" if BR2_PACKAGE_FREESCALE_IMX_PLATFORM_IMX37_3STACK
	default "IMX50" if BR2_PACKAGE_FREESCALE_IMX_PLATFORM_IMX50
	default "IMX51" if BR2_PACKAGE_FREESCALE_IMX_PLATFORM_IMX51
	default "IMX53" if BR2_PACKAGE_FREESCALE_IMX_PLATFORM_IMX53
	default "IMX6Q" if BR2_PACKAGE_FREESCALE_IMX_PLATFORM_IMX6Q
	default "IMX6S" if BR2_PACKAGE_FREESCALE_IMX_PLATFORM_IMX6S
	default "IMX6UL" if BR2_PACKAGE_FREESCALE_IMX_PLATFORM_IMX6UL
	default "IMX7" if BR2_PACKAGE_FREESCALE_IMX_PLATFORM_IMX7
	default "IMX8" if BR2_PACKAGE_FREESCALE_IMX_PLATFORM_IMX8
	default "IMX8MQ" if BR2_PACKAGE_FREESCALE_IMX_PLATFORM_IMX8M
	default "IMX8MM" if BR2_PACKAGE_FREESCALE_IMX_PLATFORM_IMX8MM
	default "IMX8MN" if BR2_PACKAGE_FREESCALE_IMX_PLATFORM_IMX8MN

config BR2_PACKAGE_FREESCALE_IMX_HAS_VPU
	bool
	default y if BR2_PACKAGE_FREESCALE_IMX_PLATFORM_IMX27ADS || \
		BR2_PACKAGE_FREESCALE_IMX_PLATFORM_IMX51 || \
		BR2_PACKAGE_FREESCALE_IMX_PLATFORM_IMX53 || \
		BR2_PACKAGE_FREESCALE_IMX_PLATFORM_IMX6Q

config BR2_PACKAGE_FREESCALE_IMX_HAS_VPU_HANTRO
	bool
	default y if BR2_PACKAGE_FREESCALE_IMX_PLATFORM_IMX8M || \
		BR2_PACKAGE_FREESCALE_IMX_PLATFORM_IMX8MM

config BR2_PACKAGE_FREESCALE_IMX_HAS_VIV_GPU
	bool
	default y if BR2_PACKAGE_FREESCALE_IMX_PLATFORM_IMX6Q || \
		BR2_PACKAGE_FREESCALE_IMX_PLATFORM_IMX6S || \
		BR2_PACKAGE_FREESCALE_IMX_PLATFORM_IMX7 || \
		BR2_PACKAGE_FREESCALE_IMX_PLATFORM_IMX8 || \
		BR2_PACKAGE_FREESCALE_IMX_PLATFORM_IMX8M || \
		BR2_PACKAGE_FREESCALE_IMX_PLATFORM_IMX8MM || \
		BR2_PACKAGE_FREESCALE_IMX_PLATFORM_IMX8MN || \
		BR2_PACKAGE_FREESCALE_IMX_PLATFORM_IMX8X

source "package/freescale-imx/imx-alsa-plugins/Config.in"
source "package/freescale-imx/imx-codec/Config.in"
source "package/freescale-imx/imx-kobs/Config.in"
source "package/freescale-imx/imx-lib/Config.in"
source "package/freescale-imx/imx-m4fwloader/Config.in"
source "package/freescale-imx/imx-parser/Config.in"
source "package/freescale-imx/imx-uuc/Config.in"
source "package/freescale-imx/imx-vpu/Config.in"
source "package/freescale-imx/imx-vpu-hantro/Config.in"
source "package/freescale-imx/imx-vpuwrap/Config.in"
source "package/freescale-imx/firmware-imx/Config.in"
source "package/freescale-imx/imx-sc-firmware/Config.in"
source "package/freescale-imx/imx-seco/Config.in"
if (BR2_PACKAGE_FREESCALE_IMX_PLATFORM_IMX51 || BR2_PACKAGE_FREESCALE_IMX_PLATFORM_IMX53)
source "package/freescale-imx/gpu-amd-bin-mx51/Config.in"
source "package/freescale-imx/libz160/Config.in"
endif
if BR2_PACKAGE_FREESCALE_IMX_HAS_VIV_GPU
source "package/freescale-imx/imx-gpu-g2d/Config.in"
source "package/freescale-imx/imx-gpu-viv/Config.in"
source "package/freescale-imx/kernel-module-imx-gpu-viv/Config.in"
endif

endif
```

## package/freescale-imx/firmware-imx/Config.in
```kconfig
config BR2_PACKAGE_FIRMWARE_IMX
	bool "firmware-imx"
	depends on BR2_arm # Only relevant for i.MX
	help
	  Firmware blobs for the Freescale i.MX SoCs.

	  It contains blobs for SDMA and VPU.

	  This library is provided by Freescale as-is and doesn't have
	  an upstream.
```

## package/freescale-imx/gpu-amd-bin-mx51/Config.in
```kconfig
comment "gpu-amd-bin-mx51 needs an (e)glibc EABI toolchain w/ C++"
	depends on BR2_arm
	depends on !BR2_ARM_EABI || !BR2_TOOLCHAIN_USES_GLIBC || \
		!BR2_INSTALL_LIBSTDCPP

config BR2_PACKAGE_GPU_AMD_BIN_MX51
	bool "gpu-amd-bin-mx51 (also imx53)"
	select BR2_PACKAGE_HAS_LIBEGL
	select BR2_PACKAGE_HAS_LIBGLES
	select BR2_PACKAGE_HAS_LIBOPENVG
	depends on BR2_ARM_EABI
	depends on BR2_TOOLCHAIN_USES_GLIBC
	depends on BR2_INSTALL_LIBSTDCPP
	help
	  Freescale libraries, headers and executables for the
	  AMD GPU on i.MX5x, containing OpenGL/ES, OpenVG
	  and EGL support.

if BR2_PACKAGE_GPU_AMD_BIN_MX51

choice
	prompt "Output option"
	help
	  There are two versions of this library: one for
	  direct framebuffer access, one for X11 rendering.
	  Choose here which version to install.

config BR2_PACKAGE_GPU_AMD_BIN_MX51_OUTPUT_X11
	depends on BR2_PACKAGE_XORG7
	select BR2_PACKAGE_LIBXCB
	select BR2_PACKAGE_XLIB_LIBX11
	select BR2_PACKAGE_XLIB_LIBXEXT
	select BR2_PACKAGE_XLIB_LIBXRENDER
	select BR2_PACKAGE_XLIB_LIBXDMCP
	select BR2_PACKAGE_XLIB_LIBXAU
	bool "X11"

comment "X11 backend needs X.org enabled"
	depends on !BR2_PACKAGE_XORG7

config BR2_PACKAGE_GPU_AMD_BIN_MX51_OUTPUT_FB
	bool "Framebuffer"

endchoice

config BR2_PACKAGE_PROVIDES_LIBEGL
	default "gpu-amd-bin-mx51"

config BR2_PACKAGE_PROVIDES_LIBGLES
	default "gpu-amd-bin-mx51"

config BR2_PACKAGE_PROVIDES_LIBOPENVG
	default "gpu-amd-bin-mx51"

config BR2_PACKAGE_GPU_AMD_BIN_MX51_EXAMPLES
	bool "install examples"
	help
	  Copy the examples to the target.

endif
```

## package/freescale-imx/gpu-viv-bin-mx6q/Config.in
```kconfig
comment "gpu-viv-bin-mx6q needs an (e)glibc toolchain"
	depends on BR2_arm
	depends on !BR2_TOOLCHAIN_USES_GLIBC

config BR2_PACKAGE_GPU_VIV_BIN_MX6Q
	bool "gpu-viv-bin-mx6q"
	select BR2_PACKAGE_HAS_LIBEGL
	select BR2_PACKAGE_HAS_LIBGLES
	select BR2_PACKAGE_HAS_LIBOPENVG
	depends on BR2_arm # Only relevant for i.MX6
	# Library binaries are linked against libc.so.6
	depends on BR2_TOOLCHAIN_USES_GLIBC
	help
	  Userspace libraries for Vivante GPU on i.MX6 platforms

	  It contains libraries and headers for GLES, OpenCL, and
	  OpenVG. It also contains a DRI plugin for X11. It also
	  contains a plugin for DirectFB-1.4.0, but that doesn't work
	  together with buildroot's DirectFB version.

	  This library is provided by Freescale as-is and doesn't have
	  an upstream.

if BR2_PACKAGE_GPU_VIV_BIN_MX6Q

choice
	prompt "Output option"
	help
	  There are two versions of this library: one for
	  direct framebuffer access, one for X11 rendering.
	  Choose here which version to install.

config BR2_PACKAGE_GPU_VIV_BIN_MX6Q_OUTPUT_X11
	bool "X11"
	depends on BR2_PACKAGE_XORG7
	select BR2_PACKAGE_XLIB_LIBXDAMAGE # Runtime dependency
	select BR2_PACKAGE_XLIB_LIBXEXT # Runtime dependency

comment "X11 backend needs Xorg package"
	depends on !BR2_PACKAGE_XORG7

config BR2_PACKAGE_GPU_VIV_BIN_MX6Q_OUTPUT_FB
	bool "Framebuffer"

endchoice

config BR2_PACKAGE_GPU_VIV_BIN_MX6Q_OUTPUT
	string
	default "x11" if BR2_PACKAGE_GPU_VIV_BIN_MX6Q_OUTPUT_X11
	default "fb" if BR2_PACKAGE_GPU_VIV_BIN_MX6Q_OUTPUT_FB

config BR2_PACKAGE_PROVIDES_LIBEGL
	default "gpu-viv-bin-mx6q"

config BR2_PACKAGE_PROVIDES_LIBGLES
	default "gpu-viv-bin-mx6q"

config BR2_PACKAGE_PROVIDES_LIBOPENVG
	default "gpu-viv-bin-mx6q"

config BR2_PACKAGE_GPU_VIV_BIN_MX6Q_EXAMPLES
	bool "install examples"
	help
	  Copy the Vivante examples to the target.

	  Warning: examples take approximately 150 MB of disk space.

endif
```

## package/freescale-imx/imx-alsa-plugins/Config.in
```kconfig
config BR2_PACKAGE_IMX_ALSA_PLUGINS
	bool "imx-alsa-plugins"
	depends on BR2_arm # Only relevant for i.MX
	depends on BR2_LINUX_KERNEL
	depends on BR2_TOOLCHAIN_HAS_THREADS # alsa-lib
	select BR2_PACKAGE_ALSA_LIB
	help
	  ALSA plugins specific for the Freescale i.MX platform. It
	  requires a kernel that includes the i.MX specific headers
	  to be built.

	  The following plugins are provided so far:
	    * Rate Converter Plugin Using Freescale ASRC Hardware
	      Resampler (i.MX53 and most i.MX6)

comment "imx-alsa-libs needs an imx-specific Linux kernel to be built"
	depends on BR2_arm
	depends on !BR2_LINUX_KERNEL

comment "imx-alsa-libs needs a toolchain w/ threads"
	depends on BR2_arm
	depends on BR2_LINUX_KERNEL && !BR2_TOOLCHAIN_HAS_THREADS
```

## package/freescale-imx/imx-codec/Config.in
```kconfig
config BR2_PACKAGE_IMX_CODEC
	bool "imx-codec"
	depends on BR2_arm || BR2_aarch64 # Only relevant for i.MX
	depends on BR2_TOOLCHAIN_USES_GLIBC # prebuilt binaries
	help
	  Binary codec libraries for the NXP i.MX SoCs.

	  This library is provided by NXP as-is and doesn't have
	  an upstream.

comment "imx-codec needs a glibc toolchain"
	depends on BR2_arm || BR2_aarch64
	depends on !BR2_TOOLCHAIN_USES_GLIBC
```

## package/freescale-imx/imx-gpu-g2d/Config.in
```kconfig
comment "imx-gpu-g2d needs a glibc toolchain with armhf enabled"
	depends on BR2_arm
	depends on !BR2_TOOLCHAIN_USES_GLIBC || !BR2_ARM_EABIHF

config BR2_PACKAGE_IMX_GPU_G2D
	bool "imx-gpu-g2d"
	# Pre-built binaries only available for ARM EABIhf
	depends on BR2_ARM_EABIHF
	# Library binaries are linked against libc.so.6
	depends on BR2_TOOLCHAIN_USES_GLIBC
	select BR2_PACKAGE_IMX_GPU_VIV
	help
	  Userspace 2D libraries for Vivante GPU on i.MX platforms.

	  This library is provided by NXP as-is and doesn't have an
	  upstream.

if BR2_PACKAGE_IMX_GPU_G2D

config BR2_PACKAGE_IMX_GPU_G2D_EXAMPLES
	bool "install examples"
	help
	  Copy the Vivante G2D examples to the target.

endif
```

## package/freescale-imx/imx-gpu-viv/Config.in
```kconfig
comment "imx-gpu-viv needs a glibc toolchain with armhf enabled"
	depends on BR2_arm
	depends on !BR2_TOOLCHAIN_USES_GLIBC || !BR2_ARM_EABIHF

comment "imx-gpu-viv needs a glibc toolchain"
	depends on BR2_aarch64
	depends on !BR2_TOOLCHAIN_USES_GLIBC

config BR2_PACKAGE_IMX_GPU_VIV
	bool "imx-gpu-viv"
	# Pre-built binaries only available for ARM EABIhf
	depends on (BR2_arm && BR2_ARM_EABIHF) || BR2_aarch64
	# Library binaries are linked against libc.so.6
	depends on BR2_TOOLCHAIN_USES_GLIBC
	select BR2_PACKAGE_HAS_LIBEGL
	select BR2_PACKAGE_HAS_LIBGLES
	select BR2_PACKAGE_HAS_LIBOPENVG
	help
	  Userspace libraries for Vivante GPU on i.MX platforms

	  It contains libraries and headers for GLES, OpenCL, and
	  OpenVG. It also contains a DRI plugin for X11. It also
	  contains a plugin for DirectFB-1.4.0, but that doesn't work
	  together with buildroot's DirectFB version.

	  This library is provided by Freescale as-is and doesn't have
	  an upstream.

if BR2_PACKAGE_IMX_GPU_VIV

choice
	prompt "Output option"
	help
	  There are two versions of this library: one for
	  direct framebuffer access, one for X11 rendering.
	  Choose here which version to install.

config BR2_PACKAGE_IMX_GPU_VIV_OUTPUT_X11
	bool "X11"
	depends on BR2_PACKAGE_XORG7
	# The i.MX8 blob doesn't support X11 output
	depends on !BR2_PACKAGE_FREESCALE_IMX_PLATFORM_IMX8M
	select BR2_PACKAGE_XLIB_LIBXDAMAGE
	select BR2_PACKAGE_XLIB_LIBXEXT
	select BR2_PACKAGE_XLIB_LIBXFIXES

comment "X11 backend needs Xorg package"
	depends on !BR2_PACKAGE_XORG7
	depends on !BR2_PACKAGE_FREESCALE_IMX_PLATFORM_IMX8M

config BR2_PACKAGE_IMX_GPU_VIV_OUTPUT_FB
	bool "Framebuffer"
	# The i.MX8 blob doesn't support FB output
	depends on !BR2_PACKAGE_FREESCALE_IMX_PLATFORM_IMX8M

config BR2_PACKAGE_IMX_GPU_VIV_OUTPUT_WL
	bool "Wayland"
	# libdrm needed by gbm_viv.so
	select BR2_PACKAGE_LIBDRM
	select BR2_PACKAGE_WAYLAND
	select BR2_PACKAGE_HAS_LIBEGL_WAYLAND

endchoice

config BR2_PACKAGE_IMX_GPU_VIV_OUTPUT
	string
	default "x11" if BR2_PACKAGE_IMX_GPU_VIV_OUTPUT_X11
	default "fb" if BR2_PACKAGE_IMX_GPU_VIV_OUTPUT_FB
	default "wl" if BR2_PACKAGE_IMX_GPU_VIV_OUTPUT_WL

config BR2_PACKAGE_PROVIDES_LIBEGL
	default "imx-gpu-viv"

config BR2_PACKAGE_PROVIDES_LIBGLES
	default "imx-gpu-viv"

config BR2_PACKAGE_PROVIDES_LIBOPENVG
	default "imx-gpu-viv"

config BR2_PACKAGE_IMX_GPU_VIV_EXAMPLES
	bool "install examples"
	help
	  Copy the Vivante examples to the target.

	  Warning: examples take approximately 150 MB of disk space.

config BR2_PACKAGE_IMX_GPU_VIV_GMEM_INFO
	bool "install gmem_info tool"
	help
	  Copy the gmem_info tool to the target which provides
	  information about GPU memory consumption.

endif
```

## package/freescale-imx/imx-kobs/Config.in
```kconfig
config BR2_PACKAGE_IMX_KOBS
	bool "imx-kobs"
	depends on BR2_arm # Only relevant for i.MX
	help
	  The imx-kobs tool is used for writing images to NAND on i.MX
	  platforms.

	  This library is provided by Freescale as-is and doesn't have
	  an upstream.
```

## package/freescale-imx/imx-lib/Config.in
```kconfig
comment "imx-lib needs an imx-specific Linux kernel to be built"
	depends on BR2_arm && !BR2_LINUX_KERNEL

config BR2_PACKAGE_IMX_LIB
	bool "imx-lib"
	depends on BR2_LINUX_KERNEL
	depends on BR2_arm # Only relevant for i.MX
	help
	  Library of userspace helpers specific for the Freescale i.MX
	  platform. It wraps the kernel interfaces for some i.MX platform
	  specific drivers. It requires a kernel that includes the i.MX
	  specific headers to be built.

	  This library is provided by Freescale as-is and doesn't have
	  an upstream.
```
