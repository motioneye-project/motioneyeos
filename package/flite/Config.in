## package/flite/Config.in
```kconfig
config BR2_PACKAGE_FLITE
	bool "flite"
	depends on BR2_USE_WCHAR
	help
	  Flite: a small, fast run time synthesis engine.

	  Flite (festival-lite) is a small, fast run-time synthesis
	  engine developed at CMU and primarily designed for small
	  embedded machines and/or large servers. Flite is designed as
	  an alternative synthesis engine to Festival for voices built
	  using the FestVox suite of voice building tools.

	  http://www.festvox.org/flite

comment "flite needs a toolchain w/ wchar"
	depends on !BR2_USE_WCHAR
```

## package/flot/Config.in
```kconfig
config BR2_PACKAGE_FLOT
	bool "flot"
	select BR2_PACKAGE_JQUERY
	help
	  Flot is a pure Javascript plotting library for jQuery. It
	  produces graphical plots of arbitrary datasets on-the-fly
	  client-side.

	  The focus is on simple usage (all settings are optional),
	  attractive looks and interactive features like zooming and
	  mouse tracking.

	  The plugin works with Internet Explorer 6+, Firefox 2.x+,
	  Safari 3.0+, Opera 9.5+ and Konqueror 4.x+ with the HTML
	  canvas tag.

	  http://www.flotcharts.org/

if BR2_PACKAGE_FLOT

comment "flot plugins"

config BR2_PACKAGE_FLOT_CANVAS
	bool "canvas"
	help
	  Flot plugin to render axis tick labels directly to the canvas

config BR2_PACKAGE_FLOT_CATEGORIES
	bool "categories"
	help
	  Flot plugin for plotting textual data or categories

config BR2_PACKAGE_FLOT_CROSSHAIR
	bool "crosshair"
	help
	  Flot plugin for showing crosshairs when the mouse hovers
	  over the plot

config BR2_PACKAGE_FLOT_ERRORBARS
	bool "errorbars"
	help
	  Flot plugin for plotting error bars

config BR2_PACKAGE_FLOT_FILLBETWEEN
	bool "fillbetween"
	help
	  Flot plugin for computing bottoms for filled line and bar charts

config BR2_PACKAGE_FLOT_IMAGE
	bool "image"
	help
	  Flot plugin for plotting images

config BR2_PACKAGE_FLOT_NAVIGATE
	bool "navigate"
	help
	  Flot plugin for adding panning and zooming capabilities to a plot

config BR2_PACKAGE_FLOT_PIE
	bool "pie"
	help
	  Flot plugin for rendering pie charts

config BR2_PACKAGE_FLOT_RESIZE
	bool "resize"
	help
	  Flot plugin for automatically redrawing plots when the
	  placeholder size changes.

config BR2_PACKAGE_FLOT_SELECTION
	bool "selection"
	help
	  Flot plugin for selecting regions

config BR2_PACKAGE_FLOT_STACK
	bool "stack"
	help
	  Flot plugin for stacking data sets

config BR2_PACKAGE_FLOT_SYMBOL
	bool "symbol"
	help
	  Flot plugin that adds some extra symbols for plotting points

config BR2_PACKAGE_FLOT_THRESHOLD
	bool "threshold"
	help
	  Flot plugin for thresholding data

config BR2_PACKAGE_FLOT_TIME
	bool "time"
	help
	  Flot plugin for handling time axes

endif
```

## package/fltk/Config.in
```kconfig
config BR2_PACKAGE_FLTK
	bool "fltk"
	depends on BR2_INSTALL_LIBSTDCPP
	depends on BR2_PACKAGE_XORG7
	depends on BR2_USE_MMU # fork()
	select BR2_PACKAGE_JPEG
	select BR2_PACKAGE_LIBPNG
	select BR2_PACKAGE_XLIB_LIBXT
	select BR2_PACKAGE_XLIB_LIBX11
	select BR2_PACKAGE_XLIB_LIBXEXT
	help
	  A cross-platform C++ GUI toolkit for UNIX/Linux (X11),
	  Microsoft Windows, and MacOS X.

	  http://www.fltk.org/

comment "fltk needs a toolchain w/ C++"
	depends on BR2_USE_MMU && BR2_PACKAGE_XORG7
	depends on !BR2_INSTALL_LIBSTDCPP
```

## package/fluid-soundfont/Config.in
```kconfig
config BR2_PACKAGE_FLUID_SOUNDFONT
	bool "fluid-soundfont"
	help
	  FluidR3 is the third release of Frank Wen's pro-quality
	  GM/GS soundfont.  The soundfont has lots of excellent
	  samples, including all the GM instruments along side with
	  the GS instruments that are recycled and reprogrammed
	  versions of the GM presets.

	  This package contains Fluid General Midi (GM) soundfont in
	  soundfont 2.0 (.sf2) format.

	  This soundfont can be used with the FluidSynth real-time
	  software synthesizer.

	  http://www.hammersound.net
```

## package/fluidsynth/Config.in
```kconfig
config BR2_PACKAGE_FLUIDSYNTH
	bool "fluidsynth"
	depends on BR2_USE_WCHAR # libglib2
	depends on BR2_TOOLCHAIN_HAS_THREADS # libglib2
	depends on BR2_USE_MMU # libglib2
	select BR2_PACKAGE_LIBGLIB2
	help
	  FluidSynth is a real-time software synthesizer based on the
	  SoundFont 2 specifications and has reached widespread
	  distribution. FluidSynth itself does not have a graphical
	  user interface, but due to its powerful API several
	  applications utilize it and it has even found its way onto
	  embedded systems and is used in some mobile apps.

	  http://www.fluidsynth.org/

if BR2_PACKAGE_FLUIDSYNTH

comment "Output support"

config BR2_PACKAGE_FLUIDSYNTH_ALSA_LIB
	bool "alsa"
	default y
	depends on BR2_TOOLCHAIN_HAS_THREADS
	select BR2_PACKAGE_ALSA_LIB
	select BR2_PACKAGE_ALSA_LIB_RAWMIDI
	select BR2_PACKAGE_ALSA_LIB_SEQ
	help
	  Enable alsa support.

comment "alsa support needs a toolchain w/ threads"
	depends on !BR2_TOOLCHAIN_HAS_THREADS

config BR2_PACKAGE_FLUIDSYNTH_JACK2
	bool "jack2"
	# See: https://sourceware.org/bugzilla/show_bug.cgi?id=19908
	depends on !BR2_TOOLCHAIN_EXTERNAL_CODESOURCERY_MIPS
	depends on BR2_TOOLCHAIN_HAS_THREADS # jack2
	depends on BR2_USE_MMU # jack2
	depends on BR2_INSTALL_LIBSTDCPP # jack2
	depends on !BR2_STATIC_LIBS # jack2
	depends on BR2_TOOLCHAIN_HAS_SYNC_4 # jack2
	select BR2_PACKAGE_JACK2
	help
	  Enable jack support.

comment "jack support needs a toolchain w/ dynamic library, threads, C++"
	depends on BR2_TOOLCHAIN_HAS_SYNC_4
	depends on BR2_USE_MMU
	depends on !BR2_TOOLCHAIN_EXTERNAL_CODESOURCERY_MIPS
	depends on BR2_STATIC_LIBS || !BR2_INSTALL_LIBSTDCPP || \
		!BR2_TOOLCHAIN_HAS_THREADS

config BR2_PACKAGE_FLUIDSYNTH_LIBSNDFILE
	bool "libsndfile"
	select BR2_PACKAGE_LIBSNDFILE
	help
	  Enable libsndfile support, for writing output to WAV files.

config BR2_PACKAGE_FLUIDSYNTH_PORTAUDIO
	bool "portaudio"
	depends on BR2_TOOLCHAIN_HAS_THREADS
	select BR2_PACKAGE_PORTAUDIO
	help
	  Enable portaudio support.

comment "portaudio support needs a toolchain w/ threads"
	depends on !BR2_TOOLCHAIN_HAS_THREADS

config BR2_PACKAGE_FLUIDSYNTH_PULSEAUDIO
	bool "pulseaudio"
	# See: https://sourceware.org/bugzilla/show_bug.cgi?id=19908
	depends on !BR2_TOOLCHAIN_EXTERNAL_CODESOURCERY_MIPS
	depends on BR2_PACKAGE_PULSEAUDIO_HAS_ATOMIC # pulseaudio
	depends on BR2_USE_WCHAR # pulseaudio
	depends on BR2_TOOLCHAIN_HAS_THREADS # pulseaudio
	depends on !BR2_STATIC_LIBS # pulseaudio
	depends on BR2_USE_MMU # pulseaudio
	select BR2_PACKAGE_PULSEAUDIO
	help
	  Enable PulseAudio support.

comment "pulseaudio support needs a toolchain w/ dynamic library, wchar, threads"
	depends on BR2_USE_MMU
	depends on !BR2_TOOLCHAIN_EXTERNAL_CODESOURCERY_MIPS
	depends on BR2_PACKAGE_PULSEAUDIO_HAS_ATOMIC
	depends on BR2_STATIC_LIBS || !BR2_USE_MMU || !BR2_TOOLCHAIN_HAS_THREADS

comment "Misc options"

config BR2_PACKAGE_FLUIDSYNTH_DBUS
	bool "dbus"
	depends on BR2_TOOLCHAIN_HAS_THREADS
	depends on BR2_USE_MMU
	select BR2_PACKAGE_DBUS
	help
	  Enable dbus support.

comment "dbus support needs a toolchain w/ threads"
	depends on BR2_USE_MMU
	depends on !BR2_TOOLCHAIN_HAS_THREADS

config BR2_PACKAGE_FLUIDSYNTH_FLOATS
	bool "32-bit single precision float"
	help
	  Enable 32-bit single precision float support, instead of
	  64-bit double precision floats for DSP samples.

config BR2_PACKAGE_FLUIDSYNTH_READLINE
	bool "readline"
	select BR2_PACKAGE_READLINE
	help
	  Enable readline support, for better line editing in FluidSynth
	  shell.

endif # BR2_PACKAGE_FLUIDSYNTH

comment "fluidsynth needs a toolchain w/ threads, wchar"
	depends on BR2_USE_MMU
	depends on !BR2_USE_WCHAR || !BR2_TOOLCHAIN_HAS_THREADS
```

## package/fluxbox/Config.in
```kconfig
config BR2_PACKAGE_FLUXBOX
	bool "fluxbox"
	depends on BR2_PACKAGE_XORG7
	depends on BR2_INSTALL_LIBSTDCPP
	select BR2_PACKAGE_XLIB_LIBX11
	# Runtime dependency, needed by startup script
	select BR2_PACKAGE_XAPP_XMODMAP
	help
	  The Fluxbox lightweight window manager for X

	  http://fluxbox.org

comment "fluxbox requires a toolchain with C++ support enabled"
	depends on BR2_PACKAGE_XORG7 && !BR2_INSTALL_LIBSTDCPP
```

## package/fmc/Config.in
```kconfig
comment "fmc needs a toolchain w/ C++"
	depends on BR2_powerpc_e500mc
	depends on !BR2_INSTALL_LIBSTDCPP

comment "fmc needs a Linux kernel to be built"
	depends on BR2_powerpc_e500mc
	depends on !BR2_LINUX_KERNEL

config BR2_PACKAGE_FMC
	bool "fmc"
	depends on BR2_powerpc_e500mc
	depends on BR2_INSTALL_LIBSTDCPP
	depends on BR2_LINUX_KERNEL # fmlib
	select BR2_PACKAGE_TCLAP
	select BR2_PACKAGE_LIBXML2
	select BR2_PACKAGE_FMLIB
	help
	  The Frame Manager Configuration tool is Freescale PowerPC platform
	  software package whose primary purpose is converting
	  Parse-Classify-Police-Distribute (PCD) descriptions of network
	  packets flow into hardware configuration. The tool provides an
	  abstraction layer between the end customer's vision of the PCD task
	  definition and real hardware implementation.

	  http://cache.freescale.com/files/32bit/doc/app_note/AN4760.pdf
```

## package/fmlib/Config.in
```kconfig
comment "fmlib needs a Linux kernel to be built"
	depends on BR2_powerpc_e500mc || BR2_powerpc_e6500
	depends on !BR2_LINUX_KERNEL

config BR2_PACKAGE_FMLIB
	bool "fmlib"
	depends on BR2_powerpc_e500mc || BR2_powerpc_e6500
	depends on BR2_LINUX_KERNEL
	help
	  The Frame Manager library provides Freescale PowerPC platforms
	  an API on top of the Frame Manager driver ioctl calls, that
	  provides a user space application with a simple way to
	  configure driver parameters and PCD (parse - classify -
	  distribute) rules.

	  http://git.freescale.com/git/cgit.cgi/ppc/sdk/fmlib.git/tree/README

if BR2_PACKAGE_FMLIB
choice
	prompt "QorIQ Target Family"
	help
	  Select the family of QorIQ processor.

config BR2_FMLIB_QORIQ_FAMILY_P4080
	bool "p40xx"
	depends on BR2_powerpc_e500mc

config BR2_FMLIB_QORIQ_FAMILY_T4240
	bool "t42xx"
	depends on BR2_powerpc_e500mc

config BR2_FMLIB_QORIQ_FAMILY_T2080
	bool "t208x"
	depends on BR2_powerpc_e6500

endchoice

config BR2_PACKAGE_FMLIB_ARCHTYPE
	string
	default "e500mc" if BR2_powerpc_e500mc
	default "ppc64e6500" if BR2_powerpc_e6500 && BR2_powerpc64
	default "ppc32e6500" if BR2_powerpc_e6500 && BR2_powerpc

config BR2_PACKAGE_FMLIB_PLATFORM
	string
	default "P4080" if BR2_FMLIB_QORIQ_FAMILY_P4080
	default "T4240" if BR2_FMLIB_QORIQ_FAMILY_T4240
	default "FMAN_V3H" if BR2_FMLIB_QORIQ_FAMILY_T2080

endif
```

## package/fmt/Config.in
```kconfig
config BR2_PACKAGE_FMT
	bool "fmt"
	depends on BR2_INSTALL_LIBSTDCPP
	depends on BR2_USE_WCHAR
	help
	  fmt is an open-source formatting library for C++. It can be
	  used as a safe alternative to printf or as a fast alternative
	  to IOStreams.

comment "fmt needs a toolchain w/ C++, wchar"
	depends on !BR2_INSTALL_LIBSTDCPP || !BR2_USE_WCHAR
```

## package/fmtools/Config.in
```kconfig
config BR2_PACKAGE_FMTOOLS
	bool "fmtools"
	help
	  fmtools is a pair of simple command-line utilities for
	  "video4linux2" radio tuner cards under Linux. It includes
	  fm for power control, tuning, and volume and fmscan for
	  scanning for stations.

	  http://benpfaff.org/fmtools/
```

## package/font-awesome/Config.in
```kconfig
config BR2_PACKAGE_FONT_AWESOME
	bool "font-awesome"
	help
	  Font Awesome is a full suite of 605 pictographic icons for
	  easy scalable vector graphics on websites.

	  https://github.com/FortAwesome/Font-Awesome
```

## package/fontconfig/Config.in
```kconfig
config BR2_PACKAGE_FONTCONFIG
	bool "fontconfig"
	select BR2_PACKAGE_FREETYPE
	select BR2_PACKAGE_EXPAT
	select BR2_PACKAGE_UTIL_LINUX
	select BR2_PACKAGE_UTIL_LINUX_LIBUUID
	help
	  Fontconfig is a library for configuring and customizing font
	  access.

	  http://www.fontconfig.org/
```

## package/foomatic-filters/Config.in
```kconfig
comment "foomatic-filters needs a toolchain w/ threads"
	depends on BR2_PACKAGE_CUPS
	depends on !BR2_TOOLCHAIN_HAS_THREADS

config BR2_PACKAGE_FOOMATIC_FILTERS
	bool "foomatic_filters"
	depends on BR2_PACKAGE_CUPS
	depends on BR2_TOOLCHAIN_HAS_THREADS # libusb
	select BR2_PACKAGE_LIBUSB
	select BR2_PACKAGE_ENSCRIPT
	help
	  Foomatic Filters
	  Foomatic is a database-driven system for integrating free software
	  printer drivers with common spoolers under Unix. It supports CUPS,
	  LPRng, LPD, GNUlpr, Solaris LP, PPR, PDQ, CPS, and direct printing
	  with every free software printer driver known to us and every
	  printer known to work with these drivers.

	  http://www.linuxfoundation.org/collaborate/workgroups/openprinting/database/foomatic
```

## package/fping/Config.in
```kconfig
config BR2_PACKAGE_FPING
	bool "fping"
	help
	  fping is a program to send ICMP echo probes to network hosts,
	  similar to ping, but much better performing when pinging
	  multiple hosts.

	  http://fping.org/
```

## package/freerdp/Config.in
```kconfig
config BR2_PACKAGE_FREERDP
	bool "freerdp"
	depends on BR2_USE_WCHAR
	depends on !BR2_STATIC_LIBS # uses dlfcn.h
	depends on BR2_TOOLCHAIN_HAS_THREADS
	select BR2_PACKAGE_OPENSSL
	select BR2_PACKAGE_ZLIB
	select BR2_PACKAGE_GST_PLUGINS_BASE if BR2_PACKAGE_GSTREAMER
	select BR2_PACKAGE_GST_PLUGINS_BASE_PLUGIN_APP if BR2_PACKAGE_GSTREAMER
	help
	  FreeRDP is a free implementation of the Remote Desktop
	  Protocol (RDP), released under the Apache license

	  This only installs the freerdp library.

	  http://www.freerdp.com/

	  Note: this also installs a key and certificate in
	  /etc/freerdp/keys/ . These are publicly-known, as they
	  are present in FreeRDP's source tree. It is strongly
	  suggested that you overwrite them with your own set,
	  either in an overlay rootfs or in a post-build script.

if BR2_PACKAGE_FREERDP

config BR2_PACKAGE_FREERDP_SERVER
	bool "build server"
	depends on BR2_PACKAGE_XORG7
	select BR2_PACKAGE_XLIB_LIBX11
	select BR2_PACKAGE_XLIB_LIBXDAMAGE
	select BR2_PACKAGE_XLIB_LIBXEXT
	select BR2_PACKAGE_XLIB_LIBXFIXES

config BR2_PACKAGE_FREERDP_CLIENT
	bool "build client"
	default y
	depends on BR2_PACKAGE_XORG7
	select BR2_PACKAGE_XLIB_LIBX11
	select BR2_PACKAGE_XLIB_LIBXEXT

comment "freerdp server and client need X.Org"
	depends on !BR2_PACKAGE_XORG7

endif

comment "freerdp needs a toolchain w/ wchar, dynamic library, threads"
	depends on !BR2_USE_WCHAR || BR2_STATIC_LIBS \
		|| !BR2_TOOLCHAIN_HAS_THREADS
```
