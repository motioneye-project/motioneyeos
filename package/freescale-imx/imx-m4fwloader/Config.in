## package/freescale-imx/imx-m4fwloader/Config.in
```kconfig
config BR2_PACKAGE_IMX_M4FWLOADER
	bool "imx-m4fwloader"
	depends on BR2_arm # Only relevant for i.MX
	help
	  This package provides a tool to load a firmware to the
	  Cortex-M4 core available in some i.MX processors.

	  https://github.com/codeauroraforum/imx-m4fwloader
```

## package/freescale-imx/imx-parser/Config.in
```kconfig
config BR2_PACKAGE_IMX_PARSER
	bool "imx-parser"
	depends on BR2_arm # Only relevant for i.MX
	help
	  Binary parser libraries for the NXP i.MX SoCs.

	  This library is provided by NXP as-is and doesn't have
	  an upstream.
```

## package/freescale-imx/imx-sc-firmware/Config.in
```kconfig
config BR2_PACKAGE_IMX_SC_FIRMWARE
	bool "imx-sc-firmware"
	depends on BR2_PACKAGE_FREESCALE_IMX_PLATFORM_IMX8 || \
		BR2_PACKAGE_FREESCALE_IMX_PLATFORM_IMX8X
	help
	  System Control Unit Firmware blobs for the Freescale i.MX8
	  SoCs.

	  This library is provided by Freescale as-is and doesn't have
	  an upstream.
```

## package/freescale-imx/imx-seco/Config.in
```kconfig
config BR2_PACKAGE_IMX_SECO
	bool "imx-seco"
	depends on BR2_PACKAGE_FREESCALE_IMX_PLATFORM_IMX8 || \
		BR2_PACKAGE_FREESCALE_IMX_PLATFORM_IMX8X
	help
	  Firmware file for the i.MX8 and i.MX8X Security Controller.

	  This library is provided by Freescale as-is and doesn't have
	  an upstream.
```

## package/freescale-imx/imx-uuc/Config.in
```kconfig
config BR2_PACKAGE_IMX_UUC
	bool "imx-uuc"
	depends on BR2_TOOLCHAIN_HAS_THREADS
	depends on BR2_arm # Only relevant for i.MX
	depends on BR2_USE_MMU # fork()
	depends on BR2_TOOLCHAIN_HEADERS_AT_LEAST_3_18 # usb_functionfs_descs_head_v2
	select BR2_PACKAGE_HOST_DOSFSTOOLS
	help
	  This package provides the Universal Adapter user-space
	  utility that is used to receive commands from the
	  Manufacturing Tool using the Freescale UTP Protocol.

	  It requires a Freescale/NXP kernel whose configuration
	  contains the CONFIG_FSL_UTP option.

	  This package is provided by Freescale/NXP as-is and doesn't
	  have an upstream.

comment "imx-uuc needs a toolchain w/ threads, headers >= 3.18"
	depends on BR2_arm
	depends on BR2_USE_MMU
	depends on !BR2_TOOLCHAIN_HAS_THREADS || \
		!BR2_TOOLCHAIN_HEADERS_AT_LEAST_3_18
```

## package/freescale-imx/imx-vpu-hantro/Config.in
```kconfig
comment "imx-vpu-hantro needs an i.MX-specific Linux kernel to be built"
	depends on !BR2_LINUX_KERNEL

comment "imx-vpu-hantro needs an i.MX platform with Hantro VPU"
	depends on BR2_LINUX_KERNEL
	depends on !BR2_PACKAGE_FREESCALE_IMX_HAS_VPU_HANTRO

config BR2_PACKAGE_IMX_VPU_HANTRO
	bool "imx-vpu-hantro"
	depends on BR2_LINUX_KERNEL
	depends on BR2_PACKAGE_FREESCALE_IMX_HAS_VPU_HANTRO
	help
	  Library of userspace helpers specific for the NXP i.MX SoC
	  integrating a Hantro Video Processing Unit (VPU) such as the
	  i.MX8MQ/i.MX8MM.
	  It requires a kernel that includes the i.MX specific headers
	  to be built.

	  This library is provided by NXP as-is and doesn't have an
	  upstream.
```

## package/freescale-imx/imx-vpu/Config.in
```kconfig
comment "imx-vpu needs an i.MX platform with VPU support"
	depends on !BR2_PACKAGE_FREESCALE_IMX_HAS_VPU

config BR2_PACKAGE_IMX_VPU
	bool "imx-vpu"
	depends on BR2_PACKAGE_FREESCALE_IMX_HAS_VPU
	select BR2_PACKAGE_FIRMWARE_IMX
	help
	  Library of userspace helpers specific for the NXP i.MX SoC
	  integrating a Chips&Media CODA Video Processing Unit (VPU)
	  such as the i.MX27/i.MX5x/i.MX6x.

	  This library is provided by NXP as-is and doesn't have an
	  upstream.
```

## package/freescale-imx/kernel-module-imx-gpu-viv/Config.in
```kconfig
comment "kernel-module-imx-gpu-viv needs a Linux kernel to be built"
	depends on !BR2_LINUX_KERNEL

config BR2_PACKAGE_KERNEL_MODULE_IMX_GPU_VIV
	bool "kernel-module-imx-gpu-viv"
	depends on BR2_LINUX_KERNEL
	help
	  Kernel loadable module for Vivante GPU.

	  This package uses an exact copy of the GPU kernel driver
	  source code of the same version as base and include fixes
	  and improvements developed by FSL Community.

	  This module is only meant for NXP-based kernel.

	  https://github.com/Freescale/kernel-module-imx-gpu-viv
```

## package/freescale-imx/libz160/Config.in
```kconfig
config BR2_PACKAGE_LIBZ160
	bool "libz160"
	depends on BR2_ARM_EABI
	depends on BR2_TOOLCHAIN_USES_GLIBC
	help
	  An API for user space programs to perform 2D accelerated
	  graphics operations on AMD GPU (included for examples in
	  iMX5x chipsets)

comment "libz160 needs an EABI toolchain w/ glibc"
	depends on !BR2_ARM_EABI || !BR2_TOOLCHAIN_USES_GLIBC
```

## package/freeswitch-mod-bcg729/Config.in
```kconfig
config BR2_PACKAGE_FREESWITCH_MOD_BCG729
	bool "freeswitch-mod-bcg729"
	depends on BR2_PACKAGE_FREESWITCH
	depends on !BR2_STATIC_LIBS # freeswitch
	select BR2_PACKAGE_BCG729
	help
	  FreeSWITCH G.729A module using the opensource bcg729
	  implementation by Belledonne Communications.

	  https://github.com/xadhoom/mod_bcg729
```

## package/freeswitch/Config.in
```kconfig
config BR2_PACKAGE_FREESWITCH
	bool "freeswitch"
	depends on BR2_INSTALL_LIBSTDCPP
	depends on !BR2_STATIC_LIBS # apr, included in freeswitch source
	depends on BR2_TOOLCHAIN_HAS_THREADS
	depends on BR2_USE_MMU # apr, included in freeswitch source
	depends on BR2_USE_WCHAR # uses wchar_t
	select BR2_PACKAGE_FFMPEG_AVRESAMPLE if BR2_PACKAGE_FFMPEG
	select BR2_PACKAGE_FFMPEG_SWSCALE if BR2_PACKAGE_FFMPEG
	select BR2_PACKAGE_LIBCURL
	select BR2_PACKAGE_JPEG
	# src/mod/applications/mod_cv/mod_cv.cpp includes
	# highgui.h, imgproc.hpp & objdetect.hpp
	select BR2_PACKAGE_OPENCV_LIB_HIGHGUI if BR2_PACKAGE_OPENCV
	select BR2_PACKAGE_OPENCV_LIB_IMGPROC if BR2_PACKAGE_OPENCV
	select BR2_PACKAGE_OPENCV_LIB_OBJDETECT if BR2_PACKAGE_OPENCV
	select BR2_PACKAGE_OPENSSL
	select BR2_PACKAGE_PCRE
	select BR2_PACKAGE_SPEEX
	select BR2_PACKAGE_SPEEXDSP
	select BR2_PACKAGE_SQLITE
	select BR2_PACKAGE_TIFF
	select BR2_PACKAGE_UTIL_LINUX
	select BR2_PACKAGE_UTIL_LINUX_LIBUUID
	select BR2_PACKAGE_ZLIB
	help
	  FreeSWITCH is a scalable open source cross-platform
	  telephony platform designed to route and interconnect
	  popular communication protocols using audio, video, text or
	  any other form of media.

	  https://www.freeswitch.org

comment "freeswitch needs a toolchain w/ C++, dynamic library, threads, wchar"
	depends on BR2_USE_MMU
	depends on !BR2_INSTALL_LIBSTDCPP || BR2_STATIC_LIBS \
		|| !BR2_TOOLCHAIN_HAS_THREADS || !BR2_USE_WCHAR
```

## package/freetype/Config.in
```kconfig
config BR2_PACKAGE_FREETYPE
	bool "freetype"
	help
	  a free, high-quality and portable font engine.

	  https://www.freetype.org/
```

## package/fscryptctl/Config.in
```kconfig
config BR2_PACKAGE_FSCRYPTCTL
	bool "fscryptctl"
	help
	  fscryptctl is a low-level tool written in C that handles raw
	  keys and manages policies for Linux filesystem encryption.

	  Notice: Fscrypt support on EXT4 requires a kernel with
	  CONFIG_EXT4_ENCRYPTION=y and a file system with the
	  encryption option and block size equal to CPU page size
	  (BR2_TARGET_ROOTFS_EXT2_MKFS_OPTIONS="-O encrypt -b 4096")

	  https://github.com/google/fscryptctl
```

## package/fstrcmp/Config.in
```kconfig
config BR2_PACKAGE_FSTRCMP
	bool "fstrcmp"
	depends on BR2_USE_WCHAR
	help
	  The fstrcmp project provides a library that is used to make
	  fuzzy comparisons of strings and byte arrays, including multi-
	  byte character strings.

	  http://fstrcmp.sourceforge.net/

comment "fstrcmp needs a toolchain w/ wchar"
	depends on !BR2_USE_WCHAR
```

## package/fswebcam/Config.in
```kconfig
config BR2_PACKAGE_FSWEBCAM
	bool "fswebcam"
	depends on BR2_USE_MMU # fork()
	depends on !BR2_STATIC_LIBS
	select BR2_PACKAGE_GD
	select BR2_PACKAGE_FREETYPE
	select BR2_PACKAGE_JPEG
	select BR2_PACKAGE_LIBPNG
	help
	  fswebcam is a neat and simple webcam app. It captures images
	  from a V4L1/V4L2 compatible device or file, averages them to
	  reduce noise and draws a caption using the GD Graphics
	  Library which also handles compressing the image to PNG or
	  JPEG. The resulting image is saved to a file or sent to
	  stdio where it can be piped to something like ncftpput or
	  scp.

	  https://www.sanslogic.co.uk/fswebcam/

comment "fswebcam needs a toolchain w/ dynamic library"
	depends on BR2_USE_MMU
	depends on BR2_STATIC_LIBS
```

## package/ftop/Config.in
```kconfig
config BR2_PACKAGE_FTOP
	bool "ftop"
	select BR2_PACKAGE_NCURSES
	help
	  Ftop is to files what top is to processes.
	  The progress of all open files and file systems can be monitored.

	  https://code.google.com/p/ftop/
```

## package/fuse/Config.in
```kconfig
config BR2_PACKAGE_LIBFUSE
	bool "libfuse"
	select BR2_LARGEFILE
	help
	  FUSE (Filesystem in UserSpacE)

	  http://fuse.sourceforge.net/
```

## package/fusion/Config.in
```kconfig
config BR2_PACKAGE_LINUX_FUSION
	bool "linux-fusion communication layer for DirectFB multi"
	default n
	depends on BR2_PACKAGE_DIRECTFB
	help
	  DirectFB Communication Layer allowing multiple DirectFB
	  applications to run concurrently
```

## package/fwts/Config.in
```kconfig
config BR2_PACKAGE_FWTS
	bool "fwts"
	depends on BR2_i386 || BR2_x86_64 || BR2_aarch64
	depends on BR2_PACKAGE_LIBBSD_ARCH_SUPPORTS # libbsd
	depends on BR2_TOOLCHAIN_HAS_SYNC_4 # json-c
	depends on BR2_USE_MMU # libglib2
	depends on BR2_USE_WCHAR # libglib2, libbsd
	depends on BR2_TOOLCHAIN_HAS_THREADS # libglib2, libbsd
	depends on BR2_TOOLCHAIN_USES_GLIBC # execinfo.h
	select BR2_PACKAGE_LIBGLIB2
	select BR2_PACKAGE_JSON_C
	select BR2_PACKAGE_LIBBSD
	help
	  Firmware Test Suite (FWTS) is a test suite that performs
	  sanity checks on firmware. It is intended to identify BIOS and
	  ACPI errors and if appropriate it will try to explain the
	  errors and give advice to help workaround or fix firmware
	  bugs.

	  dtc (libfdt) is an optional dependency for fdt related tests.

	  https://wiki.ubuntu.com/FirmwareTestSuite

if BR2_PACKAGE_FWTS
config BR2_PACKAGE_FWTS_EFI_RUNTIME_MODULE
	bool "efi_runtime module"
	depends on BR2_LINUX_KERNEL
	help
	  Firmware Test Suite (FWTS) provides a EFI runtime kernel
	  module required to run UEFI tests.

comment "efi_runtime module needs a Linux kernel to be built"
	depends on !BR2_LINUX_KERNEL
endif

comment "fwts needs a glibc toolchain w/ wchar, threads"
	depends on BR2_i386 || BR2_x86_64 || BR2_aarch64
	depends on BR2_PACKAGE_LIBBSD_ARCH_SUPPORTS # libbsd
	depends on BR2_TOOLCHAIN_HAS_SYNC_4
	depends on BR2_USE_MMU
	depends on !BR2_USE_WCHAR || !BR2_TOOLCHAIN_HAS_THREADS || \
		!BR2_TOOLCHAIN_USES_GLIBC
```

## package/fwup/Config.in
```kconfig
config BR2_PACKAGE_FWUP
	bool "fwup"
	depends on BR2_USE_MMU
	depends on BR2_USE_WCHAR
	select BR2_PACKAGE_LIBARCHIVE
	# required by libarchive to include zip compression
	select BR2_PACKAGE_ZLIB
	select BR2_PACKAGE_LIBCONFUSE
	select BR2_PACKAGE_LIBSODIUM
	help
	  Fwup is a scriptable embedded Linux firmware update creator
	  and runner.

	  https://github.com/fhunleth/fwup

comment "fwup needs a toolchain w/ wchar"
	depends on BR2_USE_MMU
	depends on !BR2_USE_WCHAR
```

## package/fxload/Config.in
```kconfig
config BR2_PACKAGE_FXLOAD
	bool "fxload"
	# Hits gcc PR63261 on Microblaze with debugging symbols
	# enabled. Since this package is unlikely to be useful on
	# Microblaze, just disable it on this architecture.
	depends on !BR2_microblaze
	help
	  This program is conveniently able to download firmware into FX, FX2,
	  and FX2LP EZ-USB devices, as well as the original AnchorChips EZ-USB.
	  It is intended to be invoked by hotplug scripts when the unprogrammed
	  device appears on the bus.

	  http://sourceforge.net/projects/linux-hotplug/
```

## package/gadgetfs-test/Config.in
```kconfig
config BR2_PACKAGE_GADGETFS_TEST
	bool "gadgetfs-test"
	depends on BR2_TOOLCHAIN_HAS_THREADS
	help
	  Test program for gadgetfs from linux-usb.org

if BR2_PACKAGE_GADGETFS_TEST

config BR2_PACKAGE_GADGETFS_TEST_USE_AIO
	bool "use asynchronous i/o"
	select BR2_PACKAGE_LIBAIO
	help
	  Select this to have gadgetfs-test do asynchronous I/O using
	  the libaio library.

endif

comment "gadgetfs-test needs a toolchain w/ threads"
	depends on !BR2_TOOLCHAIN_HAS_THREADS
```

## package/games/Config.in
```kconfig
menu "Games"
source "package/games/ace_of_penguins/Config.in"
source "package/games/doom-wad/Config.in"
source "package/games/gnuchess/Config.in"
source "package/games/lxdoom/Config.in"
source "package/games/magiccube4d/Config.in"
source "package/games/prboom/Config.in"
source "package/games/rubix/Config.in"
source "package/games/vice/Config.in"
source "package/games/xboard/Config.in"
endmenu
```

## package/games/doom-wad/Config.in
```kconfig
config BR2_PACKAGE_DOOM_WAD
	bool "shareware Doom WAD file"
	depends on BR2_PACKAGE_LXDOOM || BR2_PACKAGE_PRBOOM
	help
	  This will install the shareware wad data file for the doom game.

	  The wad file will be placed in the /usr/share/games/doom directory.
```

## package/games/gnuchess/Config.in
```kconfig
config BR2_PACKAGE_GNUCHESS
	bool "gnuchess"
	depends on BR2_TOOLCHAIN_HAS_THREADS
	help
	  GNU Chess lets most modern computers play a full game of chess.

	  http://ftp.gnu.org/pub/gnu/chess

comment "gnuchess requires a toolchain with thread support"
	depends on !BR2_TOOLCHAIN_HAS_THREADS
```
