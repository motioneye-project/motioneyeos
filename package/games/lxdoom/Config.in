## package/games/lxdoom/Config.in
```kconfig
config BR2_PACKAGE_LXDOOM
	bool "lxdoom"
	depends on BR2_PACKAGE_XORG7
	help
	  This is the linux version of the popular doom game.
```

## package/games/magiccube4d/Config.in
```kconfig
config BR2_PACKAGE_MAGICCUBE4D
	bool "magiccube4d"
	depends on BR2_INSTALL_LIBSTDCPP
	depends on BR2_PACKAGE_XORG7
	help
	  Another rubiks cube-like game in 4D

	  http://avr32linux.org/twiki/bin/viewfile/Main

comment "magiccube4d requires a toolchain with C++ support enabled"
	depends on !BR2_INSTALL_LIBSTDCPP && BR2_PACKAGE_XORG7
```

## package/games/rubix/Config.in
```kconfig
config BR2_PACKAGE_RUBIX
	bool "rubix"
	depends on BR2_PACKAGE_XORG7
	help
	  A 3D rubiks cube game for X

	  http://avr32linux.org/twiki/pub/Main/Rubix
```

## package/games/vice/Config.in
```kconfig
config BR2_PACKAGE_VICE
	bool "vice"
	depends on BROKEN # doesn't build, wrong dependencies
	# remove before 2010.02 release
	help
	  VICE is a Commodore emulator

	  http://www.viceteam.org/online
```

## package/games/xboard/Config.in
```kconfig
config BR2_PACKAGE_XBOARD
	bool "xboard"
	depends on BR2_PACKAGE_XORG7
	select BR2_PACKAGE_GNUCHESS
	help
	  XBoard and WinBoard are graphical user interfaces for chess.

	  http://ftp.gnu.org/gnu/xboard
```

## package/gamin/Config.in
```kconfig
config BR2_PACKAGE_GAMIN
	bool "gamin"
	depends on BR2_USE_WCHAR # glib2
	depends on BR2_TOOLCHAIN_HAS_THREADS # glib2
	select BR2_PACKAGE_LIBGLIB2
	help
	  the File Alteration Monitor

	  http://www.gnome.org/~veillard/gamin/sources

comment "gamin needs a toolchain w/ wchar, threads"
	depends on !BR2_USE_WCHAR || !BR2_TOOLCHAIN_HAS_THREADS
```

## package/gauche/Config.in
```kconfig
config BR2_PACKAGE_GAUCHE
	bool "gauche"
	depends on BR2_TOOLCHAIN_HAS_THREADS_NPTL
	depends on BR2_USE_MMU # fork()
	depends on BR2_ARCH_HAS_ATOMICS
	help
	  Gauche is an R7RS Scheme implementation developed to be a
	  handy script interpreter, which allows programmers and
	  system administrators to write small to large scripts for
	  their daily chores. Quick startup, built-in system
	  interface, native multilingual support are some of its
	  goals.

	  http://practical-scheme.net/gauche/

comment "gauche needs a toolchain w/ NPTL"
	depends on BR2_USE_MMU
	depends on BR2_ARCH_HAS_ATOMICS
	depends on !BR2_TOOLCHAIN_HAS_THREADS_NPTL
```

## package/gawk/Config.in
```kconfig
config BR2_PACKAGE_GAWK
	bool "gawk"
	depends on BR2_USE_WCHAR
	depends on BR2_USE_MMU # fork()
	depends on !BR2_STATIC_LIBS
	help
	  A special-purpose programming language which is data driven
	  rather than procedural.  Allows for simple data-reformatting jobs
	  with just a few lines of code.

	  http://www.gnu.org/software/gawk/

comment "gawk needs a toolchain w/ wchar, dynamic library"
	depends on BR2_USE_MMU
	depends on !BR2_USE_WCHAR || BR2_STATIC_LIBS
```

## package/gcc/Config.in.host
```kconfig
comment "GCC Options"

choice
	prompt "GCC compiler Version"
	default BR2_GCC_VERSION_ARC if BR2_arc
	default BR2_GCC_VERSION_CSKY if BR2_csky
	default BR2_GCC_VERSION_8_X
	help
	  Select the version of gcc you wish to use.

config BR2_GCC_VERSION_ARC
	bool "gcc arc (9.x)"
	# Only supported architecture
	depends on BR2_arc
	select BR2_TOOLCHAIN_GCC_AT_LEAST_9

config BR2_GCC_VERSION_CSKY
	bool "gcc csky"
	# Only supported architecture
	depends on BR2_csky
	select BR2_TOOLCHAIN_GCC_AT_LEAST_6

config BR2_GCC_VERSION_5_X
	bool "gcc 5.x"
	depends on !BR2_ARCH_NEEDS_GCC_AT_LEAST_6
	# Broken or unsupported architectures
	depends on !BR2_arc
	depends on !BR2_or1k
	# musl on ppc64 and mips64 unsupported
	depends on !(BR2_TOOLCHAIN_USES_MUSL && (BR2_powerpc64 || BR2_powerpc64le))
	depends on !(BR2_TOOLCHAIN_USES_MUSL && (BR2_mips64 || BR2_mips64el))
	# glibc >= 2.30 needs gcc >= 6.2 on all architectures.
	depends on !BR2_TOOLCHAIN_USES_GLIBC
	select BR2_TOOLCHAIN_GCC_AT_LEAST_5

config BR2_GCC_VERSION_7_X
	bool "gcc 7.x"
	depends on !BR2_ARCH_NEEDS_GCC_AT_LEAST_8
	# Broken or unsupported architectures
	depends on !BR2_or1k
	select BR2_TOOLCHAIN_GCC_AT_LEAST_7

config BR2_GCC_VERSION_8_X
	bool "gcc 8.x"
	depends on !BR2_ARCH_NEEDS_GCC_AT_LEAST_9
	# Broken or unsupported architectures
	depends on !BR2_or1k
	# powerpc spe support has been deprecated since gcc 8.x.
	# https://gcc.gnu.org/ml/gcc/2018-04/msg00102.html
	depends on !BR2_powerpc_SPE
	select BR2_TOOLCHAIN_GCC_AT_LEAST_8

config BR2_GCC_VERSION_9_X
	bool "gcc 9.x"
	# or1k needs binutils >= 2.32
	depends on !(BR2_or1k && BR2_BINUTILS_VERSION_2_31_X)
	# powerpc spe support has been deprecated since gcc 8.x.
	# https://gcc.gnu.org/ml/gcc/2018-04/msg00102.html
	depends on !BR2_powerpc_SPE
	# C-SKY sk610 needs abiv1, which is not supported in
	# upstream gcc. C-SKY gcc upstream support not tested
	# with upstream binutils and glibc.
	depends on !BR2_csky
	select BR2_TOOLCHAIN_GCC_AT_LEAST_9

endchoice

# libcilkrts was introduced in gcc 4.9 and removed in gcc 8.x
config BR2_GCC_SUPPORTS_LIBCILKRTS
	bool
	default y if !BR2_TOOLCHAIN_GCC_AT_LEAST_8

config BR2_GCC_SUPPORTS_DLANG
	bool
	default y if BR2_aarch64
	default y if BR2_arm
	default y if BR2_i386
	default y if BR2_mips || BR2_mipsel
	default y if BR2_mips64 || BR2_mips64el
	default y if BR2_powerpc || BR2_powerpc64 || BR2_powerpc64le
	default y if BR2_x86_64
	default y if BR2_riscv && !BR2_RISCV_64
	depends on BR2_TOOLCHAIN_GCC_AT_LEAST_9
	depends on BR2_TOOLCHAIN_USES_GLIBC

config BR2_GCC_VERSION
	string
	default "5.5.0"     if BR2_GCC_VERSION_5_X
	default "7.5.0"     if BR2_GCC_VERSION_7_X
	default "8.4.0"     if BR2_GCC_VERSION_8_X
	default "9.3.0"     if BR2_GCC_VERSION_9_X
	default "arc-2019.09-release" if BR2_GCC_VERSION_ARC
	default "48152afb96c59733d5bc79e3399bb7b3d4b44266" if BR2_GCC_VERSION_CSKY

config BR2_EXTRA_GCC_CONFIG_OPTIONS
	string "Additional gcc options"
	default ""
	help
	  Any additional gcc configure options you may want to
	  include. Those options are applied for all of the gcc
	  initial, gcc intermediate and gcc final passes.

config BR2_TOOLCHAIN_BUILDROOT_CXX
	bool "Enable C++ support"
	select BR2_INSTALL_LIBSTDCPP
	help
	  Enable this option if you want your toolchain to support the
	  C++ language and you want C++ libraries to be installed on
	  your target system.

comment "Fortran support needs a toolchain w/ wchar"
	depends on BR2_TOOLCHAIN_HAS_LIBQUADMATH
	depends on !BR2_USE_WCHAR # libquadmath

config BR2_TOOLCHAIN_BUILDROOT_FORTRAN
	bool "Enable Fortran support"
	# on architecture building libquadmath, wchar is required
	depends on !BR2_TOOLCHAIN_HAS_LIBQUADMATH || \
		(BR2_TOOLCHAIN_HAS_LIBQUADMATH && BR2_USE_WCHAR)
	select BR2_TOOLCHAIN_HAS_FORTRAN
	help
	  Enable this option if you want your toolchain to support the
	  Fortran language and you want Fortran libraries to be
	  installed on your target system.

config BR2_TOOLCHAIN_BUILDROOT_DLANG
	bool "Enable D language support"
	depends on BR2_GCC_SUPPORTS_DLANG
	select BR2_TOOLCHAIN_HAS_DLANG
	help
	  Enable this option if you want your toolchain to support the
	  D language and you want D libraries to be installed on your
	  target system.

config BR2_GCC_ENABLE_LTO
	bool "Enable compiler link-time-optimization support"
	select BR2_BINUTILS_ENABLE_LTO
	help
	  This option enables link-time optimization (LTO) support in
	  gcc.

config BR2_GCC_ENABLE_OPENMP
	bool "Enable compiler OpenMP support"
	depends on !BR2_PTHREADS_NONE && !BR2_arc && !BR2_microblaze
	select BR2_TOOLCHAIN_HAS_OPENMP
	help
	  Enable OpenMP support for the compiler

config BR2_GCC_ENABLE_GRAPHITE
	bool "Enable graphite support"
	depends on BR2_TOOLCHAIN_GCC_AT_LEAST_5
	help
	  This option enables the graphite optimizations in the
	  compiler.

comment "graphite support needs gcc >= 5.x"
	depends on !BR2_TOOLCHAIN_GCC_AT_LEAST_5
```

## package/gcnano-binaries/Config.in
```kconfig
comment "gcnano-binaries needs a Linux kernel to be built"
	depends on BR2_arm
	depends on !BR2_LINUX_KERNEL

comment "gcnano-binaries needs a glibc toolchain w/ threads, dynamic library"
	depends on BR2_arm
	depends on !BR2_TOOLCHAIN_USES_GLIBC || !BR2_TOOLCHAIN_HAS_THREADS \
		|| BR2_STATIC_LIBS

config BR2_PACKAGE_GCNANO_BINARIES
	bool "gcnano-binaries"
	depends on BR2_arm
	depends on BR2_LINUX_KERNEL
	depends on BR2_TOOLCHAIN_USES_GLIBC
	depends on BR2_TOOLCHAIN_HAS_THREADS # libdrm, wayland
	depends on !BR2_STATIC_LIBS
	select BR2_PACKAGE_HAS_LIBEGL
	select BR2_PACKAGE_HAS_LIBGLES
	select BR2_PACKAGE_LIBDRM
	select BR2_PACKAGE_WAYLAND
	help
	  Driver and libaries for stm vivante gcnano gpu.
	  https://github.com/STMicroelectronics/gcnano-binaries/

if BR2_PACKAGE_GCNANO_BINARIES

config BR2_PACKAGE_PROVIDES_LIBEGL
	default "gcnano-binaries"

config BR2_PACKAGE_PROVIDES_LIBGLES
	default "gcnano-binaries"

endif
```

## package/gconf/Config.in
```kconfig
config BR2_PACKAGE_GCONF
	bool "gconf"
	depends on BR2_TOOLCHAIN_HAS_THREADS # dbus, libglib2
	depends on BR2_USE_MMU # dbus, libglib2
	depends on BR2_USE_WCHAR # libglib2
	depends on !BR2_STATIC_LIBS
	select BR2_PACKAGE_DBUS
	select BR2_PACKAGE_DBUS_GLIB
	select BR2_PACKAGE_LIBGLIB2
	select BR2_PACKAGE_LIBXML2
	help
	  GConf was a system used by the GNOME desktop environment for
	  storing configuration settings for the desktop and
	  applications. It is similar to the Windows Registry.

	  https://projects.gnome.org/gconf/

comment "gconf needs a toolchain w/ threads, wchar, dynamic library"
	depends on BR2_USE_MMU
	depends on !BR2_TOOLCHAIN_HAS_THREADS || !BR2_USE_WCHAR \
		|| BR2_STATIC_LIBS
```

## package/gcr/Config.in
```kconfig
config BR2_PACKAGE_GCR
	bool "gcr"
	depends on BR2_USE_WCHAR # libglib2
	depends on BR2_TOOLCHAIN_HAS_THREADS # libglib2
	depends on BR2_USE_MMU # libglib2
	depends on !BR2_STATIC_LIBS # p11-kit
	select BR2_PACKAGE_GNUPG2 # runtime
	select BR2_PACKAGE_LIBGCRYPT
	select BR2_PACKAGE_LIBGLIB2
	select BR2_PACKAGE_P11_KIT
	help
	  Library for cryptographic UIs and accessing PKCS#11 modules.

	  https://developer.gnome.org/gcr/

comment "gcr needs a toolchain w/ wchar, threads, dynamic library"
	depends on BR2_USE_MMU
	depends on !BR2_USE_WCHAR || !BR2_TOOLCHAIN_HAS_THREADS || \
		BR2_STATIC_LIBS
```

## package/gd/Config.in
```kconfig
config BR2_PACKAGE_GD
	bool "gd"
	help
	  GD is a graphics library. It allows your code to quickly
	  draw images complete with lines, arcs, text, multiple
	  colours, cut and paste from other images, flood fills, and
	  write out the result as a PNG file. This is particularly
	  useful in World Wide Web applications, where PNG is one of
	  the formats accepted for inline images by most browsers.

	  http://www.boutell.com/gd/

if BR2_PACKAGE_GD

menu "gd tools"

config BR2_PACKAGE_GD_ANNOTATE
       bool "annotate"

config BR2_PACKAGE_GD_BDFTOGD
       bool "bdftogd"
       depends on BR2_PACKAGE_PERL

config BR2_PACKAGE_GD_GD2COPYPAL
       bool "gd2copypal"

config BR2_PACKAGE_GD_GD2TOGIF
       bool "gd2togif"

config BR2_PACKAGE_GD_GD2TOPNG
       bool "gd2topng"
       select BR2_PACKAGE_LIBPNG

config BR2_PACKAGE_GD_GDCMPGIF
       bool "gdcmpgif"

config BR2_PACKAGE_GD_GDPARTTOPNG
       bool "gdparttopng"
       select BR2_PACKAGE_LIBPNG

config BR2_PACKAGE_GD_GDTOPNG
       bool "gdtopng"
       select BR2_PACKAGE_LIBPNG

config BR2_PACKAGE_GD_GIFTOGD2
       bool "giftogd2"

config BR2_PACKAGE_GD_PNGTOGD
       bool "pngtogd"
       select BR2_PACKAGE_LIBPNG

config BR2_PACKAGE_GD_PNGTOGD2
       bool "pngtogd2"
       select BR2_PACKAGE_LIBPNG

config BR2_PACKAGE_GD_WEBPNG
       bool "webpng"
       select BR2_PACKAGE_LIBPNG

endmenu

endif
```

## package/gdb/Config.in
```kconfig
comment "gdb/gdbserver needs a toolchain w/ threads, threads debug"
	depends on !BR2_nios2 && !BR2_bfin
	depends on !BR2_TOOLCHAIN_HAS_THREADS || !BR2_TOOLCHAIN_HAS_THREADS_DEBUG

config BR2_PACKAGE_GDB
	bool "gdb"
	# When the external toolchain gdbserver is copied to the
	# target, we don't allow building a separate gdbserver. The
	# one from the external toolchain should be used.
	select BR2_PACKAGE_GDB_SERVER if \
		(!BR2_PACKAGE_GDB_DEBUGGER && !BR2_TOOLCHAIN_EXTERNAL_GDB_SERVER_COPY)
	depends on BR2_TOOLCHAIN_HAS_THREADS && BR2_TOOLCHAIN_HAS_THREADS_DEBUG
	depends on !BR2_nios2 && !BR2_bfin
	help
	  GDB, the GNU Project debugger, allows you to see what is
	  going on `inside' another program while it executes -- or
	  what another program was doing at the moment it crashed.

	  This option allows to build gdbserver and/or the gdb
	  debugger for the target.

	  For embedded development, the most common solution is to
	  build only 'gdbserver' for the target, and use a cross-gdb
	  on the host. See BR2_PACKAGE_HOST_GDB in the Toolchain menu
	  to enable one. Notice that external toolchains often provide
	  their own pre-built cross-gdb and gdbserver binaries.

	  http://www.gnu.org/software/gdb/

if BR2_PACKAGE_GDB

config BR2_PACKAGE_GDB_SERVER
	bool "gdbserver"
	depends on !BR2_TOOLCHAIN_EXTERNAL_GDB_SERVER_COPY
	help
	  Build the gdbserver stub to run on the target.
	  A full gdb is needed to debug the progam.

config BR2_PACKAGE_GDB_DEBUGGER
	bool "full debugger"
	select BR2_PACKAGE_NCURSES
	depends on BR2_USE_WCHAR
	depends on !BR2_sh && !BR2_sh64 && !BR2_microblaze

comment "full gdb on target needs a toolchain w/ wchar"
	depends on !BR2_sh && !BR2_sh64 && !BR2_microblaze
	depends on !BR2_USE_WCHAR

if BR2_PACKAGE_GDB_DEBUGGER

config BR2_PACKAGE_GDB_TUI
	bool "TUI support"
	help
	  This option enables terminal user interface (TUI) for gdb

	  "The GDB Text User Interface (TUI) is a terminal interface
	  which uses the curses library to show the source file, the
	  assembly output, the program registers and GDB commands in
	  separate text windows."

	  https://sourceware.org/gdb/current/onlinedocs/gdb/TUI.html

config BR2_PACKAGE_GDB_PYTHON
	bool "Python support"
	# Only Python 2.x is supported by gdb for now
	depends on BR2_PACKAGE_PYTHON
	help
	  This option enables Python support in the target gdb.

endif

endif
```
