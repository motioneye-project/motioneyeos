## package/gdb/Config.in.host
```kconfig
config BR2_PACKAGE_HOST_GDB_ARCH_SUPPORTS
	bool
	default y
	depends on !((BR2_arm || BR2_armeb) && BR2_BINFMT_FLAT)
	depends on !BR2_microblaze
	depends on !BR2_nios2
	depends on !BR2_or1k
	depends on !BR2_riscv
	depends on !BR2_nds32

comment "Host GDB Options"
	depends on !BR2_TOOLCHAIN_EXTERNAL_GDB_SERVER_COPY
	depends on BR2_PACKAGE_HOST_GDB_ARCH_SUPPORTS

config BR2_PACKAGE_HOST_GDB
	bool "Build cross gdb for the host"
	# When the external toolchain gdbserver is used, we shouldn't
	# allow to build a cross-gdb, as the one of the external
	# toolchain should be used.
	depends on !BR2_TOOLCHAIN_EXTERNAL_GDB_SERVER_COPY
	depends on BR2_PACKAGE_HOST_GDB_ARCH_SUPPORTS
	help
	  Build a cross gdb that runs on the host machine and debugs
	  programs running on the target. It requires 'gdbserver'
	  installed on the target, see BR2_PACKAGE_GDB_SERVER to
	  enable it.

if BR2_PACKAGE_HOST_GDB

config BR2_PACKAGE_HOST_GDB_TUI
	bool "TUI support"
	help
	  This option enables terminal user interface (TUI) for gdb

config BR2_PACKAGE_HOST_GDB_PYTHON
	bool "Python support"
	help
	  This option enables the Python support in the cross gdb.

config BR2_PACKAGE_HOST_GDB_SIM
	bool "Simulator support"
	depends on !BR2_arc
	help
	  This option enables the simulator support in the cross gdb.

choice
	prompt "GDB debugger Version"
	default BR2_GDB_VERSION_8_2
	depends on !BR2_arc
	depends on !BR2_csky
	help
	  Select the version of gdb you wish to use.

config BR2_GDB_VERSION_8_1
	bool "gdb 8.1.x"

config BR2_GDB_VERSION_8_2
	bool "gdb 8.2.x"

config BR2_GDB_VERSION_8_3
	bool "gdb 8.3.x"

endchoice

endif

# If cross-gdb is not enabled, the latest working version is chosen.
config BR2_GDB_VERSION
	string
	default "arc-2019.09-release-gdb" if BR2_arc
	default "4ecb98fbc2f94dbe01b69384afbc515107de73df" if BR2_csky
	default "8.1.1"    if BR2_GDB_VERSION_8_1
	default "8.2.1"    if BR2_GDB_VERSION_8_2 || !BR2_PACKAGE_HOST_GDB
	default "8.3"	   if BR2_GDB_VERSION_8_3
	depends on BR2_PACKAGE_GDB || BR2_PACKAGE_HOST_GDB
```

## package/gdbm/Config.in
```kconfig
config BR2_PACKAGE_GDBM
	bool "gdbm"
	help
	  GNU dbm is a set of database routines that use extensible hashing.
	  It works similar to the standard UNIX dbm routines.

	  http://www.gnu.org/software/gdbm/gdbm.html
```

## package/gdisk/Config.in
```kconfig
config BR2_PACKAGE_GDISK
	bool "gdisk"
	depends on BR2_LARGEFILE
	depends on BR2_INSTALL_LIBSTDCPP
	depends on BR2_USE_WCHAR # util-linux
	help
	  GPT fdisk (consisting of the gdisk and sgdisk programs) is a
	  text-mode partitioning tool that works on Globally Unique Identifier
	  (GUID) Partition Table (GPT) disks, rather than on the more common
	  (through 2010) Master Boot Record (MBR) partition tables.

	  http://www.rodsbooks.com/gdisk/

config BR2_PACKAGE_GDISK_GDISK
	bool "interactive gdisk"
	depends on BR2_PACKAGE_GDISK
	select BR2_PACKAGE_UTIL_LINUX
	select BR2_PACKAGE_UTIL_LINUX_LIBUUID
	help
	  Install the interactive GUID partition table (GPT) manipulator
	  /usr/sbin/gdisk which is modelled after and quite similar in use
	  to the traditional MBR based fdisk tool.

config BR2_PACKAGE_GDISK_SGDISK
	bool "command line sgdisk"
	depends on BR2_PACKAGE_GDISK
	select BR2_PACKAGE_UTIL_LINUX
	select BR2_PACKAGE_UTIL_LINUX_LIBUUID
	select BR2_PACKAGE_POPT
	help
	  Install the command-line GUID partition table (GPT) manipulator
	  /usr/sbin/sgdisk which is named after the traditional MBR based
	  sfdisk tool albeit with an entirely different option syntax.

comment "gdisk requires a toolchain with LARGEFILE/WCHAR/C++ support enabled"
	depends on !(BR2_LARGEFILE && BR2_INSTALL_LIBSTDCPP && BR2_USE_WCHAR)
```

## package/gdk-pixbuf/Config.in
```kconfig
config BR2_PACKAGE_GDK_PIXBUF
	bool "gdk-pixbuf"
	depends on BR2_USE_WCHAR # glib2
	depends on BR2_TOOLCHAIN_HAS_THREADS # glib2
	select BR2_PACKAGE_LIBGLIB2
	select BR2_PACKAGE_LIBICONV if !BR2_ENABLE_LOCALE
	help
	  Gdk-Pixbuf is an image loader and scaler. It uses GObject
	  and the GLib, to integrate well with GNOME applications.

	  http://www.gtk.org/

comment "gdk-pixbuf needs a toolchain w/ wchar, threads"
	depends on !BR2_USE_WCHAR || !BR2_TOOLCHAIN_HAS_THREADS
```

## package/genext2fs/Config.in
```kconfig
config BR2_PACKAGE_GENEXT2FS
	bool "genext2fs"
	depends on BR2_LARGEFILE
	help
	  genext2fs generates an ext2 filesystem as a normal (non-root)
	  user.  It does not require you to mount the image file to
	  copy files on it, nor does it require that you become the
	  superuser to make device nodes.

	  http://genext2fs.sourceforge.net/

comment "genext2fs needs a toolchain w/ largefile"
	depends on !BR2_LARGEFILE
```

## package/genext2fs/Config.in.host
```kconfig
config BR2_PACKAGE_HOST_GENEXT2FS
	bool "host genext2fs"
	help
	  genext2fs generates an ext2 filesystem as a normal (non-root)
	  user.  It does not require you to mount the image file to
	  copy files on it, nor does it require that you become the
	  superuser to make device nodes.

	  http://genext2fs.sourceforge.net/
```

## package/genpart/Config.in
```kconfig
config BR2_PACKAGE_GENPART
	bool "genpart"
	help
	  Generate a 16 byte partition table entry defined by command line
	  arguments and dump it to stdout. No CHS magic is done, only lba
	  entries are filled out.

	  http://www.pengutronix.de/software/genpart/index_en.html
```

## package/genromfs/Config.in
```kconfig
config BR2_PACKAGE_GENROMFS
       bool "genromfs"
       help
         Tool to generate a ROMFS filesystem.

	 http://romfs.sourceforge.net/
```

## package/gensio/Config.in
```kconfig
config BR2_PACKAGE_GENSIO
	bool "gensio"
	depends on BR2_USE_MMU # fork()
	help
	  A library to abstract stream I/O like serial port, TCP,
	  telnet, UDP, SSL, IPMI SOL, etc.

	  https://github.com/cminyard/gensio
```

## package/geoip/Config.in
```kconfig
config BR2_PACKAGE_GEOIP
	bool "geoip"
	help
	  GeoIP is a C library that enables the user to find
	  geographical and network information of an IP address.

	  To use this library, you need to download MaxMind's free
	  GeoLite or commercial GeoIP binary databases into the
	  target's /usr/share/GeoIP directory in uncompressed form.

	  Note that GeoIP2 / GeoLite2 are not supported by this
	  library.

	  https://github.com/maxmind/geoip-api-c
```

## package/gerbera/Config.in
```kconfig
config BR2_PACKAGE_GERBERA
	bool "gerbera"
	depends on BR2_USE_MMU # fork()
	depends on BR2_TOOLCHAIN_HAS_ATOMIC
	depends on BR2_TOOLCHAIN_HAS_THREADS
	depends on BR2_TOOLCHAIN_GCC_AT_LEAST_7 # C++17 optional
	depends on BR2_INSTALL_LIBSTDCPP
	depends on !BR2_PACKAGE_LIBUPNP # libupnp18
	select BR2_PACKAGE_EXPAT
	select BR2_PACKAGE_LIBICONV if !BR2_ENABLE_LOCALE
	select BR2_PACKAGE_LIBUPNP18
	select BR2_PACKAGE_SQLITE
	select BR2_PACKAGE_UTIL_LINUX
	select BR2_PACKAGE_UTIL_LINUX_LIBUUID
	select BR2_PACKAGE_ZLIB
	help
	  A free media server.
	  Stream your media to devices on your home network.

	  https://gerbera.io

comment "gerbera needs a toolchain w/ C++, threads, gcc >= 7"
	depends on BR2_USE_MMU
	depends on BR2_TOOLCHAIN_HAS_ATOMIC
	depends on !BR2_PACKAGE_LIBUPNP
	depends on !BR2_INSTALL_LIBSTDCPP || !BR2_TOOLCHAIN_HAS_THREADS || \
		!BR2_TOOLCHAIN_GCC_AT_LEAST_7
```
