## package/gesftpserver/Config.in
```kconfig
config BR2_PACKAGE_GESFTPSERVER
	bool "gesftpserver"
	select BR2_PACKAGE_LIBICONV if !BR2_ENABLE_LOCALE
	depends on BR2_USE_WCHAR
	depends on BR2_TOOLCHAIN_HAS_THREADS
	depends on BR2_USE_MMU # fork()
	help
	  Green End SFTP Server

	  This is an SFTP server supporting up to protocol version 6.
	  It is possible to use it as a drop-in replacement for the
	  OpenSSH server, or to provide sftp support for Dropbear.

	  http://www.greenend.org.uk/rjk/sftpserver/

comment "gesftpserver needs a toolchain w/ wchar, threads"
	depends on BR2_USE_MMU
	depends on !BR2_USE_WCHAR || !BR2_TOOLCHAIN_HAS_THREADS
```

## package/getent/Config.in
```kconfig
config BR2_PACKAGE_GETENT
	bool "getent"
	help
	  This package installs the 'getent' utility, which allows to
	  get entries from Name Service Switch libraries. For glibc
	  toolchains, it's the real getent program from the C library
	  that gets installed, which is NSS-capable. For uclibc and
	  musl toolchains, it's a simple wrapper script that emulates
	  getent's behavior, since there is no NSS support in uclibc
	  and musl.
```

## package/gettext-gnu/Config.in
```kconfig
config BR2_PACKAGE_GETTEXT_GNU
	bool
	depends on BR2_USE_WCHAR
	select BR2_PACKAGE_HAS_GETTEXT
	help
	  The GNU `gettext' utilities are a set of tools that provide a
	  framework to help other GNU packages produce multi-lingual
	  messages.

	  Only the libintl library will be installed in the
	  target. The full gettext suite, including tools, will be
	  installed in the staging directory.

	  http://www.gnu.org/software/gettext/

if BR2_PACKAGE_GETTEXT_GNU

config BR2_PACKAGE_PROVIDES_GETTEXT
	default "gettext-gnu"

endif

config BR2_PACKAGE_PROVIDES_HOST_GETTEXT
	default "host-gettext-gnu" if BR2_SYSTEM_ENABLE_NLS
```

## package/gettext-tiny/Config.in
```kconfig
config BR2_PACKAGE_GETTEXT_TINY
	bool
	select BR2_PACKAGE_HAS_GETTEXT
	help
	  Stub and/or lightweight replacements of the gnu gettext
	  suite; because the GNU one takes ages to compile.

	  https://github.com/sabotage-linux/gettext-tiny

if BR2_PACKAGE_GETTEXT_TINY

config BR2_PACKAGE_PROVIDES_GETTEXT
	default "gettext-tiny"

endif

config BR2_PACKAGE_PROVIDES_HOST_GETTEXT
	default "host-gettext-tiny" if !BR2_SYSTEM_ENABLE_NLS
```

## package/gettext/Config.in
```kconfig
config BR2_PACKAGE_GETTEXT
	bool "gettext"
	select BR2_PACKAGE_GETTEXT_GNU if BR2_SYSTEM_ENABLE_NLS
	select BR2_PACKAGE_GETTEXT_TINY if !BR2_SYSTEM_ENABLE_NLS

config BR2_PACKAGE_GETTEXT_PROVIDES_LIBINTL
	bool
	default y if BR2_SYSTEM_ENABLE_NLS
	depends on !BR2_TOOLCHAIN_HAS_FULL_GETTEXT

config BR2_PACKAGE_HAS_GETTEXT
	bool

config BR2_PACKAGE_PROVIDES_GETTEXT
	string

config BR2_PACKAGE_PROVIDES_HOST_GETTEXT
	string
```

## package/gflags/Config.in
```kconfig
config BR2_PACKAGE_GFLAGS
	bool "gflags"
	depends on BR2_INSTALL_LIBSTDCPP
	help
	  The gflags package contains a C++ library that implements
	  commandline flags processing. It includes built-in support for
	  standard types such as string and the ability to define flags
	  in the source file in which they are used.

	  https://github.com/gflags/gflags

comment "gflags needs a toolchain w/ C++"
	depends on !BR2_INSTALL_LIBSTDCPP
```

## package/ghostscript-fonts/Config.in
```kconfig
config BR2_PACKAGE_GHOSTSCRIPT_FONTS
	bool "ghostscript-fonts"
	help
	  Fonts and font metrics customarily distributed with Ghostscript.
	  Currently includes the 35 standard PostScript fonts and a
	  grab-bag of others.

	  http://sourceforge.net/projects/gs-fonts
```

## package/ghostscript/Config.in
```kconfig
config BR2_PACKAGE_GHOSTSCRIPT
	bool "ghostscript"
	depends on BR2_USE_MMU # fork()
	select BR2_PACKAGE_FONTCONFIG
	select BR2_PACKAGE_GHOSTSCRIPT_FONTS
	select BR2_PACKAGE_JPEG
	select BR2_PACKAGE_LCMS2
	select BR2_PACKAGE_LIBPNG
	select BR2_PACKAGE_TIFF
	help
	  Ghostscript is an interpreter for PostScript and Portable
	  Document Format (PDF) files.

	  http://ghostscript.com
```

## package/giblib/Config.in
```kconfig
config BR2_PACKAGE_GIBLIB
	bool "giblib"
	depends on BR2_PACKAGE_XORG7
	depends on !BR2_PREFER_STATIC_LIB
	select BR2_PACKAGE_IMLIB2
	select BR2_PACKAGE_IMLIB2_X
	help
	  Giblib is a simple library which wraps imlib2.

	  http://linuxbrit.co.uk/giblib/

comment "giblib support needs a toolchain w/ dynamic library"
	depends on BR2_PREFER_STATIC_LIB
```

## package/giflib/Config.in
```kconfig
config BR2_PACKAGE_GIFLIB
	bool "giflib"
	help
	  giflib is a library for reading and writing gif images.

	  http://sourceforge.net/projects/giflib
```

## package/git-crypt/Config.in
```kconfig
config BR2_PACKAGE_GIT_CRYPT
	bool "git-crypt"
	depends on BR2_INSTALL_LIBSTDCPP
	depends on BR2_TOOLCHAIN_GCC_AT_LEAST_4_9 # C++11
	depends on !BR2_TOOLCHAIN_HAS_GCC_BUG_64735 # exception_ptr
	depends on BR2_USE_MMU # git
	select BR2_PACKAGE_GIT # runtime
	select BR2_PACKAGE_OPENSSL
	help
	  git-crypt enables transparent encryption and decryption of
	  files in a git repository.

	  https://www.agwa.name/projects/git-crypt/

comment "git-crypt needs a toolchain w/ C++, gcc >= 4.9"
	depends on !BR2_INSTALL_LIBSTDCPP \
		|| !BR2_TOOLCHAIN_GCC_AT_LEAST_4_9
	depends on BR2_USE_MMU

comment "git-crypt needs a toolchain not affected by GCC bug 64735"
	depends on BR2_USE_MMU
	depends on BR2_TOOLCHAIN_HAS_GCC_BUG_64735
```

## package/git/Config.in
```kconfig
config BR2_PACKAGE_GIT
	bool "git"
	depends on BR2_USE_MMU # uses fork()
	select BR2_PACKAGE_ZLIB
	select BR2_PACKAGE_LIBICONV if !BR2_ENABLE_LOCALE
	help
	  Git is a free and open source distributed version control
	  system designed to handle everything from small to very large
	  projects.

	  http://git-scm.com
```

## package/gli/Config.in
```kconfig
config BR2_PACKAGE_GLI
	bool "gli"
	depends on BR2_INSTALL_LIBSTDCPP
	help
	  OpenGL Image (GLI)

	  http://gli.g-truc.net

comment "gli needs a toolchain w/ C++"
	depends on !BR2_INSTALL_LIBSTDCPP
```

## package/glib-networking/Config.in
```kconfig
config BR2_PACKAGE_GLIB_NETWORKING
	bool "glib-networking"
	depends on BR2_USE_WCHAR # glib2
	depends on BR2_TOOLCHAIN_HAS_THREADS # glib2
	depends on BR2_USE_MMU # glib2
	depends on !BR2_STATIC_LIBS
	select BR2_PACKAGE_LIBGLIB2
	select BR2_PACKAGE_OPENSSL if !BR2_PACKAGE_GNUTLS
	help
	  Network-related GIO modules for glib.

	  https://gitlab.gnome.org/GNOME/glib-networking

comment "glib-networking needs a toolchain w/ wchar, threads, dynamic library"
	depends on BR2_USE_MMU
	depends on !BR2_USE_WCHAR || !BR2_TOOLCHAIN_HAS_THREADS || \
		BR2_STATIC_LIBS
```

## package/glibc/Config.in
```kconfig
if BR2_TOOLCHAIN_BUILDROOT_GLIBC

comment "Glibc Options"

config BR2_PACKAGE_GLIBC
	bool
	default y
	select BR2_PACKAGE_LINUX_HEADERS
	select BR2_TOOLCHAIN_HAS_SSP if BR2_PACKAGE_HOST_BINUTILS_SUPPORTS_CFI
	help
	  https://www.gnu.org/software/libc/

config BR2_PACKAGE_GLIBC_UTILS
	bool "Install glibc utilities"
	help
	  Enabling this option will compile and install the getconf,
	  ldconfig, ldd and locale glibc utilities for the target.

endif # BR2_TOOLCHAIN_BUILDROOT_GLIBC
```

## package/glibmm/Config.in
```kconfig
config BR2_PACKAGE_GLIBMM
	bool "glibmm"
	depends on BR2_TOOLCHAIN_GCC_AT_LEAST_4_8 # C++11
	depends on BR2_INSTALL_LIBSTDCPP
	depends on BR2_USE_WCHAR # libglib2
	depends on BR2_TOOLCHAIN_HAS_THREADS # libglib2
	depends on BR2_USE_MMU # libglib2
	select BR2_PACKAGE_LIBGLIB2
	select BR2_PACKAGE_LIBSIGC
	help
	  The GLibmm package is a set of C++ bindings for GLib.

	  http://www.gtkmm.org/

comment "glibmm needs a toolchain w/ C++, wchar, threads, gcc >= 4.8"
	depends on BR2_USE_MMU
	depends on !BR2_TOOLCHAIN_GCC_AT_LEAST_4_8 || !BR2_USE_WCHAR \
		|| !BR2_INSTALL_LIBSTDCPP || !BR2_TOOLCHAIN_HAS_THREADS
```

## package/glm/Config.in
```kconfig
config BR2_PACKAGE_GLM
	bool "glm"
	depends on BR2_INSTALL_LIBSTDCPP
	help
	  OpenGL Mathematics (GLM)

	  http://glm.g-truc.net

comment "glm needs a toolchain w/ C++"
	depends on !BR2_INSTALL_LIBSTDCPP
```

## package/glmark2/Config.in
```kconfig
config BR2_PACKAGE_GLMARK2_FLAVOR_ANY
	bool

config BR2_PACKAGE_GLMARK2_FLAVOR_DRM_GLESV2
	bool
	default y
	depends on BR2_PACKAGE_HAS_LIBEGL
	depends on BR2_PACKAGE_HAS_LIBGLES
	depends on BR2_PACKAGE_HAS_UDEV
	select BR2_PACKAGE_GLMARK2_FLAVOR_ANY

config BR2_PACKAGE_GLMARK2_FLAVOR_DRM_GL
	bool
	default y
	depends on BR2_PACKAGE_HAS_LIBEGL
	depends on BR2_PACKAGE_HAS_LIBGL
	depends on BR2_PACKAGE_HAS_UDEV
	select BR2_PACKAGE_GLMARK2_FLAVOR_ANY

config BR2_PACKAGE_GLMARK2_FLAVOR_WAYLAND_GLESV2
	bool
	default y
	depends on BR2_PACKAGE_HAS_LIBEGL
	depends on BR2_PACKAGE_HAS_LIBGLES
	depends on BR2_PACKAGE_WAYLAND
	select BR2_PACKAGE_GLMARK2_FLAVOR_ANY

config BR2_PACKAGE_GLMARK2_FLAVOR_WAYLAND_GL
	bool
	default y
	depends on BR2_PACKAGE_HAS_LIBEGL
	depends on BR2_PACKAGE_HAS_LIBGL
	depends on BR2_PACKAGE_WAYLAND
	select BR2_PACKAGE_GLMARK2_FLAVOR_ANY

config BR2_PACKAGE_GLMARK2_FLAVOR_X11_GLESV2
	bool
	default y
	depends on BR2_PACKAGE_HAS_LIBEGL
	depends on BR2_PACKAGE_HAS_LIBGLES
	depends on BR2_PACKAGE_XLIB_LIBX11
	select BR2_PACKAGE_GLMARK2_FLAVOR_ANY

config BR2_PACKAGE_GLMARK2_FLAVOR_X11_GL
	bool
	default y
	depends on BR2_PACKAGE_HAS_LIBGL
	depends on BR2_PACKAGE_XLIB_LIBX11
	select BR2_PACKAGE_GLMARK2_FLAVOR_ANY

comment "glmark2 needs a toolchain w/ C++, gcc >= 4.9"
	depends on !BR2_INSTALL_LIBSTDCPP || !BR2_TOOLCHAIN_GCC_AT_LEAST_4_9

comment "glmark2 needs an OpenGL or an openGL ES and EGL backend"
	depends on BR2_TOOLCHAIN_GCC_AT_LEAST_4_9 && BR2_INSTALL_LIBSTDCPP
	depends on !BR2_PACKAGE_GLMARK2_FLAVOR_ANY

config BR2_PACKAGE_GLMARK2
	bool "glmark2"
	depends on BR2_INSTALL_LIBSTDCPP
	depends on BR2_TOOLCHAIN_GCC_AT_LEAST_4_9 # C++14
	depends on BR2_PACKAGE_GLMARK2_FLAVOR_ANY
	select BR2_PACKAGE_JPEG
	select BR2_PACKAGE_LIBPNG
	help
	  glmark2 is an OpenGL 2.0 and ES 2.0 benchmark.

	  https://github.com/glmark2/glmark2
```

## package/glog/Config.in
```kconfig
config BR2_PACKAGE_GLOG
	bool "glog"
	# __ELF__ not defined on Microblaze
	depends on !BR2_microblaze
	depends on BR2_INSTALL_LIBSTDCPP
	help
	  C++ implementation of the Google logging module

	  https://github.com/google/glog

comment "glog needs a toolchain w/ C++"
	depends on !BR2_microblaze
	depends on !BR2_INSTALL_LIBSTDCPP
```

## package/glorytun/Config.in
```kconfig
config BR2_PACKAGE_GLORYTUN
	bool "glorytun"
	select BR2_PACKAGE_LIBSODIUM
	help
	  A small, simple and secure VPN.

	  https://github.com/angt/glorytun
```

## package/glslsandbox-player/Config.in
```kconfig
config BR2_PACKAGE_GLSLSANDBOX_PLAYER
	bool "glslsandbox-player"
	depends on BR2_PACKAGE_HAS_LIBEGL
	depends on BR2_PACKAGE_HAS_LIBGLES
	# Doesn't really depend on threads, but this makes sure we have at least
	# one native windowing system available, and is good enough in practice.
	depends on BR2_TOOLCHAIN_HAS_THREADS
	help
	  GLSL Sandbox standalone player allow one to run and render
	  (most of) nice shaders available online on the
	  http://glslsandbox.com/ website, but without the need of an
	  Internet connection, a web browser or any of its
	  dependencies. Instead, the only requirement of
	  glslsandbox-player is a working EGL and GLESv2 libraries.

	  This package is useful for stressing and testing GLES shader
	  compiler in GPU drivers.

	  https://github.com/jolivain/glslsandbox-player

if BR2_PACKAGE_GLSLSANDBOX_PLAYER

config BR2_PACKAGE_GLSLSANDBOX_PLAYER_PNG
	bool "Enable PNG support"
	select BR2_PACKAGE_LIBPNG
	help
	  Enable PNG texture loading support

config BR2_PACKAGE_GLSLSANDBOX_PLAYER_TESTING
	bool "Enable testing"
	help
	  Generate and install test suite on target

config BR2_PACKAGE_GLSLSANDBOX_PLAYER_SCRIPTS
	bool "Install scripts"
	depends on !BR2_PACKAGE_PYTHON # python3
	depends on !BR2_STATIC_LIBS # python3
	depends on BR2_TOOLCHAIN_HAS_THREADS # python3
	depends on BR2_USE_MMU # bash, python3
	depends on BR2_USE_WCHAR # python3
	select BR2_PACKAGE_BASH # runtime
	select BR2_PACKAGE_BUSYBOX_SHOW_OTHERS if BR2_PACKAGE_BUSYBOX # bash
	select BR2_PACKAGE_COREUTILS # runtime (timeout)
	select BR2_PACKAGE_LIBCURL_CURL # runtime
	select BR2_PACKAGE_IMAGEMAGICK # runtime
	select BR2_PACKAGE_JPEG # runtime
	select BR2_PACKAGE_LIBCURL # runtime
	select BR2_PACKAGE_LIBOPENSSL_BIN if BR2_PACKAGE_LIBOPENSSL # runtime
	select BR2_PACKAGE_LIBRESSL_BIN if BR2_PACKAGE_LIBRESSL # runtime
	select BR2_PACKAGE_MAKE # runtime
	select BR2_PACKAGE_OPENSSL # runtime
	select BR2_PACKAGE_PYTHON3 # runtime
	help
	  Install additional helper scripts

choice
	prompt "Native windowing system"
	default BR2_PACKAGE_GLSLSANDBOX_PLAYER_MALI  if BR2_PACKAGE_SUNXI_MALI_MAINLINE
	default BR2_PACKAGE_GLSLSANDBOX_PLAYER_RPI   if BR2_PACKAGE_RPI_USERLAND
	default BR2_PACKAGE_GLSLSANDBOX_PLAYER_SDL2  if BR2_PACKAGE_SDL2_OPENGLES
	default BR2_PACKAGE_GLSLSANDBOX_PLAYER_TISGX if BR2_PACKAGE_TI_SGX_UM
	default BR2_PACKAGE_GLSLSANDBOX_PLAYER_WL    if BR2_PACKAGE_WAYLAND
	default BR2_PACKAGE_GLSLSANDBOX_PLAYER_X11   if BR2_PACKAGE_XORG7
	help
	  Select the native windowing system you wish to use.

config BR2_PACKAGE_GLSLSANDBOX_PLAYER_KMS
	bool "KMS/DRM/GBM"
	depends on BR2_TOOLCHAIN_HAS_THREADS # libdrm
	select BR2_PACKAGE_LIBDRM

config BR2_PACKAGE_GLSLSANDBOX_PLAYER_MALI
	bool "Allwinner ARM/Mali Frame Buffer"
	depends on BR2_PACKAGE_SUNXI_MALI_MAINLINE

config BR2_PACKAGE_GLSLSANDBOX_PLAYER_RPI
	bool "RaspberryPI Frame Buffer"
	depends on BR2_PACKAGE_RPI_USERLAND

config BR2_PACKAGE_GLSLSANDBOX_PLAYER_SDL2
	bool "SDL2"
	depends on BR2_PACKAGE_SDL2_OPENGLES

config BR2_PACKAGE_GLSLSANDBOX_PLAYER_TISGX
	bool "TI/SGX Frame Buffer"
	depends on BR2_PACKAGE_TI_SGX_UM

config BR2_PACKAGE_GLSLSANDBOX_PLAYER_VIVFB
	bool "Vivante Frame Buffer"
	depends on BR2_PACKAGE_IMX_GPU_VIV

config BR2_PACKAGE_GLSLSANDBOX_PLAYER_WL
	bool "Wayland"
	depends on BR2_PACKAGE_WAYLAND

config BR2_PACKAGE_GLSLSANDBOX_PLAYER_X11
	bool "X11"
	depends on BR2_PACKAGE_XORG7
	select BR2_PACKAGE_XLIB_LIBX11

endchoice

if BR2_PACKAGE_GLSLSANDBOX_PLAYER_WL
config BR2_PACKAGE_GLSLSANDBOX_PLAYER_WL_IVI
	bool "Wayland IVI shell support"
endif

endif

comment "glslsandbox-player needs a toolchain w/ threads and an openGL ES and EGL driver"
	depends on !BR2_TOOLCHAIN_HAS_THREADS || \
		!BR2_PACKAGE_HAS_LIBEGL || !BR2_PACKAGE_HAS_LIBGLES
```

## package/gmock/Config.in
```kconfig
config BR2_PACKAGE_GMOCK
	bool "gmock"
	select BR2_PACKAGE_GTEST
	depends on BR2_USE_WCHAR
	depends on BR2_TOOLCHAIN_HAS_THREADS
	depends on BR2_INSTALL_LIBSTDCPP
	depends on BR2_USE_MMU # fork()
	help
	  Inspired by jMock, EasyMock, and Hamcrest, and designed with C++'s
	  specifics in mind, Google C++ Mocking Framework (or Google Mock for
	  short) is a library for writing and using C++ mock classes.

	  Google Mock:

	    * lets you create mock classes trivially using simple macros,
	    * supports a rich set of matchers and actions,
	    * handles unordered, partially ordered, or completely ordered
	      expectations,
	    * is extensible by users, and
	    * works on Linux, Mac OS X, Windows, Windows Mobile, minGW, and
	      Symbian.

	    http://code.google.com/p/googlemock/

	  There are both host and target packages. The target one has include
	  files required to compile the tests and the static libraries required
	  to link/run them. The host package installs gmock_gen, a Python script
	  used to generate code mocks.

comment "gmock needs a toolchain w/ C++, wchar, threads"
	depends on BR2_USE_MMU
	depends on !BR2_USE_WCHAR || !BR2_TOOLCHAIN_HAS_THREADS || !BR2_INSTALL_LIBSTDCPP
```

## package/gmp/Config.in
```kconfig
config BR2_PACKAGE_GMP
	bool "gmp"
	help
	  GNU Multiple Precision Arithmetic Library.

	  http://gmplib.org/
```
