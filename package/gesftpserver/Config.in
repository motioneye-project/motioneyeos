## package/gmpc/Config.in
```kconfig
config BR2_PACKAGE_GMPC
	bool "gmpc"
	depends on BR2_PACKAGE_LIBGTK2
	depends on BR2_USE_WCHAR # glib2
	depends on BR2_TOOLCHAIN_HAS_THREADS # glib2
	depends on BR2_PACKAGE_XORG7
	select BR2_PACKAGE_LIBGLIB2
	select BR2_PACKAGE_GETTEXT if BR2_NEEDS_GETTEXT_IF_LOCALE
	select BR2_PACKAGE_LIBICONV if !BR2_ENABLE_LOCALE
	select BR2_PACKAGE_LIBMPD
	select BR2_PACKAGE_LIBSOUP
	select BR2_PACKAGE_LIBXML2
	select BR2_PACKAGE_SQLITE
	select BR2_PACKAGE_XLIB_LIBICE
	select BR2_PACKAGE_XLIB_LIBSM
	select BR2_PACKAGE_XLIB_LIBX11
	help
	  Gnome Music Player Client is a GNOME/GTK2.2 client for
	  Music Player Daemon.

	  http://gmpcwiki.sarine.nl/index.php?title=GMPC

comment "gmpc needs a toolchain w/ wchar, threads"
	depends on BR2_PACKAGE_LIBGTK2 && !BR2_USE_WCHAR || \
		!BR2_TOOLCHAIN_HAS_THREADS
```

## package/gmrender-resurrect/Config.in
```kconfig
config BR2_PACKAGE_GMRENDER_RESURRECT
	bool "gmrender-resurrect"
	depends on BR2_USE_WCHAR # gstreamer1 -> libglib2
	depends on BR2_TOOLCHAIN_HAS_THREADS # gstreamer1 -> libglib2, libupnp
	depends on BR2_USE_MMU # gstreamer1
	# uses <error.h>
	depends on !BR2_TOOLCHAIN_USES_MUSL
	select BR2_PACKAGE_GSTREAMER1
	select BR2_PACKAGE_GST1_PLUGINS_BASE # run-time only
	select BR2_PACKAGE_LIBUPNP
	help
	  UPnP (DLNA) media renderer based on gstreamer

	  https://github.com/hzeller/gmrender-resurrect

comment "gmrender-resurrect needs a glibc or uClibc toolchain w/ wchar, threads"
	depends on BR2_USE_MMU
	depends on !BR2_USE_WCHAR || !BR2_TOOLCHAIN_HAS_THREADS || \
		BR2_TOOLCHAIN_USES_MUSL
```
