## package/gperf/Config.in
```kconfig
config BR2_PACKAGE_GPERF
	bool "gperf"
	depends on BR2_INSTALL_LIBSTDCPP
	help
	  A 'perfect hash function' generator

	  http://www.gnu.org/software/gperf/

comment "gperf requires a toolchain with C++ support enabled"
	depends on !BR2_INSTALL_LIBSTDCPP
```

## package/gpm/Config.in
```kconfig
config BR2_PACKAGE_GPM
	bool "gpm"
	depends on !BR2_STATIC_LIBS
	depends on BR2_USE_MMU # fork()
	help
	  "gpm" means general purpose mouse (server) and provides mouse support
	  for Linux virtual consoles.
	  gpm-root (to draw menus in current virtual console; config file in
	  /etc/gpm-root.conf) and disable-paste (to disable paste buffer for
	  security reasons), will also be installed.

	  http://www.nico.schottelius.org/software/gpm/

if BR2_PACKAGE_GPM

config BR2_PACKAGE_GPM_INSTALL_TEST_TOOLS
	bool "install test tools"
	help
	  Install gpm test tools (get-versions, mev, hltest, mouse-test,
	  display-buttons & display-coords).

endif

comment "gpm mouse server needs a toolchain w/ dynamic library"
	depends on BR2_STATIC_LIBS
	depends on BR2_USE_MMU
```

## package/gpsd/Config.in
```kconfig
comment "gpsd needs a toolchain w/ threads"
	depends on BR2_USE_MMU
	depends on !BR2_TOOLCHAIN_HAS_THREADS

config BR2_PACKAGE_GPSD
	bool "gpsd"
	# Uses fork()
	depends on BR2_USE_MMU
	depends on BR2_TOOLCHAIN_HAS_THREADS
	help
	  gpsd is a service daemon that monitors one or more GPSes or AIS
	  receivers attached to a host computer through serial or USB ports,
	  making all data on the location/course/velocity of the sensors
	  available to be queried on TCP port 2947 of the host computer.

	  The D-Bus interface is included if dbus-glib is enabled.

	  http://gpsd.berlios.de/

config BR2_PACKAGE_GPSD_DEVICES
	string "Where to look for GPSes"
	default "/dev/ttyS1"
	depends on BR2_PACKAGE_GPSD

menu "Features"
	depends on BR2_PACKAGE_GPSD

config BR2_PACKAGE_GPSD_CLIENT_DEBUG
	bool "client debugging support"

config BR2_PACKAGE_GPSD_OLDSTYLE
	bool "oldstyle (pre-JSON) protocol support"

config BR2_PACKAGE_GPSD_PROFILING
	bool "profiling support"
	depends on BR2_TOOLCHAIN_USES_GLIBC
	depends on !BR2_aarch64

comment "profiling support not available with uClibc-based toolchain"
	depends on !BR2_TOOLCHAIN_USES_GLIBC

config BR2_PACKAGE_GPSD_NTP_SHM
	bool "NTP time hinting support"

config BR2_PACKAGE_GPSD_PPS
	bool "PPS time syncing support"
	select BR2_PACKAGE_GPSD_NTP_SHM

config BR2_PACKAGE_GPSD_USER
	bool "GPSD privilege revocation user"
config BR2_PACKAGE_GPSD_USER_VALUE
	string ""
	default "nobody"
	depends on BR2_PACKAGE_GPSD_USER

config BR2_PACKAGE_GPSD_GROUP
	bool "GPSD privilege revocation group"
config BR2_PACKAGE_GPSD_GROUP_VALUE
	string ""
	default "nobody"
	depends on BR2_PACKAGE_GPSD_GROUP

config BR2_PACKAGE_GPSD_FIXED_PORT_SPEED
	bool "compile with fixed serial port speed"
config BR2_PACKAGE_GPSD_FIXED_PORT_SPEED_VALUE
	string ""
	default "9600"
	depends on BR2_PACKAGE_GPSD_FIXED_PORT_SPEED

config BR2_PACKAGE_GPSD_MAX_CLIENT
	bool "compile with limited maximum clients"
config BR2_PACKAGE_GPSD_MAX_CLIENT_VALUE
	string "compile with limited maximum clients"
	default "10"
	depends on BR2_PACKAGE_GPSD_MAX_CLIENT

config BR2_PACKAGE_GPSD_MAX_DEV
	bool "compile with maximum allowed devices"
config BR2_PACKAGE_GPSD_MAX_DEV_VALUE
	string "compile with maximum allowed devices"
	default "2"
	depends on BR2_PACKAGE_GPSD_MAX_DEV

config BR2_PACKAGE_GPSD_RECONFIGURE
	bool "allow gpsd to change device settings"
	default y

config BR2_PACKAGE_GPSD_CONTROLSEND
	bool "allow gpsctl/gpsmon to change device settings"
	default y

config BR2_PACKAGE_GPSD_SQUELCH
	bool "squelch gpsd_report and gpsd_hexdump to save cpu"

endmenu

menu "Protocols"
	depends on BR2_PACKAGE_GPSD

config BR2_PACKAGE_GPSD_AIVDM
	bool "Aivdm"
	help
	  Aivdm support

config BR2_PACKAGE_GPSD_ASHTECH
	bool "Ashtech"
	help
	  Ashtech support

config BR2_PACKAGE_GPSD_EARTHMATE
	bool "Earthmate"
	help
	  DeLorme EarthMate Zodiac support

config BR2_PACKAGE_GPSD_EVERMORE
	bool "EverMore"
	help
	  EverMore binary support

config BR2_PACKAGE_GPSD_FURY
	bool "Fury"
	help
	  Jackson Labs Fury and Firefly support

config BR2_PACKAGE_GPSD_FV18
	bool "FV-18"
	help
	  San Jose Navigation FV-18 support

config BR2_PACKAGE_GPSD_GARMIN
	bool "Garmin (kernel)"
	help
	  Garmin kernel driver support

config BR2_PACKAGE_GPSD_GARMIN_SIMPLE_TXT
	bool "Garmin (simple text)"
	help
	  Garmin Simple Text support

config BR2_PACKAGE_GPSD_GEOSTAR
	bool "Geostar"
	help
	  Geostar Protocol support

config BR2_PACKAGE_GPSD_GPSCLOCK
	bool "GPSClock"
	help
	  GPSClock support

config BR2_PACKAGE_GPSD_ITRAX
	bool "iTrax"
	help
	  iTrax support

config BR2_PACKAGE_GPSD_MTK3301
	bool "MTK-3301"
	help
	  Mediatek MTK-3301 support

config BR2_PACKAGE_GPSD_NAVCOM
	bool "Navcom"
	help
	  Navcom binary support

config BR2_PACKAGE_GPSD_NMEA
	bool "NMEA"
	default y
	help
	  Generic NMEA support

config BR2_PACKAGE_GPSD_NMEA2000
	bool "NMEA2000"
	select BR2_PACKAGE_GPSD_NAVCOM
	select BR2_PACKAGE_GPSD_AIVDM
	help
	  NMEA2000/CAN support

config BR2_PACKAGE_GPSD_NTRIP
	bool "NTRIP"
	help
	  NTRIP support

config BR2_PACKAGE_GPSD_OCEANSERVER
	bool "OceanServer"
	help
	  OceanServer Digital Compass support

config BR2_PACKAGE_GPSD_ONCORE
	bool "OnCore"
	help
	  OnCore support

config BR2_PACKAGE_GPSD_RTCM104V2
	bool "RTCM104 v2"
	help
	  RTCM104 v2 support

config BR2_PACKAGE_GPSD_RTCM104V3
	bool "RTCM104 v3"
	help
	  RTCM104 v3 support

config BR2_PACKAGE_GPSD_SIRF
	bool "SiRF"
	help
	  SiRF binary support

config BR2_PACKAGE_GPSD_SUPERSTAR2
	bool "SuperStarII"
	help
	  Novatel SuperStarII binary support

config BR2_PACKAGE_GPSD_TRIMBLE_TSIP
	bool "Trimble TSIP"
	help
	  Trimble TSIP support

config BR2_PACKAGE_GPSD_TRIPMATE
	bool "TripMate"
	help
	  Delorme TripMate support

config BR2_PACKAGE_GPSD_TRUE_NORTH
	bool "True North Technologies"
	help
	  True North Technologies support

config BR2_PACKAGE_GPSD_UBX
	bool "UBX"
	help
	  uBlox UBX binary support

endmenu
```

## package/gptfdisk/Config.in
```kconfig
comment "gptfdisk needs a toolchain w/ wchar, C++"
	depends on !(BR2_INSTALL_LIBSTDCPP && BR2_USE_WCHAR)

config BR2_PACKAGE_GPTFDISK
	bool "gptfdisk"
	depends on BR2_INSTALL_LIBSTDCPP
	depends on BR2_USE_WCHAR # util-linux
	select BR2_PACKAGE_UTIL_LINUX
	select BR2_PACKAGE_UTIL_LINUX_LIBUUID
	select BR2_PACKAGE_GPTFDISK_GDISK if \
		!(BR2_PACKAGE_GPTFDISK_SGDISK || BR2_PACKAGE_GPTFDISK_CGDISK)
	help
	  GPT fdisk (consisting of the gdisk and sgdisk programs) is a
	  text-mode partitioning tool that works on Globally Unique Identifier
	  (GUID) Partition Table (GPT) disks, rather than on the more common
	  (through 2010) Master Boot Record (MBR) partition tables.

	  http://www.rodsbooks.com/gdisk/

if BR2_PACKAGE_GPTFDISK

config BR2_PACKAGE_GPTFDISK_GDISK
	bool "interactive gdisk"
	help
	  Install the interactive GUID partition table (GPT) manipulator
	  /usr/sbin/gdisk which is modelled after and quite similar in use
	  to the traditional MBR based fdisk tool.

config BR2_PACKAGE_GPTFDISK_SGDISK
	bool "command line sgdisk"
	select BR2_PACKAGE_POPT
	help
	  Install the command-line GUID partition table (GPT) manipulator
	  /usr/sbin/sgdisk which is named after the traditional MBR based
	  sfdisk tool albeit with an entirely different option syntax.

config BR2_PACKAGE_GPTFDISK_CGDISK
	bool "ncurses cgdisk"
	select BR2_PACKAGE_NCURSES
	select BR2_PACKAGE_NCURSES_WCHAR # needed because of UTF-16
	depends on !(BR2_bfin && BR2_BINFMT_FLAT) # ncurses wchar support
	help
	  Install the ncurses-based GUID partition table (GPT)
	  manipulator /usr/sbin/cgdisk.

endif
```

## package/gptfdisk/Config.in.host
```kconfig
config BR2_PACKAGE_HOST_GPTFDISK
	bool "host gptfdisk"
	select BR2_PACKAGE_HOST_UTIL_LINUX
	help
	  GPT fdisk (consisting of the gdisk and sgdisk programs) is a
	  text-mode partitioning tool that works on Globally Unique
	  Identifier (GUID) Partition Table (GPT) disks, rather than
	  on the more common (through 2010) Master Boot Record (MBR)
	  partition tables.

	  http://www.rodsbooks.com/gdisk/
```

## package/gqrx/Config.in
```kconfig
comment "gqrx needs a toolchain w/ C++, threads, wchar, dynamic library"
	depends on BR2_USE_MMU # gnuradio
	depends on BR2_TOOLCHAIN_HAS_SYNC_4 || BR2_TOOLCHAIN_HAS_ATOMIC
	depends on !BR2_INSTALL_LIBSTDCPP || !BR2_TOOLCHAIN_HAS_THREADS || \
		!BR2_USE_WCHAR || !BR2_STATIC_LIBS

comment "gqrx needs qt5"
	depends on !BR2_PACKAGE_QT5

comment "gqrx needs a toolchain not affected by GCC bug 64735"
	depends on BR2_TOOLCHAIN_HAS_GCC_BUG_64735

config BR2_PACKAGE_GQRX
	bool "gqrx"
	depends on BR2_USE_MMU # gnuradio
	depends on !BR2_STATIC_LIBS # gnuradio
	depends on BR2_INSTALL_LIBSTDCPP # boost
	depends on BR2_TOOLCHAIN_HAS_THREADS # boost
	depends on BR2_USE_WCHAR # boost
	depends on BR2_TOOLCHAIN_HAS_SYNC_4 || BR2_TOOLCHAIN_HAS_ATOMIC
	depends on BR2_PACKAGE_QT5
	depends on !BR2_TOOLCHAIN_HAS_GCC_BUG_64735 # gnuradio
	select BR2_PACKAGE_BOOST
	select BR2_PACKAGE_BOOST_PROGRAM_OPTIONS
	select BR2_PACKAGE_BOOST_SYSTEM
	select BR2_PACKAGE_GNURADIO
	select BR2_PACKAGE_GNURADIO_ANALOG
	select BR2_PACKAGE_GNURADIO_AUDIO
	select BR2_PACKAGE_GNURADIO_BLOCKS
	select BR2_PACKAGE_GNURADIO_DIGITAL
	select BR2_PACKAGE_GNURADIO_FFT
	select BR2_PACKAGE_GNURADIO_FILTER
	select BR2_PACKAGE_GR_OSMOSDR
	select BR2_PACKAGE_QT5BASE_GUI
	select BR2_PACKAGE_QT5BASE_WIDGETS
	select BR2_PACKAGE_QT5SVG
	help
	  Gqrx is an open source software defined radio (SDR) receiver
	  implemented using GNU Radio and the Qt GUI
	  toolkit. Currently it works on Linux and Mac with hardware
	  supported by gr-osmosdr, including Funcube Dongle, RTL-SDR,
	  Airspy, HackRF, BladeRF, RFSpace, USRP and SoapySDR.

	  Gqrx can operate as an AM/FM/SSB receiver with audio output
	  or as an FFT-only instrument. There are also various hooks
	  for interacting with external application using network
	  sockets.

	  http://gqrx.dk/
```

## package/gqview/Config.in
```kconfig
config BR2_PACKAGE_GQVIEW
	bool "gqview"
	depends on BR2_PACKAGE_LIBGTK2
	help
	  GQview is an image viewer for Unix operating systems

	  http://prdownloads.sourceforge.net/gqview
```

## package/gr-osmosdr/Config.in
```kconfig
config BR2_PACKAGE_GR_OSMOSDR
	bool "gr-osmosdr"
	depends on BR2_PACKAGE_GNURADIO
	select BR2_PACKAGE_GNURADIO_BLOCKS
	select BR2_PACKAGE_GNURADIO_FFT
	select BR2_PACKAGE_GNURADIO_FILTER
	help
	  GNU Radio block for interfacing with various radio hardware

	  http://osmocom.org/projects/osmosdr

if BR2_PACKAGE_GR_OSMOSDR

config BR2_PACKAGE_GR_OSMOSDR_PYTHON
	bool "python support"
	depends on BR2_PACKAGE_GNURADIO_PYTHON
	depends on BR2_PACKAGE_PYTHON3
	help
	  Enable Python support

config BR2_PACKAGE_GR_OSMOSDR_IQFILE
	bool "IQ File Source support"
	help
	  Enable IQ File Source support

config BR2_PACKAGE_GR_OSMOSDR_RTLSDR
	bool "Osmocom RTLSDR support"
	select BR2_PACKAGE_LIBRTLSDR
	help
	  Enable Osmocom RTLSDR support

config BR2_PACKAGE_GR_OSMOSDR_RTLSDR_TCP
	bool "RTLSDR TCP Client support"
	help
	  Enable RTLSDR TCP client support

config BR2_PACKAGE_GR_OSMOSDR_RFSPACE
	bool "RFSPACE Receivers support"
	help
	  Enable RFSPACE Receivers support

endif
```

## package/granite/Config.in
```kconfig
config BR2_PACKAGE_GRANITE
	bool "granite"
	depends on BR2_USE_WCHAR
	depends on BR2_TOOLCHAIN_HAS_THREADS
	depends on BR2_USE_MMU # fork()
	depends on BR2_PACKAGE_LIBGTK3
	select BR2_PACKAGE_LIBGEE
	select BR2_PACKAGE_LIBGLIB2
	help
	  An extension to GTK+ that provides several useful widgets and
	  classes to ease application development.

	  https://github.com/elementary/granite

comment "granite needs libgtk3 and a toolchain w/ wchar, threads"
	depends on BR2_USE_MMU
	depends on !BR2_PACKAGE_LIBGTK3 || !BR2_USE_WCHAR \
		|| !BR2_TOOLCHAIN_HAS_THREADS
```
