## package/gnu-efi/Config.in
```kconfig
config BR2_PACKAGE_GNU_EFI_ARCH_SUPPORTS
	bool
	default y if BR2_ARM_CPU_HAS_ARM
	default y if BR2_aarch64
	default y if BR2_aarch64_be
	default y if BR2_i386
	default y if BR2_x86_64

config BR2_PACKAGE_GNU_EFI
	bool "gnu-efi"
	depends on BR2_PACKAGE_GNU_EFI_ARCH_SUPPORTS
	help
	  Develop EFI applications for ARM-64, ARM-32, x86_64, IA-64
	  (IPF), IA-32 (x86), and MIPS platforms using the GNU toolchain
	  and the EFI development environment.

	  http://gnu-efi.sourceforge.net/
```

## package/gnuchess/Config.in
```kconfig
config BR2_PACKAGE_GNUCHESS
	bool "gnuchess"
	depends on BR2_INSTALL_LIBSTDCPP
	depends on BR2_TOOLCHAIN_HAS_THREADS
	select BR2_PACKAGE_FLEX
	select BR2_PACKAGE_GETTEXT if BR2_NEEDS_GETTEXT_IF_LOCALE
	help
	  GNU Chess lets most modern computers play a full game of chess.

	  http://ftp.gnu.org/pub/gnu/chess

comment "gnuchess needs a toolchain w/ C++, threads"
	depends on !BR2_INSTALL_LIBSTDCPP || !BR2_TOOLCHAIN_HAS_THREADS
```

## package/gnuconfig/Config.in
```kconfig
config BR2_UPDATE_CONFIG
	bool "update config.sub and config.guess"
	default y
	help
		This just exists to easily update the config.sub / config.guess
		files in packages to the latest version (since many bundled ones
		don't support the latest possible targets)
```

## package/gnupg/Config.in
```kconfig
config BR2_PACKAGE_GNUPG
	bool "gnupg"
	depends on !BR2_PACKAGE_GNUPG2
	select BR2_PACKAGE_ZLIB
	help
	  GnuPG is the GNU project's complete and free implementation
	  of the OpenPGP standard as defined by RFC4880. GnuPG allows
	  to encrypt and sign your data and communication, features a
	  versatile key management system as well as access modules
	  for all kinds of public key directories. GnuPG, also known
	  as GPG, is a command line tool with features for easy
	  integration with other applications.

	  http://gnupg.org/

if BR2_PACKAGE_GNUPG

config BR2_PACKAGE_GNUPG_AES
	bool "AES support"
	help
	  Support for the AES cipher

config BR2_PACKAGE_GNUPG_RSA
	bool "RSA support"
	help
	  Support for RSA public key algorithm

config BR2_PACKAGE_GNUPG_GPGV
	bool "gpgv"
	help
	  gpgv is an OpenPGP signature verification tool.

	  This program is actually a stripped-down version of gpg
	  which is only able to check signatures. It is somewhat
	  smaller than the fully-blown gpg and uses a different (and
	  simpler) way to check that the public keys used to make the
	  signature are valid. There are no configuration files and
	  only a few options are implemented.

config BR2_PACKAGE_GNUPG_GPGSPLIT
	bool "gpgsplit"
	help
	  gpgsplit splits an OpenPGP message into packets.

endif
```

## package/gnupg/Config.in.host
```kconfig
config BR2_PACKAGE_HOST_GNUPG
	bool "host gnupg"
	help
	  GnuPG is the GNU project's complete and free implementation
	  of the OpenPGP standard as defined by RFC4880. GnuPG allows
	  to encrypt and sign your data and communication, features a
	  versatile key management system as well as access modules
	  for all kinds of public key directories. GnuPG, also known
	  as GPG, is a command line tool with features for easy
	  integration with other applications.

	  http://gnupg.org/
```

## package/gnupg2/Config.in
```kconfig
comment "gnupg2 needs a toolchain w/ threads and dynamic library support"
	depends on BR2_USE_MMU
	depends on BR2_STATIC_LIBS || !BR2_TOOLCHAIN_HAS_THREADS

config BR2_PACKAGE_GNUPG2
	bool "gnupg2"
	select BR2_PACKAGE_ZLIB
	select BR2_PACKAGE_LIBGPG_ERROR
	select BR2_PACKAGE_LIBGCRYPT
	select BR2_PACKAGE_LIBASSUAN
	select BR2_PACKAGE_LIBKSBA
	select BR2_PACKAGE_LIBNPTH
	select BR2_PACKAGE_LIBICONV if !BR2_ENABLE_LOCALE
	depends on BR2_PACKAGE_LIBGPG_ERROR_ARCH_SUPPORTS # libgpg-error
	depends on BR2_TOOLCHAIN_HAS_THREADS # libnpth
	depends on BR2_USE_MMU # libassuan, libnpth
	depends on !BR2_STATIC_LIBS
	help
	  GnuPG is the GNU project's complete and free implementation
	  of the OpenPGP standard as defined by RFC4880. GnuPG allows
	  to encrypt and sign your data and communication, features a
	  versatile key management system as well as access modules
	  for all kinds of public key directories. GnuPG, also known
	  as GPG, is a command line tool with features for easy
	  integration with other applications.

	  http://gnupg.org/

if BR2_PACKAGE_GNUPG2

config BR2_PACKAGE_GNUPG2_GPGV2
	bool "gpgv2"
	help
	  gpgv2 is an OpenPGP signature verification tool.

	  This program is actually a stripped-down version of gpg
	  which is only able to check signatures. It is somewhat
	  smaller than the fully-blown gpg and uses a different (and
	  simpler) way to check that the public keys used to make the
	  signature are valid. There are no configuration files and
	  only a few options are implemented.

endif
```

## package/gnuplot/Config.in
```kconfig
config BR2_PACKAGE_GNUPLOT
	bool "gnuplot"
	help
	  A portable command-line driven graphing utility.

	  http://www.gnuplot.info/
```

## package/gnuradio/Config.in
```kconfig
comment "gnuradio needs a toolchain w/ C++, NPTL, wchar, dynamic library"
	depends on BR2_USE_MMU
	depends on !BR2_INSTALL_LIBSTDCPP || !BR2_USE_WCHAR || \
		!BR2_TOOLCHAIN_HAS_THREADS_NPTL || BR2_STATIC_LIBS

comment "gnuradio needs a toolchain not affected by GCC bug 64735"
	depends on BR2_TOOLCHAIN_HAS_GCC_BUG_64735

config BR2_PACKAGE_GNURADIO
	bool "gnuradio"
	depends on BR2_INSTALL_LIBSTDCPP
	depends on !BR2_STATIC_LIBS
	depends on BR2_TOOLCHAIN_HAS_THREADS_NPTL
	depends on BR2_USE_MMU # use fork()
	depends on BR2_USE_WCHAR # boost
	depends on !BR2_TOOLCHAIN_HAS_GCC_BUG_64735 # boost-thread
	select BR2_PACKAGE_BOOST
	select BR2_PACKAGE_BOOST_ATOMIC
	select BR2_PACKAGE_BOOST_DATE_TIME
	select BR2_PACKAGE_BOOST_FILESYSTEM
	select BR2_PACKAGE_BOOST_PROGRAM_OPTIONS
	select BR2_PACKAGE_BOOST_REGEX
	select BR2_PACKAGE_BOOST_SYSTEM
	select BR2_PACKAGE_BOOST_THREAD
	select BR2_PACKAGE_LOG4CPP
	select BR2_PACKAGE_GMP
	help
	  GNU Radio is a free & open-source software development
	  toolkit that provides signal processing blocks to implement
	  software radios. It can be used with readily-available
	  low-cost external RF hardware to create software-defined
	  radios, or without hardware in a simulation-like
	  environment. It is widely used in hobbyist, academic and
	  commercial environments to support both wireless
	  communications research and real-world radio systems.

	  http://gnuradio.org/

if BR2_PACKAGE_GNURADIO

config BR2_PACKAGE_GNURADIO_AUDIO
	bool "gr-audio"
	select BR2_PACKAGE_ALSA_LIB if !BR2_PACKAGE_PORTAUDIO
	help
	  Add audio source/sink to GNU Radio

config BR2_PACKAGE_GNURADIO_BLOCKS
	bool "blocks support"
	help
	  GNU Radio basic block library

config BR2_PACKAGE_GNURADIO_CTRLPORT
	bool "ctrlport support"
	help
	  GNU Radio ctrlport block

config BR2_PACKAGE_GNURADIO_FEC
	bool "gr-fec support"
	select BR2_PACKAGE_GNURADIO_BLOCKS
	select BR2_PACKAGE_GSL
	help
	  FEC signal processing blocks

config BR2_PACKAGE_GNURADIO_PYTHON
	bool "python support"
	depends on BR2_PACKAGE_PYTHON || BR2_PACKAGE_PYTHON3
	depends on BR2_PACKAGE_PYTHON_NUMPY_ARCH_SUPPORTS
	depends on BR2_TOOLCHAIN_USES_GLIBC || BR2_TOOLCHAIN_USES_MUSL # python-numpy
	select BR2_PACKAGE_BOOST_PYTHON
	select BR2_PACKAGE_PYTHON_NUMPY # runtime
	select BR2_PACKAGE_PYTHON_SIX # runtime
	help
	  Enable python component

comment "python support needs glibc or musl"
	depends on !(BR2_TOOLCHAIN_USES_GLIBC || BR2_TOOLCHAIN_USES_MUSL)

config BR2_PACKAGE_GNURADIO_UTILS
	bool "gr-utils support"
	depends on BR2_PACKAGE_GNURADIO_PYTHON
	help
	  Misc python utilities

config BR2_PACKAGE_GNURADIO_ZEROMQ
	bool "gr-zeromq support"
	select BR2_PACKAGE_CPPZMQ
	select BR2_PACKAGE_PYTHON_PYZMQ if BR2_PACKAGE_GNURADIO_PYTHON
	help
	  zeromq communication support

config BR2_PACKAGE_GNURADIO_ANALOG
	bool "gr-analog support"
	select BR2_PACKAGE_GNURADIO_FILTER
	help
	  Analog communications blocks

config BR2_PACKAGE_GNURADIO_CHANNELS
	bool "gr-channels support"
	select BR2_PACKAGE_GNURADIO_ANALOG
	help
	  Channel model blocks

config BR2_PACKAGE_GNURADIO_DIGITAL
	bool "gr-digital support"
	select BR2_PACKAGE_GNURADIO_ANALOG
	help
	  Digital communications blocks

config BR2_PACKAGE_GNURADIO_FFT
	bool "gr-fft support"
	select BR2_PACKAGE_FFTW
	select BR2_PACKAGE_FFTW_SINGLE
	select BR2_PACKAGE_GNURADIO_BLOCKS
	help
	  FFT signal processing blocks

config BR2_PACKAGE_GNURADIO_FILTER
	bool "gr-filter support"
	select BR2_PACKAGE_GNURADIO_FFT
	help
	  Filter signal processing blocks

config BR2_PACKAGE_GNURADIO_PAGER
	bool "gr-flex support"
	select BR2_PACKAGE_GNURADIO_ANALOG
	help
	  FLEX pager decoder implementation blocks

config BR2_PACKAGE_GNURADIO_TRELLIS
	bool "gr-trellis support"
	select BR2_PACKAGE_GNURADIO_DIGITAL
	help
	  Trellis coded modulation blocks

endif
```

## package/gnutls/Config.in
```kconfig
config BR2_PACKAGE_GNUTLS
	bool "gnutls"
	# https://gitlab.com/gnutls/gnutls/issues/203
	depends on !BR2_STATIC_LIBS
	depends on BR2_USE_WCHAR
	select BR2_PACKAGE_LIBTASN1
	select BR2_PACKAGE_LIBUNISTRING
	select BR2_PACKAGE_NETTLE
	select BR2_PACKAGE_PCRE
	help
	  GnuTLS is a secure communications library implementing the SSL
	  and TLS protocols and technologies around them.

	  http://www.gnutls.org

if BR2_PACKAGE_GNUTLS

config BR2_PACKAGE_GNUTLS_TOOLS
	bool "install tools"
	select BR2_PACKAGE_ARGP_STANDALONE \
		if BR2_TOOLCHAIN_USES_UCLIBC || BR2_TOOLCHAIN_USES_MUSL
	help
	  Install GnuTLS command line tools for various cryptographic tasks.

endif

comment "gnutls needs a toolchain w/ wchar, dynamic library"
	depends on !BR2_USE_WCHAR || BR2_STATIC_LIBS
```

## package/go-bootstrap/Config.in.host
```kconfig
config BR2_PACKAGE_HOST_GO_BOOTSTRAP_ARCH_SUPPORTS
	bool
	# See src/cmd/dist/unix.c for the list of support
	# architectures
	default y if BR2_HOSTARCH = "x86"
	default y if BR2_HOSTARCH = "x86_64"
	default y if BR2_HOSTARCH = "arm"
```

## package/go/Config.in.host
```kconfig
config BR2_PACKAGE_HOST_GO_ARCH_SUPPORTS
	bool
	default y
	depends on !BR2_TOOLCHAIN_HAS_BINUTILS_BUG_20006
	depends on BR2_PACKAGE_HOST_GO_BOOTSTRAP_ARCH_SUPPORTS
	depends on (BR2_arm && BR2_TOOLCHAIN_SUPPORTS_PIE) || BR2_aarch64 \
		|| BR2_i386 || BR2_x86_64 || BR2_powerpc64le \
		|| BR2_mips64 || BR2_mips64el
	depends on !BR2_ARM_CPU_ARMV4
	# MIPS R6 support in Go has not yet been developed.
	depends on !BR2_MIPS_CPU_MIPS64R6

config BR2_PACKAGE_HOST_GO_CGO_LINKING_SUPPORTS
	bool
	default y
	depends on BR2_PACKAGE_HOST_GO_ARCH_SUPPORTS
	# Go doesn't support CGO linking on MIPS64x platforms
	# See: https://github.com/karalabe/xgo/issues/46
	depends on !BR2_mips64 && !BR2_mips64el
```

## package/gob2/Config.in
```kconfig
config BR2_PACKAGE_GOB2
	bool "gob2"
	depends on BR2_USE_WCHAR # glib2
	depends on BR2_TOOLCHAIN_HAS_THREADS # glib2
	depends on BR2_USE_MMU # bison, glib2
	select BR2_PACKAGE_LIBGLIB2
	select BR2_PACKAGE_FLEX
	select BR2_PACKAGE_BISON
	# development tool, useless on the target
	depends on BR2_DEPRECATED_SINCE_2014_02
	help
	  GOB (GTK+ Object Builder) is a preprocessor which simplifies
	  the writing of GObjects in C.

	  http://www.jirka.org/gob.html

comment "gob2 needs a toolchain w/ wchar"
	depends on BR2_USE_MMU
	depends on BR2_DEPRECATED_SINCE_2014_02
	depends on !BR2_USE_WCHAR || !BR2_TOOLCHAIN_HAS_THREADS
```

## package/gobject-introspection/Config.in
```kconfig
config BR2_PACKAGE_GOBJECT_INTROSPECTION
	bool "gobject-introspection"
	depends on BR2_USE_MMU # python3, libglib2
	depends on BR2_PACKAGE_HOST_QEMU_ARCH_SUPPORTS
	# While gcc 4.8 might be compatible with gobject-introspection,
	# The autobuilders use some toolchains from codesourcery which
	# have gcc 4.8 and a very old version of glibc, which will cause
	# compile errors with locale.c. As such, require 4.9 until this
	# can be verified.
	depends on BR2_TOOLCHAIN_GCC_AT_LEAST_4_9
	depends on BR2_TOOLCHAIN_USES_GLIBC
	# gobject-introspection does not require python3 to run on the
	# target; however, because the tools run in a qemu wrapper, a
	# cross-compiled python3 must be installed to staging. As there
	# is no current mechanism to tell Buildroot only to install
	# python to staging, then python must also be installed
	# unconditionally to the target when building
	# gobject-introspection.
	depends on BR2_PACKAGE_PYTHON3
	select BR2_PACKAGE_HOST_QEMU
	select BR2_PACKAGE_HOST_QEMU_LINUX_USER_MODE
	select BR2_PACKAGE_LIBFFI
	select BR2_PACKAGE_LIBGLIB2
	select BR2_PACKAGE_ZLIB
	help
	  GObject introspection is a middleware layer between C
	  libraries (using GObject) and language bindings. The C library
	  can be scanned at compile time and generate a metadata file,
	  in addition to the actual native C library. Then at runtime,
	  language bindings can read this metadata and automatically
	  provide bindings to call into the C library.

	  https://wiki.gnome.org/action/show/Projects/GObjectIntrospection

comment "gobject-introspection needs python3"
	depends on !BR2_PACKAGE_PYTHON3

comment "gobject-introspection needs a glibc toolchain, gcc >= 4.9"
	depends on BR2_USE_MMU
	depends on BR2_PACKAGE_HOST_QEMU_ARCH_SUPPORTS
	depends on !BR2_TOOLCHAIN_USES_GLIBC || \
		!BR2_TOOLCHAIN_GCC_AT_LEAST_4_9
```

## package/google-breakpad/Config.in
```kconfig
config BR2_PACKAGE_GOOGLE_BREAKPAD_ARCH_SUPPORTS
	bool
	default y if BR2_i386 || BR2_x86_64 || BR2_arm || BR2_aarch64 || \
		BR2_mips || BR2_mipsel

config BR2_PACKAGE_GOOGLE_BREAKPAD
	bool "google-breakpad"
	depends on BR2_INSTALL_LIBSTDCPP
	depends on BR2_HOST_GCC_AT_LEAST_4_8 # C++11
	depends on BR2_TOOLCHAIN_GCC_AT_LEAST_4_8 # C++11
	depends on BR2_USE_WCHAR
	depends on BR2_TOOLCHAIN_HAS_THREADS
	depends on (BR2_TOOLCHAIN_USES_GLIBC || BR2_TOOLCHAIN_USES_UCLIBC)
	depends on BR2_PACKAGE_GOOGLE_BREAKPAD_ARCH_SUPPORTS
	depends on BR2_PACKAGE_HOST_GOOGLE_BREAKPAD_ARCH_SUPPORTS
	select BR2_PACKAGE_LINUX_SYSCALL_SUPPORT
	help
	  Google-Breakpad is a library and tool suite that allows you
	  to distribute an application to users with compiler-provided
	  debugging information removed, record crashes in compact
	  "minidump" files, send them back to your server, and produce
	  C and C++ stack traces from these minidumps. Breakpad can
	  also write minidumps on request for programs that have not
	  crashed.

	  You may want to set BR2_ENABLE_DEBUG, in order to get useful
	  results.

	  This target package installs a static library named
	  libbreakpad_client.a which should be linked into programs
	  willing to use Google Breakpad. A host variant of this
	  package is also available, and provides the different tools
	  needed to extract the debugging symbols from target
	  binaries.

	  https://chromium.googlesource.com/breakpad/breakpad

comment "google-breakpad requires a glibc or uClibc toolchain w/ wchar, thread, C++, gcc >= 4.8"
	depends on BR2_PACKAGE_GOOGLE_BREAKPAD_ARCH_SUPPORTS
	depends on BR2_PACKAGE_HOST_GOOGLE_BREAKPAD_ARCH_SUPPORTS
	depends on !BR2_INSTALL_LIBSTDCPP || !BR2_USE_WCHAR || \
		!BR2_TOOLCHAIN_HAS_THREADS || \
		!(BR2_TOOLCHAIN_USES_GLIBC || BR2_TOOLCHAIN_USES_UCLIBC) || \
		!BR2_TOOLCHAIN_GCC_AT_LEAST_4_8 || !BR2_HOST_GCC_AT_LEAST_4_8
```

## package/google-breakpad/Config.in.host
```kconfig
config BR2_PACKAGE_HOST_GOOGLE_BREAKPAD_ARCH_SUPPORTS
	bool
	default y if BR2_HOSTARCH = "x86_64"
	default y if BR2_HOSTARCH = "x86"
	default y if BR2_HOSTARCH = "arm"
	default y if BR2_HOSTARCH = "aarch64"
	default y if BR2_HOSTARCH = "mips"
	default y if BR2_HOSTARCH = "mipsel"
```

## package/googlefontdirectory/Config.in
```kconfig
config BR2_PACKAGE_GOOGLEFONTDIRECTORY
	bool "Google font directory"
	help
	  Font files available from Google Fonts

	  https://github.com/google/fonts

if BR2_PACKAGE_GOOGLEFONTDIRECTORY

config BR2_PACKAGE_GOOGLEFONTDIRECTORY_FONTS
	string "List of fonts to install"
	default "ufl/ubuntu"
	help
	  Specify a space-separated list of fonts to install. They
	  correspond to the path of the font directory within Google
	  Font directory code base. For example: ufl/ubuntu,
	  apache/kranky or ofl/gleego.

endif
```
