## package/gstreamer1/gst-omx/Config.in
```kconfig
config BR2_PACKAGE_GST_OMX
	bool "gst-omx"
	depends on BR2_PACKAGE_HAS_LIBOPENMAX
	select BR2_PACKAGE_GST1_PLUGINS_BASE
	help
	  GStreamer plug-in to use OpenMAX API.

	  http://cgit.freedesktop.org/gstreamer/gst-omx

comment "gst-omx requires a OpenMAX implementation"
	depends on !BR2_PACKAGE_HAS_LIBOPENMAX
```

## package/gstreamer1/gst1-imx/Config.in
```kconfig
comment "gst1-imx needs a toolchain w/ dynamic library"
	depends on BR2_arm
	depends on BR2_STATIC_LIBS

menuconfig BR2_PACKAGE_GST1_IMX
	bool "gst1-imx"
	depends on BR2_arm # Only relevant for i.MX
	depends on !BR2_STATIC_LIBS
	select BR2_PACKAGE_GST1_PLUGINS_BASE
	help
	  This is a set of GStreamer 1.0 plugins for plugins for Freescale's
	  i.MX platforms, which make use of the i.MX multimedia capabilities.

	  https://github.com/Freescale/gstreamer-imx

if BR2_PACKAGE_GST1_IMX

config BR2_PACKAGE_GST1_IMX_EGLVISINK
	bool "imxeglvivsink"
	depends on BR2_PACKAGE_IMX_GPU_VIV
	help
	  Elements leveraging the 3D GPU

comment "imxeglvivsink needs the Vivante 3D libraries"
	depends on !BR2_PACKAGE_IMX_GPU_VIV

config BR2_PACKAGE_GST1_IMX_G2D
	bool "imxg2d"
	depends on BR2_PACKAGE_IMX_GPU_VIV_G2D
	help
	  Elements leveraging the 2D GPU

comment "imxg2d needs the Vivante 2D libraries"
	depends on !BR2_PACKAGE_IMX_GPU_VIV_G2D

config BR2_PACKAGE_GST1_IMX_IPU
	bool "imxipu"
	depends on BR2_LINUX_KERNEL
	help
	  Elements leveraging the IPU

comment "imxipu needs an imx-specific Linux kernel to be built"
	depends on !BR2_LINUX_KERNEL

config BR2_PACKAGE_GST1_IMX_MP3ENCODER
	bool "mp3encoder"
	depends on BR2_PACKAGE_IMX_CODEC
	help
	  Elements for MP3 encoding

comment "mp3encoder needs the i.MX codec binaries"
	depends on !BR2_PACKAGE_IMX_CODEC

config BR2_PACKAGE_GST1_IMX_PXP
	bool "imxpxp"
	depends on BR2_LINUX_KERNEL
	help
	  Elements leveraging the PXP

comment "imxpxp needs an imx-specific Linux kernel to be built"
	depends on !BR2_LINUX_KERNEL

config BR2_PACKAGE_GST1_IMX_UNIAUDIODEC
	bool "uniaudiodec"
	depends on BR2_PACKAGE_IMX_CODEC
	help
	  Elements for audio decoding

comment "uniaudiodec needs the i.MX codec binaries"
	depends on !BR2_PACKAGE_IMX_CODEC

config BR2_PACKAGE_GST1_IMX_VPU
	bool "imxvpu"
	depends on BR2_PACKAGE_LIBIMXVPUAPI
	help
	  Elements leveraging the VPU

comment "imxvpu needs the VPU imxvpuapi library"
	depends on !BR2_PACKAGE_LIBIMXVPUAPI

config BR2_PACKAGE_GST1_IMX_V4L2VIDEOSRC
	bool "imxv4l2videosrc"
	select BR2_PACKAGE_GST1_PLUGINS_BAD
	help
	  Elements for V4L2 capture

config BR2_PACKAGE_GST1_IMX_V4L2VIDEOSINK
	bool "imxv4l2videosink"
	select BR2_PACKAGE_GST1_PLUGINS_BAD
	depends on BR2_TOOLCHAIN_HEADERS_AT_LEAST_4_2 # V4L2_COLORSPACE_DEFAULT
	help
	  Elements for V4L2 output

comment "imxv4l2videosink needs a toolchain w/ headers >= 4.2"
	depends on !BR2_TOOLCHAIN_HEADERS_AT_LEAST_4_2

endif
```

## package/gstreamer1/gst1-interpipe/Config.in
```kconfig
config BR2_PACKAGE_GST1_INTERPIPE
	bool "gst1-interpipe"
	select BR2_PACKAGE_GSTREAMER1_CHECK
	select BR2_PACKAGE_GST1_PLUGINS_BASE
	select BR2_PACKAGE_GST1_PLUGINS_BASE_PLUGIN_APP
	help
	  GstInterpipe is a Gstreamer plug-in that allows communication
	  between two independent pipelines.

	  https://github.com/RidgeRun/gst-interpipe
```

## package/gstreamer1/gst1-libav/Config.in
```kconfig
config BR2_PACKAGE_GST1_LIBAV
	bool "gst1-libav"
	depends on BR2_PACKAGE_FFMPEG_ARCH_SUPPORTS
	select BR2_PACKAGE_FFMPEG
	select BR2_PACKAGE_FFMPEG_SWSCALE
	select BR2_PACKAGE_GST1_PLUGINS_BASE
	help
	  GStreamer plugin (formerly gst-ffmpeg).

	  This package contains GStreamer plugins based on
	  the libav project.

	  The codecs, muxers, bitstreams and filters to build can be
	  selected in the ffmpeg package.

	  http://gstreamer.freedesktop.org/
```
