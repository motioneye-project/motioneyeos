## package/grantlee/Config.in
```kconfig
config BR2_PACKAGE_GRANTLEE
	bool "grantlee"
	depends on BR2_PACKAGE_QT5_JSCORE_AVAILABLE && BR2_PACKAGE_QT5
	select BR2_PACKAGE_QT5SCRIPT
	select BR2_PACKAGE_QT5BASE_GUI
	help
	  Qt implementation of the Django template framework

	  http://www.grantlee.org
```

## package/graphite2/Config.in
```kconfig
config BR2_PACKAGE_GRAPHITE2
	bool "graphite2"
	depends on BR2_INSTALL_LIBSTDCPP
	depends on !BR2_STATIC_LIBS
	help
	  Graphite is a project within SIL's scripts and software dev
	  groups to provide cross-platform rendering for complex
	  writing systems.

	  http://sourceforge.net/projects/silgraphite/

comment "graphite2 needs a toolchain w/ C++, dynamic library"
	depends on !BR2_INSTALL_LIBSTDCPP || BR2_STATIC_LIBS
```

## package/grep/Config.in
```kconfig
config BR2_PACKAGE_GREP
	bool "grep"
	depends on BR2_USE_WCHAR
	depends on BR2_PACKAGE_BUSYBOX_SHOW_OTHERS
	help
	  The GNU regular expression matcher.

	  http://www.gnu.org/software/grep/grep.html

comment "grep needs a toolchain w/ wchar"
	depends on !BR2_USE_WCHAR
	depends on BR2_PACKAGE_BUSYBOX_SHOW_OTHERS
```

## package/grpc/Config.in
```kconfig
config BR2_PACKAGE_GRPC
	bool "grpc"
	depends on BR2_INSTALL_LIBSTDCPP # protobuf
	depends on BR2_TOOLCHAIN_HAS_THREADS # protobuf
	depends on BR2_PACKAGE_PROTOBUF_ARCH_SUPPORTS # protobuf
	depends on BR2_HOST_GCC_AT_LEAST_4_8 # protobuf
	depends on BR2_TOOLCHAIN_GCC_AT_LEAST_4_8 # protobuf
	depends on !BR2_STATIC_LIBS # protobuf
	depends on BR2_TOOLCHAIN_HAS_SYNC_4 || BR2_TOOLCHAIN_HAS_ATOMIC
	select BR2_PACKAGE_C_ARES
	select BR2_PACKAGE_OPENSSL
	select BR2_PACKAGE_PROTOBUF
	select BR2_PACKAGE_ZLIB
	help
	  A language-neutral, platform-neutral, open source, remote
	  procedure call (RPC) system initially developed at Google.

	  http://github.com/grpc/grpc

comment "grpc needs a toolchain w/ C++, threads, dynamic library, host and target gcc >= 4.8"
	depends on BR2_TOOLCHAIN_HAS_SYNC_4 || BR2_TOOLCHAIN_HAS_ATOMIC
	depends on !BR2_INSTALL_LIBSTDCPP || !BR2_TOOLCHAIN_HAS_THREADS \
		|| BR2_STATIC_LIBS || !BR2_HOST_GCC_AT_LEAST_4_8 \
		|| !BR2_TOOLCHAIN_GCC_AT_LEAST_4_8
	depends on BR2_PACKAGE_PROTOBUF_ARCH_SUPPORTS
```

## package/gsettings-desktop-schemas/Config.in
```kconfig
config BR2_PACKAGE_GSETTINGS_DESKTOP_SCHEMAS
	bool "gsettings-desktop-schemas"
	depends on BR2_USE_WCHAR # glib2
	depends on BR2_TOOLCHAIN_HAS_THREADS # glib2
	depends on BR2_USE_MMU # glib2
	select BR2_PACKAGE_LIBGLIB2
	help
	  gsettings-desktop-schemas contains a collection of GSettings
	  schemas for settings shared by various components of a
	  desktop.

	  https://github.com/GNOME/gsettings-desktop-schemas

comment "gsettings-desktop-schemas needs a toolchain w/ wchar, threads"
	depends on BR2_USE_MMU
	depends on !BR2_USE_WCHAR || !BR2_TOOLCHAIN_HAS_THREADS
```

## package/gsl/Config.in
```kconfig
config BR2_PACKAGE_GSL
	bool "gsl"
	help
	  The GNU Scientific Library (GSL) is a numerical library for
	  C and C++ programmers.  The library provides a wide range of
	  mathematical routines such as random number generators,
	  special functions and least-squares fitting. There are over
	  1000 functions in total with an extensive test suite.

	  http://www.gnu.org/software/gsl
```

## package/gssdp/Config.in
```kconfig
config BR2_PACKAGE_GSSDP
	bool "gssdp"
	depends on BR2_USE_WCHAR # glib2, libsoup
	depends on BR2_TOOLCHAIN_HAS_THREADS # glib2, libsoup
	depends on BR2_USE_MMU # glib2, libsoup
	select BR2_PACKAGE_LIBGLIB2
	select BR2_PACKAGE_LIBSOUP
	help
	  GSSDP implements resource discovery and announcement over
	  SSDP.

	  http://www.gupnp.org

comment "gssdp needs a toolchain w/ wchar, threads"
	depends on BR2_USE_MMU
	depends on !BR2_USE_WCHAR || !BR2_TOOLCHAIN_HAS_THREADS
```

## package/gstreamer/Config.in
```kconfig
# Gstreamer 0.10.x & Plugins
source "package/gstreamer/gstreamer/Config.in"

if BR2_PACKAGE_GSTREAMER
source "package/gstreamer/gst-plugins-base/Config.in"
source "package/gstreamer/gst-plugins-good/Config.in"
source "package/gstreamer/gst-plugins-bad/Config.in"
source "package/gstreamer/gst-plugins-ugly/Config.in"
source "package/gstreamer/gst-ffmpeg/Config.in"
source "package/gstreamer/gst-fsl-plugins/Config.in"
source "package/gstreamer/gst-omapfb/Config.in"
source "package/gstreamer/gst-plugin-x170/Config.in"
endif
```

## package/gstreamer/gst-ffmpeg/Config.in
```kconfig
config BR2_PACKAGE_GST_FFMPEG
	bool "gst-ffmpeg"
	# Unsupported for MIPS R6. It bundles a version of libav which
	# doesn't have support for MIPS R6.
	depends on !BR2_MIPS_CPU_MIPS32R6 && !BR2_MIPS_CPU_MIPS64R6
	# triggers https://gcc.gnu.org/bugzilla/show_bug.cgi?id=65151 on sh
	depends on BR2_TOOLCHAIN_GCC_AT_LEAST_5 || !BR2_sh
	select BR2_PACKAGE_GST_PLUGINS_BASE
	help
	  GStreamer plugin containing one plugin with a set of elements using
	  the Libav library. It contains most popular decoders as well as
	  colorspace conversion elements.

	  This package is configured to use an internal copy of the Libav
	  library.

	  http://gstreamer.freedesktop.org/modules/gst-ffmpeg.html

if BR2_PACKAGE_GST_FFMPEG

config BR2_PACKAGE_GST_FFMPEG_GPL
	bool "Enable GPL code"
	help
	  Allow use of GPL code. The resulting libs and binaries will
	  be under GPL.

endif

comment "gst-ffmpeg needs a toolchain w/ gcc >= 5"
	depends on !BR2_TOOLCHAIN_GCC_AT_LEAST_5 && BR2_sh
```

## package/gstreamer/gst-fsl-plugins/Config.in
```kconfig
comment "gst-fsl-plugins needs an imx-specific Linux kernel to be built"
	depends on BR2_arm && !BR2_LINUX_KERNEL

config BR2_PACKAGE_GST_FSL_PLUGINS
	bool "gst-fsl-plugins"
	depends on BR2_LINUX_KERNEL
	depends on BR2_arm # Only relevant for i.MX
	select BR2_PACKAGE_GST_PLUGINS_BASE
	select BR2_PACKAGE_LIBFSLVPUWRAP
	select BR2_PACKAGE_IMX_LIB
	select BR2_PACKAGE_LIBFSLPARSER
	select BR2_PACKAGE_LIBFSLCODEC
	help
	  GStreamer plugins for hardware-accelerated audio and video
	  parsers and codecs on i.MX platforms. It requires a kernel that
	  includes the i.MX specific headers to be built.

	  To use the VPU, its firmware blob must be installed as well. This
	  can be found in the firmware-imx package in the "Hardware handling"
	  menu.

	  This library is provided by Freescale as-is and doesn't have
	  an upstream. Pengutronix maintains gst-fsl-plugins at
	  git://git.pengutronix.de/git/imx/gst-plugins-fsl-vpu.git
	  but it diverges heavily from Freescale's original implementation.

if BR2_PACKAGE_GST_FSL_PLUGINS
choice
	prompt "i.MX platform"

config BR2_PACKAGE_GST_FSL_PLUGINS_PLATFORM_MX233
	bool "imx233"

config BR2_PACKAGE_GST_FSL_PLUGINS_PLATFORM_MX25
	select BR2_PACKAGE_IMX_LIB_PLATFORM_IMX25_3STACK
	bool "imx25"

config BR2_PACKAGE_GST_FSL_PLUGINS_PLATFORM_MX27
	select BR2_PACKAGE_IMX_LIB_PLATFORM_IMX27ADS
	bool "imx27"

config BR2_PACKAGE_GST_FSL_PLUGINS_PLATFORM_MX28
	bool "imx28"

config BR2_PACKAGE_GST_FSL_PLUGINS_PLATFORM_MX31
	bool "imx31"

config BR2_PACKAGE_GST_FSL_PLUGINS_PLATFORM_MX35
	bool "imx35"

config BR2_PACKAGE_GST_FSL_PLUGINS_PLATFORM_MX37
	select BR2_PACKAGE_IMX_LIB_PLATFORM_IMX37_3STACK
	bool "imx37"

config BR2_PACKAGE_GST_FSL_PLUGINS_PLATFORM_MX50
	select BR2_PACKAGE_IMX_LIB_PLATFORM_IMX50
	bool "imx50"

config BR2_PACKAGE_GST_FSL_PLUGINS_PLATFORM_MX51
	select BR2_PACKAGE_IMX_LIB_PLATFORM_IMX51
	bool "imx51"

config BR2_PACKAGE_GST_FSL_PLUGINS_PLATFORM_MX53
	select BR2_PACKAGE_IMX_LIB_PLATFORM_IMX53
	bool "imx53"

config BR2_PACKAGE_GST_FSL_PLUGINS_PLATFORM_MX5X
	select BR2_PACKAGE_IMX_LIB_PLATFORM_IMX5X
	bool "imx5X"

config BR2_PACKAGE_GST_FSL_PLUGINS_PLATFORM_MX6
	select BR2_PACKAGE_IMX_LIB_PLATFORM_IMX6Q
	bool "imx6"

endchoice

config BR2_PACKAGE_GST_FSL_PLUGINS_PLATFORM
	string
	default "MX233" if BR2_PACKAGE_GST_FSL_PLUGINS_PLATFORM_MX233
	default "MX25" if BR2_PACKAGE_GST_FSL_PLUGINS_PLATFORM_MX25
	default "MX27" if BR2_PACKAGE_GST_FSL_PLUGINS_PLATFORM_MX27
	default "MX28" if BR2_PACKAGE_GST_FSL_PLUGINS_PLATFORM_MX28
	default "MX31" if BR2_PACKAGE_GST_FSL_PLUGINS_PLATFORM_MX31
	default "MX35" if BR2_PACKAGE_GST_FSL_PLUGINS_PLATFORM_MX35
	default "MX37" if BR2_PACKAGE_GST_FSL_PLUGINS_PLATFORM_MX37
	default "MX50" if BR2_PACKAGE_GST_FSL_PLUGINS_PLATFORM_MX50
	default "MX51" if BR2_PACKAGE_GST_FSL_PLUGINS_PLATFORM_MX51
	default "MX53" if BR2_PACKAGE_GST_FSL_PLUGINS_PLATFORM_MX53
	default "MX5X" if BR2_PACKAGE_GST_FSL_PLUGINS_PLATFORM_MX5X
	default "MX6" if BR2_PACKAGE_GST_FSL_PLUGINS_PLATFORM_MX6
endif
```

## package/gstreamer/gst-omapfb/Config.in
```kconfig
config BR2_PACKAGE_GST_OMAPFB
	bool "gst-omapfb"
	depends on BR2_cortex_a8
	help
	  GStreamer plug-in to use OMAP framebuffer.

	  http://github.com/felipec/gst-omapfb
```

## package/gstreamer/gst-plugin-x170/Config.in
```kconfig
config BR2_PACKAGE_GST_PLUGIN_X170
	bool "gst-plugin-x170"
	depends on BR2_arm926t
	# glibc toolchain includes WCHAR and threading for libglib2
	depends on BR2_TOOLCHAIN_USES_GLIBC # on2-8170-libs
	depends on BR2_LINUX_KERNEL # on2-8170-libs
	select BR2_PACKAGE_ON2_8170_LIBS
	help
	  GStreamer plug-in to use the Hantro X170 video decoder
	  present on ATMEL AT91SAM9M10 SoC.

	  http://www.at91.com/linux4sam/bin/view/Linux4SAM/SAM9M10Gstreamer

comment "gst-plugin-x170 needs a glibc toolchain and a Linux kernel to be built"
	depends on BR2_arm926t
	depends on !BR2_LINUX_KERNEL || !BR2_TOOLCHAIN_USES_GLIBC
```

## package/gstreamer/gst-plugins-base/Config.in
```kconfig
menuconfig BR2_PACKAGE_GST_PLUGINS_BASE
	bool "gst-plugins-base"
	select BR2_PACKAGE_XLIB_LIBX11 if BR2_PACKAGE_XORG7
	select BR2_PACKAGE_XLIB_LIBXEXT if BR2_PACKAGE_XORG7
	select BR2_PACKAGE_XLIB_LIBXV if BR2_PACKAGE_XORG7
	help
	  A basic set of well-supported plug-ins for GStreamer.

	  http://gstreamer.freedesktop.org/

if BR2_PACKAGE_GST_PLUGINS_BASE

comment "dependency-less plugins"

config BR2_PACKAGE_GST_PLUGINS_BASE_PLUGIN_ADDER
	bool "adder"

config BR2_PACKAGE_GST_PLUGINS_BASE_PLUGIN_APP
	bool "app"

config BR2_PACKAGE_GST_PLUGINS_BASE_PLUGIN_AUDIOCONVERT
	bool "audioconvert (mandatory for audio playback)"
	default y

config BR2_PACKAGE_GST_PLUGINS_BASE_PLUGIN_AUDIORATE
	bool "audiorate"

config BR2_PACKAGE_GST_PLUGINS_BASE_PLUGIN_AUDIORESAMPLE
	bool "audioresample (mandatory for audio playback)"
	default y

config BR2_PACKAGE_GST_PLUGINS_BASE_PLUGIN_AUDIOTESTSRC
	bool "audiotestsrc"

config BR2_PACKAGE_GST_PLUGINS_BASE_PLUGIN_ENCODING
	bool "encoding"

config BR2_PACKAGE_GST_PLUGINS_BASE_PLUGIN_FFMPEGCOLORSPACE
	bool "ffmpegcolorspace (mandatory for video playback)"
	default y

config BR2_PACKAGE_GST_PLUGINS_BASE_PLUGIN_GDP
	bool "gdp"

config BR2_PACKAGE_GST_PLUGINS_BASE_PLUGIN_PLAYBACK
	bool "playback (mandatory)"
	default y

config BR2_PACKAGE_GST_PLUGINS_BASE_PLUGIN_SUBPARSE
	bool "subparse"

config BR2_PACKAGE_GST_PLUGINS_BASE_PLUGIN_TCP
	bool "tcp"

config BR2_PACKAGE_GST_PLUGINS_BASE_PLUGIN_TYPEFIND
	bool "typefind (mandatory)"
	default y

config BR2_PACKAGE_GST_PLUGINS_BASE_PLUGIN_VIDEOTESTSRC
	bool "videotestsrc"

config BR2_PACKAGE_GST_PLUGINS_BASE_PLUGIN_VIDEORATE
	bool "videorate"

config BR2_PACKAGE_GST_PLUGINS_BASE_PLUGIN_VIDEOSCALE
	bool "videoscale (mandatory for video playback)"
	default y

config BR2_PACKAGE_GST_PLUGINS_BASE_PLUGIN_VOLUME
	bool "volume (mandatory for audio playback)"
	default y

comment "plugins with external dependencies (there may be more available)"

config BR2_PACKAGE_GST_PLUGINS_BASE_PLUGIN_ALSA
	bool "alsa (mandatory for audio playback)"
	select BR2_PACKAGE_ALSA_LIB
	select BR2_PACKAGE_ALSA_LIB_MIXER
	select BR2_PACKAGE_ALSA_LIB_PCM

config BR2_PACKAGE_GST_PLUGINS_BASE_PLUGIN_OGG
	bool "ogg (*.ogg audio/video)"
	select BR2_PACKAGE_LIBOGG

config BR2_PACKAGE_GST_PLUGINS_BASE_PLUGIN_PANGO
	bool "pango font renderer"
	depends on BR2_INSTALL_LIBSTDCPP
	depends on BR2_USE_WCHAR # pango -> libglib2
	depends on BR2_TOOLCHAIN_HAS_THREADS # pango -> libglib2
	depends on BR2_USE_MMU # pango -> glib2
	select BR2_PACKAGE_PANGO

comment "pango plugin needs a toolchain w/ C++, wchar, threads"
	depends on !BR2_INSTALL_LIBSTDCPP || !BR2_USE_WCHAR || \
		!BR2_TOOLCHAIN_HAS_THREADS

config BR2_PACKAGE_GST_PLUGINS_BASE_PLUGIN_THEORA
	bool "theora (*.ogg video)"
	select BR2_PACKAGE_LIBTHEORA

config BR2_PACKAGE_GST_PLUGINS_BASE_PLUGIN_TREMOR
	bool "tremor"
	select BR2_PACKAGE_TREMOR

config BR2_PACKAGE_GST_PLUGINS_BASE_PLUGIN_VORBIS
	bool "vorbis (*.ogg audio)"
	select BR2_PACKAGE_LIBVORBIS

endif
```

## package/gstreamer/gst-plugins-ugly/Config.in
```kconfig
menuconfig BR2_PACKAGE_GST_PLUGINS_UGLY
	bool "gst-plugins-ugly"
	select BR2_PACKAGE_GST_PLUGINS_BASE
	help
	  A set of well-supported plug-ins for GStreamer, but might pose
	  problems for distributors.

	  http://gstreamer.freedesktop.org/

if BR2_PACKAGE_GST_PLUGINS_UGLY

comment "dependency-less plugins"

config BR2_PACKAGE_GST_PLUGINS_UGLY_PLUGIN_ASFDEMUX
	bool "asfdemux"

config BR2_PACKAGE_GST_PLUGINS_UGLY_PLUGIN_DVDLPCMDEC
	bool "dvdlpcmdec"

config BR2_PACKAGE_GST_PLUGINS_UGLY_PLUGIN_DVDSUB
	bool "dvdsub"

config BR2_PACKAGE_GST_PLUGINS_UGLY_PLUGIN_IEC958
	bool "iec958"

config BR2_PACKAGE_GST_PLUGINS_UGLY_PLUGIN_MPEGAUDIOPARSE
	bool "mpegaudioparse"

config BR2_PACKAGE_GST_PLUGINS_UGLY_PLUGIN_MPEGSTREAM
	bool "mpegstream"

config BR2_PACKAGE_GST_PLUGINS_UGLY_PLUGIN_REALMEDIA
	bool "realmedia"

config BR2_PACKAGE_GST_PLUGINS_UGLY_PLUGIN_SYNAESTHESIA
	bool "synaesthesia"

comment "plugins with external dependencies (there may be more available)"

config BR2_PACKAGE_GST_PLUGINS_UGLY_PLUGIN_LAME
	bool "lame (*.mp3 audio encoder)"
	select BR2_PACKAGE_LAME

config BR2_PACKAGE_GST_PLUGINS_UGLY_PLUGIN_MAD
	bool "mad (*.mp3 audio)"
	select BR2_PACKAGE_LIBID3TAG
	select BR2_PACKAGE_LIBMAD

config BR2_PACKAGE_GST_PLUGINS_UGLY_PLUGIN_MPEG2DEC
	bool "mpeg2dec"
	select BR2_PACKAGE_LIBMPEG2

endif
```

## package/gstreamer/gstreamer/Config.in
```kconfig
comment "gstreamer 0.10 needs a toolchain w/ wchar, threads, dynamic library"
	depends on BR2_USE_MMU
	depends on !BR2_USE_WCHAR || !BR2_TOOLCHAIN_HAS_THREADS || \
		BR2_STATIC_LIBS

config BR2_PACKAGE_GSTREAMER
	bool "gstreamer 0.10"
	depends on BR2_USE_WCHAR # glib2
	depends on BR2_TOOLCHAIN_HAS_THREADS # glib2
	depends on BR2_USE_MMU # glib2
	depends on !BR2_STATIC_LIBS
	select BR2_PACKAGE_LIBGLIB2
	help
	  GStreamer is an open source multimedia framework.

	  This 0.10.x version of GStreamer is incompatible with
	  GStreamer 1.X.

	  http://gstreamer.freedesktop.org/

if BR2_PACKAGE_GSTREAMER

config BR2_PACKAGE_GSTREAMER_GST_DEBUG
	bool "enable gst-debug trace support"
	default y
	help
	  Enable support for the gst-debug tracing functionality in gstreamer.
	  This has limited CPU overhead, but does increase the rootfs size
	  somewhat.

config BR2_PACKAGE_GSTREAMER_PLUGIN_REGISTRY
	bool "enable plugin registry"
	default y
	help
	  Enable support for the GStreamer plugin registry. This may increase
	  the launch-time for a GStreamer application.

endif
```

## package/gstreamer1/Config.in
```kconfig
# Gstreamer 1.x & Plugins
source "package/gstreamer1/gstreamer1/Config.in"

if BR2_PACKAGE_GSTREAMER1
source "package/gstreamer1/gstreamer1-mm/Config.in"
source "package/gstreamer1/gst1-plugins-base/Config.in"
source "package/gstreamer1/gst1-plugins-bayer2rgb-neon/Config.in"
source "package/gstreamer1/gst1-plugins-good/Config.in"
source "package/gstreamer1/gst1-plugins-bad/Config.in"
source "package/gstreamer1/gst1-plugins-ugly/Config.in"
source "package/gstreamer1/gst1-imx/Config.in"
source "package/gstreamer1/gst1-interpipe/Config.in"
source "package/gstreamer1/gst1-libav/Config.in"
source "package/gstreamer1/gst1-python/Config.in"
source "package/gstreamer1/gst1-rtsp-server/Config.in"
source "package/gstreamer1/gst1-shark/Config.in"
source "package/gstreamer1/gst1-validate/Config.in"
source "package/gstreamer1/gst1-vaapi/Config.in"
source "package/gstreamer1/gst-omx/Config.in"
source "package/gstreamer1/gstreamer1-editing-services/Config.in"
endif
```
