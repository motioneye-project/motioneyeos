## package/gstreamer1/gst1-rpicamsrc/Config.in
```kconfig
config BR2_PACKAGE_GST1_RPICAMSRC
	bool "gst1-rpicamsrc"
	depends on BR2_PACKAGE_HAS_LIBOPENMAX
	select BR2_PACKAGE_GST1_PLUGINS_BASE
	help
	  GStreamer element for the Raspberry Pi camera module

	  https://github.com/thaytan/gst-rpicamsrc
```

## package/gstreamer1/gst1-shark/Config.in
```kconfig
config BR2_PACKAGE_GST1_SHARK
	bool "gst1-shark"
	select BR2_PACKAGE_GSTREAMER1_CHECK
	select BR2_PACKAGE_GST1_PLUGINS_BASE
	select BR2_PACKAGE_GST1_PLUGINS_BASE_PLUGIN_APP
	select BR2_PACKAGE_GSTREAMER1_GST_DEBUG # gst_debug_log_valist, GST_CAT_STATES
	help
	  GstShark leverages GStreamers newest instrumentation subsystem
	  by installing a set of custom hooks to the trace points. A
	  variety of data analytics are extracted and presented to the
	  user in a graphical, friendly way.

	  https://github.com/RidgeRun/gst-shark
```

## package/gstreamer1/gst1-vaapi/Config.in
```kconfig
config BR2_PACKAGE_GST1_VAAPI
	bool "gst1-vaapi"
	select BR2_PACKAGE_LIBVA
	select BR2_PACKAGE_LIBDRM
	select BR2_PACKAGE_GST1_PLUGINS_BASE
	select BR2_PACKAGE_GST1_PLUGINS_BAD # gstreamer-codecparsers
	depends on !BR2_STATIC_LIBS # dlopen(), libva
	depends on BR2_TOOLCHAIN_HAS_THREADS # libva, libdrm
	depends on BR2_PACKAGE_HAS_UDEV
	help
	  gstreamer-vaapi consists in a collection of VA-API based
	  plugins for GStreamer and helper libraries.

	  vaapi<CODEC>dec is used to decode JPEG, MPEG-2, MPEG-4:2,
	  H.264 AVC, H.264 MVC, VP8, VC-1, WMV3, HEVC videos to VA
	  surfaces, depending on the actual value of <CODEC> and the
	  underlying hardware capabilities.  This plugin is also able
	  to implicitly download the decoded surface to raw YUV
	  buffers.

	  vaapi<CODEC>enc is used to encode into MPEG-2, H.264 AVC,
	  H.264 MVC, JPEG, VP8, HEVC videos, depending on the actual
	  value of <CODEC> (mpeg2, h264, etc.) and the hardware
	  capabilities. By default, raw format bitstreams are
	  generated, so the result may be piped to a muxer, e.g. qtmux
	  for MP4 containers.

	  vaapipostproc is used to filter VA surfaces, for
	  e.g. scaling, deinterlacing (bob, motion-adaptive,
	  motion-compensated), noise reduction or sharpening. This
	  plugin is also used to upload raw YUV pixels into VA
	  surfaces.

	  vaapisink is used to render VA surfaces to an X11 or Wayland
	  display. This plugin also features a "headless" mode (DRM)
	  more suited to remote transcode scenarios, with faster
	  throughput.

	  https://cgit.freedesktop.org/gstreamer/gstreamer-vaapi

if BR2_PACKAGE_GST1_VAAPI

config BR2_PACKAGE_GST1_VAAPI_ENCODERS
	bool "enable encoders"

endif

comment "gst1-vaapi needs udev /dev management and a toolchain w/ threads, dynamic library"
	depends on !BR2_TOOLCHAIN_HAS_THREADS || BR2_STATIC_LIBS || \
		!BR2_PACKAGE_HAS_UDEV
```

## package/gstreamer1/gst1-validate/Config.in
```kconfig
config BR2_PACKAGE_GST1_VALIDATE
	bool "gst1-validate"
	depends on BR2_PACKAGE_PYTHON
	select BR2_PACKAGE_GST1_PLUGINS_BASE
	select BR2_PACKAGE_PYTHON_PYEXPAT
	# cairo is autodetected but needs PNG support
	select BR2_PACKAGE_CAIRO_PNG if BR2_PACKAGE_CAIRO
	help
	  GstValidate is a tool that allows GStreamer developers to
	  check that the GstElements they write behave the way they
	  are supposed to.

	  http://gstreamer.freedesktop.org/

comment "gst1-validate depends on python"
	depends on !BR2_PACKAGE_PYTHON
```

## package/gstreamer1/gstreamer1-editing-services/Config.in
```kconfig
config BR2_PACKAGE_GSTREAMER1_EDITING_SERVICES
	bool "gstreamer1-editing-services"
	select BR2_PACKAGE_LIBXML2
	select BR2_PACKAGE_GST1_PLUGINS_BASE
	select BR2_PACKAGE_GST1_PLUGINS_GOOD
	select BR2_PACKAGE_GST1_PLUGINS_BASE_PLUGIN_AUDIOCONVERT # runtime
	select BR2_PACKAGE_GST1_PLUGINS_BASE_PLUGIN_AUDIOMIXER # runtime
	select BR2_PACKAGE_GST1_PLUGINS_BASE_PLUGIN_AUDIORESAMPLE # runtime
	select BR2_PACKAGE_GST1_PLUGINS_BASE_PLUGIN_VIDEOCONVERT # runtime
	select BR2_PACKAGE_GST1_PLUGINS_BASE_PLUGIN_VIDEOTESTSRC # runtime
	select BR2_PACKAGE_GST1_PLUGINS_BASE_PLUGIN_VIDEOSCALE # runtime
	select BR2_PACKAGE_GST1_PLUGINS_BASE_PLUGIN_VOLUME # runtime
	select BR2_PACKAGE_GST1_PLUGINS_GOOD_PLUGIN_IMAGEFREEZE # runtime
	help
	  GStreamer Editing Services is a high-level library for
	  facilitating the creation of audio/video non-linear editors.

	  http://gstreamer.freedesktop.org
```

## package/gstreamer1/gstreamer1-mm/Config.in
```kconfig
config BR2_PACKAGE_GSTREAMER1_MM
	bool "gstreamer1-mm"
	depends on BR2_TOOLCHAIN_GCC_AT_LEAST_4_9 # glibmm
	depends on BR2_INSTALL_LIBSTDCPP # glibmm
	depends on BR2_USE_WCHAR # glibmm -> libglib2
	depends on BR2_TOOLCHAIN_HAS_THREADS # libglib2
	depends on BR2_USE_MMU # glibmm -> libglib2
	select BR2_PACKAGE_GLIBMM
	select BR2_PACKAGE_GSTREAMER1_CHECK
	select BR2_PACKAGE_GST1_PLUGINS_BASE
	help
	  gstreamermm provides C++ bindings for the GStreamer streaming
	  multimedia library (http://gstreamer.freedesktop.org). With
	  gstreamermm it is possible to	develop applications that work
	  with multimedia in C++.

	  gstreamermm is developed over glibmm, libsigc++ and libxml++
	  and the functionalities they provide. This means that, among
	  other things, referencing and unreferencing of GObjects is
	  handled automatically via glibmm's automatic pointer class,
	  Glib::RefPtr, and libsigc++'s slots are used for callbacks and
	  signals.

	  https://gstreamer.freedesktop.org/bindings/cplusplus.html

comment "gstreamer1-mm needs a toolchain w/ C++, wchar, threads, gcc >= 4.9"
	depends on BR2_USE_MMU
	depends on !BR2_TOOLCHAIN_GCC_AT_LEAST_4_9 || !BR2_USE_WCHAR \
		|| !BR2_INSTALL_LIBSTDCPP || !BR2_TOOLCHAIN_HAS_THREADS
```

## package/gstreamer1/gstreamer1/Config.in
```kconfig
comment "gstreamer 1.x needs a toolchain w/ wchar, threads"
	depends on BR2_USE_MMU
	depends on !BR2_USE_WCHAR || !BR2_TOOLCHAIN_HAS_THREADS

config BR2_PACKAGE_GSTREAMER1
	bool "gstreamer 1.x"
	depends on BR2_USE_WCHAR # glib2
	depends on BR2_TOOLCHAIN_HAS_THREADS # glib2
	depends on BR2_USE_MMU # glib2
	select BR2_PACKAGE_LIBGLIB2
	help
	  GStreamer is an open source multimedia framework. This 1.x version of
	  Gstreamer is incompatible with Gstreamer 0.10.x.

	  http://gstreamer.freedesktop.org/

if BR2_PACKAGE_GSTREAMER1

config BR2_PACKAGE_GSTREAMER1_PARSE
	bool "enable command-line parser"
	default y
	help
	  Enable command line parser for gstreamer. This may increase the CPU
	  overhead by a small amount.

config BR2_PACKAGE_GSTREAMER1_TRACE
	bool "enable tracing subsystem"
	default y
	help
	  Enable the tracing subsystem within gstreamer. This may increase CPU
	  overhead by a small amount.

config BR2_PACKAGE_GSTREAMER1_GST_DEBUG
	bool "enable gst-debug trace support"
	default y
	help
	  Enable support for the gst-debug tracing functionality in gstreamer.
	  This has limited CPU overhead, but does increase the rootfs size
	  somewhat.

config BR2_PACKAGE_GSTREAMER1_PLUGIN_REGISTRY
	bool "enable plugin registry"
	default y
	help
	  Enable support for the GStreamer plugin registry. This may increase
	  the launch-time for a GStreamer application.

config BR2_PACKAGE_GSTREAMER1_INSTALL_TOOLS
	bool "install gst-launch & gst-inspect"
	default y
	help
	  Install the gst-launch and gst-inspect tools. This will take up
	  additional space on the target.

endif
```

## package/gtest/Config.in
```kconfig
config BR2_PACKAGE_GTEST
	bool "gtest"
	depends on BR2_USE_WCHAR
	depends on BR2_TOOLCHAIN_HAS_THREADS
	depends on BR2_INSTALL_LIBSTDCPP
	depends on BR2_USE_MMU # fork()
	help
	  Google's framework for writing C++ tests on a variety of
	  platforms (Linux, Mac OS X, Windows, Cygwin, Windows CE, and
	  Symbian). Based on the xUnit architecture. Supports
	  automatic test discovery, a rich set of assertions,
	  user-defined assertions, death tests, fatal and non-fatal
	  failures, value- and type-parameterized tests, various
	  options for running the tests, and XML test report
	  generation.

	  Gtest also allows to easily build testsuites for C programs.

	  This package allows running testsuites on the target which
	  might be advantageous in certain cases.

	  https://github.com/google/googletest

if BR2_PACKAGE_GTEST

config BR2_PACKAGE_GTEST_GMOCK
	bool "gmock"
	help
	  Inspired by jMock, EasyMock, and Hamcrest, and designed with
	  C++'s specifics in mind, Google C++ Mocking Framework (or
	  Google Mock for short) is a library for writing and using C++
	  mock classes.

	  Google Mock:

	    * lets you create mock classes trivially using simple
	      macros, supports a rich set of matchers and actions,
	    * handles unordered, partially ordered, or completely
	      ordered expectations,
	    * is extensible by users, and
	    * works on Linux, Mac OS X, Windows, Windows Mobile, minGW,
	      and Symbian.

	  There are both host and target packages. The target one has
	  include files required to compile the tests and the static
	  libraries required to link/run them. The host package installs
	  gmock_gen, a Python script used to generate code mocks.

endif # BR2_PACKAGE_GTEST

comment "gtest needs a toolchain w/ C++, wchar, threads"
	depends on BR2_USE_MMU
	depends on !BR2_USE_WCHAR || !BR2_TOOLCHAIN_HAS_THREADS || \
		!BR2_INSTALL_LIBSTDCPP
```

## package/gtk2-engines/Config.in
```kconfig
config BR2_PACKAGE_LIBGTK2_ENGINES
	bool "gtk engines"
	depends on BR2_PACKAGE_LIBGTK2
	help
	  A collection of basic theme engines for GTK+.
```

## package/gtk2-themes/Config.in
```kconfig
menu "GTK Themes"
depends on BR2_PACKAGE_LIBGTK2

source "package/gtk2-themes/gtk2-theme-hicolor/Config.in"

endmenu
```

## package/gtkmm3/Config.in
```kconfig
comment "gtkmm3 needs libgtk3 and a toolchain w/ C++, wchar, threads, gcc >= 4.8"
	depends on BR2_USE_MMU
	depends on BR2_TOOLCHAIN_HAS_SYNC_4
	depends on !BR2_TOOLCHAIN_GCC_AT_LEAST_4_8 || !BR2_USE_WCHAR \
		|| !BR2_INSTALL_LIBSTDCPP || !BR2_PACKAGE_LIBGTK3 \
		|| !BR2_TOOLCHAIN_HAS_THREADS

config BR2_PACKAGE_GTKMM3
	bool "gtkmm3"
	# Broken on existing external/internal nios2 toolchains,
	# revisit when they are upgraded with at least Binutils >= 2.26
	# and GCC >= 5.3.
	# https://sourceware.org/bugzilla/show_bug.cgi?id=19405
	depends on !BR2_nios2
	depends on BR2_TOOLCHAIN_HAS_SYNC_4 # pangomm, libgtk3 -> pango -> harfbuzz
	depends on BR2_INSTALL_LIBSTDCPP # glibmm, libpangomm -> glibmm/pango
	depends on BR2_TOOLCHAIN_GCC_AT_LEAST_4_8 # C++11
	depends on BR2_TOOLCHAIN_HAS_THREADS # *mm/libgtk3 -> libglib2
	depends on BR2_USE_MMU # *mm/libgtk3 -> libglib2
	depends on BR2_USE_WCHAR # *mm/libgtk3 -> libglib2
	depends on BR2_PACKAGE_LIBGTK3
	select BR2_PACKAGE_ATKMM
	select BR2_PACKAGE_CAIROMM
	select BR2_PACKAGE_GLIBMM
	select BR2_PACKAGE_LIBSIGC
	select BR2_PACKAGE_PANGOMM
	help
	  The gtkmm3 package is a set of C++ bindings for GTK 3.

	  http://www.gtkmm.org/
```

## package/gtkperf/Config.in
```kconfig
config BR2_PACKAGE_GTKPERF
	bool "gtkperf (performance test for GTK2)"
	depends on BR2_PACKAGE_LIBGTK2
	help
	  GtkPerf is an application designed to test GTK+ performance.
	  The point is to create common testing platform to run
	  predefined GTK+ widgets
	  e.g. (opening comboboxes, toggling buttons, scrolling text yms.)
	  and this way define the speed of device/platform.
```

## package/guile/Config.in
```kconfig
config BR2_PACKAGE_GUILE
	bool "guile"
	depends on !BR2_TOOLCHAIN_USES_MUSL # no strtol_l
	depends on BR2_TOOLCHAIN_HAS_THREADS
	depends on BR2_PACKAGE_LIBATOMIC_OPS_ARCH_SUPPORTS # bdwgc
	depends on BR2_USE_WCHAR # libunistring
	depends on !BR2_STATIC_LIBS
	select BR2_PACKAGE_LIBUNISTRING
	select BR2_PACKAGE_LIBFFI
	select BR2_PACKAGE_GMP
	select BR2_PACKAGE_BDWGC
	select BR2_PACKAGE_LIBTOOL
	help
	  Guile is an interpreter and compiler for the Scheme
	  programming language, a clean and elegant dialect of Lisp.

	  http://www.gnu.org/software/guile

comment "guile needs a uClibc or (e)glibc toolchain w/ threads, wchar, dynamic library"
	depends on !BR2_TOOLCHAIN_HAS_THREADS || !BR2_USE_WCHAR || \
		BR2_STATIC_LIBS || BR2_TOOLCHAIN_USES_MUSL
```

## package/gupnp-av/Config.in
```kconfig
config BR2_PACKAGE_GUPNP_AV
	bool "gupnp-av"
	depends on BR2_USE_WCHAR # glib2, gupnp
	depends on BR2_TOOLCHAIN_HAS_THREADS # glib2, gupnp
	depends on BR2_USE_MMU # glib2, gupnp
	select BR2_PACKAGE_LIBGLIB2
	select BR2_PACKAGE_GUPNP
	select BR2_PACKAGE_LIBXML2
	help
	  GUPnP-AV is a collection of helpers for building AV (audio/video)
	  applications using GUPnP.

	  http://www.gupnp.org/

comment "gupnp-av needs a toolchain w/ wchar, threads"
	depends on BR2_USE_MMU
	depends on !BR2_USE_WCHAR || !BR2_TOOLCHAIN_HAS_THREADS
```

## package/gupnp-dlna/Config.in
```kconfig
config BR2_PACKAGE_GUPNP_DLNA
	bool "gupnp-dlna"
	depends on BR2_USE_WCHAR # glib2
	depends on BR2_TOOLCHAIN_HAS_THREADS # glib2
	depends on BR2_USE_MMU # glib2
	select BR2_PACKAGE_LIBGLIB2
	select BR2_PACKAGE_LIBXML2
	help
	  GUPnP DLNA is a small utility library that aims to ease the
	  DLNA-related tasks such as media profile guessing, transcoding
	  to a given profile, etc.

	  http://www.gupnp.org/

comment "gupnp-dlna needs a toolchain w/ wchar, threads"
	depends on BR2_USE_MMU
	depends on !BR2_USE_WCHAR || !BR2_TOOLCHAIN_HAS_THREADS
```

## package/gupnp-tools/Config.in
```kconfig
config BR2_PACKAGE_GUPNP_TOOLS
	bool "gupnp-tools"
	# gssdp, gupnp, libsoup all select on libglib2, so they have
	# the same dependencies as libgtk3, which we depend on. So for
	# the same of simplicity, we don't replicate all those
	# (complex) dependencies.
	select BR2_PACKAGE_GSSDP
	select BR2_PACKAGE_GUPNP
	select BR2_PACKAGE_LIBSOUP
	select BR2_PACKAGE_LIBXML2
	depends on BR2_PACKAGE_LIBGTK3
	help
	  GUPnP Tools are free replacements of Intel UPnP tools that
	  use GUPnP. They provides client and server side tools which
	  enable one to easily test and debug one's UPnP devices and
	  control points.

	  http://www.gupnp.org/

comment "gupnp-tools needs libgtk3"
	depends on !BR2_PACKAGE_LIBGTK3
```

## package/gupnp/Config.in
```kconfig
config BR2_PACKAGE_GUPNP
	bool "gupnp"
	depends on BR2_USE_WCHAR # glib2, gssdp
	depends on BR2_TOOLCHAIN_HAS_THREADS # glib2, gssdp
	depends on BR2_USE_MMU # glib2, gssdp
	select BR2_PACKAGE_LIBGLIB2
	select BR2_PACKAGE_GSSDP
	select BR2_PACKAGE_LIBXML2
	select BR2_PACKAGE_UTIL_LINUX
	select BR2_PACKAGE_UTIL_LINUX_LIBUUID
	help
	  GUPnP implements the UPnP specification: resource announcement
	  and discovery, description, control, event notification, and
	  presentation.

	  http://www.gupnp.org/

comment "gupnp needs a toolchain w/ wchar, threads"
	depends on BR2_USE_MMU
	depends on !BR2_USE_WCHAR || !BR2_TOOLCHAIN_HAS_THREADS
```

## package/gutenprint/Config.in
```kconfig
config BR2_PACKAGE_GUTENPRINT
	bool "gutenprint"
	# because of cups security issues
	depends on BR2_DEPRECATED_SINCE_2015_05
	depends on BR2_INSTALL_LIBSTDCPP
	depends on BR2_PACKAGE_CUPS
	select BR2_PACKAGE_LIBICONV if !BR2_ENABLE_LOCALE
	help
	  Gutenprint, formerly named Gimp-Print, is a suite of printer
	  drivers that may be used with most common UNIX print spooling
	  systems, including CUPS, lpr, LPRng, or others

	  http://gimp-print.sourceforge.net/

comment "gutenprint needs a toolchain w/ C++"
	depends on BR2_PACKAGE_CUPS
	depends on !BR2_INSTALL_LIBSTDCPP
```
