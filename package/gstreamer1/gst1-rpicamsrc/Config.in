## package/gvfs/Config.in
```kconfig
config BR2_PACKAGE_GVFS
	bool "gvfs"
	depends on BR2_USE_WCHAR # glib2
	depends on BR2_USE_MMU # dbus, glib2
	depends on BR2_TOOLCHAIN_HAS_THREADS # dbus, glib2
	select BR2_PACKAGE_LIBGLIB2
	select BR2_PACKAGE_DBUS
	select BR2_PACKAGE_SHARED_MIME_INFO
	help
	  gvfs is a userspace virtual filesystem where mount runs as a
	  separate processes which you talk to via D-Bus. It also
	  contains a gio module that seamlessly adds gvfs support to
	  all applications using the gio API. It also supports exposing
	  the gvfs mounts to non-gio applications using fuse.

	  https://wiki.gnome.org/action/show/Projects/gvfs

comment "gvfs needs a toolchain w/ wchar, threads"
	depends on BR2_USE_MMU
	depends on !BR2_USE_WCHAR || !BR2_TOOLCHAIN_HAS_THREADS
```

## package/gzip/Config.in
```kconfig
config BR2_PACKAGE_GZIP
	bool "gzip"
	depends on BR2_USE_WCHAR
	help
	  Standard GNU compressor. Provides things like gzip,
	  gunzip, gzcat, etc...

	  http://www.gnu.org/software/gzip/gzip.html

comment "gzip needs a toolchain w/ wchar"
	depends on !BR2_USE_WCHAR
```

## package/hackrf/Config.in
```kconfig
config BR2_PACKAGE_HACKRF
	bool "hackrf"
	depends on !BR2_STATIC_LIBS
	depends on BR2_TOOLCHAIN_HAS_THREADS
	select BR2_PACKAGE_FFTW
	select BR2_PACKAGE_FFTW_SINGLE
	select BR2_PACKAGE_LIBUSB
	help
	  Library and tools for accessing HackRF SDR boards.

	  https://github.com/mossmann/hackrf/tree/master/host

comment "hackrf needs a toolchain w/ threads, dynamic library"
	depends on BR2_STATIC_LIBS || !BR2_TOOLCHAIN_HAS_THREADS
```

## package/hal/Config.in
```kconfig
config BR2_PACKAGE_HAL
	bool "hal"
	depends on BR2_USE_WCHAR # glib2
	select BR2_PACKAGE_EXPAT
	select BR2_PACKAGE_LIBGLIB2
	select BR2_PACKAGE_GETTEXT if BR2_NEEDS_GETTEXT_IF_LOCALE
	select BR2_PACKAGE_LIBINTL if BR2_NEEDS_GETTEXT_IF_LOCALE
	select BR2_PACKAGE_LIBICONV if !BR2_ENABLE_LOCALE
	select BR2_PACKAGE_DBUS
	select BR2_DBUS_EXPAT
	select BR2_PACKAGE_DBUS_GLIB
	select BR2_PACKAGE_HWDATA
	select BR2_PACKAGE_UDEV
	select BR2_PACKAGE_UDEV_VOLUME_ID
	help
	  The Hardware Abstraction Layer (HAL) suite.

comment "hal requires a toolchain with WCHAR support"
	depends on !BR2_USE_WCHAR
```

## package/hans/Config.in
```kconfig
comment "hans needs a toolchain w/ C++"
	depends on !BR2_INSTALL_LIBSTDCPP

config BR2_PACKAGE_HANS
	bool "hans"
	depends on BR2_INSTALL_LIBSTDCPP
	help
	  Hans makes it possible to tunnel IPv4 through ICMP echo
	  packets, so you could call it a ping tunnel.
	  This can be useful when you find yourself in the situation
	  that your Internet access is firewalled, but pings are
	  allowed.

	  http://code.gerade.org/hans/
```

## package/haproxy/Config.in
```kconfig
config BR2_PACKAGE_HAPROXY_ARCH_SUPPORTS
	bool
	default y
	# src/proto_http.c:6330:1: internal compiler error: Segmentation fault
	depends on !BR2_nios2
	# https://gcc.gnu.org/bugzilla/show_bug.cgi?id=60040
	depends on !(BR2_sh4 && !BR2_TOOLCHAIN_GCC_AT_LEAST_7)

config BR2_PACKAGE_HAPROXY
	bool "haproxy"
	depends on BR2_PACKAGE_HAPROXY_ARCH_SUPPORTS
	depends on BR2_USE_MMU # fork()
	depends on BR2_TOOLCHAIN_HAS_SYNC_1 && BR2_TOOLCHAIN_HAS_SYNC_4
	help
	  HAProxy is a free, very fast and reliable solution offering
	  high availability, load balancing, and proxying for TCP and
	  HTTP-based applications.

	  http://www.haproxy.org
```
