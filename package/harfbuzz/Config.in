## package/harfbuzz/Config.in
```kconfig
config BR2_PACKAGE_HARFBUZZ
	bool "harfbuzz"
	depends on BR2_INSTALL_LIBSTDCPP
	depends on BR2_TOOLCHAIN_HAS_SYNC_4
	depends on BR2_TOOLCHAIN_GCC_AT_LEAST_4_8
	help
	  HarfBuzz is an OpenType text shaping engine

	  http://www.freedesktop.org/wiki/Software/HarfBuzz/

	  Harfbuzz can make optional use of cairo, freetype,
	  glib2 and icu packages if they are selected.

comment "harfbuzz needs a toolchain w/ C++, gcc => 4.8"
	depends on BR2_TOOLCHAIN_HAS_SYNC_4
	depends on !BR2_INSTALL_LIBSTDCPP || \
		!BR2_TOOLCHAIN_GCC_AT_LEAST_4_8
```

## package/haserl/Config.in
```kconfig
config BR2_PACKAGE_HASERL
	bool "haserl"
	depends on BR2_USE_MMU # fork()
	help
	  Haserl is a small cgi wrapper that enables shell scripts to be
	  embedded into html documents. It is intended for environments
	  where something like PHP is too big.

	  http://haserl.sourceforge.net/

config BR2_PACKAGE_HASERL_WITH_LUA
	bool "Lua support"
	depends on BR2_PACKAGE_HASERL
	select BR2_PACKAGE_LUA
	help
	  Enable Lua support for haserl
```

## package/hdparm/Config.in
```kconfig
config BR2_PACKAGE_HDPARM
	bool "hdparm"
	depends on BR2_PACKAGE_BUSYBOX_SHOW_OTHERS
	help
	  hdparm - get/set hard disk parameters for Linux IDE drives.

	  http://www.ibiblio.org/pub/Linux/system/hardware/
```

## package/heirloom-mailx/Config.in
```kconfig
config BR2_PACKAGE_HEIRLOOM_MAILX
	bool "heirloom-mailx"
	help
	  Heirloom mailx (previously known as nail) is a mail user
	  agent for Unix systems.

	  It can be used as a command-line mail reader, but also more
	  importantly on embedded systems, as a mail composition
	  program and SMTP client, in order to send e-mail from shell
	  scripts. It supports SMTP authentication (login, plain,
	  cram-md5), SMTPS, MIME encoding of attachements, and more.

	  http://heirloom.sourceforge.net/mailx.html
```

## package/hiawatha/Config.in
```kconfig
comment "hiawatha needs a toolchain w/ threads, dynamic library"
	depends on BR2_USE_MMU
	depends on BR2_TOOLCHAIN_HAS_SYNC_4
	depends on !BR2_TOOLCHAIN_HAS_THREADS || BR2_STATIC_LIBS

config BR2_PACKAGE_HIAWATHA
	bool "hiawatha"
	# needs fork()
	depends on BR2_USE_MMU
	depends on BR2_TOOLCHAIN_HAS_SYNC_4 # __sync_*_4 intrisics
	depends on BR2_TOOLCHAIN_HAS_THREADS
	depends on !BR2_STATIC_LIBS
	select BR2_PACKAGE_ZLIB
	help
	  Hiawatha is a webserver for Unix and has been built with
	  security in mind. This resulted in a highly secure
	  webserver, in both code and features.

	  This webserver runs on Linux, BSD, MacOS X and
	  Windows. Although it can run any kind of CGI / FastCGI
	  application, it has been optimized for usage with PHP. Most
	  well known PHP frameworks and CMS applications have been
	  tested with Hiawatha and ran without a problem. Hiawatha
	  supports many web and HTTP features such as CGI/FastCGI,
	  HTTP authentication, virtual host support, request
	  pipelining, keep alive connections, URL rewriting and many
	  more.

	  http://www.hiawatha-webserver.org/

if BR2_PACKAGE_HIAWATHA

config BR2_PACKAGE_HIAWATHA_SSL
	bool "hiawatha TLS support"
	select BR2_PACKAGE_MBEDTLS

endif
```

## package/hicolor-icon-theme/Config.in
```kconfig
config BR2_PACKAGE_HICOLOR_ICON_THEME
	bool "hicolor icon theme"
	help
	  Freedesktop Hicolor icon theme

	  This is the fallback icon theme, which only creates the
	  standard directory structure for storing icons of third-party
	  applications (i.e. the ones not available in usual icon themes).
```

## package/hidapi/Config.in
```kconfig
config BR2_PACKAGE_HIDAPI
	bool "hidapi"
	depends on BR2_PACKAGE_HAS_UDEV
	depends on BR2_TOOLCHAIN_HAS_THREADS_NPTL
	select BR2_PACKAGE_LIBUSB
	select BR2_PACKAGE_LIBGUDEV
	select BR2_PACKAGE_LIBICONV if !BR2_ENABLE_LOCALE
	# runtime UTF conversion support
	select BR2_TOOLCHAIN_GLIBC_GCONV_LIBS_COPY if BR2_TOOLCHAIN_USES_GLIBC
	help
	  HIDAPI is a multi-platform library which allows an application
	  to interface with USB and Bluetooth HID-Class devices on
	  Windows, Linux, and Mac OS X.

	  http://www.signal11.us/oss/hidapi/

comment "hidapi needs udev /dev management and a toolchain w/ NPTL threads"
	depends on !BR2_TOOLCHAIN_HAS_THREADS_NPTL || !BR2_PACKAGE_HAS_UDEV
```

## package/hiredis/Config.in
```kconfig
config BR2_PACKAGE_HIREDIS
	bool "hiredis"
	help
	  Minimalistic C client for Redis >= 1.2

	  It is minimalistic because it just adds minimal support for
	  the protocol, but at the same time it uses a high level
	  printf-alike API in order to make it much higher level than
	  otherwise suggested by its minimal code base and the lack of
	  explicit bindings for every Redis command.

	  https://github.com/redis/hiredis
```

## package/hostap/Config.in
```kconfig
config BR2_PACKAGE_HOSTAP
	bool "hostap"
	default n
	depends on BR2_DEPRECATED
	select BR2_PACKAGE_PCMCIA
	help
	  Linux driver for wireless LAN cards based on Intersil's 
	  Prism2/2.5/3 chipset.

	  http://hostap.epitest.fi/
```

## package/hostapd/Config.in
```kconfig
config BR2_PACKAGE_HOSTAPD
	bool "hostapd"
	depends on BR2_USE_MMU # fork()
	help
	  User space daemon for wireless access points.

	  It implements IEEE 802.11 access point management,
	  IEEE 802.1X/WPA/WPA2/EAP authenticators, RADIUS client,
	  EAP server and RADIUS authentication server.

	  http://w1.fi/hostapd/

if BR2_PACKAGE_HOSTAPD

config BR2_PACKAGE_HOSTAPD_DRIVER_HOSTAP
	bool "Enable hostap driver"
	default y
	select BR2_PACKAGE_HOSTAPD_HAS_WIFI_DRIVERS
	help
	  Enable support for Host AP driver.

config BR2_PACKAGE_HOSTAPD_DRIVER_NL80211
	bool "Enable nl80211 driver"
	default y
	depends on BR2_TOOLCHAIN_HAS_THREADS # libnl
	select BR2_PACKAGE_LIBNL
	select BR2_PACKAGE_HOSTAPD_HAS_WIFI_DRIVERS
	help
	  Enable support for drivers using the nl80211 kernel interface.

comment "nl80211 driver needs a toolchain w/ threads"
	depends on !BR2_TOOLCHAIN_HAS_THREADS

config BR2_PACKAGE_HOSTAPD_DRIVER_WIRED
	bool "Enable wired driver"
	help
	  Enable support for wired authenticator.

config BR2_PACKAGE_HOSTAPD_DRIVER_NONE
	bool
	default y
	depends on !BR2_PACKAGE_HOSTAPD_DRIVER_HOSTAP
	depends on !BR2_PACKAGE_HOSTAPD_DRIVER_NL80211
	depends on !BR2_PACKAGE_HOSTAPD_DRIVER_WIRED

config BR2_PACKAGE_HOSTAPD_HAS_WIFI_DRIVERS
	bool

config BR2_PACKAGE_HOSTAPD_ACS
	bool "Enable ACS"
	default y
	depends on BR2_PACKAGE_HOSTAPD_DRIVER_NL80211
	help
	  Enable support for standard ACS (Automatic Channel Selection).
	  Some propietary drivers use a custom algorithm which requires
	  channel to be set to '0' (which enables ACS in the config),
	  causing hostapd to use the standard one which doesn't work
	  for those cases.

comment "ACS is currently only supported through the nl80211 driver"
	depends on !BR2_PACKAGE_HOSTAPD_DRIVER_NL80211

config BR2_PACKAGE_HOSTAPD_EAP
	bool "Enable EAP"
	depends on !BR2_STATIC_LIBS
	help
	  Enable support for EAP and RADIUS.

comment "hostapd EAP needs a toolchain w/ dynamic library"
	depends on BR2_STATIC_LIBS

config BR2_PACKAGE_HOSTAPD_WPS
	bool "Enable WPS"
	help
	  Enable support for Wi-Fi Protected Setup.

config BR2_PACKAGE_HOSTAPD_WPA3
	bool "Enable WPA3 support"
	select BR2_PACKAGE_OPENSSL
	select BR2_PACKAGE_OPENSSL_FORCE_LIBOPENSSL
	help
	  Enable WPA3 support including OWE, SAE, DPP

config BR2_PACKAGE_HOSTAPD_VLAN
	bool "Enable VLAN support"
	default y
	help
	  Enable support for VLANs.

if BR2_PACKAGE_HOSTAPD_VLAN

config BR2_PACKAGE_HOSTAPD_VLAN_DYNAMIC
	bool "Enable dynamic VLAN support"
	default y
	help
	  Enable support for fully dynamic VLANs.
	  This enables hostapd to automatically create
	  bridge and VLAN interfaces if necessary.

config BR2_PACKAGE_HOSTAPD_VLAN_NETLINK
	bool "Use netlink-based API for VLAN operations"
	default y
	depends on BR2_TOOLCHAIN_HAS_THREADS # libnl
	select BR2_PACKAGE_LIBNL
	help
	  Use netlink-based kernel API for VLAN operations
	  instead of ioctl().

comment "netlink-based VLAN support needs a toolchain w/ threads"
	depends on !BR2_TOOLCHAIN_HAS_THREADS

endif # BR2_PACKAGE_HOSTAPD_VLAN

endif
```

## package/hotplug/Config.in
```kconfig
config BR2_PACKAGE_HOTPLUG
	bool "hotplug"
	depends on BR2_DEPRECATED
	help
	  Plug in new devices and use them immediately.

	  http://linux-hotplug.sourceforge.net/
```

## package/hplip/Config.in
```kconfig
config BR2_PACKAGE_HPLIP
	bool "hplip"
	depends on BR2_INSTALL_LIBSTDCPP
	depends on BR2_PACKAGE_CUPS
	depends on BR2_TOOLCHAIN_HAS_THREADS # libusb
	select BR2_PACKAGE_LIBUSB
	select BR2_PACKAGE_JPEG
	help
	  HP Linux Imaging and Printing (HPLIP)
	  HPLIP is an HP-developed solution for printing, scanning, and faxing
	  with HP inkjet and laser based printers in Linux. The HPLIP project
	  provides printing support for 2,211 printer models, including
	  Deskjet, Officejet, Photosmart, PSC (Print Scan Copy), Business
	  Inkjet, LaserJet, Edgeline MFP, and LaserJet MFP.

	  http://hplipopensource.com/

comment "hplip requires a toolchain with C++ and thread support enabled"
	depends on !BR2_INSTALL_LIBSTDCPP || !BR2_TOOLCHAIN_HAS_THREADS
```

## package/htop/Config.in
```kconfig
config BR2_PACKAGE_HTOP
	bool "htop"
	depends on BR2_USE_MMU # fork()
	select BR2_PACKAGE_NCURSES
	help
	  htop is an interactive text-mode process viewer for Linux.
	  It aims to be a better top.

	  http://htop.sf.net
```

## package/httping/Config.in
```kconfig
config BR2_PACKAGE_HTTPING
	bool "httping"
	help
	  Httping is like 'ping' but for http-requests.
	  Give it an url, and it'll show you how long it takes to connect,
	  send a request and retrieve the reply (only the headers).
	  Be aware that the transmission across the network also takes time!
	  So it measures the latency of the webserver + network.

	  http://www.vanheusden.com/httping/

if BR2_PACKAGE_HTTPING

config BR2_PACKAGE_HTTPING_TFO
	bool "TCP Fast Open (TFO) support"

endif
```

## package/hwdata/Config.in
```kconfig
config BR2_PACKAGE_HWDATA
	bool "hwdata"
	help
	  Various hardware identification and configuration data

	  - Individual Address Block (IAB) and Organizationally Unique
	    Identifier (OUI) databases, from IEEE Registration Authority
	  - PCI ID database
	  - PNP ID database (from Microsoft)
	  - USB ID database

	  https://github.com/vcrhonek/hwdata

if BR2_PACKAGE_HWDATA

config BR2_PACKAGE_HWDATA_IAB_OUI_TXT
	bool "install iab.txt and oui.txt"
	help
	  Install iab.txt and oui.txt

config BR2_PACKAGE_HWDATA_PCI_IDS
	bool "install pci.ids"
	default y
	help
	  Install pci.ids

config BR2_PACKAGE_HWDATA_PNP_IDS
	bool "install pnp.ids"
	help
	  Install pnp.ids

config BR2_PACKAGE_HWDATA_USB_IDS
	bool "install usb.ids"
	default y
	help
	  Install usb.ids

endif
```

## package/i2c-tools/Config.in
```kconfig
config BR2_PACKAGE_I2C_TOOLS
	bool "i2c-tools"
	depends on BR2_PACKAGE_BUSYBOX_SHOW_OTHERS
	help
	  Heterogeneous set of I2C tools for Linux

	  This package contains a heterogeneous set of I2C tools for
	  Linux: a bus probing tool, a chip dumper, register-level
	  access helpers, EEPROM decoding scripts, and more.

	  https://i2c.wiki.kernel.org/index.php/I2C_Tools
```

## package/i2pd/Config.in
```kconfig
config BR2_PACKAGE_I2PD
	bool "i2pd"
	depends on BR2_USE_MMU # fork()
	depends on BR2_TOOLCHAIN_HAS_ATOMIC
	# pthread_condattr_setclock
	depends on BR2_TOOLCHAIN_HAS_THREADS_NPTL
	depends on BR2_INSTALL_LIBSTDCPP
	depends on BR2_USE_WCHAR # boost
	depends on !BR2_TOOLCHAIN_HAS_GCC_BUG_64735 # exception_ptr
	select BR2_PACKAGE_BOOST
	select BR2_PACKAGE_BOOST_DATE_TIME
	select BR2_PACKAGE_BOOST_FILESYSTEM
	select BR2_PACKAGE_BOOST_PROGRAM_OPTIONS
	select BR2_PACKAGE_BOOST_SYSTEM
	select BR2_PACKAGE_OPENSSL
	select BR2_PACKAGE_ZLIB
	help
	  i2pd (I2P Daemon) is a full-featured C++ implementation of I2P
	  client.

	  I2P (Invisible Internet Protocol) is a universal anonymous
	  network layer.
	  All communications over I2P are anonymous and end-to-end
	  encrypted, participants don't reveal their real IP addresses.

	  http://i2pd.website

comment "i2pd needs a toolchain w/ C++, NPTL, wchar"
	depends on BR2_USE_MMU
	depends on BR2_TOOLCHAIN_HAS_ATOMIC
	depends on !BR2_INSTALL_LIBSTDCPP || \
		!BR2_TOOLCHAIN_HAS_THREADS_NPTL || !BR2_USE_WCHAR

comment "i2pd needs exception_ptr"
	depends on BR2_USE_MMU
	depends on BR2_TOOLCHAIN_HAS_ATOMIC
	depends on BR2_TOOLCHAIN_HAS_GCC_BUG_64735
```

## package/i7z/Config.in
```kconfig
config BR2_PACKAGE_I7Z
	bool "i7z"
	depends on BR2_i386 || BR2_x86_64
	depends on BR2_TOOLCHAIN_HAS_THREADS
	select BR2_PACKAGE_NCURSES
	help
	  "A better i7 (and now i3, i5) reporting tool for Linux."

	  i7z can print out the C-states and temperature for i3, i5
	  and i7 based Core processors from Intel (including Nehalems,
	  Sandy Bridge and Ivy Bridge).

	  https://github.com/ajaiantilal/i7z

comment "i7z needs a toolchain w/ threads"
	depends on BR2_i386 || BR2_x86_64
	depends on !BR2_TOOLCHAIN_HAS_THREADS
```

## package/ibm-sw-tpm2/Config.in
```kconfig
config BR2_PACKAGE_IBM_SW_TPM2
	bool "ibm-sw-tpm2"
	depends on BR2_TOOLCHAIN_HAS_THREADS
	depends on !BR2_STATIC_LIBS # ibm-sw-tpm2
	select BR2_PACKAGE_OPENSSL
	# libressl is not supported
	select BR2_PACKAGE_OPENSSL_FORCE_LIBOPENSSL
	help
	  This project is an implementation of the TCG TPM 2.0
	  specification. It is based on the TPM specification Parts 3
	  and 4 source code donated by Microsoft, with additional
	  files to complete the implementation.

	  https://sourceforge.net/projects/ibmswtpm2/

comment "ibm-sw-tpm2 needs a toolchain w/ threads, dynamic library"
	depends on !BR2_TOOLCHAIN_HAS_THREADS || BR2_STATIC_LIBS
```

## package/ibrcommon/Config.in
```kconfig
config BR2_PACKAGE_IBRCOMMON
	bool "ibrcommon"
	depends on BR2_INSTALL_LIBSTDCPP
	depends on BR2_TOOLCHAIN_HAS_THREADS
	help
	  IBR-DTN is a small dtn application that supports:
	  Bundle Protocol RFC 5050
	  Bundle Security Protocol RFC 6257

	  http://trac.ibr.cs.tu-bs.de/project-cm-2012-ibrdtn

comment "ibrcommon needs a toolchain w/ C++, threads"
	depends on !BR2_INSTALL_LIBSTDCPP || !BR2_TOOLCHAIN_HAS_THREADS
```

## package/ibrdtn-tools/Config.in
```kconfig
config BR2_PACKAGE_IBRDTN_TOOLS
	bool "ibrdtn-tools"
	depends on BR2_INSTALL_LIBSTDCPP
	depends on BR2_TOOLCHAIN_HAS_THREADS
	select BR2_PACKAGE_IBRCOMMON
	select BR2_PACKAGE_IBRDTN
	help
	  IBR-DTN is a small dtn application that supports:
	  Bundle Protocol RFC 5050
	  Bundle Security Protocol RFC 6257

	  http://trac.ibr.cs.tu-bs.de/project-cm-2012-ibrdtn

comment "ibrdtn-tools needs a toolchain w/ C++, threads"
	depends on !BR2_INSTALL_LIBSTDCPP || !BR2_TOOLCHAIN_HAS_THREADS
```

## package/icu/Config.in
```kconfig
config BR2_PACKAGE_ICU
	bool "icu"
	depends on BR2_INSTALL_LIBSTDCPP
	depends on BR2_USE_WCHAR
	depends on BR2_TOOLCHAIN_HAS_THREADS
	# icu does some funky things by generating by itself an ELF
	# file, and it cannot easily be changed to generate FLAT
	# format.
	depends on !BR2_BINFMT_FLAT
	depends on BR2_ARCH_HAS_ATOMICS
	help
	  International Components for Unicode.

	  http://site.icu-project.org/

if BR2_PACKAGE_ICU

config BR2_PACKAGE_ICU_CUSTOM_DATA_PATH
	string "Path to custom data library file"
	help
	  This option allows to define the path to a custom data
	  library generated with http://apps.icu-project.org/datacustom/
	  Make sure you select the appropiate version to match the one
	  provided by buildroot.
	  Leave empty to not use this functionality.

endif

comment "icu needs a toolchain w/ C++, wchar, threads"
	depends on !BR2_BINFMT_FLAT
	depends on BR2_ARCH_HAS_ATOMICS
	depends on !BR2_INSTALL_LIBSTDCPP || !BR2_USE_WCHAR || \
		!BR2_TOOLCHAIN_HAS_THREADS
```

## package/ifenslave/Config.in
```kconfig
config BR2_PACKAGE_IFENSLAVE
	bool "ifenslave"
	depends on BR2_PACKAGE_BUSYBOX_SHOW_OTHERS
	help
	  Configure network interfaces for parallel routing (bonding)

	  https://salsa.debian.org/debian/ifenslave
```
