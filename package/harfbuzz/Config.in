## package/ifmetric/Config.in
```kconfig
config BR2_PACKAGE_IFMETRIC
	bool "ifmetric"
	help
	  Ifmetric is a Linux tool for setting the metrics of all IPv4
	  routes attached to a given network interface at once. This
	  may be used to change the priority of routing IPv4 traffic
	  over the interface. Lower metrics correlate with higher
	  priorities.

	  http://0pointer.de/lennart/projects/ifmetric/
```

## package/ifplugd/Config.in
```kconfig
config BR2_PACKAGE_IFPLUGD
	bool "ifplugd"
	# libdaemon uses fork()
	depends on BR2_USE_MMU
	select BR2_PACKAGE_LIBDAEMON
	help
	  Ifplugd is a daemon which will automatically configure your
	  ethernet device when a cable is plugged in and automatically
	  de-configure it if the cable is pulled out. This is useful
	  on laptops with onboard network adapters, since it will only
	  configure the interface when a cable is really connected.

	  http://0pointer.de/lennart/projects/ifplugd/
```
