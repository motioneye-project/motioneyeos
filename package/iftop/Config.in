## package/iftop/Config.in
```kconfig
config BR2_PACKAGE_IFTOP
	bool "iftop"
	select BR2_PACKAGE_NCURSES
	select BR2_PACKAGE_LIBPCAP
	depends on BR2_INET_IPV6
	depends on BR2_TOOLCHAIN_HAS_THREADS
	help
	  iftop does for network usage what top(1) does for CPU usage.
	  It listens to network traffic on a named interface and displays
	  a table of current bandwidth usage by pairs of hosts. Handy for
	  answering the question "why is our ADSL link so slow?".

	  http://www.ex-parrot.com/pdw/iftop/

comment "iftop needs a toolchain w/ IPv6, threads"
	depends on !BR2_INET_IPV6 || !BR2_TOOLCHAIN_HAS_THREADS
```

## package/ifupdown-scripts/Config.in
```kconfig
config BR2_PACKAGE_IFUPDOWN_SCRIPTS
	bool "ifupdown scripts"
	default y if BR2_ROOTFS_SKELETON_DEFAULT
	depends on !BR2_PACKAGE_SYSTEMD_NETWORKD && !BR2_PACKAGE_OPENRC
	help
	  Set of scripts used by ifupdown (either the standalone one,
	  or the busybox one) to bring network up, or tear it down.
```

## package/ifupdown/Config.in
```kconfig
config BR2_PACKAGE_IFUPDOWN
	bool "ifupdown"
	depends on BR2_USE_MMU # fork()
	depends on BR2_TOOLCHAIN_HEADERS_AT_LEAST_3_0 # iproute2
	# Default/our uclibc lacks wordexp()
	depends on !BR2_TOOLCHAIN_USES_UCLIBC
	# runtime for ip binary
	select BR2_PACKAGE_IPROUTE2 if !BR2_PACKAGE_BUSYBOX
	# runtime for run-parts
	select BR2_PACKAGE_DEBIANUTILS if !BR2_PACKAGE_BUSYBOX
	help
	  High level tools to configure network interfaces.

	  https://tracker.debian.org/pkg/ifupdown

comment "ifupdown needs an (e)glibc or musl toolchain w/ headers >= 3.0"
	depends on BR2_USE_MMU
	depends on BR2_TOOLCHAIN_USES_UCLIBC || \
		!BR2_TOOLCHAIN_HEADERS_AT_LEAST_3_0
```

## package/igmpproxy/Config.in
```kconfig
config BR2_PACKAGE_IGMPPROXY
	bool "igmpproxy"
	depends on BR2_USE_WCHAR
	help
	  A simple dynamic Multicast Routing Daemon
	  using only IGMP signalling. It's intended
	  for simple forwarding of Multicast traffic
	  between networks.

	  http://sourceforge.net/projects/igmpproxy/

comment "igmpproxy needs a toolchain with wchar support"
	depends on !BR2_USE_WCHAR
```

## package/ijs/Config.in
```kconfig
config BR2_PACKAGE_IJS
	bool "ijs"
	depends on BR2_USE_MMU # fork()
	help
	  The IJS package contains a library which implements a
	  protocol for transmission of raster page images.

	  http://www.openprinting.org/
```

## package/ima-evm-utils/Config.in
```kconfig
config BR2_PACKAGE_IMA_EVM_UTILS
	bool "ima-evm-utils"
	depends on BR2_USE_MMU # keyutils
	depends on !BR2_STATIC_LIBS # keyutils
	select BR2_PACKAGE_OPENSSL
	select BR2_PACKAGE_KEYUTILS
	help
	  Linux Integrity Measurement Architecture (IMA)
	  Extended Verification Module (EVM) tools.

	  https://sourceforge.net/p/linux-ima/wiki/Home/

comment "ima-evm-utils needs dynamic library support"
	depends on BR2_USE_MMU
	depends on BR2_STATIC_LIBS
```

## package/imagemagick/Config.in
```kconfig
config BR2_PACKAGE_IMAGEMAGICK
	bool "imagemagick"
	depends on BR2_USE_MMU # fork()
	depends on BR2_TOOLCHAIN_HAS_THREADS
	help
	  ImageMagick(R) is a software suite to create, edit, and
	  compose bitmap images. It can read, convert and write images
	  in a variety of formats (about 100) including DPX, EXR, GIF,
	  JPEG, JPEG-2000, PDF, PhotoCD, PNG, Postscript, SVG, and TIFF.
	  Use ImageMagick to translate, flip, mirror, rotate, scale,
	  shear and transform images, adjust image colors, apply various
	  special effects, or draw text,
	  lines, polygons, ellipses and Bézier curves.

	  http://www.imagemagick.org/

comment "imagemagick needs a toolchain w/ threads"
	depends on BR2_USE_MMU
	depends on !BR2_TOOLCHAIN_HAS_THREADS
```

## package/imagemagick/Config.in.host
```kconfig
config BR2_PACKAGE_HOST_IMAGEMAGICK
	bool "host imagemagick"
	help
	  ImageMagick(R) is a software suite to create, edit, and
	  compose bitmap images. It can read, convert and write images
	  in a variety of formats (about 100) including DPX, EXR, GIF,
	  JPEG, JPEG-2000, PDF, PhotoCD, PNG, Postscript, SVG, and TIFF.
	  Use ImageMagick to translate, flip, mirror, rotate, scale,
	  shear and transform images, adjust image colors, apply various
	  special effects, or draw text, lines, polygons, ellipses and
	  Bézier curves.

	  http://www.imagemagick.org/

if BR2_PACKAGE_HOST_IMAGEMAGICK

config BR2_PACKAGE_HOST_IMAGEMAGICK_SVG
	bool "SVG support"
	help
	  Say 'y' here is you need ImageMagick tools (like convert)
	  to support SVG.

	  This is not enabled by default, as it brings quite a few
	  extra dependencies, and thus extra build time.

endif
```

## package/imlib2/Config.in
```kconfig
comment "imlib2 needs a toolchain w/ dynamic library"
	depends on BR2_STATIC_LIBS

config BR2_PACKAGE_IMLIB2
	bool "imlib2"
	depends on !BR2_STATIC_LIBS # dlopen()
	select BR2_PACKAGE_FREETYPE
	help
	  Imlib 2 is the successor to Imlib. This library provides
	  routines to load, save and render images in various formats.

	  http://freshmeat.net/projects/imlib2/

if BR2_PACKAGE_IMLIB2

config BR2_PACKAGE_IMLIB2_JPEG
	bool "JPEG support"
	select BR2_PACKAGE_JPEG

config BR2_PACKAGE_IMLIB2_PNG
	bool "PNG support"
	select BR2_PACKAGE_LIBPNG

config BR2_PACKAGE_IMLIB2_GIF
	bool "GIF support"
	select BR2_PACKAGE_GIFLIB

config BR2_PACKAGE_IMLIB2_TIFF
	bool "TIFF support"
	select BR2_PACKAGE_TIFF

config BR2_PACKAGE_IMLIB2_ID3
	bool "ID3 support"
	select BR2_PACKAGE_LIBID3TAG

config BR2_PACKAGE_IMLIB2_X
	bool "X support"
	default y
	depends on BR2_PACKAGE_XORG7
	select BR2_PACKAGE_XLIB_LIBXEXT
	select BR2_PACKAGE_XLIB_LIBX11
endif
```

## package/imx-mkimage/Config.in.host
```kconfig
config BR2_PACKAGE_HOST_IMX_MKIMAGE
	bool "host imx-mkimage"
	help
	  imx-mkimage is used to combine input images and generate
	  final boot image with appropriate IVT set.

	  https://source.codeaurora.org/external/imx/imx-mkimage
```

## package/imx-usb-loader/Config.in
```kconfig
config BR2_PACKAGE_IMX_USB_LOADER
	bool "imx-usb-loader"
	depends on BR2_TOOLCHAIN_HAS_THREADS # libusb
	select BR2_PACKAGE_LIBUSB
	help
	  This package contains tools to download and execute code
	  on Freescale i.MX5/i.MX6 and Vybrid SoCs through the
	  Serial Download Protocol.

	  https://github.com/boundarydevices/imx_usb_loader

comment "imx-usb-loader needs a toolchain w/ threads"
	depends on !BR2_TOOLCHAIN_HAS_THREADS
```

## package/imx-usb-loader/Config.in.host
```kconfig
config BR2_PACKAGE_HOST_IMX_USB_LOADER
	bool "host-imx-usb loader"
	depends on BR2_arm
	help
	  This package contains tools to download and execute code
	  on Freescale i.MX5/i.MX6 and Vybrid SoCs through the
	  Serial Download Protocol.

	  https://github.com/boundarydevices/imx_usb_loader
```

## package/inadyn/Config.in
```kconfig
config BR2_PACKAGE_INADYN
	bool "inadyn"
	depends on BR2_USE_MMU # Uses fork()
	depends on !BR2_PREFER_STATIC_LIB # dlopen()
	help
	  INADYN is a free DynDNS client. It gives the possibility
	  to have your own fixed hostname registered on the internet,
	  although your IP might be changing.

	  https://github.com/troglobit/inadyn

comment "inadyn needs a toolchain w/ dynamic library"
	depends on BR2_PREFER_STATIC_LIB
	depends on BR2_USE_MMU
```

## package/inconsolata/Config.in
```kconfig
config BR2_PACKAGE_INCONSOLATA
	bool "inconsolata"
	help
	  Inconsolata is a monospace font, designed for code listings
	  and the like.

	  http://www.google.com/fonts/specimen/Inconsolata
```

## package/infozip/Config.in
```kconfig
config BR2_PACKAGE_INFOZIP
	bool "infozip"
	help
	  Zip is a compression and file packaging/archive utility.
	  Although highly compatible both with PKWARE's PKZIP and
	  PKUNZIP utilities for MS-DOS and with Info-ZIP's own UnZip,
	  our primary objectives have been portability and
	  other-than-MSDOS functionality.

	  http://infozip.sourceforge.net/Zip.html
```

## package/initscripts/Config.in
```kconfig
config BR2_PACKAGE_INITSCRIPTS
	bool
	help
	  The basics startup scripts for both SysV and Busybox
```

## package/inotify-tools/Config.in
```kconfig
config BR2_PACKAGE_INOTIFY_TOOLS
	bool "inotify-tools"
	depends on BR2_USE_MMU # fork()
	help
	  inotify-tools is a C library and a set of command-line
	  programs for Linux providing a simple interface to inotify.
	  These programs can be used to monitor and act upon
	  filesystem events. Provides the 'inotifywait' and 'inotifywatch'
	  binaries.

	  https://github.com/rvoicilas/inotify-tools
```

## package/input-tools/Config.in
```kconfig
config BR2_PACKAGE_INPUT_TOOLS
	bool "input-tools"
	help
	  Tools for the Linux kernel input layer.
	  http://linuxconsole.sourceforge.net/

if BR2_PACKAGE_INPUT_TOOLS

config BR2_PACKAGE_INPUT_TOOLS_INPUTATTACH
	bool "inputattach"
	default y
	help
	  Inputattach is used for attaching a serial line to the input layer.

config BR2_PACKAGE_INPUT_TOOLS_JSCAL
	bool "jscal"
	default y
	help
	  Joystick calibration program.

config BR2_PACKAGE_INPUT_TOOLS_JSTEST
	bool "jstest"
	default y
	help
	  Joystick test program.

endif
```

## package/intel-gmmlib/Config.in
```kconfig
config BR2_PACKAGE_INTEL_GMMLIB
	bool "intel-gmmlib"
	depends on BR2_x86_64
	depends on !BR2_STATIC_LIBS
	help
	  The Intel(R) Graphics Memory Management Library provides
	  device specific and buffer management for the Intel(R)
	  Graphics Compute Runtime for OpenCL(TM) and the Intel(R)
	  Media Driver for VAAPI.

	  https://github.com/intel/gmmlib

comment "intel-gmmlib needs a toolchain w/ dynamic library"
	depends on BR2_STATIC_LIBS
```

## package/intel-mediadriver/Config.in
```kconfig
config BR2_PACKAGE_INTEL_MEDIADRIVER
	bool "intel-mediadriver"
	depends on BR2_x86_64
	depends on !BR2_STATIC_LIBS # mesa3d, libva
	depends on BR2_INSTALL_LIBSTDCPP # mesa3d
	depends on BR2_TOOLCHAIN_HAS_SYNC_1 # mesa3d
	depends on BR2_TOOLCHAIN_HAS_THREADS # libva
	depends on BR2_TOOLCHAIN_HAS_THREADS_NPTL # mesa3d
	depends on BR2_PACKAGE_XORG7
	select BR2_PACKAGE_INTEL_GMMLIB
	select BR2_PACKAGE_LIBPCIACCESS
	select BR2_PACKAGE_LIBVA
	select BR2_PACKAGE_MESA3D
	select BR2_PACKAGE_XLIB_LIBX11
	help
	  The Intel(R) Media Driver for VAAPI is a new VA-API (Video
	  Acceleration API) user mode driver supporting hardware
	  accelerated decoding, encoding, and video post processing for
	  GEN based graphics hardware.

	  https://github.com/intel/media-driver

comment "intel-mediadriver needs X.org"
	depends on BR2_x86_64 && BR2_TOOLCHAIN_HAS_SYNC_1
	depends on !BR2_PACKAGE_XORG7

comment "intel-mediadriver needs a toolchain w/ dynamic library, C++, NPTL"
	depends on BR2_x86_64 && BR2_TOOLCHAIN_HAS_SYNC_1
	depends on BR2_STATIC_LIBS || !BR2_INSTALL_LIBSTDCPP || \
		!BR2_TOOLCHAIN_HAS_THREADS_NPTL
```

## package/intel-mediasdk/Config.in
```kconfig
config BR2_PACKAGE_INTEL_MEDIASDK
	bool "intel-mediasdk"
	depends on BR2_x86_64
	depends on !BR2_STATIC_LIBS # intel-mediadriver
	depends on BR2_INSTALL_LIBSTDCPP # intel-mediadriver
	depends on BR2_TOOLCHAIN_HAS_SYNC_1 # intel-mediadriver
	depends on BR2_TOOLCHAIN_HAS_THREADS # intel-mediadriver
	depends on BR2_TOOLCHAIN_HAS_THREADS_NPTL # intel-mediadriver
	depends on BR2_PACKAGE_XORG7  # intel-mediadriver
	select BR2_PACKAGE_INTEL_MEDIADRIVER
	select BR2_PACKAGE_LIBDRM_INTEL
	help
	  Intel(R) Media SDK provides an API to access
	  hardware-accelerated video decode, encode and filtering on
	  Intel® platforms with integrated graphics.

	  Supported video encoders: HEVC, AVC, MPEG-2, JPEG
	  Supported Video decoders: HEVC, AVC, VP8, MPEG-2, VC1, JPEG
	  Supported video pre-processing filters: Color Conversion,
	  Deinterlace, Denoise, Resize, Rotate, Composition

	  http://mediasdk.intel.com/

comment "intel-mediasdk needs X.org"
	depends on BR2_x86_64 && BR2_TOOLCHAIN_HAS_SYNC_1
	depends on !BR2_PACKAGE_XORG7

comment "intel-mediasdk needs a toolchain w/ dynamic library, C++, NPTL"
	depends on BR2_x86_64 && BR2_TOOLCHAIN_HAS_SYNC_1
	depends on BR2_STATIC_LIBS || !BR2_INSTALL_LIBSTDCPP || \
		!BR2_TOOLCHAIN_HAS_THREADS_NPTL
```

## package/intel-microcode/Config.in
```kconfig
config BR2_PACKAGE_INTEL_MICROCODE
	bool "intel-microcode"
	depends on BR2_x86_64 || BR2_i386
	help
	  This package provides an Intel microcode data file that can be
	  used to correct processor errors. The iucode-tool package and
	  proper kernel support are required to upload the microcode.

	  https://github.com/intel/Intel-Linux-Processor-Microcode-Data-Files

config BR2_PACKAGE_INTEL_MICROCODE_INSTALL_TARGET
	bool "install microcode files to /lib/firmware in target"
	default y
	depends on BR2_PACKAGE_INTEL_MICROCODE
	help
	  Select this option to have the microcode files installed to
	  /lib/firmware/intel-ucode in the target root filesystem, in
	  addition to the images directory.
```

## package/intltool/Config.in
```kconfig
config BR2_PACKAGE_INTLTOOL
	bool "intltool"
	# Hide from configuration as we only support the host package
	# for the moment
	depends on BR2_HOST_ONLY
	help
	  Utility scripts for internationalizing XML

	  http://www.freedesktop.org/wiki/Software/intltool
```

## package/iodine/Config.in
```kconfig
config BR2_PACKAGE_IODINE
	bool "iodine"
	select BR2_PACKAGE_ZLIB
	help
	  iodine lets you tunnel IPv4 data through a DNS server.
	  This can be usable in different situations where
	  internet access is firewalled, but DNS queries are allowed.

	  http://code.kryo.se/iodine/
```

## package/iostat/Config.in
```kconfig
config BR2_PACKAGE_IOSTAT
	bool "iostat"
	help
	  An I/O performance monitoring utility.

	  http://www.linuxinsight.com/iostat_utility.html
```
