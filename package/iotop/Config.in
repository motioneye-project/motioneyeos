## package/jamvm/Config.in
```kconfig
config BR2_PACKAGE_JAMVM_ARCH_SUPPORTS
	bool
	default y if BR2_arm || BR2_armeb
	default y if BR2_i386 || BR2_x86_64
	default y if (BR2_mips || BR2_mipsel) \
		&& (BR2_MIPS_FP32_MODE_32 || BR2_MIPS_SOFT_FLOAT)
	default y if BR2_powerpc

config BR2_PACKAGE_JAMVM
	bool "jamvm"
	depends on BR2_PACKAGE_JAMVM_ARCH_SUPPORTS
	depends on BR2_PACKAGE_CLASSPATH_ARCH_SUPPORTS
	depends on BR2_TOOLCHAIN_HAS_THREADS
	depends on !BR2_STATIC_LIBS
	select BR2_PACKAGE_ZLIB
	select BR2_PACKAGE_CLASSPATH
	help
	  JamVM is a new Java Virtual Machine which conforms to the
	  JVM specification version 2 (blue book).

	  http://jamvm.sf.net

comment "jamvm needs a toolchain w/ threads, dynamic library"
	depends on BR2_PACKAGE_JAMVM_ARCH_SUPPORTS
	depends on BR2_PACKAGE_CLASSPATH_ARCH_SUPPORTS
	depends on !BR2_TOOLCHAIN_HAS_THREADS || BR2_STATIC_LIBS
```

## package/jansson/Config.in
```kconfig
config BR2_PACKAGE_JANSSON
	bool "jansson"
	help
	  Jansson is a C library for encoding, decoding and manipulating
	  JSON data.

	  http://www.digip.org/jansson/
```
