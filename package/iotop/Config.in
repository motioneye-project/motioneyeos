## package/iotop/Config.in
```kconfig
comment "iotop depends on python or python3"
	depends on !BR2_PACKAGE_PYTHON && !BR2_PACKAGE_PYTHON3

config BR2_PACKAGE_IOTOP
	bool "iotop"
	depends on BR2_PACKAGE_PYTHON || BR2_PACKAGE_PYTHON3
	select BR2_PACKAGE_PYTHON_CURSES if BR2_PACKAGE_PYTHON
	select BR2_PACKAGE_PYTHON3_CURSES if BR2_PACKAGE_PYTHON3
	help
	  iotop does for I/O usage what top does for CPU usage.

	  http://guichaz.free.fr/iotop/
```

## package/iozone/Config.in
```kconfig
config BR2_PACKAGE_IOZONE
	bool "iozone"
	depends on BR2_USE_MMU # fork()
	depends on BR2_TOOLCHAIN_HAS_THREADS_NPTL
	help
	  IOzone is a filesystem benchmark tool.
	  The benchmark generates and measures a variety of file
	  operations

	  http://www.iozone.org/

comment "iozone needs a toolchain w/ NPTL"
	depends on BR2_USE_MMU
	depends on !BR2_TOOLCHAIN_HAS_THREADS_NPTL
```

## package/iperf/Config.in
```kconfig
config BR2_PACKAGE_IPERF
	bool "iperf"
	depends on BR2_INSTALL_LIBSTDCPP
	# uses fork()
	depends on BR2_USE_MMU
	help
	  Internet Protocol bandwidth measuring tool for measuring
	  TCP/UDP performance.

	  https://sourceforge.net/projects/iperf2/

comment "iperf needs a toolchain w/ C++"
	depends on BR2_USE_MMU
	depends on !BR2_INSTALL_LIBSTDCPP
```

## package/iperf3/Config.in
```kconfig
config BR2_PACKAGE_IPERF3
	bool "iperf3"
	depends on BR2_TOOLCHAIN_HAS_THREADS
	help
	  iperf is a tool for active measurements of the maximum
	  achievable bandwidth on IP networks.
	  It supports tuning of various parameters related to timing,
	  protocols, and buffers. For each test it reports the bandwidth,
	  loss, and other parameters.
	  It's a redesign of the NLANR/DAST iperf(2) and is not
	  backward compatible.

	  https://github.com/esnet/iperf

comment "iperf3 needs a toolchain w/ threads"
	depends on !BR2_TOOLCHAIN_HAS_THREADS
```

## package/ipkg/Config.in
```kconfig
config BR2_PACKAGE_IPKG
	bool "ipkg"
	depends on BR2_DEPRECATED_SINCE_2016_08
	help
	  The Itsy Package Installer from handhelds.org

	  http://www.handhelds.org
```

## package/ipmitool/Config.in
```kconfig
config BR2_PACKAGE_IPMITOOL
	bool "ipmitool"
	depends on BR2_USE_MMU # fork()
	help
	  IPMItool provides a simple command-line interface to IPMI-enabled devices.

	  http://sourceforge.net/projects/ipmitool/

if BR2_PACKAGE_IPMITOOL

config BR2_PACKAGE_IPMITOOL_LANPLUS
	bool "enable lanplus interface"
	select BR2_PACKAGE_OPENSSL
	help
	  Enables the IPMI v2.0 RMCP+ LAN interface typically used to send IPMI
	  commands to the BMC of a remote server.
	  Not needed if you only want to communicate with the local BMC of your
	  device using the OpenIPMI ipmi_si kernel module, or if using the
	  legacy IPMI v1.5 RMCP LAN interface.

config BR2_PACKAGE_IPMITOOL_USB
	bool "enable usb interface"
	help
	  Enables the IPMI USB interface typically used to send inband
	  IPMI commands to the BMC of a server.

config BR2_PACKAGE_IPMITOOL_IPMIEVD
	bool "ipmievd"
	help
	  IPMI event daemon for sending events to syslog

config BR2_PACKAGE_IPMITOOL_IPMISHELL
	bool "ipmishell"
	select BR2_PACKAGE_NCURSES
	select BR2_PACKAGE_READLINE
	help
	  IPMI shell interface

endif
```

## package/iproute2/Config.in
```kconfig
config BR2_PACKAGE_IPROUTE2
	bool "iproute2"
	depends on BR2_USE_MMU # fork()
	depends on BR2_TOOLCHAIN_HEADERS_AT_LEAST_3_4 # __kernel_{u,}long_t
	help
	  Kernel routing and traffic control utilities. Provides things
	  like ip and tc.

	  http://www.linuxfoundation.org/collaborate/workgroups/networking/iproute2

comment "iproute2 needs a toolchain w/ headers >= 3.4"
	depends on BR2_USE_MMU
	depends on !BR2_TOOLCHAIN_HEADERS_AT_LEAST_3_4
```

## package/iprutils/Config.in
```kconfig
config BR2_PACKAGE_IPRUTILS
	bool "iprutils"
	depends on BR2_USE_MMU # fork()
	depends on !BR2_bfin # pciutils
	select BR2_PACKAGE_NCURSES
	select BR2_PACKAGE_LIBSYSFS
	select BR2_PACKAGE_PCIUTILS
	select BR2_PACKAGE_ZLIB
	help
	  System utilities for IBM Power RAID devices

	  http://sourceforge.net/projects/iprdd/
```

## package/ipsec-tools/Config.in
```kconfig
config BR2_PACKAGE_IPSEC_TOOLS
	bool "ipsec-tools"
	select BR2_PACKAGE_OPENSSL
	select BR2_PACKAGE_FLEX
	help
	  This package is required to support IPSec for Linux 2.6+

	  http://ipsec-tools.sourceforge.net/

if BR2_PACKAGE_IPSEC_TOOLS

config BR2_PACKAGE_IPSEC_TOOLS_ADMINPORT
	default y
	bool "Enable racoonctl(8)"
	help
	  Lets racoon to listen to racoon admin port, which is to
	  be contacted by racoonctl(8).

config BR2_PACKAGE_IPSEC_TOOLS_NATT
	bool "Enable NAT-Traversal"
	help
	  This needs kernel support, which is available on Linux. On
	  NetBSD, NAT-Traversal kernel support has not been integrated
	  yet, you can get it from here:

	  http://ipsec-tools.sourceforge.net/netbsd_nat-t.diff If you

	  live in a country where software patents are legal, using
	  NAT-Traversal might infringe a patent.

config BR2_PACKAGE_IPSEC_TOOLS_FRAG
	bool "Enable IKE fragmentation"
	help
	  Enable IKE fragmentation, which is a workaround for
	  broken routers that drop fragmented packets

config BR2_PACKAGE_IPSEC_TOOLS_DPD
	bool "Enable DPD (Dead Peer Detection)"
	help
	  Enable dead peer detection support

config BR2_PACKAGE_IPSEC_TOOLS_STATS
	default y
	bool "Enable statistics logging function"

config BR2_PACKAGE_IPSEC_TOOLS_READLINE
	select BR2_PACKAGE_READLINE
	bool "Enable readline input support"

choice
	prompt "Security context"
	default BR2_PACKAGE_IPSEC_SECCTX_DISABLE
	help
	  Selects whether or not to enable security context support.

config BR2_PACKAGE_IPSEC_SECCTX_DISABLE
	bool "Disable security context support"

config BR2_PACKAGE_IPSEC_SECCTX_ENABLE
	bool "Enable SELinux security context support"

config BR2_PACKAGE_IPSEC_SECCTX_KERNEL
	bool "Enable kernel security context"

endchoice

endif
```

## package/ipset/Config.in
```kconfig
config BR2_PACKAGE_IPSET
	bool "ipset"
	select BR2_PACKAGE_LIBMNL
	help
	  Utility to manage IP sets in the linux kernel.
	  Requires a patched kernel or version >=2.6.39.

	  http://ipset.netfilter.org/
```

## package/iptables/Config.in
```kconfig
config BR2_PACKAGE_IPTABLES
	bool "iptables"
	help
	  Linux kernel firewall, NAT, and packet mangling tools.

	  http://www.netfilter.org/projects/iptables/index.html

if BR2_PACKAGE_IPTABLES

config BR2_PACKAGE_IPTABLES_BPF_NFSYNPROXY
	bool "bpfc and nfsynproxy"
	select BR2_PACKAGE_LIBPCAP
	help
	  Build bpf compiler and nfsynproxy configuration tool.

config BR2_PACKAGE_IPTABLES_NFTABLES
	bool "nftables compat"
	# uses dlfcn
	depends on !BR2_STATIC_LIBS
	depends on BR2_USE_WCHAR
	depends on BR2_TOOLCHAIN_HEADERS_AT_LEAST_3_12
	select BR2_PACKAGE_LIBMNL
	select BR2_PACKAGE_LIBNFTNL
	help
	  Build nftables compat utilities.

comment "nftables compat needs a toolchain w/ wchar, dynamic library, headers >= 3.12"
	depends on !BR2_TOOLCHAIN_HEADERS_AT_LEAST_3_12 || \
		!BR2_USE_WCHAR || BR2_STATIC_LIBS

endif
```

## package/iputils/Config.in
```kconfig
config BR2_PACKAGE_IPUTILS
	bool "iputils"
	depends on BR2_USE_MMU # fork()
	help
	  This package is set of small useful utilities for Linux
	  networking. It includes complete versions of ping, traceroute,
	  etc.

	  https://github.com/iputils/iputils
```

## package/iqvlinux/Config.in
```kconfig
config BR2_PACKAGE_IQVLINUX
	bool "iqvlinux"
	depends on BR2_LINUX_KERNEL
	help
	  Intel Ethernet Adapter Debug Driver for Linux (iqvlinux),
	  which supports kernel versions 2.6.x up through 4.0.x.

	  This debug driver supports all Intel's networking Tools based
	  on the SDK version 2.19.36.0 or higher which support Intel
	  Ethernet chip including e1000, e1000e, i210...

	  Note: This driver requires PCI support to be enabled
	  (i.e. CONFIG_PCI).

	  http://sourceforge.net/projects/e1000/files/iqvlinux/

comment "iqvlinux needs a Linux kernel to be built"
	depends on !BR2_LINUX_KERNEL
```

## package/irda-utils/Config.in
```kconfig
menuconfig BR2_PACKAGE_IRDA_UTILS
	bool "irda_utils"
	help
		Tools for accessing the irda-Subsystem of the Linux-Kernel

if BR2_PACKAGE_IRDA_UTILS
config IRDA_IRATTACH
	bool "irattach"
	default y
	help
		To start the Irda-Subsystem in SIR-Mode you may need this

config IRDA_IRDAPING
	bool "irdaping"
	help
		what ping is for networks is irdaping for Irda

config IRDA_IRNETD
	bool "irnetd"
	help
		Needed for Networking over Irda

config IRDA_IRDADUMP
	bool "irdadump"
	help
		Like tcpdump, but for infrared connections

config IRDA_FINDCHIP
	bool "findchip"

config IRDA_PSION
	bool "support psion-dongle"

config IRDA_TEKRAM
	bool "support tekram-dongle"

config IRDA_SMCINIT
	bool "support toshiba-laptops"
	help
		Some Toshiba Laptops have buggy BIOSes which didn't initialize 
		Irda. This may help those.
	
endif
```

## package/irqbalance/Config.in
```kconfig
config BR2_PACKAGE_IRQBALANCE
	bool "irqbalance"
	depends on BR2_USE_WCHAR # libglib2
	depends on BR2_TOOLCHAIN_HAS_THREADS # libglib2
	depends on BR2_USE_MMU # libglib2
	select BR2_PACKAGE_LIBGLIB2
	help
	  Irqbalance is a daemon to help balance the cpu load generated
	  by interrupts across all of a systems cpus.
	  Irqbalance identifies the highest volume interrupt sources,
	  and isolates them to a single unique cpu, so that load is
	  spread as much as possible over an entire processor set, while
	  minimizing cache hit rates for irq handlers.

	  https://github.com/Irqbalance/irqbalance

comment "irqbalance needs a toolchain w/ wchar, threads"
	depends on BR2_USE_MMU
	depends on !BR2_USE_WCHAR || !BR2_TOOLCHAIN_HAS_THREADS
```

## package/irrlicht/Config.in
```kconfig
config BR2_PACKAGE_IRRLICHT
	bool "irrlicht"
	depends on BR2_INSTALL_LIBSTDCPP
	depends on BR2_PACKAGE_XORG7
	depends on BR2_PACKAGE_HAS_LIBGL # use GLX
	select BR2_PACKAGE_XLIB_LIBXXF86VM # libXxf86vm
	help
	  An open source high performance realtime 3D graphics engine.

	  http://irrlicht.sourceforge.net/

comment "irrlicht needs a toolchain w/ C++"
	depends on !BR2_INSTALL_LIBSTDCPP

comment "irrlicht needs X11 and an OpenGL provider"
	depends on !BR2_PACKAGE_HAS_LIBGL || !BR2_PACKAGE_XORG7
	depends on BR2_INSTALL_LIBSTDCPP
```

## package/irssi/Config.in
```kconfig
config BR2_PACKAGE_IRSSI
	bool "irssi"
	select BR2_PACKAGE_LIBGLIB2
	select BR2_PACKAGE_NCURSES
	depends on BR2_USE_WCHAR # libglib2
	depends on BR2_TOOLCHAIN_HAS_THREADS # libglib2
	depends on BR2_USE_MMU # fork()
	help
	  Irssi is a terminal based IRC client for UNIX systems.

	  http://irssi.org/

if BR2_PACKAGE_IRSSI

config BR2_PACKAGE_IRSSI_PROXY
	bool "proxy module"
	help
	  Build the irssi proxy module, which allows an IRC connection
	  to be shared among multiple clients.

config BR2_PACKAGE_IRSSI_TRUE_COLOR
	bool "true color support"
	help
	  Build with true color support in terminal.

endif

comment "irssi needs a toolchain w/ wchar, threads"
	depends on BR2_USE_MMU
	depends on !BR2_USE_WCHAR || !BR2_TOOLCHAIN_HAS_THREADS
```

## package/iucode-tool/Config.in
```kconfig
config BR2_PACKAGE_IUCODE_TOOL
	bool "iucode-tool"
	depends on BR2_x86_64 || BR2_i386
	select BR2_PACKAGE_INTEL_MICROCODE
	select BR2_PACKAGE_ARGP_STANDALONE if BR2_TOOLCHAIN_USES_UCLIBC
	help
	  Intel processor microcode tool

	  https://gitorious.org/iucode-tool
```

## package/iw/Config.in
```kconfig
config BR2_PACKAGE_IW
	bool "iw"
	depends on BR2_TOOLCHAIN_HAS_THREADS # libnl
	select BR2_PACKAGE_LIBNL
	help
	  Utility for wireless devices using the mac80211 kernel stack

	  https://wireless.wiki.kernel.org/en/users/documentation/iw

comment "iw needs a toolchain w/ threads"
	depends on !BR2_TOOLCHAIN_HAS_THREADS
```

## package/iwd/Config.in
```kconfig
config BR2_PACKAGE_IWD
	bool "iwd"
	depends on BR2_USE_MMU # dbus
	depends on BR2_TOOLCHAIN_HAS_THREADS # dbus
	depends on BR2_TOOLCHAIN_HAS_SYNC_4 # ell
	depends on !BR2_STATIC_LIBS # ell
	depends on BR2_USE_WCHAR # ell
	select BR2_PACKAGE_DBUS # runtime
	select BR2_PACKAGE_ELL
	help
	  iNet Wireless daemon (iwd)

	  https://iwd.wiki.kernel.org/

comment "iwd needs a toolchain w/ threads, dynamic library, wchar"
	depends on BR2_USE_MMU # dbus
	depends on BR2_TOOLCHAIN_HAS_SYNC_4 # ell
	depends on BR2_STATIC_LIBS || !BR2_USE_WCHAR
```

## package/jack1/Config.in
```kconfig
config BR2_PACKAGE_JACK1
	bool "jack1"
	depends on BR2_USE_MMU # fork()
	depends on BR2_TOOLCHAIN_HAS_THREADS # alsa-lib
	depends on !BR2_STATIC_LIBS
	depends on BR2_TOOLCHAIN_HAS_SYNC_4
	depends on !BR2_PACKAGE_JACK2
	select BR2_PACKAGE_ALSA_LIB
	select BR2_PACKAGE_ALSA_LIB_HWDEP
	select BR2_PACKAGE_ALSA_LIB_RAWMIDI
	select BR2_PACKAGE_ALSA_LIB_SEQ
	select BR2_PACKAGE_BERKELEYDB
	select BR2_PACKAGE_LIBSAMPLERATE
	select BR2_PACKAGE_LIBSNDFILE
	help
	  JACK Audio Connection Kit (JACK 1 implementation).

	  JACK is a low-latency sound server, allowing multiple
	  applications to connect to one audio device, and to share
	  audio between themselves. This package contains the daemon
	  jackd as well as some example clients.

	  http://jackaudio.org/

	  Another implementation (BR2_PACKAGE_JACK2) is also available,
	  please consult the documentation to choose the right one:

	  https://github.com/jackaudio/jackaudio.github.com/wiki/Q_difference_jack1_jack2

comment "jack1 needs a toolchain w/ threads, dynamic library"
	depends on BR2_USE_MMU
	depends on BR2_TOOLCHAIN_HAS_SYNC_4
	depends on !BR2_TOOLCHAIN_HAS_THREADS || BR2_STATIC_LIBS
```

## package/jack2/Config.in
```kconfig
config BR2_PACKAGE_JACK2
	bool "jack2"
	depends on BR2_TOOLCHAIN_HAS_THREADS # alsa-lib
	depends on BR2_USE_MMU # fork()
	depends on BR2_INSTALL_LIBSTDCPP
	depends on !BR2_STATIC_LIBS
	depends on BR2_TOOLCHAIN_HAS_SYNC_4
	select BR2_PACKAGE_LIBSAMPLERATE
	select BR2_PACKAGE_LIBSNDFILE
	select BR2_PACKAGE_ALSA_LIB
	select BR2_PACKAGE_ALSA_LIB_HWDEP
	select BR2_PACKAGE_ALSA_LIB_SEQ
	select BR2_PACKAGE_ALSA_LIB_RAWMIDI
	# Ensure we get at least one:
	select BR2_PACKAGE_JACK2_LEGACY if !BR2_PACKAGE_JACK2_DBUS
	help
	  JACK Audio Connection Kit (server and example clients).

	  JACK is a low-latency sound server, allowing multiple
	  applications to connect to one audio device, and to share
	  audio between themselves. This package contains the daemon
	  jackd as well as some example clients.

	  http://jackaudio.org/

if BR2_PACKAGE_JACK2

config BR2_PACKAGE_JACK2_LEGACY
	bool "classic jack2"
	help
	  Build and use jackd.

	  https://github.com/jackaudio/jackaudio.github.com/wiki/JackDbusPackaging

config BR2_PACKAGE_JACK2_DBUS
	bool "dbus jack2"
	depends on BR2_USE_WCHAR # dbus-python, python
	select BR2_PACKAGE_DBUS
	select BR2_PACKAGE_DBUS_PYTHON
	select BR2_PACKAGE_PYTHON3 if !BR2_PACKAGE_PYTHON # runtime
	select BR2_PACKAGE_PYTHON_PYEXPAT if BR2_PACKAGE_PYTHON # runtime
	select BR2_PACKAGE_PYTHON3_PYEXPAT if BR2_PACKAGE_PYTHON3 # runtime
	help
	  Build and use jackdbus.

	  https://github.com/jackaudio/jackaudio.github.com/wiki/JackDbusPackaging

endif

comment "jack2 needs a toolchain w/ threads, C++, dynamic library"
	depends on BR2_USE_MMU
	depends on BR2_TOOLCHAIN_HAS_SYNC_4
	depends on !BR2_TOOLCHAIN_HAS_THREADS || !BR2_INSTALL_LIBSTDCPP || \
		BR2_STATIC_LIBS
```

## package/jailhouse/Config.in
```kconfig
config BR2_PACKAGE_JAILHOUSE
	bool "jailhouse"
	depends on BR2_aarch64 || BR2_x86_64
	depends on BR2_LINUX_KERNEL
	help
	  The Jailhouse partitioning Hypervisor based on Linux.

	  https://github.com/siemens/jailhouse

if BR2_PACKAGE_JAILHOUSE

config BR2_PACKAGE_JAILHOUSE_HELPER_SCRIPTS
	bool "helper scripts"
	depends on BR2_PACKAGE_PYTHON
	select BR2_PACKAGE_PYTHON_MAKO # runtime
	help
	  Python-based helpers for the Jailhouse Hypervisor.

	  https://github.com/siemens/jailhouse

comment "helper scripts require Python"
	depends on !BR2_PACKAGE_PYTHON

endif

comment "jailhouse needs a Linux kernel to be built"
	depends on BR2_aarch64 || BR2_x86_64
	depends on !BR2_LINUX_KERNEL
```
