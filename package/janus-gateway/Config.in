## package/janus-gateway/Config.in
```kconfig
menuconfig BR2_PACKAGE_JANUS_GATEWAY
	bool "janus-gateway"
	depends on BR2_TOOLCHAIN_HAS_THREADS # libglib2
	depends on BR2_USE_WCHAR # libnice -> libglib2
	depends on BR2_USE_MMU # libnice
	depends on !BR2_STATIC_LIBS # dlopen
	select BR2_PACKAGE_JANSSON
	select BR2_PACKAGE_LIBGLIB2
	select BR2_PACKAGE_LIBNICE
	select BR2_PACKAGE_LIBSRTP
	select BR2_PACKAGE_OPENSSL
	help
	  Janus is an open source, general purpose, WebRTC gateway
	  designed and developed by Meetecho.

	  https://github.com/meetecho/janus-gateway

if BR2_PACKAGE_JANUS_GATEWAY

comment "plugins"

config BR2_PACKAGE_JANUS_AUDIO_BRIDGE
	bool "audio bridge"
	select BR2_PACKAGE_OPUS

config BR2_PACKAGE_JANUS_ECHO_TEST
	bool "echo test"

config BR2_PACKAGE_JANUS_RECORDPLAY
	bool "record and play"

config BR2_PACKAGE_JANUS_SIP_GATEWAY
	bool "sip gateway"
	select BR2_PACKAGE_SOFIA_SIP

config  BR2_PACKAGE_JANUS_STREAMING
	bool "streaming"
	# SO_REUSEPORT
	depends on BR2_TOOLCHAIN_HEADERS_AT_LEAST_3_9

comment "streaming plugin needs a toolchain w/ headers >= 3.9"
	depends on !BR2_TOOLCHAIN_HEADERS_AT_LEAST_3_9

config BR2_PACKAGE_JANUS_TEXT_ROOM
	bool "text room"

config BR2_PACKAGE_JANUS_VIDEO_CALL
	bool "video call"

config BR2_PACKAGE_JANUS_VIDEO_ROOM
	bool "video room"

config BR2_PACKAGE_JANUS_VOICE_MAIL
	bool "voice mail"
	select BR2_PACKAGE_LIBOGG

comment "transports"

config BR2_PACKAGE_JANUS_MQTT
	bool "MQTT"
	depends on !BR2_STATIC_LIBS
	depends on BR2_TOOLCHAIN_HAS_THREADS
	select BR2_PACKAGE_PAHO_MQTT_C

comment "MQTT transport needs a toolchain w/ threads and dynamic library support"
	depends on BR2_STATIC_LIBS || !BR2_TOOLCHAIN_HAS_THREADS

config BR2_PACKAGE_JANUS_RABBITMQ
	bool "RabbitMQ"
	depends on BR2_TOOLCHAIN_HAS_THREADS
	select BR2_PACKAGE_RABBITMQ_C

comment "RabbitMQ transport needs a toolchain w/ threads"
	depends on !BR2_TOOLCHAIN_HAS_THREADS

config BR2_PACKAGE_JANUS_REST
	bool "REST (HTTP/HTTPS)"
	depends on BR2_TOOLCHAIN_HAS_THREADS
	select BR2_PACKAGE_LIBMICROHTTPD

comment "REST transport needs a toolchain w/ threads"
	depends on !BR2_TOOLCHAIN_HAS_THREADS

config BR2_PACKAGE_JANUS_UNIX_SOCKETS
	bool "Unix Sockets"
	default y

config BR2_PACKAGE_JANUS_WEBSOCKETS
	bool "WebSockets"
	depends on BR2_USE_MMU
	select BR2_PACKAGE_LIBWEBSOCKETS

endif

comment "janus-gateway needs a toolchain w/ dynamic library, threads, wchar"
	depends on BR2_USE_MMU
	depends on BR2_STATIC_LIBS || !BR2_TOOLCHAIN_HAS_THREADS || !BR2_USE_WCHAR
```

## package/jasper/Config.in
```kconfig
config BR2_PACKAGE_JASPER
	bool "jasper"
	select BR2_PACKAGE_JPEG
	help
	  JPEG-2000 decoder

	  http://www.ece.uvic.ca/~mdadams/jasper/
```

## package/java/Config.in
```kconfig
menu "Java"
source "package/java/classpath/Config.in"
source "package/java/jamvm/Config.in"
source "package/java/concierge/Config.in"
endmenu
```

## package/java/classpath/Config.in
```kconfig
config BR2_PACKAGE_CLASSPATH
	bool "classpath"
	select BR2_PACKAGE_PKGCONFIG

	help
	  GNU Classpath, Essential Libraries for Java, is a GNU
	  project to create free core class libraries for use with
	  virtual machines and compilers for the java programming
	  language.

	  http://www.classpath.org/
```

## package/java/jamvm/Config.in
```kconfig
config BR2_PACKAGE_JAMVM
	bool "jamvm"
        depends on BR2_PACKAGE_CLASSPATH
	select BR2_PACKAGE_PKGCONFIG
	help
	  JamVM is a new Java Virtual Machine which conforms to 
	  the JVM specification version 2 (blue book). 

	  http://jamvm.sourceforge.net/
```

## package/jbig2dec/Config.in
```kconfig
config BR2_PACKAGE_JBIG2DEC
	bool "jbig2dec"
	help
	  jbig2dec is a decoder implementation of the JBIG2
	  image compression format.

	  https://jbig2dec.com/
```

## package/jemalloc/Config.in
```kconfig
config BR2_PACKAGE_JEMALLOC_ARCH_SUPPORTS
	bool
	# see include/jemalloc/internal/quantum.h
	default y if BR2_arm || BR2_armeb
	default y if BR2_aarch64 || BR2_aarch64_be
	default y if BR2_i386 || BR2_x86_64
	default y if BR2_m68k
	default y if BR2_mips || BR2_mipsel || BR2_mips64 || BR2_mips64el
	default y if BR2_nios2
	default y if BR2_or1k
	default y if BR2_powerpc
	default y if BR2_riscv
	default y if BR2_sh4 || BR2sh4eb || BR2_sh4a || BR2_sh4aeb
	default y if BR2_sparc64

config BR2_PACKAGE_JEMALLOC
	bool "jemalloc"
	depends on BR2_PACKAGE_JEMALLOC_ARCH_SUPPORTS
	depends on BR2_TOOLCHAIN_HAS_THREADS
	help
	  This library providing a malloc(3) implementation that
	  emphasizes fragmentation avoidance and scalable concurrency
	  support.

	  http://jemalloc.net/

comment "jemalloc needs a toolchain w/ threads"
	depends on BR2_PACKAGE_JEMALLOC_ARCH_SUPPORTS
	depends on !BR2_TOOLCHAIN_HAS_THREADS
```

## package/jhead/Config.in
```kconfig
config BR2_PACKAGE_JHEAD
	bool "jhead"
	depends on BR2_USE_WCHAR
	help
	  Jhead is a program for manipulating settings and thumbnails
	  in Exif jpeg headers used by most Digital Cameras.

	  http://www.sentex.net/~mwandel/jhead/

comment "jhead needs a toolchain w/ wchar"
	depends on !BR2_USE_WCHAR
```

## package/jimtcl/Config.in
```kconfig
config BR2_PACKAGE_JIMTCL
	bool "jimtcl"
	help
	  Jim Tcl is a small footprint reimplementation of the Tcl
	  scripting language. The core language engine is compatible
	  with Tcl 8.5+, while implementing a significant subset of
	  the Tcl 8.6 command set, plus additional features available
	  only in Jim Tcl.

	  http://jim.tcl.tk
```

## package/jitterentropy-library/Config.in
```kconfig
config BR2_PACKAGE_JITTERENTROPY_LIBRARY
	bool "libjitterentropy"
	help
	  Hardware RNG based on CPU timing jitter.

	  https://github.com/smuellerDD/jitterentropy-library
```

## package/jo/Config.in
```kconfig
config BR2_PACKAGE_JO
	bool "jo"
	help
	  Command-line processor to output JSON from a shell

	  https://github.com/jpmens/jo
```

## package/joe/Config.in
```kconfig
config BR2_PACKAGE_JOE
	bool "joe"
	depends on BR2_USE_MMU # fork()
	help
	  Joe's Own Editor

	  JOE is an easy-to-use, full featured terminal-based screen editor.
	  Its behavior is a blending of WordStar and GNU-EMACS (but it does
	  not use code from either program). It is a great editor for new
	  users or as an alternative to vi.

	  http://joe-editor.sf.net

config BR2_PACKAGE_JOE_FULL
	bool "full install of rc and syntax highlighting files"
	depends on BR2_PACKAGE_JOE
	default y
	help
	  Install all rc and syntax highlighting files. Without this option
	  only the joe binary is installed, which contains a default
	  configuration.
```

## package/jose/Config.in
```kconfig
config BR2_PACKAGE_JOSE
	bool "jose"
	depends on BR2_TOOLCHAIN_HAS_THREADS
	select BR2_PACKAGE_ZLIB
	select BR2_PACKAGE_JANSSON
	select BR2_PACKAGE_OPENSSL
	help
	  C-language implementation of Javascript Object Signing and
	  Encryption.

	  https://github.com/latchset/jose

comment "jose needs a toolchain w/ threads"
	depends on !BR2_TOOLCHAIN_HAS_THREADS
```

## package/jpeg-turbo/Config.in
```kconfig
config BR2_PACKAGE_JPEG_TURBO
	bool "jpeg-turbo"
	help
	  Libjpeg-turbo is a derivative of libjpeg that uses SIMD
	  instructions (MMX, SSE2, NEON) to accelerate baseline JPEG
	  compression and decompression on x86, x86-64, and ARM
	  systems.

	  http://www.libjpeg-turbo.org
```

## package/jpeg/Config.in
```kconfig
config BR2_PACKAGE_JPEG
	bool "jpeg support"
	help
	  Select the desired JPEG library provider.

# jpeg-turbo has simd support for some architectures
config BR2_PACKAGE_JPEG_SIMD_SUPPORT
	bool
	default y if BR2_X86_CPU_HAS_MMX
	default y if BR2_ARM_CPU_HAS_NEON
	default y if BR2_POWERPC_CPU_HAS_ALTIVEC
	default y if BR2_aarch64 || BR2_aarch64_be

if BR2_PACKAGE_JPEG

choice
	prompt "jpeg variant"
	default BR2_PACKAGE_JPEG_TURBO if BR2_PACKAGE_JPEG_SIMD_SUPPORT
	help
	  Select the normal libjpeg or libjpeg-turbo.

config BR2_PACKAGE_LIBJPEG
	bool "jpeg"
	select BR2_PACKAGE_HAS_JPEG
	help
	  The ubiquitous C library for manipulating JPEG images.

	  http://www.ijg.org/

config BR2_PACKAGE_JPEG_TURBO
	bool "jpeg-turbo"
	select BR2_PACKAGE_HAS_JPEG
	help
	  Libjpeg-turbo is a derivative of libjpeg that uses SIMD
	  instructions (MMX, SSE2, NEON) to accelerate baseline JPEG
	  compression and decompression on x86, x86-64, and ARM
	  systems.

	  http://www.libjpeg-turbo.org

endchoice

config BR2_PACKAGE_HAS_JPEG
	bool

config BR2_PACKAGE_PROVIDES_JPEG
	string
	default "libjpeg"    if BR2_PACKAGE_LIBJPEG
	default "jpeg-turbo" if BR2_PACKAGE_JPEG_TURBO

endif
```

## package/jq/Config.in
```kconfig
config BR2_PACKAGE_JQ
	bool "jq"
	depends on BR2_TOOLCHAIN_HAS_THREADS
	help
	  jq is like sed for JSON data - you can use it to slice and
	  filter and map and transform structured data with the same
	  ease that sed, awk, grep and friends let you play with text.

	  http://stedolan.github.io/jq/

comment "jq needs a toolchain w/ threads"
	depends on !BR2_TOOLCHAIN_HAS_THREADS
```

## package/jq/Config.in.host
```kconfig
config BR2_PACKAGE_HOST_JQ
	bool "host jq"
	help
	  jq is like sed for JSON data - you can use it to slice and filter
	  and map and transform structured data with the same ease that sed,
	  awk, grep and friends let you play with text.

	  As a host tool, jq can be useful to create/edit/merge/check JSON
	  files from a post-build script.

	  http://stedolan.github.io/jq/
```

## package/jquery-datetimepicker/Config.in
```kconfig
config BR2_PACKAGE_JQUERY_DATETIMEPICKER
	bool "jquery-datetimepicker"
	help
	  Use this plugin to unobtrusively add a datetimepicker,
	  datepicker or timepicker dropdown to your forms.

	  http://xdsoft.net/jqplugins/datetimepicker
```

## package/jquery-keyboard/Config.in
```kconfig
config BR2_PACKAGE_JQUERY_KEYBOARD
	bool "jquery-keyboard"
	select BR2_PACKAGE_JQUERY_UI
	help
	  Virtual Keyboard using jQuery UI

	  https://github.com/Mottie/Keyboard
```

## package/jquery-mobile/Config.in
```kconfig
config BR2_PACKAGE_JQUERY_MOBILE
	bool "jquery-mobile"
	help
	  jQuery-Mobile is a unified, HTML5-based user interface
	  system for all popular mobile device platforms, built on the
	  rock-solid jQuery and jQuery UI foundation. Its lightweight
	  code is built with progressive enhancement, and has a
	  flexible, easily themeable design.

	  http://jquerymobile.com

if BR2_PACKAGE_JQUERY_MOBILE

config BR2_PACKAGE_JQUERY_MOBILE_FULL
	bool "jquery-mobile development files"
	help
	  Installs the development versions.

config BR2_PACKAGE_JQUERY_MOBILE_DEMOS
	bool "jquery-mobile demo files"
	help
	  Installs the demo files.
	  The main demo page is http://hostname/demos/index.html

endif
```

## package/jquery-sidebar/Config.in
```kconfig
config BR2_PACKAGE_JQUERY_SIDEBAR
	bool "jquery-sidebar"
	help
	  A stupid simple sidebar jQuery plugin.

	  http://jillix.github.io/jQuery-sidebar/
```

## package/jquery-sparkline/Config.in
```kconfig
config BR2_PACKAGE_JQUERY_SPARKLINE
	bool "jquery-sparkline"
	help
	  This jQuery plugin generates sparklines (small inline
	  charts) directly in the browser using data supplied either
	  inline in the HTML, or via javascript.

	  The plugin is compatible with most modern browsers and has
	  been tested with Firefox 2+, Safari 3+, Opera 9, Google
	  Chrome and Internet Explorer 6, 7 & 8.

	  http://www.omnipotent.net/jquery.sparkline/
```

## package/jquery-ui-themes/Config.in
```kconfig
config BR2_PACKAGE_JQUERY_UI_THEMES
	bool "jquery-ui-themes"
	depends on BR2_PACKAGE_JQUERY_UI
	help
	  Themes for jQuery UI.

	  http://jqueryui.com/

if BR2_PACKAGE_JQUERY_UI_THEMES

choice
	prompt "theme to install"
	help
	  Specify the jQuery UI theme to install.

config BR2_PACKAGE_JQUERY_UI_THEMES_BLACK_TIE
	bool "black-tie"

config BR2_PACKAGE_JQUERY_UI_THEMES_BLITZER
	bool "blitzer"

config BR2_PACKAGE_JQUERY_UI_THEMES_CUPERTINO
	bool "cupertino"

config BR2_PACKAGE_JQUERY_UI_THEMES_DARK_HIVE
	bool "dark-hive"

config BR2_PACKAGE_JQUERY_UI_THEMES_DOT_LUV
	bool "dot-luv"

config BR2_PACKAGE_JQUERY_UI_THEMES_EGGPLANT
	bool "eggplant"

config BR2_PACKAGE_JQUERY_UI_THEMES_EXCITE_BIKE
	bool "excite-bike"

config BR2_PACKAGE_JQUERY_UI_THEMES_FLICK
	bool "flick"

config BR2_PACKAGE_JQUERY_UI_THEMES_HOT_SNEAKS
	bool "hot-sneaks"

config BR2_PACKAGE_JQUERY_UI_THEMES_HUMANITY
	bool "humanity"

config BR2_PACKAGE_JQUERY_UI_THEMES_LE_FROG
	bool "le-frog"

config BR2_PACKAGE_JQUERY_UI_THEMES_MINT_CHOC
	bool "mint-choc"

config BR2_PACKAGE_JQUERY_UI_THEMES_OVERCAST
	bool "overcast"

config BR2_PACKAGE_JQUERY_UI_THEMES_PEPPER_GRINDER
	bool "pepper-grinder"

config BR2_PACKAGE_JQUERY_UI_THEMES_REDMOND
	bool "redmond"

config BR2_PACKAGE_JQUERY_UI_THEMES_SMOOTHNESS
	bool "smoothness"

config BR2_PACKAGE_JQUERY_UI_THEMES_SOUTH_STREET
	bool "south-street"

config BR2_PACKAGE_JQUERY_UI_THEMES_START
	bool "start"

config BR2_PACKAGE_JQUERY_UI_THEMES_SUNNY
	bool "sunny"

config BR2_PACKAGE_JQUERY_UI_THEMES_SWANKY_PURSE
	bool "swanky-purse"

config BR2_PACKAGE_JQUERY_UI_THEMES_TRONTASTIC
	bool "trontastic"

config BR2_PACKAGE_JQUERY_UI_THEMES_UI_DARKNESS
	bool "ui-darkness"

config BR2_PACKAGE_JQUERY_UI_THEMES_UI_LIGHTNESS
	bool "ui-lightness"

config BR2_PACKAGE_JQUERY_UI_THEMES_VADER
	bool "vader"

endchoice

config BR2_PACKAGE_JQUERY_UI_THEMES_THEME
	string
	default "black-tie"		if BR2_PACKAGE_JQUERY_UI_THEMES_BLACK_TIE
	default "blitzer"		if BR2_PACKAGE_JQUERY_UI_THEMES_BLITZER
	default "cupertino"		if BR2_PACKAGE_JQUERY_UI_THEMES_CUPERTINO
	default "dark-hive"		if BR2_PACKAGE_JQUERY_UI_THEMES_DARK_HIVE
	default "dot-luv"		if BR2_PACKAGE_JQUERY_UI_THEMES_DOT_LUV
	default "eggplant"		if BR2_PACKAGE_JQUERY_UI_THEMES_EGGPLANT
	default "excite-bike"		if BR2_PACKAGE_JQUERY_UI_THEMES_EXCITE_BIKE
	default "flick"			if BR2_PACKAGE_JQUERY_UI_THEMES_FLICK
	default "hot-sneaks"		if BR2_PACKAGE_JQUERY_UI_THEMES_HOT_SNEAKS
	default "humanity"		if BR2_PACKAGE_JQUERY_UI_THEMES_HUMANITY
	default "le-frog"		if BR2_PACKAGE_JQUERY_UI_THEMES_LE_FROG
	default "mint-choc"		if BR2_PACKAGE_JQUERY_UI_THEMES_MINT_CHOC
	default "overcast"		if BR2_PACKAGE_JQUERY_UI_THEMES_OVERCAST
	default "pepper-grinder"	if BR2_PACKAGE_JQUERY_UI_THEMES_PEPPER_GRINDER
	default "redmond"		if BR2_PACKAGE_JQUERY_UI_THEMES_REDMOND
	default "smoothness"		if BR2_PACKAGE_JQUERY_UI_THEMES_SMOOTHNESS
	default "south-street"		if BR2_PACKAGE_JQUERY_UI_THEMES_SOUTH_STREET
	default "start"			if BR2_PACKAGE_JQUERY_UI_THEMES_START
	default "sunny"			if BR2_PACKAGE_JQUERY_UI_THEMES_SUNNY
	default "swanky-purse"		if BR2_PACKAGE_JQUERY_UI_THEMES_SWANKY_PURSE
	default "trontastic"		if BR2_PACKAGE_JQUERY_UI_THEMES_TRONTASTIC
	default "ui-darkness"		if BR2_PACKAGE_JQUERY_UI_THEMES_UI_DARKNESS
	default "ui-lightness"		if BR2_PACKAGE_JQUERY_UI_THEMES_UI_LIGHTNESS
	default "vader"			if BR2_PACKAGE_JQUERY_UI_THEMES_UI_VADER

endif
```

## package/jquery-ui/Config.in
```kconfig
config BR2_PACKAGE_JQUERY_UI
	bool "jQuery UI"
	select BR2_PACKAGE_JQUERY
	help
	  jQuery UI provides abstractions for low-level interaction and
	  animation, advanced effects and high-level, themeable widgets,
	  built on top of the jQuery JavaScript Library, that you can use
	  to build highly interactive web applications.

	  http://jqueryui.com/
```

## package/jquery-validation/Config.in
```kconfig
config BR2_PACKAGE_JQUERY_VALIDATION
	bool "jQuery-Validation"
	select BR2_PACKAGE_JQUERY
	help
	  The jQuery Validation Plugin provides drop-in validation for
	  your existing forms, while making all kinds of
	  customizations to fit your application really easy.

	  http://bassistance.de/jquery-plugins/jquery-plugin-validation/
```
