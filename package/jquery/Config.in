## package/jquery/Config.in
```kconfig
config BR2_PACKAGE_JQUERY
	bool "jQuery"
	help
	  jQuery is a fast and concise JavaScript Library that
	  simplifies HTML document traversing, event handling,
	  animating, and Ajax interactions for rapid web development.

	  http://jquery.com
```

## package/jsmin/Config.in
```kconfig
config BR2_PACKAGE_JSMIN
	bool "jsmin"
	help
	  JSMin is a filter which removes comments and unnecessary
	  whitespace from JavaScript files. It typically reduces
	  filesize by half, resulting in faster downloads. It also
	  encourages a more expressive programming style because it
	  eliminates the download cost of clean, literate
	  self-documentation.

	  http://www.crockford.com/javascript/jsmin.html
```

## package/json-c/Config.in
```kconfig
config BR2_PACKAGE_JSON_C
	bool "json-c"
	help
	  JSON-C - A JSON implementation in C

	  JSON-C implements a reference counting object model that
	  allows you to easily construct JSON objects in C, output
	  them as JSON formatted strings and parse JSON formatted
	  strings back into the C representation of JSON objects.

	  http://oss.metaparadigm.com/json-c/
```

## package/json-for-modern-cpp/Config.in
```kconfig
config BR2_PACKAGE_JSON_FOR_MODERN_CPP
	bool "json-for-modern-cpp"
	depends on BR2_TOOLCHAIN_GCC_AT_LEAST_4_9 # C++11
	depends on BR2_INSTALL_LIBSTDCPP
	help
	  Json for modern c++ has the following desing goals in mind:

	  - Intuitive syntax. In languages such as Python, JSON feels
	    like a first class data type. All the operator magic of
	    modern C++ is used to achieve the same feeling in c++.

	  - Trivial integration. The whole code consists of a single
	    header file json.hpp. That's it. No library, no
	    subproject, no dependencies, no complex build system. The
	    class is written in vanilla C++11. All in all, everything
	    should require no adjustment of compiler flags or project
	    settings.

	  - Serious testing. The class is heavily unit-tested and
	    covers 100% of the code, including all exceptional
	    behavior.  Furthermore, it is checked with Valgrind that
	    there are no memory leaks. To maintain high quality, the
	    project is following the Core Infrastructure Initiative
	    (CII) best practices.

	  https://github.com/nlohmann/json

comment "json-for-modern-cpp needs a toolchain w/ C++, gcc >= 4.9"
	depends on !BR2_INSTALL_LIBSTDCPP || !BR2_TOOLCHAIN_GCC_AT_LEAST_4_9
```

## package/json-glib/Config.in
```kconfig
config BR2_PACKAGE_JSON_GLIB
	bool "json-glib"
	depends on BR2_USE_WCHAR # glib2
	depends on BR2_TOOLCHAIN_HAS_THREADS # glib2
	select BR2_PACKAGE_LIBGLIB2
	select BR2_PACKAGE_GETTEXT if BR2_NEEDS_GETTEXT
	help
	  JSON-GLib is a library providing serialization and
	  deserialization support for the JavaScript Object Notation
	  (JSON) format described by RFC 4627.

	  https://live.gnome.org/JsonGlib/

comment "json-glib needs a toolchain w/ wchar, threads"
	depends on !BR2_USE_WCHAR || !BR2_TOOLCHAIN_HAS_THREADS
```

## package/jsoncpp/Config.in
```kconfig
config BR2_PACKAGE_JSONCPP
	bool "jsoncpp"
	depends on BR2_TOOLCHAIN_GCC_AT_LEAST_4_7 # C++11
	depends on BR2_INSTALL_LIBSTDCPP
	help
	  JsonCpp is a C++ library that allows manipulating JSON
	  values, including serialization and deserialization to and
	  from strings. It can also preserve existing comment in
	  unserialization/serialization steps, making it a convenient
	  format to store user input files.

	  https://github.com/open-source-parsers/jsoncpp

comment "jsoncpp needs a toolchain w/ C++, gcc >= 4.7"
	depends on !BR2_INSTALL_LIBSTDCPP || !BR2_TOOLCHAIN_GCC_AT_LEAST_4_7
```

## package/kbd/Config.in
```kconfig
config BR2_PACKAGE_KBD
	bool "kbd"
	# Uses fork()
	depends on BR2_USE_MMU
	help
	  Keytable files and keyboard utilities.

	  http://kernel.org/pub/linux/utils/kbd/
```

## package/keepalived/Config.in
```kconfig
config BR2_PACKAGE_KEEPALIVED
	bool "keepalived"
	depends on BR2_USE_MMU
	depends on !BR2_STATIC_LIBS # uses libdl
	depends on BR2_TOOLCHAIN_HEADERS_AT_LEAST_3_4
	select BR2_PACKAGE_OPENSSL
	select BR2_PACKAGE_POPT
	help
	  The main goal of the keepalived project is to add a strong &
	  robust keepalive facility to the Linux Virtual Server
	  project. It implements a multilayer TCP/IP stack
	  checks. Keepalived implements a framework based on three
	  family checks: Layer3, Layer4 & Layer5. This framework gives
	  the daemon the ability of checking a LVS server pool
	  states. Keepalived can be sumarize as a LVS driving daemon.

	  http://www.keepalived.org/

comment "keepalived needs a toolchain w/ dynamic library, headers >= 3.4"
	depends on BR2_USE_MMU
	depends on BR2_STATIC_LIBS || !BR2_TOOLCHAIN_HEADERS_AT_LEAST_3_4
```

## package/kexec-lite/Config.in
```kconfig
config BR2_PACKAGE_KEXEC_LITE
	bool "kexec-lite"
	depends on BR2_powerpc || BR2_powerpc64 || BR2_powerpc64le
	depends on !BR2_STATIC_LIBS # dtc, elfutils
	depends on BR2_USE_WCHAR # elfutils
	depends on BR2_TOOLCHAIN_USES_UCLIBC || BR2_TOOLCHAIN_USES_GLIBC # elfutils
	select BR2_PACKAGE_ELFUTILS
	select BR2_PACKAGE_DTC
	select BR2_PACKAGE_DTC_PROGRAMS
	help
	  Kexec is a user space utiltity for loading another kernel
	  and asking the currently running kernel to do something with it.

	  This package is a tiny implementation of the kexec userspace
	  components, for devicetree-based platforms.

comment "kexec-lite needs a uClibc or (e)glibc toolchain w/ wchar, dynamic library"
	depends on BR2_powerpc || BR2_powerpc64
	depends on BR2_STATIC_LIBS || !BR2_USE_WCHAR \
		|| !(BR2_TOOLCHAIN_USES_UCLIBC || BR2_TOOLCHAIN_USES_GLIBC)
```

## package/kexec/Config.in
```kconfig
config BR2_PACKAGE_KEXEC
	bool "kexec"
	depends on BR2_i386 || BR2_x86_64 || BR2_arm || BR2_armeb || \
		BR2_mips || BR2_mips64 || BR2_mipsel || BR2_mips64el || \
		BR2_powerpc || BR2_sh4 || BR2_sh4a
	help
	  Kexec is a user space utility for loading another kernel
	  and asking the currently running kernel to do something with
	  it.

	  https://www.kernel.org/pub/linux/utils/kernel/kexec/

if BR2_PACKAGE_KEXEC

config BR2_PACKAGE_KEXEC_ZLIB
	bool "zlib support"
	select BR2_PACKAGE_ZLIB
	help
	  Support for compressed kernel images

endif
```

## package/keyutils/Config.in
```kconfig
config BR2_PACKAGE_KEYUTILS
	bool "keyutils"
	depends on BR2_USE_MMU # fork()
	depends on !BR2_STATIC_LIBS # dlopen
	help
	  These tools are used to control the key management system
	  built into the Linux kernel.

	  http://people.redhat.com/~dhowells/keyutils/

comment "keyutils needs a toolchain w/ dynamic library"
	depends on BR2_USE_MMU
	depends on BR2_STATIC_LIBS
```

## package/kf5/Config.in
```kconfig
menuconfig BR2_PACKAGE_KF5
	bool "KF5"
	depends on BR2_PACKAGE_QT5
	help
	  This option enables the KF5 KDE Frameworks. Sub-options
	  allow to select which modules should be built.

	  https://techbase.kde.org/KDE_Frameworks

if BR2_PACKAGE_KF5
source "package/kf5/kf5-extra-cmake-modules/Config.in"
source "package/kf5/kf5-kcoreaddons/Config.in"
source "package/kf5/kf5-modemmanager-qt/Config.in"
source "package/kf5/kf5-networkmanager-qt/Config.in"
endif
```

## package/kf5/kf5-extra-cmake-modules/Config.in
```kconfig
config BR2_PACKAGE_KF5_EXTRA_CMAKE_MODULES
	bool "kf5-extra-cmake-modules"
	help
	  KF5 is a set of Qt framework addons, extending Qt in various
	  ways, not only restricted in helping integration in KDE.

	  This package corresponds to the extra CMake modules,
	  required for most KF5 libraries.

	  https://api.kde.org/frameworks/extra-cmake-modules/html/index.html
```

## package/kf5/kf5-kcoreaddons/Config.in
```kconfig
config BR2_PACKAGE_KF5_KCOREADDONS
	bool "kf5-kcoreaddons"
	select BR2_PACKAGE_KF5_EXTRA_CMAKE_MODULES
	select BR2_PACKAGE_QT5TOOLS
	select BR2_PACKAGE_QT5TOOLS_LINGUIST_TOOLS
	help
	  KF5 is a set of Qt framework addons, extending Qt in
	  various ways, not only restricted in helping integration
	  in KDE.

	  This package contains KCoreAddons, a set of classes built
	  on top of QtCore to perform various tasks.

	  https://api.kde.org/frameworks/kcoreaddons/html/index.html
```

## package/kf5/kf5-modemmanager-qt/Config.in
```kconfig
config BR2_PACKAGE_KF5_MODEMMANAGER_QT
	bool "kf5-modemmanager-qt"
	depends on BR2_USE_MMU # qt5dbus
	depends on BR2_TOOLCHAIN_HAS_THREADS # qt5dbus
	depends on BR2_PACKAGE_MODEM_MANAGER
	select BR2_PACKAGE_QT5BASE_DBUS
	select BR2_PACKAGE_KF5_EXTRA_CMAKE_MODULES
	help
	  KF5 is a set of Qt framework addons, extending Qt in various
	  ways, not only restricted in helping integration in KDE.

	  This package contains the ModemManager Qt5 bindings from the
	  KF5 project.

	  https://api.kde.org/frameworks/modemmanager-qt/html/index.html

comment "kf5-modemmanager-qt needs toolchain w/ threads"
	depends on BR2_USE_MMU
	depends on BR2_PACKAGE_MODEM_MANAGER
	depends on !BR2_TOOLCHAIN_HAS_THREADS
```

## package/kf5/kf5-networkmanager-qt/Config.in
```kconfig
config BR2_PACKAGE_KF5_NETWORKMANAGER_QT
	bool "kf5-networkmanager-qt"
	depends on BR2_USE_MMU # qt5dbus
	depends on BR2_TOOLCHAIN_HAS_THREADS # qt5dbus
	depends on BR2_PACKAGE_NETWORK_MANAGER
	select BR2_PACKAGE_QT5BASE_DBUS
	select BR2_PACKAGE_KF5_EXTRA_CMAKE_MODULES
	help
	  KF5 is a set of Qt framework addons, extending Qt in various
	  ways, not only restricted in helping integration in KDE.

	  This package contains the NetworkManager Qt5 bindings from
	  the KF5 project.

	  https://api.kde.org/frameworks/networkmanager-qt/html/index.html

comment "kf5-networkmanager-qt needs toolchain w/ threads"
	depends on BR2_USE_MMU
	depends on BR2_PACKAGE_NETWORK_MANAGER
	depends on !BR2_TOOLCHAIN_HAS_THREADS
```

## package/kismet/Config.in
```kconfig
comment "kismet needs a toolchain w/ threads, C++, dynamic library"
	depends on BR2_USE_MMU
	depends on !BR2_INSTALL_LIBSTDCPP || !BR2_TOOLCHAIN_HAS_THREADS || \
		BR2_STATIC_LIBS

config BR2_PACKAGE_KISMET
	bool "kismet"
	depends on BR2_INSTALL_LIBSTDCPP
	depends on BR2_TOOLCHAIN_HAS_THREADS # libnl
	depends on BR2_USE_MMU # fork()
	depends on !BR2_STATIC_LIBS # dlfcn.h
	select BR2_PACKAGE_NCURSES
	select BR2_PACKAGE_NCURSES_TARGET_PANEL
	select BR2_PACKAGE_LIBPCAP
	select BR2_PACKAGE_LIBNL
	help
	  Kismet - 802.11 layer2 wireless network detector, sniffer,
	  and intrusion detection system.

	  Kismet will work with any wireless card which supports raw
	  monitoring (rfmon) mode, and can sniff 802.11b, 802.11a, and
	  802.11g traffic.

	  Kismet identifies networks by passively collecting packets
	  and detecting standard named networks, detecting (and given
	  time, decloaking) hidden networks, and infering the presence
	  of nonbeaconing networks via data traffic.

	  http://www.kismetwireless.net

if BR2_PACKAGE_KISMET

config BR2_PACKAGE_KISMET_CLIENT
	bool "Install client"

config BR2_PACKAGE_KISMET_DRONE
	bool "Install drone"

config BR2_PACKAGE_KISMET_SERVER
	bool "Install server"
	default y

endif
```

## package/kmod/Config.in
```kconfig
config BR2_PACKAGE_KMOD
	bool "kmod"
	depends on !BR2_STATIC_LIBS
	help
	  handle kernel modules

	  http://git.kernel.org/?p=utils/kernel/kmod/kmod.git

if BR2_PACKAGE_KMOD

config BR2_PACKAGE_KMOD_TOOLS
	bool "kmod utilities"
	depends on BR2_PACKAGE_BUSYBOX_SHOW_OTHERS
	help
	  Install kmod module utilities (depmod, insmod, lsmod,
	  modinfo, modprobe, rmmod).

endif

comment "kmod needs a toolchain w/ dynamic library"
	depends on BR2_STATIC_LIBS
```

## package/kmscube/Config.in
```kconfig
config BR2_PACKAGE_KMSCUBE
	bool "kmscube"
	# requires libgbm from mesa3d
	depends on BR2_PACKAGE_MESA3D_OPENGL_EGL
	depends on BR2_PACKAGE_MESA3D_OPENGL_ES
	help
	  kmscube is an application to test kms/drm drivers.

	  https://github.com/robclark/kmscube/
```

## package/kmsxx/Config.in
```kconfig
config BR2_PACKAGE_KMSXX
	bool "kms++"
	depends on BR2_TOOLCHAIN_GCC_AT_LEAST_4_8
	depends on BR2_TOOLCHAIN_HEADERS_AT_LEAST_3_8
	depends on BR2_INSTALL_LIBSTDCPP
	depends on BR2_TOOLCHAIN_HAS_THREADS # libdrm
	select BR2_PACKAGE_LIBDRM
	help
	  libkms++ is a C++11 library for kernel mode setting.

	  Also included are simple test tools for KMS.

	  https://github.com/tomba/kmsxx

if BR2_PACKAGE_KMSXX

config BR2_PACKAGE_KMSXX_INSTALL_TESTS
	bool "Install test programs"
	help
	  This option allows to install the kmsxx test programs.

endif

comment "kms++ needs a toolchain w/ threads, C++, gcc >= 4.8, headers >= 3.8"
	depends on !BR2_TOOLCHAIN_HAS_THREADS || !BR2_INSTALL_LIBSTDCPP || \
		!BR2_TOOLCHAIN_GCC_AT_LEAST_4_8 || !BR2_TOOLCHAIN_HEADERS_AT_LEAST_3_8
```

## package/knock/Config.in
```kconfig
config BR2_PACKAGE_KNOCK
	bool "knock"
	select BR2_PACKAGE_LIBPCAP
	help
	  A port knocking implementation.
	  Provides a daemon and a user application. Port knocking can be
	  used to run an arbitrary application, once the daemon detects
	  a predefined sequence of incoming TCP/UDP packets on a network
	  interface. This can be used, e.g. to open up ports in a
	  firewall.

	  http://www.zeroflux.org/projects/knock
```

## package/kobs-ng/Config.in
```kconfig
config BR2_PACKAGE_KOBS_NG
	bool "kobs-ng"
	depends on BR2_arm
	help
	  The kobs-ng tool is used for writing images to NAND on i.MX
	  platforms.

	  This utility is provided by Freescale as-is and doesn't have an
	  upstream.
```

## package/kodi-addon-xvdr/Config.in
```kconfig
config BR2_PACKAGE_KODI_ADDON_XVDR
	bool "kodi-addon-xvdr"
	# upstream discontinued the development
	depends on BR2_DEPRECATED_SINCE_2016_05
	help
	  This is a PVR add-on for Kodi to add VDR (http://tvdr.de/)
	  as a TV/PVR Backend to Kodi.

	  It adds support for Live TV watching, replaying of Recordings,
	  programming Timers and EPG TV Guide to use on same computer or
	  over the Network.

	  https://github.com/pipelka/xbmc-addon-xvdr

	  Note: since the VDR server is not packaged in Buildroot, using
	  this addon requires that a remote VDR server be used.
```

## package/kodi-adsp-basic/Config.in
```kconfig
config BR2_PACKAGE_KODI_ADSP_BASIC
	bool "kodi-adsp-basic"
	select BR2_PACKAGE_LIBPLATFORM
	select BR2_PACKAGE_KODI_PLATFORM
	help
	  This add-on contains basic dsp related parts to handle
	  speaker delays, channel related volume amplification. As
	  mode it supports a Dolby Pro Logic II compatible
	  multichannel downmix to stereo, which becomes available if
	  only 2 channel output on Kodi is selected.

	  https://github.com/kodi-adsp/adsp.basic
```

## package/kodi-adsp-freesurround/Config.in
```kconfig
config BR2_PACKAGE_KODI_ADSP_FREESURROUND
	bool "kodi-adsp-freesurround"
	select BR2_PACKAGE_LIBPLATFORM
	select BR2_PACKAGE_KODI_PLATFORM
	help
	  FreeSurround is meant to be the KODI equivalent of your
	  hi-fi receiver's Dolby ProLogic II button. It's purpose is
	  to decode surround information from your stereo music and to
	  produce multichannel output from it.

	  https://github.com/kodi-adsp/adsp.freesurround
```
