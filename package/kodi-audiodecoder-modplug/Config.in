## package/kodi-audiodecoder-modplug/Config.in
```kconfig
config BR2_PACKAGE_KODI_AUDIODECODER_MODPLUG
	bool "kodi-audiodecoder-modplug"
	select BR2_PACKAGE_LIBMODPLUG
	help
	  Modplug decoder addon for Kodi

	  https://github.com/xbmc/audiodecoder.modplug
```

## package/kodi-audiodecoder-nosefart/Config.in
```kconfig
config BR2_PACKAGE_KODI_AUDIODECODER_NOSEFART
	bool "kodi-audiodecoder-nosefart"
	help
	  Nosefart decoder addon for Kodi

	  https://github.com/xbmc/audiodecoder.nosefart
```

## package/kodi-audiodecoder-sidplay/Config.in
```kconfig
config BR2_PACKAGE_KODI_AUDIODECODER_SIDPLAY
	bool "kodi-audiodecoder-sidplay"
	select BR2_PACKAGE_LIBSIDPLAY2
	help
	  Sidplay decoder addon for Kodi

	  https://github.com/xbmc/audiodecoder.sidplay
```

## package/kodi-audiodecoder-snesapu/Config.in
```kconfig
config BR2_PACKAGE_KODI_AUDIODECODER_SNESAPU
	bool "kodi-audiodecoder-snesapu"
	help
	  SPC decoder addon for Kodi

	  https://github.com/xbmc/audiodecoder.snesapu
```

## package/kodi-audiodecoder-stsound/Config.in
```kconfig
config BR2_PACKAGE_KODI_AUDIODECODER_STSOUND
	bool "kodi-audiodecoder-stsound"
	help
	  YM decoder addon for Kodi

	  https://github.com/xbmc/audiodecoder.stsound
```

## package/kodi-audiodecoder-timidity/Config.in
```kconfig
config BR2_PACKAGE_KODI_AUDIODECODER_TIMIDITY
	bool "kodi-audiodecoder-timidity"
	help
	  Timidity decoder addon for Kodi

	  https://github.com/xbmc/audiodecoder.timidity
```

## package/kodi-audiodecoder-vgmstream/Config.in
```kconfig
config BR2_PACKAGE_KODI_AUDIODECODER_VGMSTREAM
	bool "kodi-audiodecoder-vgmstream"
	help
	  VGM decoder addon for Kodi

	  https://github.com/xbmc/audiodecoder.vgmstream
```

## package/kodi-audioencoder-flac/Config.in
```kconfig
config BR2_PACKAGE_KODI_AUDIOENCODER_FLAC
	bool "kodi-audioencoder-flac"
	select BR2_PACKAGE_FLAC
	select BR2_PACKAGE_KODI_OPTICALDRIVE
	select BR2_PACKAGE_LIBOGG
	help
	  An audioencoder addon for Kodi

	  https://github.com/xbmc/audioencoder.flac
```

## package/kodi-audioencoder-lame/Config.in
```kconfig
config BR2_PACKAGE_KODI_AUDIOENCODER_LAME
	bool "kodi-audioencoder-lame"
	select BR2_PACKAGE_KODI_OPTICALDRIVE
	select BR2_PACKAGE_LAME
	help
	  An audioencoder addon for Kodi

	  https://github.com/xbmc/audioencoder.lame
```

## package/kodi-audioencoder-vorbis/Config.in
```kconfig
config BR2_PACKAGE_KODI_AUDIOENCODER_VORBIS
	bool "kodi-audioencoder-vorbis"
	select BR2_PACKAGE_LIBOGG
	select BR2_PACKAGE_LIBVORBIS
	help
	  An audioencoder addon for Kodi

	  https://github.com/xbmc/audioencoder.vorbis
```

## package/kodi-audioencoder-wav/Config.in
```kconfig
config BR2_PACKAGE_KODI_AUDIOENCODER_WAV
	bool "kodi-audioencoder-wav"
	select BR2_PACKAGE_KODI_OPTICALDRIVE
	help
	  An audioencoder addon for Kodi

	  https://github.com/xbmc/audioencoder.wav
```

## package/kodi-inputstream-adaptive/Config.in
```kconfig
config BR2_PACKAGE_KODI_INPUTSTREAM_ADAPTIVE
	bool "kodi-inputstream-adaptive"
	# wvdecrypter/cdm/build/build_config.h
	depends on BR2_aarch64 || BR2_arm || BR2_i386 || BR2_mipsel \
		|| BR2_mips64el || BR2_x86_64
	select BR2_PACKAGE_LIBPLATFORM
	select BR2_PACKAGE_KODI_PLATFORM
	help
	  Kodi inputstream addon for several manifest types

	  https://github.com/peak3d/inputstream.adaptive
```

## package/kodi-inputstream-rtmp/Config.in
```kconfig
config BR2_PACKAGE_KODI_INPUTSTREAM_RTMP
	bool "kodi-inputstream-rtmp"
	select BR2_PACKAGE_RTMPDUMP
	help
	  RTMP input stream add-on for Kodi

	  https://github.com/notspiff/inputstream.rtmp
```

## package/kodi-peripheral-joystick/Config.in
```kconfig
config BR2_PACKAGE_KODI_PERIPHERAL_JOYSTICK
	bool "kodi-peripheral-joystick"
	depends on BR2_PACKAGE_HAS_UDEV
	select BR2_PACKAGE_TINYXML
	help
	  Kodi joystick support (drivers and button maps)

	  https://github.com/xbmc/peripheral.joystick

comment "kodi-peripheral-joystick needs udev /dev management"
	depends on !BR2_PACKAGE_HAS_UDEV
```

## package/kodi-peripheral-steamcontroller/Config.in
```kconfig
config BR2_PACKAGE_KODI_PERIPHERAL_STEAMCONTROLLER
	bool "kodi-peripheral-steamcontroller"
	select BR2_PACKAGE_KODI_PLATFORM
	select BR2_PACKAGE_LIBUSB
	help
	  Steam controller driver for Kodi

	  https://github.com/kodi-game/peripheral.steamcontroller
```

## package/kodi-peripheral-xarcade/Config.in
```kconfig
config BR2_PACKAGE_KODI_PERIPHERAL_XARCADE
	bool "kodi-peripheral-xarcade"
	help
	  X-Arcade Tankstick support for Kodi

	  https://github.com/kodi-game/peripheral.xarcade
```

## package/kodi-platform/Config.in
```kconfig
config BR2_PACKAGE_KODI_PLATFORM
	bool
	select BR2_PACKAGE_LIBPLATFORM
	help
	  Kodi add-on platform support library

	  https://github.com/xbmc/kodi-platform
```

## package/kodi-pvr-addons/Config.in
```kconfig
config BR2_PACKAGE_KODI_PVR_ADDONS
	bool "kodi-pvr-addons"
	help
	  A collection of PVR backend addons for Kodi

	  https://github.com/opdenkamp/xbmc-pvr-addons
```

## package/kodi-pvr-argustv/Config.in
```kconfig
config BR2_PACKAGE_KODI_PVR_ARGUSTV
	bool "kodi-pvr-argustv"
	depends on BR2_TOOLCHAIN_GCC_AT_LEAST_4_7 # jsoncpp
	select BR2_PACKAGE_JSONCPP
	select BR2_PACKAGE_KODI_PLATFORM
	help
	  Kodi's ARGUS TV client addon

	  https://github.com/kodi-pvr/pvr.argustv

comment "kodi-pvr-argustv needs a toolchain w/ gcc >= 4.7"
	depends on !BR2_TOOLCHAIN_GCC_AT_LEAST_4_7
```

## package/kodi-pvr-dvblink/Config.in
```kconfig
config BR2_PACKAGE_KODI_PVR_DVBLINK
	bool "kodi-pvr-dvblink"
	select BR2_PACKAGE_KODI_PLATFORM
	select BR2_PACKAGE_TINYXML2
	help
	  Kodi's DVBLink client addon

	  https://github.com/kodi-pvr/pvr.dvblink
```

## package/kodi-pvr-dvbviewer/Config.in
```kconfig
config BR2_PACKAGE_KODI_PVR_DVBVIEWER
	bool "kodi-pvr-dvbviewer"
	select BR2_PACKAGE_KODI_PLATFORM
	help
	  Kodi's DVBViewer client addon

	  https://github.com/kodi-pvr/pvr.dvbviewer
```

## package/kodi-pvr-filmon/Config.in
```kconfig
config BR2_PACKAGE_KODI_PVR_FILMON
	bool "kodi-pvr-filmon"
	depends on BR2_TOOLCHAIN_GCC_AT_LEAST_4_7 # jsoncpp
	select BR2_PACKAGE_JSONCPP
	select BR2_PACKAGE_KODI_PLATFORM
	help
	  Filmon PVR client addon for Kodi

	  https://github.com/kodi-pvr/pvr.filmon

comment "kodi-pvr-filmon needs a toolchain w/ gcc >= 4.7"
	depends on !BR2_TOOLCHAIN_GCC_AT_LEAST_4_7
```

## package/kodi-pvr-hdhomerun/Config.in
```kconfig
config BR2_PACKAGE_KODI_PVR_HDHOMERUN
	bool "kodi-pvr-hdhomerun"
	select BR2_PACKAGE_JSONCPP
	select BR2_PACKAGE_KODI_PLATFORM
	select BR2_PACKAGE_LIBHDHOMERUN
	help
	  Kodi's HDHomeRun client addon

	  https://github.com/kodi-pvr/pvr.hdhomerun
```

## package/kodi-pvr-iptvsimple/Config.in
```kconfig
config BR2_PACKAGE_KODI_PVR_IPTVSIMPLE
	bool "kodi-pvr-iptvsimple"
	select BR2_PACKAGE_KODI_PLATFORM
	select BR2_PACKAGE_RAPIDXML
	help
	  IPTV Live TV and Radio PVR client addon for Kodi

	  https://github.com/kodi-pvr/pvr.iptvsimple
```

## package/kodi-pvr-mediaportal-tvserver/Config.in
```kconfig
config BR2_PACKAGE_KODI_PVR_MEDIAPORTAL_TVSERVER
	bool "kodi-pvr-mediaportal-tvserver"
	select BR2_PACKAGE_KODI_PLATFORM
	help
	  MediaPortal TVServer PVR client addon for Kodi

	  https://github.com/kodi-pvr/pvr.mediaportal.tvserver
```
