## package/kodi-pvr-mythtv/Config.in
```kconfig
config BR2_PACKAGE_KODI_PVR_MYTHTV
	bool "kodi-pvr-mythtv"
	select BR2_PACKAGE_KODI_PLATFORM
	help
	  MythTV PVR for Kodi

	  https://github.com/kodi-pvr/pvr.mythtv
```

## package/kodi-pvr-nextpvr/Config.in
```kconfig
config BR2_PACKAGE_KODI_PVR_NEXTPVR
	bool "kodi-pvr-nextpvr"
	select BR2_PACKAGE_KODI_PLATFORM
	help
	  Kodi's NextPVR client addon

	  https://github.com/kodi-pvr/pvr.nextpvr
```

## package/kodi-pvr-njoy/Config.in
```kconfig
config BR2_PACKAGE_KODI_PVR_NJOY
	bool "kodi-pvr-njoy"
	select BR2_PACKAGE_KODI_PLATFORM
	help
	  Kodi's Njoy N7 client addon

	  https://github.com/kodi-pvr/pvr.njoy
```

## package/kodi-pvr-pctv/Config.in
```kconfig
config BR2_PACKAGE_KODI_PVR_PCTV
	bool "kodi-pvr-pctv"
	select BR2_PACKAGE_JSONCPP
	select BR2_PACKAGE_KODI_PLATFORM
	help
	  PCTV PVR client addon for Kodi

	  https://github.com/kodi-pvr/pvr.vdr.vnsi
```

## package/kodi-pvr-stalker/Config.in
```kconfig
config BR2_PACKAGE_KODI_PVR_STALKER
	bool "kodi-pvr-stalker"
	select BR2_PACKAGE_JSONCPP
	select BR2_PACKAGE_KODI_PLATFORM
	select BR2_PACKAGE_LIBXML2
	help
	  A PVR Client that connects Kodi to Stalker Middleware

	  https://github.com/kodi-pvr/pvr.stalker
```

## package/kodi-pvr-vbox/Config.in
```kconfig
config BR2_PACKAGE_KODI_PVR_VBOX
	bool "kodi-pvr-vbox"
	select BR2_PACKAGE_KODI_PLATFORM
	help
	  Kodi PVR addon for interfacing with VBox Communications XTi TV Gateway

	  https://github.com/kodi-pvr/pvr.vbox
```

## package/kodi-pvr-vdr-vnsi/Config.in
```kconfig
config BR2_PACKAGE_KODI_PVR_VDR_VNSI
	bool "kodi-pvr-vdr-vnsi"
	select BR2_PACKAGE_KODI_PLATFORM
	help
	  Kodi PVR addon VNSI

	  https://github.com/kodi-pvr/pvr.vdr.vnsi
```

## package/kodi-pvr-vuplus/Config.in
```kconfig
config BR2_PACKAGE_KODI_PVR_VUPLUS
	bool "kodi-pvr-vuplus"
	depends on BR2_TOOLCHAIN_GCC_AT_LEAST_4_9 # json-for-modern-cpp
	select BR2_PACKAGE_JSON_FOR_MODERN_CPP
	select BR2_PACKAGE_KODI_PLATFORM
	select BR2_PACKAGE_TINYXML
	help
	  VuPlus PVR client addon for Kodi

	  https://github.com/kodi-pvr/pvr.vuplus

comment "kodi-pvr-vuplus needs a toolchain w/ gcc >= 4.9"
	depends on !BR2_TOOLCHAIN_GCC_AT_LEAST_4_9
```

## package/kodi-pvr-wmc/Config.in
```kconfig
config BR2_PACKAGE_KODI_PVR_WMC
	bool "kodi-pvr-wmc"
	select BR2_PACKAGE_KODI_PLATFORM
	help
	  Kodi's Windows Media Center client addon

	  https://github.com/kodi-pvr/pvr.wmc
```

## package/kodi-screensaver-asteroids/Config.in
```kconfig
config BR2_PACKAGE_KODI_SCREENSAVER_ASTEROIDS
	bool "kodi-screensaver-asteroids"
	depends on BR2_PACKAGE_HAS_LIBGL
	select BR2_PACKAGE_GLM
	help
	  Asteroids screensaver for Kodi

	  https://github.com/xbmc/screensaver.asteroids

comment "kodi-screensaver-asteroids needs OpenGL"
	depends on !BR2_PACKAGE_HAS_LIBGL
```

## package/kodi-screensaver-asterwave/Config.in
```kconfig
config BR2_PACKAGE_KODI_SCREENSAVER_ASTERWAVE
	bool "kodi-screensaver-asterwave"
	depends on BR2_PACKAGE_HAS_LIBGL # libglu, libsoil
	select BR2_PACKAGE_LIBGLU
	select BR2_PACKAGE_LIBSOIL
	help
	  AsterWave screensaver for Kodi

	  https://github.com/xbmc/screensaver.asterwave

comment "kodi-screensaver-asterwave needs OpenGL"
	depends on !BR2_PACKAGE_HAS_LIBGL
```

## package/kodi-screensaver-biogenesis/Config.in
```kconfig
config BR2_PACKAGE_KODI_SCREENSAVER_BIOGENESIS
	bool "kodi-screensaver-biogenesis"
	depends on BR2_PACKAGE_KODI_GL
	help
	  BioGenesis screensaver for Kodi

	  https://github.com/notspiff/screensaver.biogenesis

comment "kodi-screensaver-biogenesis needs an OpenGL backend"
	depends on !BR2_PACKAGE_KODI_GL
```

## package/kodi-screensaver-cpblobs/Config.in
```kconfig
config BR2_PACKAGE_KODI_SCREENSAVER_CPBLOBS
	bool "kodi-screensaver-cpblobs"
	depends on BR2_PACKAGE_HAS_LIBGL # libsoil
	select BR2_PACKAGE_LIBSOIL
	help
	  CpBlobs screensaver for Kodi

	  https://github.com/xbmc/screensaver.cpblobs

comment "kodi-screensaver-cpblobs needs OpenGL"
	depends on !BR2_PACKAGE_HAS_LIBGL
```

## package/kodi-screensaver-crystalmorph/Config.in
```kconfig
config BR2_PACKAGE_KODI_SCREENSAVER_CRYSTALMORPH
	bool "kodi-screensaver-crystalmorph"
	depends on BR2_PACKAGE_HAS_LIBGL # libglu
	help
	  CrystalMorph screensaver for Kodi

	  https://github.com/notspiff/screensaver.crystalmorph

comment "kodi-screensaver-crystalmorph needs OpenGL"
	depends on !BR2_PACKAGE_HAS_LIBGL
```

## package/kodi-screensaver-greynetic/Config.in
```kconfig
config BR2_PACKAGE_KODI_SCREENSAVER_GREYNETIC
	bool "kodi-screensaver-greynetic"
	depends on BR2_PACKAGE_HAS_LIBGL
	help
	  Greynetic screensaver for Kodi

	  https://github.com/xbmc/screensaver.greynetic

comment "kodi-screensaver-greynetic needs OpenGL"
	depends on !BR2_PACKAGE_HAS_LIBGL
```

## package/kodi-screensaver-matrixtrails/Config.in
```kconfig
config BR2_PACKAGE_KODI_SCREENSAVER_MATRIXTRAILS
	bool "kodi-screensaver-matrixtrails"
	depends on BR2_PACKAGE_KODI_GL # libsoil
	select BR2_PACKAGE_LIBSOIL
	help
	  Matrix trails screensaver for Kodi

	  https://github.com/notspiff/screensaver.matrixtrails

comment "matrixtrails needs an OpenGL backend"
	depends on !BR2_PACKAGE_KODI_GL
```

## package/kodi-screensaver-pingpong/Config.in
```kconfig
config BR2_PACKAGE_KODI_SCREENSAVER_PINGPONG
	bool "kodi-screensaver-pingpong"
	depends on BR2_PACKAGE_HAS_LIBGL
	help
	  Ping-pong screensaver for Kodi

	  https://github.com/xbmc/screensaver.pingpong

comment "kodi-screensaver-pingpong needs OpenGL"
	depends on !BR2_PACKAGE_HAS_LIBGL
```

## package/kodi-screensaver-planestate/Config.in
```kconfig
config BR2_PACKAGE_KODI_SCREENSAVER_PLANESTATE
	bool "kodi-screensaver-planestate"
	depends on BR2_PACKAGE_HAS_LIBGL # libsoil
	select BR2_PACKAGE_LIBSOIL
	help
	  PlaneState screensaver for Kodi

	  https://github.com/notspiff/screensaver.planestate

comment "kodi-screensaver-planestate needs OpenGL"
	depends on !BR2_PACKAGE_HAS_LIBGL
```

## package/kodi-screensaver-pyro/Config.in
```kconfig
config BR2_PACKAGE_KODI_SCREENSAVER_PYRO
	bool "kodi-screensaver-pyro"
	depends on BR2_PACKAGE_HAS_LIBGL
	help
	  Pyro screensaver for Kodi

	  https://github.com/xbmc/screensaver.pyro

comment "kodi-screensaver-pyro needs OpenGL"
	depends on !BR2_PACKAGE_HAS_LIBGL
```

## package/kodi-screensaver-rsxs/Config.in
```kconfig
config BR2_PACKAGE_KODI_SCREENSAVER_RSXS
	bool "kodi-screensaver-rsxs"
	depends on BR2_PACKAGE_HAS_LIBGL # libglu
	select BR2_PACKAGE_BZIP2
	select BR2_PACKAGE_GLI
	select BR2_PACKAGE_GLM
	select BR2_PACKAGE_JPEG
	select BR2_PACKAGE_LIBPNG
	select BR2_PACKAGE_LIBTOOL
	select BR2_PACKAGE_TIFF
	help
	  RSXS screensaver add-ons for Kodi

	  https://github.com/xbmc/screensavers.rsxs

comment "kodi-screensaver-rsxs needs an OpenGL backend"
	depends on !BR2_PACKAGE_HAS_LIBGL
```

## package/kodi-screensaver-stars/Config.in
```kconfig
config BR2_PACKAGE_KODI_SCREENSAVER_STARS
	bool "kodi-screensaver-stars"
	depends on BR2_PACKAGE_HAS_LIBGL
	help
	  Starfield screensaver for Kodi

	  https://github.com/notspiff/screensaver.stars

comment "kodi-screensaver-stars needs OpenGL"
	depends on !BR2_PACKAGE_HAS_LIBGL
```

## package/kodi-skin-confluence/Config.in
```kconfig
config BR2_PACKAGE_KODI_SKIN_CONFLUENCE
	bool "kodi-skin-confluence"
	help
	  Kodi confluence skin

	  https://github.com/xbmc/skin.confluence
```

## package/kodi-vfs-rar/Config.in
```kconfig
config BR2_PACKAGE_KODI_VFS_RAR
	bool "kodi-vfs-rar"
	select BR2_PACKAGE_TINYXML
	help
	  RAR VFS addon for Kodi

	  https://github.com/xbmc/vfs.rar
```

## package/kodi-vfs-sftp/Config.in
```kconfig
config BR2_PACKAGE_KODI_VFS_SFTP
	bool "kodi-vfs-sftp"
	select BR2_PACKAGE_KODI_PLATFORM
	select BR2_PACKAGE_LIBPLATFORM
	select BR2_PACKAGE_LIBSSH
	help
	  SFTP VFS addon for Kodi

	  https://github.com/xbmc/vfs.sftp
```

## package/kodi-visualisation-fishbmc/Config.in
```kconfig
config BR2_PACKAGE_KODI_VISUALISATION_FISHBMC
	bool "kodi-visualisation-fishbmc"
	help
	  Fische visualiser for Kodi

	  https://github.com/xbmc/visualization.fishbmc
```
