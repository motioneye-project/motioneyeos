## package/kvm-unit-tests/Config.in
```kconfig
config BR2_PACKAGE_KVM_UNIT_TESTS_ARCH_SUPPORTS
	bool
	# On ARM, it uses virtualization extensions
	default y if BR2_cortex_a7 || BR2_cortex_a12 || \
		BR2_cortex_a15 || BR2_cortex_a15_a7 || \
		BR2_cortex_a17 || BR2_cortex_a17_a7
	default y if BR2_i386 || BR2_x86_64
	default y if BR2_powerpc64 || BR2_powerpc64le

config BR2_PACKAGE_KVM_UNIT_TESTS
	bool "kvm-unit-tests"
	depends on BR2_PACKAGE_KVM_UNIT_TESTS_ARCH_SUPPORTS
	# on i386 and x86-64, __builtin_reachable is used, so we need
	# gcc 4.5 at least. on i386, we use the target gcc, while on
	# x86-64 we use the host gcc (see .mk file for details)
	depends on BR2_TOOLCHAIN_GCC_AT_LEAST_4_5 || !BR2_i386
	depends on BR2_HOST_GCC_AT_LEAST_4_5 || !BR2_x86_64
	select BR2_HOSTARCH_NEEDS_IA32_COMPILER if BR2_x86_64=y
	help
	  kvm-unit-tests is a project as old as KVM. As its name
	  suggests, it's purpose is to provide unit tests for KVM. The
	  unit tests are tiny guest operating systems that generally
	  execute only tens of lines of C and assembler test code in
	  order to obtain its PASS/FAIL result. Unit tests provide KVM
	  and virt hardware functional testing by targeting the
	  features through minimal implementations of their use per
	  the hardware specification. The simplicity of unit tests
	  make them easy to verify they are correct, easy to maintain,
	  and easy to use in timing measurements. Unit tests are also
	  often used for quick and dirty bug reproducers. The
	  reproducers may then be kept as regression tests.  It's
	  strongly encouraged that patches implementing new KVM
	  features are submitted with accompanying unit tests.

	  http://www.linux-kvm.org/page/KVM-unit-tests

comment "kvm-unit-tests needs a toolchain w/ gcc >= 4.5"
	depends on BR2_i386
	depends on !BR2_TOOLCHAIN_GCC_AT_LEAST_4_5

comment "kvm-unit-tests needs a host gcc >= 4.5"
	depends on BR2_x86_64
	depends on !BR2_HOST_GCC_AT_LEAST_4_5
```

## package/kvmtool/Config.in
```kconfig
config BR2_PACKAGE_KVMTOOL
	bool "kvmtool"
	depends on BR2_USE_MMU # guest simple init fork()
	# No MADV_HUGEPAGE define in uClibc(-ng)
	depends on (BR2_TOOLCHAIN_USES_GLIBC || BR2_TOOLCHAIN_USES_MUSL)
	# Only mips big-endian seems to be supported (build breaks)
	# Should work on powerpc64 but the build breaks with missing types
	depends on BR2_aarch64 || BR2_arm || BR2_armeb || BR2_i386 || \
		BR2_mips || BR2_x86_64
	# libfdt is only required for DT architectures...
	# ...but it's not able to build for static targets
	depends on !(BR2_STATIC_LIBS && (BR2_aarch64 || BR2_arm || BR2_armeb))
	select BR2_PACKAGE_DTC if BR2_aarch64 || BR2_arm || BR2_armeb
	help
	  kvmtool is a lightweight tool for hosting KVM guests.
	  As a pure virtualization tool it only supports guests using
	  the same architecture, though it supports running 32-bit guests
	  on those 64-bit architectures that allow this.

	  https://git.kernel.org/cgit/linux/kernel/git/will/kvmtool.git/tree/README

comment "kvmtool needs a (e)glibc or musl toolchain"
	depends on BR2_USE_MMU
	depends on BR2_i386 || BR2_mips || BR2_x86_64
	depends on !(BR2_TOOLCHAIN_USES_GLIBC || BR2_TOOLCHAIN_USES_MUSL)

comment "kvmtool needs a (e)glibc or musl toolchain w/ dynamic library"
	depends on BR2_USE_MMU
	depends on BR2_aarch64 || BR2_arm || BR2_armeb
	depends on !(BR2_TOOLCHAIN_USES_GLIBC || BR2_TOOLCHAIN_USES_MUSL) || \
		BR2_STATIC_LIBS
```

## package/kyua/Config.in
```kconfig
config BR2_PACKAGE_KYUA
	bool "kyua"
	depends on BR2_INSTALL_LIBSTDCPP
	depends on BR2_PACKAGE_HAS_LUAINTERPRETER # lutok
	depends on !BR2_PACKAGE_LUAJIT # lutok
	depends on !BR2_STATIC_LIBS # lutok
	depends on BR2_USE_MMU # atf
	select BR2_PACKAGE_ATF
	select BR2_PACKAGE_LUTOK
	select BR2_PACKAGE_SQLITE
	help
	  Kyua is a testing framework for infrastructure software,
	  originally designed to equip BSD-based operating systems
	  with a test suite. This means that Kyua is lightweight
	  and simple, and that Kyua integrates well with various build
	  systems and continuous integration frameworks.

	  https://github.com/jmmv/kyua

comment "kyua needs a toolchain w/ C++, dynamic library and full Lua"
	depends on !BR2_INSTALL_LIBSTDCPP || BR2_PACKAGE_LUAJIT || BR2_STATIC_LIBS
	depends on BR2_PACKAGE_HAS_LUAINTERPRETER
	depends on BR2_USE_MMU
```

## package/l2tp/Config.in
```kconfig
config BR2_PACKAGE_L2TP
	bool "l2tp"
	help
	  Layer 2 Tunnelling Protocol (RFC2661).

	  http://sourceforge.net/projects/l2tpd/
```

## package/lapack/Config.in
```kconfig
comment "lapack/blas needs a toolchain w/ fortran"
	depends on !(BR2_powerpc && BR2_TOOLCHAIN_USES_UCLIBC)
	depends on !BR2_TOOLCHAIN_HAS_FORTRAN

config BR2_PACKAGE_LAPACK
	bool "lapack/blas"
	depends on BR2_TOOLCHAIN_HAS_FORTRAN
	# _fpu_control is used on PowerPC, but not available with uClibc
	depends on !(BR2_powerpc && BR2_TOOLCHAIN_USES_UCLIBC)
	help
	  LAPACK and BLAS FORTRAN implementation. This package
	  installs two libraries: libblas and liblapack.

	  http://www.netlib.org/lapack/

config BR2_PACKAGE_LAPACK_COMPLEX
	bool "Complex/Complex16 support"
	default y
	depends on BR2_PACKAGE_LAPACK
	help
	  Builds support for COMPLEX and COMPLEX16 data types.
```

## package/latencytop/Config.in
```kconfig
config BR2_PACKAGE_LATENCYTOP
	bool "latencytop"
	depends on BR2_USE_WCHAR
	select BR2_PACKAGE_NCURSES
	select BR2_PACKAGE_LIBGLIB2
	help
	  There are many types and causes of latency. LatencyTOP
	  focuses on the type of latency that causes skips in audio,
	  stutters in your desktop experience or that overloads your
	  server (while you have plenty of CPU power left).

	  LatencyTOP focuses on the cases where the applications want
	  to run and execute useful code, but there's some resource
	  that's not currently available (and the kernel then blocks
	  the process). This is done both on a system level and on a
	  per process level, so that you can see what's happening to
	  the system, and which process is suffering and/or causing
	  the delays.

	  http://www.latencytop.org

comment "latencytop requires a toolchain with WCHAR support"
	depends on !BR2_USE_WCHAR
```

## package/lbase64/Config.in
```kconfig
config BR2_PACKAGE_LBASE64
	bool "lbase64"
	help
	  A base64 library for Lua

	  http://webserver2.tecgraf.puc-rio.br/~lhf/ftp/lua/#lbase64
```

## package/lbreakout2/Config.in
```kconfig
config BR2_PACKAGE_LBREAKOUT2
	bool "LBreakout2"
	select BR2_PACKAGE_SDL
	select BR2_PACKAGE_LIBPNG
	select BR2_PACKAGE_GETTEXT if BR2_NEEDS_GETTEXT_IF_LOCALE
	help
	  LBreakout2 is the successor to LBreakout, a breakout-style arcade
	  game in the manner of Arkanoid. Requires SDL, libpng, and
	  optionnally SDL_mixer/SDL_net.
	  A display with minimum 640x480 resolution, a keyboard and a mouse
	  are recommanded.

	  http://lgames.sourceforge.net/index.php?project=LBreakout2

if BR2_PACKAGE_LBREAKOUT2

config BR2_PACKAGE_LBREAKOUT2_AUDIO
	bool "audio support"
	default y
	select BR2_PACKAGE_SDL_MIXER
	help
	  Activates audio support in LBreakout2. Will add SDL_mixer.

config BR2_PACKAGE_LBREAKOUT2_NET
	bool "network support"
	default y
	select BR2_PACKAGE_SDL_NET
	help
	  Activates network support LBreakout2. Will add SDL_net.

endif
```

## package/lcdapi/Config.in
```kconfig
config BR2_PACKAGE_LCDAPI
	bool "lcdapi"
	depends on BR2_INSTALL_LIBSTDCPP
	depends on BR2_TOOLCHAIN_HAS_THREADS
	help
	  C++ client API for lcdproc, containing a set of widget classes.

	  https://github.com/spdawson/lcdapi

comment "lcdapi needs a toolchain w/ C++, threads"
	depends on !BR2_INSTALL_LIBSTDCPP || !BR2_TOOLCHAIN_HAS_THREADS
```

## package/lcdproc/Config.in
```kconfig
config BR2_PACKAGE_LCDPROC
	bool "lcdproc"
	depends on BR2_USE_MMU # fork()
	select BR2_PACKAGE_FREETYPE
	select BR2_PACKAGE_NCURSES
	select BR2_PACKAGE_ZLIB
	help
	  LCD display driver daemon and clients

	  http://lcdproc.org/

if BR2_PACKAGE_LCDPROC

config BR2_PACKAGE_LCDPROC_DRIVERS
	string "List of drivers to build"
	default "all"
	help
	  Specify a comma-separated list of lcdproc drivers to be built

config BR2_PACKAGE_LCDPROC_MENUS
	bool "Menu support"
	help
	  Enable support for lcdproc menus

endif
```

## package/leafnode2/Config.in
```kconfig
config BR2_PACKAGE_LEAFNODE2
	bool "leafnode2"
	depends on BR2_USE_MMU # fork()
	select BR2_PACKAGE_PCRE
	help
	  Leafnode-2 is a store-and-forward NNTP (or Usenet) proxy
	  server designed for small sites with just a few active
	  newsgroups.

	  Leafnode-2 needs inetd, check chapter 14 of the documentation
	  at:
	  http://krusty.dt.e-technik.tu-dortmund.de/~ma/leafnode/beta/leafnode-readme.txt

	  For example, you can add this line to inetd.conf:
	  nntp    stream  tcp     nowait  news    /usr/sbin/leafnode

	  http://krusty.dt.e-technik.tu-dortmund.de/~ma/leafnode/beta
```

## package/leafpad/Config.in
```kconfig
config BR2_PACKAGE_LEAFPAD
	bool "leafpad"
	depends on BR2_PACKAGE_LIBGTK2
	help
	  GTK+ based simple text editor

	  http://savannah.nongnu.org/download/leafpad
```

## package/lensfun/Config.in
```kconfig
config BR2_PACKAGE_LENSFUN
	bool "lensfun"
	depends on BR2_INSTALL_LIBSTDCPP
	depends on BR2_USE_WCHAR # libglib2
	depends on BR2_TOOLCHAIN_HAS_THREADS # libglib2
	depends on BR2_USE_MMU # libglib2
	select BR2_PACKAGE_LIBGLIB2
	help
	  Lensfun itself is only a library for correcting several
	  artefacts and a database for storing lens profiles. To
	  actually use Lensfun to process your images you need an
	  image editing application with Lensfun support.

	  http://lensfun.sourceforge.net

if BR2_PACKAGE_LENSFUN

config BR2_PACKAGE_LENSFUN_TOOLS
	bool "lensfun tools"
	select BR2_PACKAGE_LIBPNG
	help
	  Build 'lenstool'.

endif

comment "lensfun needs a toolchain w/ C++, threads, wchar"
	depends on BR2_USE_MMU
	depends on !BR2_INSTALL_LIBSTDCPP || !BR2_TOOLCHAIN_HAS_THREADS \
		|| !BR2_USE_WCHAR
```
