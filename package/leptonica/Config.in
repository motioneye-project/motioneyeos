## package/leptonica/Config.in
```kconfig
config BR2_PACKAGE_LEPTONICA
	bool "leptonica"
	help
	  Leptonica is an image processing and image analysis library.

	  http://www.leptonica.org/
```

## package/less/Config.in
```kconfig
config BR2_PACKAGE_LESS
	bool "less"
	depends on BR2_PACKAGE_BUSYBOX_SHOW_OTHERS
	select BR2_PACKAGE_NCURSES
	help
	  Excellent text file viewer.

	  http://www.greenwoodsoftware.com/
```

## package/lesstif/Config.in
```kconfig
config BR2_PACKAGE_LESSTIF
	bool "lesstif"
	depends on BR2_PACKAGE_XORG7
	select BR2_PACKAGE_XLIB_LIBXT
	select BR2_PACKAGE_XLIB_LIBXEXT
	select BR2_PACKAGE_FREETYPE
	depends on BR2_USE_MMU # fork()
	help
	  lesstif is the Hungry Programmers' version of OSF/Motif

	  http://lesstif.sourceforge.net/
```

## package/let-me-create/Config.in
```kconfig
comment "let-me-create needs a toolchain w/ C++, threads, dynamic library"
	depends on !BR2_INSTALL_LIBSTDCPP || !BR2_TOOLCHAIN_HAS_THREADS \
		|| BR2_STATIC_LIBS

config BR2_PACKAGE_LET_ME_CREATE
	bool "let-me-create"
	# build issues in static libs configuration
	# see https://github.com/CreatorDev/LetMeCreate/issues/28
	depends on !BR2_STATIC_LIBS
	depends on BR2_INSTALL_LIBSTDCPP
	depends on BR2_TOOLCHAIN_HAS_THREADS
	help
	  This library is collection of small wrappers for some
	  interfaces on the Creator Ci40 board. It aims at making
	  easier to develop on this platform. It also provides
	  wrappers for a few clicks.

	  https://github.com/CreatorDev/LetMeCreate

if BR2_PACKAGE_LET_ME_CREATE

config BR2_PACKAGE_LET_ME_CREATE_EXAMPLES
	bool "Build and install examples"
	help
	  Build and install examples

endif
```

## package/leveldb/Config.in
```kconfig
config BR2_PACKAGE_LEVELDB
	bool "leveldb"
	depends on BR2_INSTALL_LIBSTDCPP
	depends on BR2_TOOLCHAIN_GCC_AT_LEAST_4_8 # C++11
	depends on BR2_TOOLCHAIN_HAS_THREADS
	help
	  LevelDB is a fast key-value storage library written at Google
	  that provides an ordered mapping from string keys to string
	  values.

	  https://github.com/google/leveldb

comment "leveldb needs a toolchain w/ C++, threads, gcc >= 4.8"
	depends on !BR2_INSTALL_LIBSTDCPP || \
		!BR2_TOOLCHAIN_HAS_THREADS || !BR2_TOOLCHAIN_GCC_AT_LEAST_4_8
```

## package/lft/Config.in
```kconfig
config BR2_PACKAGE_LFT
	bool "lft"
	select BR2_PACKAGE_LIBPCAP
	help
	  LFT, short for Layer Four Traceroute, is a sort of
	  'traceroute' that often works much faster (than the
	  commonly-used Van Jacobson method) and goes through many
	  configurations of packet-filters (firewalls).

	  http://pwhois.org/lft/
```

## package/lftp/Config.in
```kconfig
config BR2_PACKAGE_LFTP
	bool "lftp"
	depends on BR2_USE_WCHAR
	depends on BR2_INSTALL_LIBSTDCPP
	depends on BR2_USE_MMU # fork()
	select BR2_PACKAGE_READLINE
	select BR2_PACKAGE_ZLIB
	select BR2_PACKAGE_OPENSSL if !BR2_PACKAGE_GNUTLS
	help
	  LFTP is a sophisticated ftp/http client, and a file transfer program
	  supporting a number of network protocols. Like BASH, it has job
	  control and uses the readline library for input. It has bookmarks,
	  a built-in mirror command, and can transfer several files in parallel.
	  It was designed with reliability in mind.

	  http://lftp.yar.ru/

if BR2_PACKAGE_LFTP

comment "Commands"

config BR2_PACKAGE_LFTP_CMD_MIRROR
	bool "Mirror command"
	default y
	help
	  Enable mirror command

config BR2_PACKAGE_LFTP_CMD_SLEEP
	bool "Sleep command"
	default y
	help
	  Enable sleep command

config BR2_PACKAGE_LFTP_CMD_TORRENT
	bool "Torrent command"
	help
	  Enable torrent command

comment "Protocols"

config BR2_PACKAGE_LFTP_PROTO_FISH
	bool "FISH protocol"
	help
	  Enable FISH protocol

config BR2_PACKAGE_LFTP_PROTO_FTP
	bool "FTP protocol"
	default y
	help
	  Enable FTP protocol

config BR2_PACKAGE_LFTP_PROTO_HTTP
	bool "HTTP protocol"
	help
	  Enable HTTP protocol

config BR2_PACKAGE_LFTP_PROTO_SFTP
	bool "SFTP protocol"
	help
	  Enable SFTP protocol

endif  # BR2_PACKAGE_LFTP

comment "lftp requires a toolchain w/ C++, wchar"
	depends on BR2_USE_MMU
	depends on !(BR2_USE_WCHAR && BR2_INSTALL_LIBSTDCPP)
```

## package/libaacs/Config.in
```kconfig
config BR2_PACKAGE_LIBAACS
	bool "libaacs"
	depends on BR2_PACKAGE_LIBGPG_ERROR_ARCH_SUPPORTS # libgcrypt
	depends on !BR2_STATIC_LIBS
	select BR2_PACKAGE_LIBGCRYPT
	help
	  libaacs is a research project to implement the Advanced Access
	  Content System specification.
	  NB: this project doesn't offer any key or certificate that
	  could be used to decode encrypted copyrighted material.

	  http://www.videolan.org/developers/libaacs.html

comment "libaacs needs a toolchain w/ dynamic library"
	depends on BR2_STATIC_LIBS
```

## package/libaio/Config.in
```kconfig
config BR2_PACKAGE_LIBAIO_ARCH_SUPPORTS
	bool
	default y if BR2_aarch64 || BR2_arm || BR2_armeb || BR2_i386 || \
		BR2_m68k || BR2_mips || BR2_mipsel || BR2_powerpc || \
		BR2_powerpc64 || BR2_powerpc64le || BR2_sparc || \
		BR2_x86_64

config BR2_PACKAGE_LIBAIO
	bool "libaio"
	depends on BR2_PACKAGE_LIBAIO_ARCH_SUPPORTS
	help
	  Library for doing asynchronous I/O
```

## package/libamcodec/Config.in
```kconfig
comment "libamcodec needs a toolchain w/ threads, dynamic library"
	depends on BR2_arm || BR2_aarch64
	depends on !BR2_TOOLCHAIN_HAS_THREADS || BR2_STATIC_LIBS

config BR2_PACKAGE_LIBAMCODEC
	bool "libamcodec"
	depends on BR2_arm || BR2_aarch64
	depends on BR2_TOOLCHAIN_HAS_THREADS # alsa-lib
	depends on !BR2_STATIC_LIBS # dlfcn.h
	select BR2_PACKAGE_ALSA_LIB
	help
	    Interface library for Amlogic media codecs

	    https://github.com/mdrjr/c2_aml_libs.git
```

## package/libao/Config.in
```kconfig
config BR2_PACKAGE_LIBAO
	bool "libao"
	help
	  Libao is a cross-platform audio library that allows programs
	  to output audio using a simple API on a wide variety of platforms.

	  http://www.xiph.org/ao/
```

## package/libapparmor/Config.in
```kconfig
config BR2_PACKAGE_LIBAPPARMOR
	bool "libapparmor"
	depends on BR2_TOOLCHAIN_HAS_SYNC_4
	depends on BR2_TOOLCHAIN_HAS_THREADS
	depends on BR2_TOOLCHAIN_HEADERS_AT_LEAST_3_16
	help
	  AppArmor is an effective and easy-to-use Linux application
	  security system. AppArmor proactively protects the operating
	  system and applications from external or internal threats,
	  even zero-day attacks, by enforcing good behavior and
	  preventing even unknown application flaws from being
	  exploited.

	  This package installs only the library.

	  http://wiki.apparmor.net

comment "libapparmor needs a toolchain w/ headers >= 3.16, threads"
	depends on BR2_TOOLCHAIN_HAS_SYNC_4
	depends on !BR2_TOOLCHAIN_HAS_THREADS \
		|| !BR2_TOOLCHAIN_HEADERS_AT_LEAST_3_16
```

## package/libarchive/Config.in
```kconfig
comment "libarchive needs a toolchain w/ wchar"
	depends on !BR2_USE_WCHAR

config BR2_PACKAGE_LIBARCHIVE
	bool "libarchive"
	depends on BR2_USE_WCHAR
	help
	  Libarchive is a reusable C library for reading and writing a
	  variety of streaming archive formats.

	  http://www.libarchive.org/

if BR2_PACKAGE_LIBARCHIVE

config BR2_PACKAGE_LIBARCHIVE_BSDTAR
	bool "bsdtar"
	help
	  The 'bsdtar' program is a full-featured 'tar'
	  replacement built on libarchive.

config BR2_PACKAGE_LIBARCHIVE_BSDCPIO
	bool "bsdcpio"
	help
	  The 'bsdcpio' program is a different interface to
	  essentially the same functionality as 'bsdtar'.

endif
```

## package/libargon2/Config.in
```kconfig
config BR2_PACKAGE_LIBARGON2
	bool "libargon2"
	depends on BR2_USE_MMU
	depends on !BR2_STATIC_LIBS
	help
	  A modern password hashing algorithm

	  https://password-hashing.net/#argon2

comment "libargon needs a toolchain w/ dynamic library"
	depends on BR2_USE_MMU
	depends on BR2_STATIC_LIBS
```

## package/libargtable2/Config.in
```kconfig
config BR2_PACKAGE_LIBARGTABLE2
	bool "libargtable2"
	help
	  A greatly simplified and yet quite robust argument parsing
	  set of library calls.

	  http://argtable.sourceforge.net/
```

## package/libart/Config.in
```kconfig
config BR2_PACKAGE_LIBART
	bool "libart"
	default n
	help
	  Libart is a library for high-performance 2D graphics. It
	  supports a very powerful imaging model, basically the same
	  as SVG and the Java 2D API. It includes all PostScript
	  imaging operations, and adds antialiasing and
	  alpha-transparency. It is also highly tuned for incremental
	  rendering. It contains data structures and algorithms suited
	  to rapid, precise computation of Region of Interest, and a
	  two-phase rendering pipeline optimized for interactive
	  display.

	  http://www.levien.com/libart/
```

## package/libasplib/Config.in
```kconfig
config BR2_PACKAGE_LIBASPLIB
	bool "libasplib"
	depends on BR2_INSTALL_LIBSTDCPP
	help
	  asplib (Achim's Signal Processing LIBrary), is a small and
	  lightweight C++ library for digital signal processing.

	  https://github.com/AchimTuran/asplib

comment "asplib needs a toolchain w/ C++"
	depends on !BR2_INSTALL_LIBSTDCPP
```

## package/libass/Config.in
```kconfig
config BR2_PACKAGE_LIBASS
	bool "libass"
	select BR2_PACKAGE_FREETYPE
	select BR2_PACKAGE_LIBFRIBIDI
	help
	  libass is a portable subtitle renderer for the ASS/SSA
	  (Advanced Substation Alpha/Substation Alpha) subtitle format

	  https://github.com/libass/libass
```

## package/libassuan/Config.in
```kconfig
config BR2_PACKAGE_LIBASSUAN
	bool "libassuan"
	depends on BR2_PACKAGE_LIBGPG_ERROR_ARCH_SUPPORTS # libgpg-error
	depends on BR2_USE_MMU # fork()
	select BR2_PACKAGE_LIBGPG_ERROR
	help
	  Libassuan is a small library implementing the so-called
	  Assuan protocol.

	  This protocol is used for IPC between most newer GnuPG
	  components. Both, server and client side functions are
	  provided.

	  http://www.gnupg.org/related_software/libassuan/
```

## package/libatasmart/Config.in
```kconfig
config BR2_PACKAGE_LIBATASMART
	bool "libatasmart"
	depends on BR2_PACKAGE_HAS_UDEV # libudev is configure dependency
	help
	  The libatasmart package is a disk reporting library.
	  It only supports a subset of the ATA S.M.A.R.T. functionality.

	  http://0pointer.de/blog/projects/being-smart.html

comment "libatasmart requires udev to be enabled"
	depends on !BR2_PACKAGE_HAS_UDEV
```

## package/libatomic_ops/Config.in
```kconfig
config BR2_PACKAGE_LIBATOMIC_OPS_ARCH_SUPPORTS
	bool
	default y if BR2_arm || BR2_armeb || BR2_aarch64 || BR2_i386 || BR2_sparc || BR2_sparc64 || BR2_powerpc || BR2_powerpc64 || BR2_powerpc64le || BR2_x86_64 || BR2_mips || BR2_mipsel || BR2_mips64 || BR2_mips64el
	# Unsupported for MIPS R6
	depends on !BR2_MIPS_CPU_MIPS32R6 && !BR2_MIPS_CPU_MIPS64R6

config BR2_PACKAGE_LIBATOMIC_OPS
	bool "libatomic_ops"
	depends on BR2_PACKAGE_LIBATOMIC_OPS_ARCH_SUPPORTS
	help
	  Atomic operations library

	  https://github.com/ivmai/libatomic_ops
```

## package/libavl/Config.in
```kconfig
config BR2_PACKAGE_LIBAVL
	bool "libavl"
	depends on !BR2_STATIC_LIBS
	help
	  AVLTree is a small implementation of AVL trees for the C
	  programming language.

	  https://packages.debian.org/buster/libavl1

	  This is not the GNU AVL library by Ben Pfaff.

comment "libavl needs a toolchain w/ dynamic library"
	depends on BR2_STATIC_LIBS
```

## package/libb64/Config.in
```kconfig
config BR2_PACKAGE_LIBB64
	bool "libb64"
	help
	  libb64 is a library of ANSI C routines for fast encoding
	  and decoding of data into and from a base64-encoded format.
	  C++ wrappers are included, as well as the source code for
	  standalone encoding and decoding executables.

	  Base64 uses a subset of displayable ASCII characters, and is
	  therefore a useful encoding for storing binary data in a text
	  file, such as XML, or sending binary data over text-only
	  email.

	  http://libb64.sourceforge.net
```

## package/libbdplus/Config.in
```kconfig
config BR2_PACKAGE_LIBBDPLUS
	bool "libbdplus"
	depends on BR2_PACKAGE_LIBGPG_ERROR_ARCH_SUPPORTS # libgcrypt
	depends on BR2_TOOLCHAIN_HAS_THREADS
	depends on !BR2_STATIC_LIBS
	select BR2_PACKAGE_LIBGCRYPT
	help
	  libbdplus is a research project to implement the BD+ System
	  Specifications.
	  This research project provides, through an open-source
	  library, a way to understand how the BD+ works.
	  NB: this project doesn't offer any key, configuration file or
	  certificate that could be used to decode encrypted copyrighted
	  material.

	  http://www.videolan.org/developers/libbdplus.html

comment "libbdplus needs a toolchain w/ threads, dynamic library"
	depends on BR2_PACKAGE_LIBGPG_ERROR_ARCH_SUPPORTS
	depends on !BR2_TOOLCHAIN_HAS_THREADS || BR2_STATIC_LIBS
```

## package/libbeecrypt/Config.in
```kconfig
config BR2_PACKAGE_LIBBEECRYPT
	bool "libbeecrypt"
	default n
	help
	  Beecrypt is a general-purpose cryptography library.

	  http://rpm5.org
```
