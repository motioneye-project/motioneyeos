## package/libbluray/Config.in
```kconfig
config BR2_PACKAGE_LIBBLURAY
	bool "libbluray"
	depends on BR2_TOOLCHAIN_HAS_THREADS
	depends on !BR2_STATIC_LIBS
	help
	  libbluray is a client library for accessing bluray disks.

	  http://www.videolan.org/developers/libbluray.html

comment "libbluray needs a toolchain w/ threads, dynamic library"
	depends on !BR2_TOOLCHAIN_HAS_THREADS || BR2_STATIC_LIBS
```

## package/libbroadvoice/Config.in
```kconfig
config BR2_PACKAGE_LIBBROADVOICE
	bool "libbroadvoice"
	# broken with gcc <= 4.8 on arc
	# https://gcc.gnu.org/bugzilla/show_bug.cgi?id=59049
	depends on !BR2_arc || BR2_TOOLCHAIN_GCC_AT_LEAST_4_9
	help
	  broadvoice - a library for the BroadVoice 16 and 32 speech
	  codecs

	  https://www.broadcom.com/support/broadvoice
```

## package/libbsd/Config.in
```kconfig
config BR2_PACKAGE_LIBBSD_ARCH_SUPPORTS
	bool
	default y
	# libbsd does not support those architectures (see src/local-elf.h)
	depends on !BR2_microblaze
	depends on !BR2_arc
	depends on !BR2_xtensa
	# uClibc on noMMU doesn't provide __register_atfork()
	depends on !(BR2_TOOLCHAIN_USES_UCLIBC && !BR2_USE_MMU)

config BR2_PACKAGE_LIBBSD
	bool "libbsd"
	depends on BR2_PACKAGE_LIBBSD_ARCH_SUPPORTS
	depends on BR2_TOOLCHAIN_HAS_THREADS
	depends on BR2_USE_WCHAR
	help
	  This library provides useful functions commonly found on BSD
	  systems, and lacking on others like GNU systems, thus making
	  it easier to port projects with strong BSD origins, without
	  needing to embed the same code over and over again on each
	  project.

	  http://libbsd.freedesktop.org/

comment "libbsd needs a toolchain w/ threads, wchar"
	depends on BR2_PACKAGE_LIBBSD_ARCH_SUPPORTS
	depends on !BR2_TOOLCHAIN_HAS_THREADS || !BR2_USE_WCHAR
```

## package/libbson/Config.in
```kconfig
config BR2_PACKAGE_LIBBSON
	bool "libbson"
	depends on BR2_TOOLCHAIN_HAS_THREADS
	help
	  libbson is a library providing useful routines related to
	  building, parsing, and iterating BSON documents.

comment "libbson needs a toolchain w/ threads"
	depends on !BR2_TOOLCHAIN_HAS_THREADS
```

## package/libcamera/Config.in
```kconfig
config BR2_PACKAGE_LIBCAMERA
	bool "libcamera"
	depends on BR2_INSTALL_LIBSTDCPP
	depends on BR2_TOOLCHAIN_HAS_THREADS
	# C++11 + https://gcc.gnu.org/bugzilla/show_bug.cgi?id=54316
	depends on BR2_TOOLCHAIN_GCC_AT_LEAST_5
	depends on BR2_PACKAGE_HAS_UDEV
	help
	  libcamera provides a software stack to support
	  complex devices that need heavy hardware image
	  processing operations.

	  http://www.libcamera.org/

comment "libcamera needs udev and a toolchain w/ C++, threads, gcc >= 5"
	depends on !BR2_INSTALL_LIBSTDCPP || !BR2_TOOLCHAIN_HAS_THREADS || \
		!BR2_TOOLCHAIN_GCC_AT_LEAST_5 || !BR2_PACKAGE_HAS_UDEV
```

## package/libcap-ng/Config.in
```kconfig
config BR2_PACKAGE_LIBCAP_NG
	bool "libcap-ng"
	depends on !BR2_TOOLCHAIN_EXTERNAL_CODESOURCERY_NIOSII # triggers compiler bug
	help
	  The libcap-ng library is intended to make programming with
	  posix capabilities much easier than the traditional libcap
	  library. It includes utilities that can analyse all currently
	  running applications and print out any capabilities and whether
	  or not it has an open ended bounding set.

	  http://people.redhat.com/sgrubb/libcap-ng/
```

## package/libcap/Config.in
```kconfig
config BR2_PACKAGE_LIBCAP
	bool "libcap"
	help
	  This library implements the user-space interfaces to the
	  POSIX 1003.1e capabilities available in Linux kernels. These
	  capabilities are a partitioning of the all powerful root
	  privilege into a set of distinct privileges.

	  http://sites.google.com/site/fullycapable/

if BR2_PACKAGE_LIBCAP

config BR2_PACKAGE_LIBCAP_TOOLS
	bool "install tools"
	depends on BR2_USE_MMU
	help
	  Install setcap, getcap, getpcaps and capsh tools.

	  For these tools to run properly, you should enable, in your
	  kernel configuration, extended file attributes/security labels
	  support for the file system type used on target system (e.g.
	  CONFIG_EXT2_FS_XATTR and CONFIG_EXT2_FS_SECURITY for ext2).

endif
```

## package/libcdaudio/Config.in
```kconfig
config BR2_PACKAGE_LIBCDAUDIO
	bool "libcdaudio"
	help
	  libcdaudio is a library designed to provide functions to
	  control operation of a CD-ROM when playing audio CDs. It
	  also contains functions for CDDB and CD Index lookup.

	  http://libcdaudio.sourceforge.net/
```

## package/libcddb/Config.in
```kconfig
config BR2_PACKAGE_LIBCDDB
	bool "libcddb"
	select BR2_PACKAGE_LIBICONV if !BR2_ENABLE_LOCALE
	help
	  Libcddb is a C library to access data on a CDDB server
	  (freedb.org). It allows you to:
	    * search the database for possible CD matches;
	    * retrieve detailed information about a specific CD;
	    * submit new CD entries to the database.

	  http://libcddb.sourceforge.net/index.html

if BR2_PACKAGE_LIBCDDB

config BR2_PACKAGE_LIBCDDB_INSTALL_CDDB_QUERY
	bool "install cddb_query"
	help
	  cddb_query is an optionnal libcddb test program.

endif
```

## package/libcdio-paranoia/Config.in
```kconfig
config BR2_PACKAGE_LIBCDIO_PARANOIA
	bool "libcdio-paranoia"
	depends on BR2_USE_MMU # libcdio
	select BR2_PACKAGE_LIBCDIO
	help
	  CD paranoia on top of libcdio

	  http://www.gnu.org/software/libcdio/
```

## package/libcdio/Config.in
```kconfig
config BR2_PACKAGE_LIBCDIO
	bool "libcdio"
	depends on BR2_USE_MMU # fork()
	select BR2_PACKAGE_LIBICONV if !BR2_ENABLE_LOCALE
	help
	  The GNU Compact Disc Input and Control library.

	  http://www.gnu.org/software/libcdio/
```

## package/libcec/Config.in
```kconfig
config BR2_PACKAGE_LIBCEC
	bool "libcec"
	depends on BR2_INSTALL_LIBSTDCPP
	depends on BR2_TOOLCHAIN_HAS_THREADS
	depends on BR2_USE_WCHAR
	depends on !BR2_STATIC_LIBS
	select BR2_PACKAGE_LIBPLATFORM
	help
	  libcec allows you in combination with the right hardware to
	  control your home theater devices with your TV remote
	  control utilizing existing HDMI cabling.

	  http://libcec.pulse-eight.com

comment "libcec needs a toolchain w/ C++, wchar, threads, dynamic library"
	depends on !BR2_INSTALL_LIBSTDCPP || !BR2_TOOLCHAIN_HAS_THREADS || \
		!BR2_USE_WCHAR || BR2_STATIC_LIBS
```

## package/libcgi/Config.in
```kconfig
config BR2_PACKAGE_LIBCGI
	bool "libcgi"
	default n
	help
		LibCGI is a library written from scratch to easily make 
		CGI applications in C.

		There are a lot of functions like string manipulation, 
		session and cookie support, GET and POST methods manipulation 
		etc..., to help you to quickly write powerful CGI programs.

		http://libcgi.sourceforge.net/
```

## package/libcgicc/Config.in
```kconfig
config BR2_PACKAGE_LIBCGICC
	bool "libcgicc"
	depends on BR2_INSTALL_LIBSTDCPP
	help
	  GNU cgicc is a C++ class library that greatly simplifies
	  the creation of CGI applications for the World Wide Web.

	  http://www.cgicc.com

comment "libcgicc requires a toolchain with C++ support enabled"
	depends on !BR2_INSTALL_LIBSTDCPP
```

## package/libcgroup/Config.in
```kconfig
config BR2_PACKAGE_LIBCGROUP
	bool "libcgroup"
	depends on BR2_INSTALL_LIBSTDCPP
	# libcgroup uses <fts.h> which is not included by default in uClibc
	depends on BR2_TOOLCHAIN_USES_GLIBC
	help
	  libcgroup is a library that abstracts the control
	  group file system in Linux.

	  http://libcg.sourceforge.net/

if BR2_PACKAGE_LIBCGROUP

config BR2_PACKAGE_LIBCGROUP_TOOLS
	bool "install tools"
	help
	  Include a set of command-line tools for managing cgroups.

endif

comment "libcgroup needs a glibc toolchain w/ C++"
	depends on !BR2_INSTALL_LIBSTDCPP || !BR2_TOOLCHAIN_USES_GLIBC
```

## package/libclc/Config.in
```kconfig
config BR2_PACKAGE_LIBCLC
	bool "libclc"
	depends on BR2_PACKAGE_LLVM_ARCH_SUPPORTS
	help
	  libclc is an open source, BSD licensed implementation of
	  the library requirements of the OpenCL C programming language,
	  as specified by the OpenCL 1.1 Specification.

	  http://libclc.llvm.org/
```

## package/libcli/Config.in
```kconfig
config BR2_PACKAGE_LIBCLI
	bool "libcli"
	help
	  Libcli provides a shared library for including a Cisco-like
	  command- line interface into other software. It's a telnet
	  interface which supports command-line editing, history,
	  authentication and callbacks for a user-definable function
	  tree.

	  http://sites.dparrish.com/libcli
```

## package/libcoap/Config.in
```kconfig
config BR2_PACKAGE_LIBCOAP
	bool "libcoap"
	help
	  libcoap is a C implementation of a lightweight application-protocol
	  for devices that are constrained their resources such as computing
	  power, RF range, memory, bandwith, or network packet sizes. This
	  protocol, CoAP, is standardized by the IETF as RFC 7252. For further
	  information related to CoAP, see <http://coap.technology>.

	  https://github.com/obgm/libcoap
```

## package/libcodec2/Config.in
```kconfig
config BR2_PACKAGE_LIBCODEC2
	bool "libcodec2"
	help
	  Codec2 is an open source low bit rate speech codec designed
	  for communications quality speech between 700 and 3200 bit/s.

	  http://rowetel.com/codec2.html

if BR2_PACKAGE_LIBCODEC2

config BR2_PACKAGE_LIBCODEC2_EXAMPLES
	bool "libcodec2_examples"
	help
	  Install Codec2 examples.

endif
```

## package/libcofi/Config.in
```kconfig
config BR2_PACKAGE_LIBCOFI
	bool "libcofi"
	depends on BR2_arm
	# builds a shared library
	depends on !BR2_STATIC_LIBS
	help
	  A replacement for memcpy and memset functionality for the
	  Raspberry Pi with the intention of gaining greater performance.

	  https://github.com/simonjhall/copies-and-fills

comment "libcofi needs a toolchain w/ dynamic library"
	depends on BR2_arm
	depends on BR2_STATIC_LIBS
```

## package/libconfig/Config.in
```kconfig
config BR2_PACKAGE_LIBCONFIG
	bool "libconfig"
	help
	  Libconfig is a simple library for manipulating structured
	  configuration files. The file format is more compact and more
	  readable than XML. And unlike XML, it is type-aware, so it is
	  not necessary to do string parsing in application code.

	  https://hyperrealm.github.io/libconfig/
```

## package/libconfuse/Config.in
```kconfig
config BR2_PACKAGE_LIBCONFUSE
	bool "libconfuse"
	help
	  LibConfuse is a configuration file parser library written in
	  C. It supports sections and (lists of) values (strings,
	  integers, floats, booleans or other sections), as well as some
	  other features (such as single/double-quoted strings,
	  environment variable expansion, functions and nested include
	  statements.

	  http://savannah.nongnu.org/download/confuse/
```

## package/libcorrect/Config.in
```kconfig
config BR2_PACKAGE_LIBCORRECT
	bool "libcorrect"
	depends on !BR2_STATIC_LIBS
	help
	  A C library for Forward Error Correction, providing
	  convolutional codes and Reed-Solomon codes. It is part
	  of the Quiet Modem Project.

	  https://github.com/quiet/libcorrect

comment "libcorrect needs a toolchain w/ dynamic library"
	depends on BR2_STATIC_LIBS
```

## package/libcpprestsdk/Config.in
```kconfig
config BR2_PACKAGE_LIBCPPRESTSDK
	bool "libcpprestsdk"
	depends on BR2_ENABLE_LOCALE
	depends on BR2_INSTALL_LIBSTDCPP
	depends on BR2_USE_WCHAR # boost
	depends on !BR2_TOOLCHAIN_HAS_GCC_BUG_64735 # exception_ptr
	depends on BR2_TOOLCHAIN_HAS_THREADS_NPTL
	select BR2_PACKAGE_BOOST
	select BR2_PACKAGE_BOOST_ATOMIC
	select BR2_PACKAGE_BOOST_CHRONO
	select BR2_PACKAGE_BOOST_DATE_TIME
	select BR2_PACKAGE_BOOST_FILESYSTEM
	select BR2_PACKAGE_BOOST_RANDOM
	select BR2_PACKAGE_BOOST_REGEX
	select BR2_PACKAGE_BOOST_THREAD
	select BR2_PACKAGE_OPENSSL
	help
	  The C++ REST SDK is a Microsoft project for cloud-based
	  client-server communication in native code using a modern
	  asynchronous C++ API design. This project aims to help C++
	  developers connect to and interact with services.

	  https://github.com/Microsoft/cpprestsdk

comment "libcpprestsdk needs a toolchain w/ NPTL, C++, wchar, locale"
	depends on !BR2_TOOLCHAIN_HAS_THREADS_NPTL || \
		!BR2_INSTALL_LIBSTDCPP || \
		!BR2_USE_WCHAR || !BR2_ENABLE_LOCALE

comment "libcpprestsdk needs exception_ptr"
	depends on BR2_TOOLCHAIN_HAS_GCC_BUG_64735
```

## package/libcroco/Config.in
```kconfig
config BR2_PACKAGE_LIBCROCO
	bool "libcroco"
	depends on BR2_USE_WCHAR # glib2
	depends on BR2_TOOLCHAIN_HAS_THREADS # glib2
	depends on BR2_USE_MMU # glib2
	select BR2_PACKAGE_LIBXML2
	select BR2_PACKAGE_LIBGLIB2
	help
	  Libcroco is a standalone css2 parsing and manipulation
	  library. The parser provides a low level event driven SAC
	  like api and a css object model like api.

	  Libcroco provides a CSS2 selection engine and an
	  experimental xml/css rendering engine.

	  https://github.com/GNOME/libcroco

comment "libcroco needs a toolchain w/ wchar, threads"
	depends on BR2_USE_MMU
	depends on !BR2_USE_WCHAR || !BR2_TOOLCHAIN_HAS_THREADS
```
