## package/libcrossguid/Config.in
```kconfig
config BR2_PACKAGE_LIBCROSSGUID
	bool "libcrossguid"
	depends on BR2_INSTALL_LIBSTDCPP
	depends on BR2_TOOLCHAIN_GCC_AT_LEAST_4_7 # C++11
	select BR2_PACKAGE_UTIL_LINUX
	select BR2_PACKAGE_UTIL_LINUX_LIBUUID
	help
	  Lightweight cross platform C++ GUID/UUID library

	  https://github.com/graeme-hill/crossguid

comment "libcrossguid needs a toolchain w/ C++, gcc >= 4.7"
	depends on !BR2_INSTALL_LIBSTDCPP || !BR2_TOOLCHAIN_GCC_AT_LEAST_4_7
```

## package/libcsv/Config.in
```kconfig
config BR2_PACKAGE_LIBCSV
	bool "libcsv"
	help
	  libcsv is a small, simple and fast CSV library written in
	  pure ANSI C89 that can read and write CSV data. It provides
	  a straight-forward interface using callback functions to
	  handle parsed fields and rows and can parse improperly
	  formatted CSV files.

	  https://sourceforge.net/projects/libcsv/
```

## package/libcue/Config.in
```kconfig
config BR2_PACKAGE_LIBCUE
	bool "libcue"
	select BR2_PACKAGE_FLEX
	help
	  CUE Sheet Parser Library

	  http://libcue.sourceforge.net/
```

## package/libcurl/Config.in
```kconfig
config BR2_PACKAGE_LIBCURL
	bool "libcurl"
	help
	  cURL is a tool for getting files from FTP, HTTP, Gopher,
	  Telnet, and Dict servers, using any of the supported
	  protocols.

	  http://curl.haxx.se/

if BR2_PACKAGE_LIBCURL

config BR2_PACKAGE_LIBCURL_CURL
	bool "curl binary"
	help
	  Install curl binary as well

config BR2_PACKAGE_LIBCURL_VERBOSE
	bool "verbose strings"
	help
	  Enable verbose text strings

config BR2_PACKAGE_LIBCURL_PROXY_SUPPORT
	bool "proxy support"
	default y
	help
	  Enable proxy support.

config BR2_PACKAGE_LIBCURL_COOKIES_SUPPORT
	bool "cookies support"
	default y
	help
	  Enable support for cookies.

config BR2_PACKAGE_LIBCURL_EXTRA_PROTOCOLS_FEATURES
	bool "enable extra protocols and features"
	default y
	help
	  Enable the following extra protocols and features:
	  - LDAP / LDAPS
	  - POP3 / IMAP / SMTP
	  - Telnet
	  - TFTP
	  - RTSP
	  - SMB / CIFS
	  - DICT
	  - Gopher

choice
	prompt "SSL/TLS library to use"

config BR2_PACKAGE_LIBCURL_OPENSSL
	bool "OpenSSL"
	depends on BR2_PACKAGE_OPENSSL

config BR2_PACKAGE_LIBCURL_GNUTLS
	bool "GnuTLS"
	depends on BR2_PACKAGE_GNUTLS

config BR2_PACKAGE_LIBCURL_LIBNSS
	bool "NSS"
	depends on BR2_PACKAGE_LIBNSS

config BR2_PACKAGE_LIBCURL_MBEDTLS
	bool "mbed TLS"
	depends on BR2_PACKAGE_MBEDTLS

config BR2_PACKAGE_LIBCURL_WOLFSSL
	bool "WolfSSL"
	depends on BR2_PACKAGE_WOLFSSL

config BR2_PACKAGE_LIBCURL_TLS_NONE
	bool "None"

endchoice

endif
```

## package/libdaemon/Config.in
```kconfig
config BR2_PACKAGE_LIBDAEMON
	bool "libdaemon"
	# needs fork()
	depends on BR2_USE_MMU
	help
	  libdaemon is a lightweight C library that eases the
	  writing of UNIX daemons.

	  http://0pointer.de/lennart/projects/libdaemon/
```

## package/libdcadec/Config.in
```kconfig
config BR2_PACKAGE_LIBDCADEC
	bool "libdcadec"
	help
	  dcadec is a free DTS Coherent Acoustics decoder with support
	  for HD extensions.

	  https://github.com/foo86/dcadec
```

## package/libdmtx/Config.in
```kconfig
config BR2_PACKAGE_LIBDMTX
	bool "libdmtx"
	help
	  libdmtx is a software library that enables programs to read
	  and write Data Matrix barcodes of the modern ECC200 variety.

	  https://github.com/dmtx/libdmtx
```

## package/libdnet/Config.in
```kconfig
config BR2_PACKAGE_LIBDNET
	bool "libdnet"
	help
	  libdnet - simplified interface to low-level networking
	  routines.

	  http://libdnet.sourceforge.net/

if BR2_PACKAGE_LIBDNET

config BR2_PACKAGE_LIBDNET_PYTHON
	bool "libdnet python module"
	depends on BR2_PACKAGE_PYTHON
	help
	  dnet module for python

comment "dnet module for python requires python package"
	depends on !BR2_PACKAGE_PYTHON

endif
```

## package/libdri2/Config.in
```kconfig
config BR2_PACKAGE_LIBDRI2
	bool "libdri2"
	depends on BR2_TOOLCHAIN_HAS_THREADS # libdrm
	depends on BR2_PACKAGE_XORG7
	select BR2_PACKAGE_LIBDRM
	select BR2_PACKAGE_XLIB_LIBXDAMAGE
	select BR2_PACKAGE_XLIB_LIBXEXT
	select BR2_PACKAGE_XORGPROTO
	help
	  Library for the DRI2 extension to the X Window System.

	  https://github.com/robclark/libdri2

comment "libdri2 needs a toolchain w/ threads"
	depends on !BR2_TOOLCHAIN_HAS_THREADS
```

## package/libdrm/Config.in
```kconfig
menuconfig BR2_PACKAGE_LIBDRM
	bool "libdrm"
	depends on BR2_TOOLCHAIN_HAS_THREADS # libpthread-stubs
	select BR2_PACKAGE_LIBPTHREAD_STUBS
	help
	  Direct Rendering Manager

	  http://dri.freedesktop.org/libdrm/

if BR2_PACKAGE_LIBDRM

config BR2_PACKAGE_LIBDRM_HAS_ATOMIC
	bool
	default y if BR2_PACKAGE_LIBATOMIC_OPS_ARCH_SUPPORTS || \
		BR2_TOOLCHAIN_HAS_SYNC_4

config BR2_PACKAGE_LIBDRM_ENABLE_ATOMIC
	bool
	select BR2_PACKAGE_LIBATOMIC_OPS if !BR2_TOOLCHAIN_HAS_SYNC_4

config BR2_PACKAGE_LIBDRM_INTEL
	bool "intel"
	depends on BR2_i386 || BR2_x86_64
	depends on BR2_PACKAGE_LIBDRM_HAS_ATOMIC
	select BR2_PACKAGE_LIBDRM_ENABLE_ATOMIC
	select BR2_PACKAGE_LIBPCIACCESS
	help
	  Install intel graphics driver.

config BR2_PACKAGE_LIBDRM_RADEON
	bool "radeon"
	depends on BR2_PACKAGE_LIBDRM_HAS_ATOMIC
	select BR2_PACKAGE_LIBDRM_ENABLE_ATOMIC
	help
	  Install AMD/ATI graphics driver.

config BR2_PACKAGE_LIBDRM_AMDGPU
	bool "amdgpu"
	depends on BR2_PACKAGE_LIBDRM_HAS_ATOMIC
	select BR2_PACKAGE_LIBDRM_ENABLE_ATOMIC
	help
	  Install AMD GPU driver.

config BR2_PACKAGE_LIBDRM_NOUVEAU
	bool "nouveau"
	depends on BR2_PACKAGE_LIBDRM_HAS_ATOMIC
	select BR2_PACKAGE_LIBDRM_ENABLE_ATOMIC
	help
	  Install NVIDIA graphics driver.

config BR2_PACKAGE_LIBDRM_VMWGFX
	bool "vmwgfx"
	depends on BR2_i386 || BR2_x86_64
	help
	  Installs Vmware graphics driver.

config BR2_PACKAGE_LIBDRM_OMAP
	bool "omap (experimental)"
	depends on BR2_arm
	depends on BR2_PACKAGE_LIBDRM_HAS_ATOMIC
	select BR2_PACKAGE_LIBDRM_ENABLE_ATOMIC
	help
	  Install the TI OMAP driver using an experimental API.

config BR2_PACKAGE_LIBDRM_ETNAVIV
	bool "etnaviv (experimental)"
	depends on BR2_PACKAGE_LIBDRM_HAS_ATOMIC
	select BR2_PACKAGE_LIBDRM_ENABLE_ATOMIC
	help
	  Install the Etnaviv/Vivante driver using an experimental API.

config BR2_PACKAGE_LIBDRM_EXYNOS
	bool "exynos (experimental)"
	depends on BR2_arm
	help
	  Install Samsung Exynos driver using an experimental API.

config BR2_PACKAGE_LIBDRM_FREEDRENO
	bool "freedreno"
	depends on BR2_arm || BR2_aarch64 || BR2_aarch64_be
	depends on BR2_PACKAGE_LIBDRM_HAS_ATOMIC
	select BR2_PACKAGE_LIBDRM_ENABLE_ATOMIC
	help
	  Install Qualcomm Snapdragon driver.

config BR2_PACKAGE_LIBDRM_TEGRA
	bool "tegra (experimental)"
	depends on BR2_arm
	depends on BR2_PACKAGE_LIBDRM_HAS_ATOMIC
	select BR2_PACKAGE_LIBDRM_ENABLE_ATOMIC
	help
	  Install NVIDIA Tegra driver using an experimental API.

config BR2_PACKAGE_LIBDRM_VC4
	bool "vc4"
	depends on BR2_aarch64 || BR2_arm
	help
	  Install vc4 (Raspberry Pi) driver.

config BR2_PACKAGE_LIBDRM_INSTALL_TESTS
	bool "Install test programs"
	help
	  This option allows to install the libdrm test programs.

endif

comment "libdrm needs a toolchain w/ threads"
	depends on !BR2_TOOLCHAIN_HAS_THREADS
```

## package/libdvbcsa/Config.in
```kconfig
config BR2_PACKAGE_LIBDVBCSA
	bool "libdvbcsa"
	help
	  libdvbcsa is a free implementation of the DVB Common Scrambling
	  Algorithm - DVB/CSA - with encryption and decryption capabilities

	  As libdvbcsa implements a standard, it is completely legal to use it.

	  http://www.videolan.org/developers/libdvbcsa.html
```

## package/libdvbpsi/Config.in
```kconfig
config BR2_PACKAGE_LIBDVBPSI
	bool "libdvbpsi"
	depends on BR2_TOOLCHAIN_HAS_THREADS
	help
	  libdvbpsi is a simple library designed for decoding and
	  generation of MPEG TS and DVB PSI tables according to standards
	  ISO/IEC 13818 and ITU-T H.222.0.

	  http://www.videolan.org/developers/libdvbpsi.html

comment "libdvbpsi needs a toolchain w/ threads"
	depends on !BR2_TOOLCHAIN_HAS_THREADS
```

## package/libdvbsi/Config.in
```kconfig
config BR2_PACKAGE_LIBDVBSI
	bool "libdvbsi"
	depends on BR2_INSTALL_LIBSTDCPP
	depends on BR2_USE_WCHAR
	depends on BR2_TOOLCHAIN_HAS_THREADS
	help
	  C++ parsing library for Service Information (SI) in DVB systems.
	  With libdvbsi++ you can convert raw DVB service information to
	  a set of C++ objects, removing the need to parse data manually.

	  http://www.saftware.de/

comment "libdvbsi++ needs a toolchain w/ C++, wchar, threads"
	depends on !BR2_INSTALL_LIBSTDCPP || !BR2_USE_WCHAR || !BR2_TOOLCHAIN_HAS_THREADS
```

## package/libdvdnav/Config.in
```kconfig
config BR2_PACKAGE_LIBDVDNAV
	bool "libdvdnav"
	depends on BR2_TOOLCHAIN_HAS_THREADS
	select BR2_PACKAGE_LIBDVDREAD
	help
	  libdvdnav is a library that allows easy use of sophisticated
	  DVD navigation features such as DVD menus, multiangle
	  playback and even interactive DVD games.

	  https://www.videolan.org/developers/libdvdnav.html

comment "libdvdnav needs a toolchain w/ threads"
	depends on !BR2_TOOLCHAIN_HAS_THREADS
```

## package/libdvdread/Config.in
```kconfig
config BR2_PACKAGE_LIBDVDREAD
	bool "libdvdread"
	select BR2_PACKAGE_LIBDVDCSS
	help
	  libdvdread provides a simple foundation for reading
	  DVD-Video images.

	  https://www.videolan.org/developers/libdvdnav.html
```

## package/libeXosip2/Config.in
```kconfig
config BR2_PACKAGE_LIBEXOSIP2
	bool "libeXosip2"
	depends on BR2_USE_MMU # fork()
	select BR2_PACKAGE_LIBOSIP2
	help
	  eXosip is a library that hides the complexity of using the
	  SIP protocol for mutlimedia session establishement.
	  This protocol is mainly to be used by VoIP telephony
	  applications (endpoints or conference server) but might be
	  also usefull for any application that wish to establish
	  sessions like multiplayer games.
	  eXosip is based in libosip.

	  http://savannah.nongnu.org/projects/exosip/
```

## package/libeastl/Config.in
```kconfig
config BR2_PACKAGE_LIBEASTL_ARCH_SUPPORTS
	bool
	default y if BR2_i386
	default y if BR2_x86_64
	default y if BR2_aarch64
	default y if BR2_powerpc
	default y if BR2_powerpc64

config BR2_PACKAGE_LIBEASTL
	bool "libeastl"
	depends on BR2_PACKAGE_LIBEASTL_ARCH_SUPPORTS
	depends on BR2_INSTALL_LIBSTDCPP
	depends on BR2_TOOLCHAIN_GCC_AT_LEAST_4_9 # C++14
	help
	  EASTL stands for Electronic Arts Standard Template
	  Library. EASTL stands for Electronic Arts Standard Template
	  Library. It is a C++ template library of containers,
	  algorithms, and iterators useful for runtime and tool
	  development across multiple platforms.  It is an extensive
	  and robust implementation that has an emphasis on high
	  performance.

	  https://github.com/electronicarts/EASTL

comment "libeastl needs a toolchain w/ C++, gcc >= 4.9"
	depends on BR2_PACKAGE_LIBEASTL_ARCH_SUPPORTS
	depends on !BR2_TOOLCHAIN_GCC_AT_LEAST_4_9 || !BR2_INSTALL_LIBSTDCPP
```

## package/libebml/Config.in
```kconfig
config BR2_PACKAGE_LIBEBML
	bool "libebml"
	depends on BR2_INSTALL_LIBSTDCPP
	depends on BR2_USE_WCHAR
	help
	  Access library for the EBML (Extensible Binary Meta
	  Language, a binary derivative of XML) format.

	  http://matroska.org

comment "libebml needs a toolchain w/ C++, wchar"
	depends on !BR2_INSTALL_LIBSTDCPP || !BR2_USE_WCHAR
```

## package/libedit/Config.in
```kconfig
config BR2_PACKAGE_LIBEDIT
	bool "libedit"
	depends on BR2_USE_WCHAR
	depends on BR2_USE_MMU # fork()
	select BR2_PACKAGE_NCURSES
	help
	  The editline library (from BSD) provides generic line editing
	  and history functions. It slightly resembles GNU readline.

	  The official homepage is at:
	  http://ftp.netbsd.org/pub/NetBSD/NetBSD-release-5-0/src/lib/libedit/

	  Jess Thrysoee maintains an autotoolified packaged, which we use
	  in Buildroot as it makes it much simpler than using the upstream
	  sources which require pmake:
	  http://www.thrysoee.dk/editline/

comment "libedit needs a toolchain w/ wchar"
	depends on BR2_USE_MMU
	depends on !BR2_USE_WCHAR
```

## package/libee/Config.in
```kconfig
config BR2_PACKAGE_LIBEE
	bool "libee"
	select BR2_PACKAGE_LIBESTR
	help
	  An Event Expression Library inspired by CEE.

	  CEE is an upcoming standard used to describe network
	  events in a number of normalized formats. It's goal is
	  to unify they currently many different representations
	  that exist in the industry.

	  The core idea of libee is to provide a small but hopefully
	  convenient API layer above the CEE standard. However, CEE
	  is not finished. At the time of this writing, CEE is under
	  heavy development and even some of its core data structures
	  (like the data dictionary and taxonmy) have not been fully
	  specified.

	  http://www.libee.org
```

## package/libelf/Config.in
```kconfig
config BR2_PACKAGE_LIBELF
	bool "libelf"
	help
	  The elf library provides routines to access, and manipulate,
	  Elf object files.

	  http://www.mr511.de/software/
```

## package/libepoxy/Config.in
```kconfig
config BR2_PACKAGE_LIBEPOXY
	bool "libepoxy"
	depends on BR2_PACKAGE_HAS_LIBEGL || BR2_PACKAGE_HAS_LIBGL
	select BR2_PACKAGE_XUTIL_UTIL_MACROS
	help
	  Epoxy is a library for handling OpenGL function pointer
	  management for you.

	  https://github.com/anholt/libepoxy

comment "libepoxy needs an OpenGL and/or OpenGL EGL backend"
	depends on !BR2_PACKAGE_HAS_LIBEGL && !BR2_PACKAGE_HAS_LIBGL
```

## package/liberation/Config.in
```kconfig
config BR2_PACKAGE_LIBERATION
	bool "Liberation (Free fonts)"
	help
	  The Liberation Fonts are intended to be replacements for the
	  three most commonly used fonts on Microsoft systems:
	  Times New Roman, Arial, and Courier New.

	  https://github.com/liberationfonts/liberation-fonts

if BR2_PACKAGE_LIBERATION

config BR2_PACKAGE_LIBERATION_MONO
	bool "mono fonts"
	default y

config BR2_PACKAGE_LIBERATION_SANS
	bool "sans fonts"
	default y

config BR2_PACKAGE_LIBERATION_SERIF
	bool "serif fonts"
	default y

endif
```

## package/libesmtp/Config.in
```kconfig
config BR2_PACKAGE_LIBESMTP
	bool "libesmtp"
	depends on !BR2_STATIC_LIBS
	help
	  Library for sending emails through SMTP.

	  http://www.stafford.uklinux.net/libesmtp

comment "libesmtp needs a toolchain w/ dynamic library"
	depends on BR2_STATIC_LIBS
```

## package/libestr/Config.in
```kconfig
config BR2_PACKAGE_LIBESTR
	bool "libestr"
	help
	  Some essentials for string handling (and a bit more)

	  http://libestr.adiscon.com/
```
