## package/libev/Config.in
```kconfig
config BR2_PACKAGE_LIBEV
	bool "libev"
	help
	  Userspace library for handling asynchronous notifications

	  http://software.schmorp.de/pkg/libev.html
```

## package/libevas-generic-loaders/Config.in
```kconfig
config BR2_PACKAGE_LIBEVAS_GENERIC_LOADERS
	bool "libevas generic loaders"
	depends on BR2_PACKAGE_EFL
	select BR2_PACKAGE_ZLIB
	help
	  These are additional "generic" loaders for Evas that are
	  stand-alone executables that evas may run from its generic
	  loader module.

	  https://www.enlightenment.org/

if BR2_PACKAGE_LIBEVAS_GENERIC_LOADERS

config BR2_PACKAGE_LIBEVAS_GENERIC_LOADERS_LIBRAW
	bool "libraw loader"
	depends on BR2_INSTALL_LIBSTDCPP # libraw
	select BR2_PACKAGE_LIBRAW
	help
	  This option enables the Evas generic Libraw loader

comment "libraw loader needs a toolchain w/ C++"
	depends on !BR2_INSTALL_LIBSTDCPP

config BR2_PACKAGE_LIBEVAS_GENERIC_LOADERS_SVG
	bool "SVG loader"
	depends on BR2_USE_MMU # librsvg -> glib2
	depends on BR2_USE_WCHAR # librsvg -> glib2
	depends on BR2_TOOLCHAIN_HAS_THREADS # librsvg -> glib2
	depends on BR2_INSTALL_LIBSTDCPP # librsvg -> pango
	depends on BR2_TOOLCHAIN_HAS_SYNC_4 # librsvg -> pango -> harfbuzz
	select BR2_PACKAGE_LIBRSVG
	select BR2_PACKAGE_CAIRO
	help
	  This option enables the Evas generic SVG loader

comment "SVG loader needs a toolchain w/ wchar, threads, C++"
	depends on BR2_TOOLCHAIN_HAS_SYNC_4
	depends on BR2_USE_MMU
	depends on !BR2_USE_WCHAR || !BR2_TOOLCHAIN_HAS_THREADS || !BR2_INSTALL_LIBSTDCPP

endif
```

## package/libevent/Config.in
```kconfig
config BR2_PACKAGE_LIBEVENT
	bool "libevent"
	help
	  Userspace library for handling asynchronous notifications

	  http://libevent.org
```

## package/libexif/Config.in
```kconfig
config BR2_PACKAGE_LIBEXIF
	bool "libexif"
	help
	  Most digital cameras produce EXIF files, which are JPEG
	  files with extra tags that contain information about the
	  image.  The EXIF library allows you to parse an EXIF file
	  and read the data from those tags.

	  http://libexif.sf.net
```

## package/libfastjson/Config.in
```kconfig
config BR2_PACKAGE_LIBFASTJSON
	bool "libfastjson"
	# uses the __sync_*_4 intrisics, or pthreads to emulate atomicity
	depends on BR2_TOOLCHAIN_HAS_SYNC_4 || BR2_TOOLCHAIN_HAS_THREADS
	help
	  Libfastjson - A fast json library for C

	  Libfastjson is a fork from json-c. The aim of this project
	  is not to provide a slightly modified clone of json-c.
	  Its aim is to provide:

	  - a small library with essential json handling functions
	  - sufficiently good json support (not 100% standards
	    compliant)
	  - be very fast in processing

	  https://github.com/rsyslog/libfastjson/
```

## package/libfcgi/Config.in
```kconfig
config BR2_PACKAGE_LIBFCGI
	bool "libfcgi"
	depends on BR2_USE_MMU # fork()
	help
	  FCGI, a fastcgi developer library for C/C++

	  https://fastcgi-archives.github.io/
```

## package/libffi/Config.in
```kconfig
config BR2_PACKAGE_LIBFFI
	bool "libffi"
	depends on BR2_TOOLCHAIN_HAS_THREADS
	help
	  The libffi library provides a portable, high level
	  programming interface to various calling conventions. This
	  allows a programmer to call any function specified by a call
	  interface description at run-time.

	  http://sourceware.org/libffi/

comment "libffi needs a toolchain w/ threads"
	depends on !BR2_TOOLCHAIN_HAS_THREADS
```

## package/libfloat/Config.in
```kconfig
config BR2_PACKAGE_LIBFLOAT
	bool "libfloat"
	depends on BR2_DEPRECATED
	help
	 Soft floating point library.
	
	 http://netwinder.osuosl.org/devteam/scottb/libfloat/
```

## package/libfm-extra/Config.in
```kconfig
config BR2_PACKAGE_LIBFM_EXTRA
	bool "libfm-extra"
	depends on BR2_USE_WCHAR # libglib2
	depends on BR2_TOOLCHAIN_HAS_THREADS # libglib2
	depends on BR2_USE_MMU # libglib2
	select BR2_PACKAGE_LIBGLIB2
	help
	  The libfm-extra package contains a library and other files
	  required by menu-cache-gen libexec of menu-cache

	  http://wiki.lxde.org/en/Libfm

comment "libfm-extra needs a toolchain w/ wchar, threads"
	depends on BR2_USE_MMU
	depends on !BR2_USE_WCHAR || !BR2_TOOLCHAIN_HAS_THREADS
```

## package/libfm/Config.in
```kconfig
config BR2_PACKAGE_LIBFM
	bool "libfm"
	select BR2_PACKAGE_MENU_CACHE
	select BR2_PACKAGE_LIBGLIB2
	select BR2_PACKAGE_LIBGTK2
	select BR2_PACKAGE_CAIRO
	depends on BR2_PACKAGE_XORG7
	depends on BR2_USE_WCHAR # libglib2
	depends on BR2_TOOLCHAIN_HAS_THREADS # libglib2
	depends on BR2_USE_MMU # libglib2
	depends on BR2_INSTALL_LIBSTDCPP # libgtk2
	depends on BR2_TOOLCHAIN_HAS_SYNC_4 # libgtk2 -> pango -> harfbuzz
	help
	  A glib/gio-based library providing some file management
	  utilities and related-widgets missing in gtk+/glib. This is
	  the core of PCManFM.  The library is desktop independent
	  (not LXDE specific) and has clean API. It can be used to
	  develop other applications requiring file management
	  functionality. For example, you can create your own file
	  manager with facilities provided by libfm.

	  http://wiki.lxde.org/en/Libfm

comment "libfm needs X.org and a toolchain w/ wchar, threads, C++"
	depends on BR2_USE_MMU
	depends on BR2_TOOLCHAIN_HAS_SYNC_4
	depends on !BR2_USE_WCHAR || !BR2_INSTALL_LIBSTDCPP || \
		!BR2_TOOLCHAIN_HAS_THREADS || !BR2_PACKAGE_XORG7
```

## package/libfreefare/Config.in
```kconfig
config BR2_PACKAGE_LIBFREEFARE
	bool "libfreefare"
	depends on BR2_TOOLCHAIN_HAS_THREADS # libusb
	select BR2_PACKAGE_OPENSSL
	select BR2_PACKAGE_LIBNFC
	help
	  Library for high level manipulation of MIFARE cards.

	  http://code.google.com/p/nfc-tools/wiki/libfreefare

comment "libfreefare needs a toolchain with thread support"
	depends on !BR2_TOOLCHAIN_HAS_THREADS
```

## package/libfreeglut/Config.in
```kconfig
config BR2_PACKAGE_LIBFREEGLUT
	bool "libfreeglut"
	depends on BR2_PACKAGE_HAS_LIBGL
	depends on BR2_PACKAGE_XORG7
	select BR2_PACKAGE_LIBGLU
	select BR2_PACKAGE_XLIB_LIBXI
	select BR2_PACKAGE_XLIB_LIBXRANDR
	select BR2_PACKAGE_XLIB_LIBXXF86VM
	help
	  FreeGLUT is a free-software/open-source alternative to the
	  OpenGL Utility Toolkit (GLUT) library. GLUT (and hence
	  FreeGLUT) takes care of all the system-specific chores
	  required for creating windows, initializing OpenGL contexts,
	  and handling input events, to allow for trully portable OpenGL
	  programs.

	  http://freeglut.sourceforge.net

comment "libfreeglut depends on X.org and needs an OpenGL backend"
	depends on !BR2_PACKAGE_XORG7 || !BR2_PACKAGE_HAS_LIBGL
```

## package/libfreeimage/Config.in
```kconfig
config BR2_PACKAGE_LIBFREEIMAGE
	bool "libfreeimage"
	depends on BR2_INSTALL_LIBSTDCPP
	depends on !BR2_STATIC_LIBS
	# compiler issue: "Error: invalid register number `63'"
	depends on !BR2_arc
	# Numerous build issues
	depends on !BR2_bfin
	help
	  FreeImage is an Open Source library project for developers who
	  would like to support popular graphics image formats like PNG,
	  BMP, JPEG, TIFF and others as needed by today's multimedia
	  applications.

	  http://freeimage.sourceforge.net

comment "libfreeimage needs a toolchain w/ C++, dynamic library"
	depends on !BR2_arc
	depends on !BR2_bfin
	depends on BR2_STATIC_LIBS || !BR2_INSTALL_LIBSTDCPP
```

## package/libfribidi/Config.in
```kconfig
config BR2_PACKAGE_LIBFRIBIDI
	bool "libfribidi"
	help
	  GNU FriBidi is an implementation of the Unicode
	  Bidirectional Algorithm (bidi).

	  http://www.fribidi.org/
```

## package/libfslcodec/Config.in
```kconfig
config BR2_PACKAGE_LIBFSLCODEC
	bool "libfslcodec"
	depends on BR2_arm # Only relevant for i.MX
	depends on BR2_TOOLCHAIN_USES_GLIBC # prebuilt binaries
	help
	  Binary codec libraries for the Freescale i.MX SoCs.

	  This library is provided by Freescale as-is and doesn't have
	  an upstream.

comment "libfslcodec needs an (e)glibc toolchain"
	depends on BR2_arm
	depends on !BR2_TOOLCHAIN_USES_GLIBC
```

## package/libfslparser/Config.in
```kconfig
config BR2_PACKAGE_LIBFSLPARSER
	bool "libfslparser"
	depends on BR2_arm # Only relevant for i.MX
	help
	  Binary parser libraries for the Freescale i.MX SoCs.

	  This library is provided by Freescale as-is and doesn't have
	  an upstream.
```

## package/libfslvpuwrap/Config.in
```kconfig
comment "libfslvpuwrap needs an imx-specific Linux kernel to be built"
	depends on BR2_arm
	depends on !BR2_LINUX_KERNEL

comment "libfslvpuwrap needs an i.MX platform with VPU support"
	depends on BR2_arm
	depends on BR2_LINUX_KERNEL && !BR2_PACKAGE_FREESCALE_IMX_HAS_VPU

config BR2_PACKAGE_LIBFSLVPUWRAP
	bool "libfslvpuwrap"
	depends on BR2_LINUX_KERNEL
	depends on BR2_arm # Only relevant for i.MX
	depends on BR2_PACKAGE_FREESCALE_IMX_HAS_VPU
	select BR2_PACKAGE_IMX_VPU
	help
	  Wrapper library for the vpu library, giving it a different API.

	  This library is provided by Freescale as-is and doesn't have
	  an upstream.
```

## package/libftdi/Config.in
```kconfig
config BR2_PACKAGE_LIBFTDI
	bool "libftdi"
	depends on BR2_TOOLCHAIN_HAS_THREADS # libusb
	select BR2_PACKAGE_LIBUSB
	select BR2_PACKAGE_LIBUSB_COMPAT
	help
	  Userspace access to FTDI USB interface chips

	  http://www.intra2net.com/en/developer/libftdi/index.php

if BR2_PACKAGE_LIBFTDI

config BR2_PACKAGE_LIBTFDI_CPP
	bool "C++ bindings"
	depends on BR2_INSTALL_LIBSTDCPP
	depends on BR2_PACKAGE_BOOST_ARCH_SUPPORTS
	depends on BR2_USE_WCHAR
	select BR2_PACKAGE_BOOST
	help
	  C++ bindings for libftdi

comment "libftdi C++ bindings need a toolchain w/ wchar, C++"
	depends on BR2_PACKAGE_BOOST_ARCH_SUPPORTS
	depends on !BR2_USE_WCHAR || !BR2_INSTALL_LIBSTDCPP

endif # BR2_PACKAGE_LIBFTDI

comment "libftdi needs a toolchain w/ threads"
	depends on !BR2_TOOLCHAIN_HAS_THREADS
```

## package/libftdi1/Config.in
```kconfig
config BR2_PACKAGE_LIBFTDI1
	bool "libftdi1"
	select BR2_PACKAGE_LIBUSB
	depends on BR2_TOOLCHAIN_HAS_THREADS # libusb
	help
	  Userspace access to FTDI USB interface chips (version 1.x)

	  http://www.intra2net.com/en/developer/libftdi/index.php

if BR2_PACKAGE_LIBFTDI1

config BR2_PACKAGE_LIBFTDI1_LIBFTDIPP1
	bool "libftdipp1"
	select BR2_PACKAGE_BOOST
	depends on BR2_INSTALL_LIBSTDCPP # boost
	depends on BR2_TOOLCHAIN_HAS_THREADS # boost
	depends on BR2_USE_WCHAR # boost
	help
	  C++ bindings for libftdi

comment "libftdipp1 needs a toolchain w/ C++, wchar"
	depends on !BR2_INSTALL_LIBSTDCPP || !BR2_USE_WCHAR

config BR2_PACKAGE_LIBFTDI1_PYTHON_BINDINGS
	bool "python bindings"
	depends on BR2_PACKAGE_PYTHON || BR2_PACKAGE_PYTHON3
	help
	  Python bindings for libftdi

config BR2_PACKAGE_LIBFTDI1_FDTI_EEPROM
	select BR2_PACKAGE_LIBCONFUSE
	bool "ftdi_eeprom tool"

endif # BR2_PACKAGE_LIBFTDI1

comment "libftdi1 needs a toolchain w/ threads"
	depends on !BR2_TOOLCHAIN_HAS_THREADS
```

## package/libfuse/Config.in
```kconfig
config BR2_PACKAGE_LIBFUSE
	bool "libfuse"
	# Really doesn't like static, see fuse/lib/fuse.c
	depends on !BR2_PREFER_STATIC_LIB
	depends on BR2_LARGEFILE
	depends on BR2_TOOLCHAIN_HAS_THREADS
	depends on BR2_USE_MMU # fork()
	help
	  FUSE (Filesystem in UserSpacE)

	  http://fuse.sourceforge.net/

comment "libfuse needs a toolchain w/ largefile, threads, dynamic library"
        depends on !BR2_LARGEFILE || !BR2_TOOLCHAIN_HAS_THREADS || BR2_PREFER_STATIC_LIB
```

## package/libfuse3/Config.in
```kconfig
config BR2_PACKAGE_LIBFUSE3
	bool "libfuse3"
	depends on !BR2_STATIC_LIBS
	depends on BR2_TOOLCHAIN_HAS_THREADS
	depends on BR2_USE_MMU # fork()
	help
	  The reference implementation of the Linux FUSE
	  (Filesystem in Userspace) interface.

	  https://github.com/libfuse/libfuse

comment "libfuse3 needs a toolchain w/ threads, dynamic library"
	depends on BR2_USE_MMU
	depends on !BR2_TOOLCHAIN_HAS_THREADS || BR2_STATIC_LIBS
```

## package/libg7221/Config.in
```kconfig
config BR2_PACKAGE_LIBG7221
	bool "libg7221"
	help
	  libg722_1 is a library for the ITU G.722.1 and Annex C
	  wideband speech codecs.

	  http://www.soft-switch.org
```

## package/libgail/Config.in
```kconfig
config BR2_PACKAGE_LIBGAIL
	bool "libgail"
	depends on BR2_USE_WCHAR # pango -> libglib2
	depends on BR2_TOOLCHAIN_HAS_THREADS # pango -> libglib2
	depends on BR2_USE_MMU # pango -> libglib2
	depends on BR2_INSTALL_LIBSTDCPP # pango -> freetype
	depends on BR2_TOOLCHAIN_HAS_SYNC_4 # pango -> harfbuzz
	depends on BR2_PACKAGE_LIBGTK2
	depends on BR2_DEPRECATED_SINCE_2015_08
	select BR2_PACKAGE_PANGO
	help
	  GAIL provides accessibility support for gtk+ and
	  libgnomecanvas by implementing AtkObjects for widgets in
	  gtk+ and libgnomecanvas.

	  The GAIL library is a GTK+ module. For example, if the
	  module is loaded in a program which calls
	  gtk_widget_get_accessible() for a GtkEntry an instance of
	  GailEntry is returned. This module is normally used with the
	  atk-bridge GTK+ module from at-spi to allow an assistive
	  technology, e.g a screenreader, to query or drive the
	  program.

	  http://developer.gnome.org/projects/gap

comment "libgail needs a toolchain w/ C++, wchar, threads"
	depends on BR2_PACKAGE_LIBGTK2
	depends on !BR2_INSTALL_LIBSTDCPP || !BR2_USE_WCHAR || !BR2_TOOLCHAIN_HAS_THREADS
	depends on BR2_USE_MMU
	depends on BR2_TOOLCHAIN_HAS_SYNC_4
	depends on BR2_DEPRECATED_SINCE_2015_08
```

## package/libgc/Config.in
```kconfig
config BR2_PACKAGE_LIBGC
	bool "libgc"
	select BR2_PACKAGE_LIBATOMIC_OPS
	depends on BR2_PACKAGE_LIBATOMIC_ARCH_SUPPORTS
	help
	  The Boehm-Demers-Weiser conservative garbage collector can be used
	  as a garbage collecting replacement for C malloc or C++ new. It allows
	  you to allocate memory basically as you normally would, without
	  explicitly deallocating memory that is no longer useful.

	  http://www.hboehm.info/gc/
```

## package/libgcrypt/Config.in
```kconfig
config BR2_PACKAGE_LIBGCRYPT
	bool "libgcrypt"
	depends on BR2_PACKAGE_LIBGPG_ERROR_ARCH_SUPPORTS # libgpg-error
	select BR2_PACKAGE_LIBGPG_ERROR
	help
	  LibGCrypt is GNU's basic cryptographic library.

	  http://www.gnu.org/software/libgcrypt/
```
