## package/libgdiplus/Config.in
```kconfig
config BR2_PACKAGE_LIBGDIPLUS
	bool "libgdiplus"
	select BR2_PACKAGE_XLIB_LIBXFT
	select BR2_PACKAGE_LIBGLIB2
	select BR2_PACKAGE_CAIRO
	select BR2_PACKAGE_LIBPNG
	depends on BR2_PACKAGE_XORG7
	depends on BR2_USE_WCHAR # libglib2 -> gettext
	depends on BR2_TOOLCHAIN_HAS_THREADS # libglib2
	depends on BR2_USE_MMU # libglib2
	help
	  An Open Source implementation of the GDI+ API.

	  https://github.com/mono/libgdiplus

comment "libgdiplus needs a toolchain w/ wchar, threads"
	depends on BR2_USE_MMU
	depends on BR2_PACKAGE_XORG7
	depends on !BR2_USE_WCHAR || !BR2_TOOLCHAIN_HAS_THREADS
```

## package/libgee/Config.in
```kconfig
config BR2_PACKAGE_LIBGEE
	bool "libgee"
	depends on BR2_USE_WCHAR
	depends on BR2_TOOLCHAIN_HAS_THREADS
	depends on BR2_USE_MMU # fork()
	select BR2_PACKAGE_LIBGLIB2
	help
	  Libgee is an utility library providing GObject-based
	  interfaces and classes for commonly used data structures.

	  https://wiki.gnome.org/Projects/Libgee

comment "libgee needs a toolchain w/ wchar, threads"
	depends on BR2_USE_MMU
	depends on !BR2_USE_WCHAR || !BR2_TOOLCHAIN_HAS_THREADS
```

## package/libgeotiff/Config.in
```kconfig
config BR2_PACKAGE_LIBGEOTIFF
	bool "libgeotiff"
	depends on BR2_INSTALL_LIBSTDCPP # proj
	depends on BR2_TOOLCHAIN_GCC_AT_LEAST_4_7 # proj
	depends on BR2_TOOLCHAIN_HAS_THREADS # proj
	depends on BR2_USE_WCHAR # proj
	select BR2_PACKAGE_PROJ
	select BR2_PACKAGE_TIFF
	help
	  Libgeotiff is an open source library normally hosted on top of
	  libtiff for reading, and writing GeoTIFF information tags.

	  https://github.com/OSGeo/libgeotiff

comment "libgeotiff needs a toolchain w/ C++, gcc >= 4.7, threads, wchar"
	depends on !BR2_INSTALL_LIBSTDCPP || \
		!BR2_TOOLCHAIN_GCC_AT_LEAST_4_7 || \
		!BR2_TOOLCHAIN_HAS_THREADS || !BR2_USE_WCHAR
```

## package/libgit2/Config.in
```kconfig
config BR2_PACKAGE_LIBGIT2
	bool "libgit2"
	depends on !BR2_STATIC_LIBS # libhttpparser
	select BR2_PACKAGE_LIBHTTPPARSER
	select BR2_PACKAGE_ZLIB
	help
	  libgit2 is a portable, pure C implementation of the Git core
	  methods provided as a linkable library with a solid API,
	  allowing to build Git functionality into your application.

	  https://github.com/libgit2/libgit2

comment "libgit2 needs a toolchain w/ dynamic library"
	depends on BR2_STATIC_LIBS
```

## package/libglade/Config.in
```kconfig
config BR2_PACKAGE_LIBGLADE
	bool "libglade"
	depends on BR2_PACKAGE_LIBGTK2
	depends on BR2_USE_WCHAR # glib2
	select BR2_PACKAGE_LIBGLIB2
	select BR2_PACKAGE_ATK
	select BR2_PACKAGE_LIBXML2
	help
	  Libglade allows you to load glade interface files in a program
	  at runtime. It doesn't require GLADE to be used, but GLADE is
	  by far the easiest way to create the interface files.

	  http://ftp.gnome.org/pub/GNOME/sources/libglade/

comment "libglade requires a toolchain with WCHAR support"
	depends on BR2_PACKAGE_LIBGTK2 && !BR2_USE_WCHAR
```

## package/libglfw/Config.in
```kconfig
config BR2_PACKAGE_LIBGLFW
	bool "libglfw"
	depends on BR2_PACKAGE_XORG7
	depends on BR2_PACKAGE_HAS_LIBGL
	select BR2_PACKAGE_XLIB_LIBXCURSOR
	select BR2_PACKAGE_XLIB_LIBXEXT
	select BR2_PACKAGE_XLIB_LIBXI
	select BR2_PACKAGE_XLIB_LIBXINERAMA
	select BR2_PACKAGE_XLIB_LIBXRANDR
	help
	  GLFW is an Open Source, multi-platform library for creating
	  windows with OpenGL contexts and receiving input and events.

	  http://www.glfw.org

comment "libglfw depends on X.org and needs an OpenGL backend"
	depends on !BR2_PACKAGE_XORG7 || !BR2_PACKAGE_HAS_LIBGL
```

## package/libglib12/Config.in
```kconfig
config BR2_PACKAGE_LIBGLIB12
	bool "libglib12"
	depends on BR2_DEPRECATED
	help
	  Low-level core library that forms the basis of GTK+ and GNOME.

	  http://www.gtk.org/
```

## package/libglib2/Config.in
```kconfig
config BR2_PACKAGE_LIBGLIB2
	bool "libglib2"
	depends on BR2_USE_WCHAR # gettext
	depends on BR2_TOOLCHAIN_HAS_THREADS
	depends on BR2_USE_MMU # fork()
	select BR2_PACKAGE_GETTEXT if BR2_NEEDS_GETTEXT
	select BR2_PACKAGE_LIBICONV if !BR2_ENABLE_LOCALE
	select BR2_PACKAGE_LIBFFI
	select BR2_PACKAGE_PCRE
	select BR2_PACKAGE_PCRE_UCP
	select BR2_PACKAGE_UTIL_LINUX
	select BR2_PACKAGE_UTIL_LINUX_LIBMOUNT
	select BR2_PACKAGE_ZLIB
	help
	  Low-level core library that forms the basis of GTK+ and GNOME.

	  http://www.gtk.org/

comment "libglib2 needs a toolchain w/ wchar, threads"
	depends on BR2_USE_MMU
	depends on !BR2_USE_WCHAR || !BR2_TOOLCHAIN_HAS_THREADS
```

## package/libglob/Config.in
```kconfig
config BR2_PACKAGE_LIBGLOB
	bool "libglob"
	help
	  OpenBSD implementation of glob(3).

	  https://github.com/void-linux/libglob
```

## package/libglu/Config.in
```kconfig
config BR2_PACKAGE_LIBGLU
	bool "libglu"
	depends on BR2_PACKAGE_HAS_LIBGL
	help
	  Mesa OpenGL Utility library

	  http://cgit.freedesktop.org/mesa/glu/

comment "libglu needs an OpenGL backend"
	depends on !BR2_PACKAGE_HAS_LIBGL
```

## package/libgpg-error/Config.in
```kconfig
config BR2_PACKAGE_LIBGPG_ERROR_ARCH_SUPPORTS
	bool
	# see src/syscfg/
	default y if \
		BR2_aarch64	|| BR2_aarch64_eb	|| BR2_arm	|| \
		BR2_armeb	|| BR2_i386		|| BR2_mips	|| \
		BR2_mipsel	|| BR2_mips64		|| BR2_mips64el	|| \
		BR2_m68k	|| BR2_nios2		|| BR2_powerpc	|| \
		BR2_powerpc64 	|| BR2_powerpc64le 	|| BR2_RISCV_64	|| \
		BR2_sh4		|| BR2_sh4eb		|| BR2_sh4a	|| \
		BR2_sh4aeb	|| BR2_sparc		|| BR2_sparc64	|| \
		BR2_x86_64

config BR2_PACKAGE_LIBGPG_ERROR
	bool "libgpg-error"
	depends on BR2_PACKAGE_LIBGPG_ERROR_ARCH_SUPPORTS
	help
	  Libgpg-error is a small library with error codes and
	  descriptions shared by most GnuPG related software.

	  https://www.gnupg.org/related_software/libgpg-error

config BR2_PACKAGE_LIBGPG_ERROR_SYSCFG
	string
	default "aarch64-unknown-linux-gnu" \
		if BR2_aarch64 || BR2_aarch64_eb
	default "arm-unknown-linux-gnueabi" \
		if BR2_arm || BR2_armeb
	default "i686-pc-linux-gnu" \
		if BR2_i386
	default "mips-unknown-linux-gnu" \
		if BR2_mips || BR2_mipsel
	default "mips64el-unknown-linux-gnuabi64" \
		if BR2_mips64 || BR2_mips64el
	default "m68k-unknown-linux-gnu" \
		if BR2_m68k
	default "nios2-unknown-linux-gnu" \
		if BR2_nios2
	default "powerpc-unknown-linux-gnu" \
		if BR2_powerpc
	default "powerpc64-unknown-linux-gnu" \
		if BR2_powerpc64 || BR2_powerpc64le
	default "riscv64-unknown-linux-gnu" \
		if BR2_RISCV_64
	default "sh4-unknown-linux-gnu" \
		if BR2_sh4 || BR2_sh4eb || BR2_sh4a || BR2_sh4aeb
	default "sparc-unknown-linux-gnu" \
		if BR2_sparc
	default "sparc64-unknown-linux-gnu" \
		if BR2_sparc64
	default "x86_64-pc-linux-gnu" \
		if BR2_x86_64
```

## package/libgpgme/Config.in
```kconfig
config BR2_PACKAGE_LIBGPGME
	bool "libgpgme"
	depends on BR2_USE_MMU # libassuan
	#gnupg is not needed to build, but at runtime.
	select BR2_PACKAGE_GNUPG
	select BR2_PACKAGE_LIBGPG_ERROR
	select BR2_PACKAGE_LIBASSUAN
	help
	  GnuPG Made Easy (GPGME) is a library designed to make access
	  to GnuPG easier for applications.

	  http://www.gnupg.org/related_software/gpgme/
```

## package/libgphoto2/Config.in
```kconfig
config BR2_PACKAGE_LIBGPHOTO2
	bool "libgphoto2"
	depends on BR2_TOOLCHAIN_HAS_THREADS # libusb
	select BR2_PACKAGE_LIBTOOL
	select BR2_PACKAGE_LIBUSB
	select BR2_PACKAGE_LIBXML2
	help
	  libgphoto2 is the core library designed to allow access to
	  digital camera by external programs.

	  http://gphoto.org/proj/libgphoto2/

comment "libgphoto needs a toolchain w/ threads"
	depends on !BR2_TOOLCHAIN_HAS_THREADS
```

## package/libgpiod/Config.in
```kconfig
config BR2_PACKAGE_LIBGPIOD
	bool "libgpiod"
	depends on BR2_TOOLCHAIN_HEADERS_AT_LEAST_4_8
	help
	  This is a C library that abstracts the GPIO character
	  device operations on linux.

	  https://github.com/brgl/libgpiod

if BR2_PACKAGE_LIBGPIOD

config BR2_PACKAGE_LIBGPIOD_TOOLS
	bool "install tools"
	help
	  Include a set of command-line tools for managing GPIOs.

endif

comment "libgpiod needs kernel headers >= 4.8"
	depends on !BR2_TOOLCHAIN_HEADERS_AT_LEAST_4_8
```

## package/libgsasl/Config.in
```kconfig
config BR2_PACKAGE_LIBGSASL
	bool "libgsasl"
	depends on BR2_USE_WCHAR
	help
	  Simple Authentication and Security Layer framework Library.
	  GNU SASL is an implementation of the Simple Authentication and
	  Security Layer framework and a few common SASL mechanisms.
	  SASL is used by network servers (e.g., IMAP, SMTP) to request
	  authentication from clients, and in clients to authenticate
	  against servers.

	  http://www.gnu.org/software/gsasl

comment "libgsasl needs a toolchain w/ wchar"
	depends on !BR2_USE_WCHAR
```

## package/libgsm/Config.in
```kconfig
config BR2_PACKAGE_LIBGSM
	bool "libgsm"
	depends on !BR2_STATIC_LIBS
	help
	  Shared libraries for GSM 06.10 lossy speech compression.

	  http://www.quut.com/gsm

comment "libgsm needs a toolchain w/ dynamic library"
	depends on BR2_STATIC_LIBS
```

## package/libgta/Config.in
```kconfig
config BR2_PACKAGE_LIBGTA
	bool "libgta"
	select BR2_PACKAGE_BZIP2
	select BR2_PACKAGE_ZLIB
	select BR2_PACKAGE_XZ
	help
	  Libgta is a portable library that implements the Generic
	  Tagged Array (GTA) file format.

	  http://gta.nongnu.org
```

## package/libgtk12/Config.in
```kconfig
config BR2_PACKAGE_LIBGTK12
	bool "libgtk12"
	default n
	select BR2_PACKAGE_LIBGLIB12
	depends on BR2_PACKAGE_XORG||BR2_PACKAGE_XORG7
	help
	  The GTK+ graphical user interface library

	  http://www.gtk.org/
```

## package/libgtk2/Config.in
```kconfig
config BR2_PACKAGE_LIBGTK2
	bool "libgtk2"
	select BR2_PACKAGE_ATK
	select BR2_PACKAGE_CAIRO
	select BR2_PACKAGE_CAIRO_PS
	select BR2_PACKAGE_CAIRO_PDF
	select BR2_PACKAGE_CAIRO_SVG
	select BR2_PACKAGE_LIBGLIB2
	select BR2_PACKAGE_PANGO
	select BR2_PACKAGE_GDK_PIXBUF
	select BR2_PACKAGE_FONTCONFIG
	select BR2_PACKAGE_XLIB_LIBX11
	select BR2_PACKAGE_XLIB_LIBXEXT
	select BR2_PACKAGE_XLIB_LIBXRENDER
	depends on BR2_PACKAGE_XORG7
	depends on BR2_USE_WCHAR # glib2
	depends on BR2_TOOLCHAIN_HAS_THREADS # glib2
	depends on BR2_USE_MMU # glib2
	depends on BR2_INSTALL_LIBSTDCPP # pango
	depends on BR2_ARCH_HAS_ATOMICS # cairo
	help
	  The GTK+ version 2 graphical user interface library

	  http://www.gtk.org/

if BR2_PACKAGE_LIBGTK2

config BR2_PACKAGE_LIBGTK2_DEMO
	bool "Install libgtk2 demo program"
	help
	  The GTK+ source base contains a gtk-demo program. This
	  option allows to install this program to the target.

endif

comment "libgtk2 needs a toolchain w/ wchar, threads, C++"
	depends on BR2_USE_MMU
	depends on BR2_ARCH_HAS_ATOMICS
	depends on BR2_PACKAGE_XORG7
	depends on !BR2_USE_WCHAR || !BR2_INSTALL_LIBSTDCPP || \
		!BR2_TOOLCHAIN_HAS_THREADS
```

## package/libgtk3/Config.in
```kconfig
config BR2_PACKAGE_LIBGTK3
	bool "libgtk3"
	select BR2_PACKAGE_ATK
	select BR2_PACKAGE_CAIRO
	select BR2_PACKAGE_CAIRO_PS
	select BR2_PACKAGE_CAIRO_PDF
	select BR2_PACKAGE_CAIRO_SVG
	select BR2_PACKAGE_LIBGLIB2
	select BR2_PACKAGE_PANGO
	select BR2_PACKAGE_GDK_PIXBUF
	# atleast 1 backend must be enabled
	select BR2_PACKAGE_LIBGTK3_BROADWAY if \
		!(BR2_PACKAGE_LIBGTK3_X11 || BR2_PACKAGE_LIBGTK3_WAYLAND)
	depends on BR2_USE_WCHAR # glib2
	depends on BR2_TOOLCHAIN_HAS_THREADS # glib2
	depends on BR2_USE_MMU # glib2
	depends on BR2_INSTALL_LIBSTDCPP # pango
	depends on BR2_ARCH_HAS_ATOMICS # cairo
	help
	  The GTK+ version 3 graphical user interface library

	  http://www.gtk.org/

if BR2_PACKAGE_LIBGTK3

comment "GDK backend"

config BR2_PACKAGE_LIBGTK3_X11
	bool "GDK X11 backend"
	default y
	depends on BR2_PACKAGE_XORG7
	select BR2_PACKAGE_FONTCONFIG
	select BR2_PACKAGE_XLIB_LIBX11
	select BR2_PACKAGE_XLIB_LIBXEXT
	select BR2_PACKAGE_XLIB_LIBXRENDER
	select BR2_PACKAGE_XLIB_LIBXI
	help
	  This enables the X11 backend for GDK.

config BR2_PACKAGE_LIBGTK3_WAYLAND
	bool "GDK Wayland backend"
	default y
	depends on BR2_PACKAGE_WAYLAND
	select BR2_PACKAGE_LIBXKBCOMMON
	help
	  This enables the Wayland backend for GDK.

config BR2_PACKAGE_LIBGTK3_BROADWAY
	bool "GDK Broadway backend"
	help
	  This enables the Broadway backend for GDK, which provides support
	  for displaying GTK+ applications in a web browser, using HTML5 and
	  web sockets.

	  For example, to run gtk3-demo on a target which IP address is
	  192.168.0.1 and use it from a web browser, execute the following
	  commands:

	    $ broadwayd -a 192.168.0.1 -p 8080 :2 &
	    $ export GDK_BACKEND=broadway
	    $ export BROADWAY_DISPLAY=:2
	    $ gtk3-demo

	  Then open a web browser at address http://192.168.0.1:8080.
	  Javascript and web sockets should be enabled.

config BR2_PACKAGE_LIBGTK3_DEMO
	bool "Install libgtk3 demo program"
	select BR2_PACKAGE_SHARED_MIME_INFO
	select BR2_PACKAGE_HICOLOR_ICON_THEME
	help
	  The GTK+ source base contains a demo program. This
	  option allows to install this program to the target.

config BR2_PACKAGE_LIBGTK3_TESTS
	bool "Install libgtk3 tests"
	help
	  The GTK+ source base contains tests. This option
	  allows to install them to the target.

endif

comment "libgtk3 needs a toolchain w/ wchar, threads, C++"
	depends on BR2_USE_MMU
	depends on BR2_ARCH_HAS_ATOMICS
	depends on !BR2_USE_WCHAR || !BR2_INSTALL_LIBSTDCPP || \
		!BR2_TOOLCHAIN_HAS_THREADS
```

## package/libgudev/Config.in
```kconfig
config BR2_PACKAGE_LIBGUDEV
	bool "libgudev"
	depends on BR2_PACKAGE_HAS_UDEV
	depends on BR2_USE_WCHAR # gettext
	depends on BR2_TOOLCHAIN_HAS_THREADS
	depends on BR2_USE_MMU # fork()
	select BR2_PACKAGE_LIBGLIB2
	help
	  This library provides GObject bindings for libudev.  It was
	  originally part of udev-extras, then udev, then systemd.
	  It's now a project on its own. Required for building some
	  programs that use udev, when using systemd.

	  https://wiki.gnome.org/Projects/libgudev

comment "libgudev needs udev /dev handling and a toolchain w/ wchar, threads"
	depends on BR2_USE_MMU
	depends on !BR2_USE_WCHAR || !BR2_TOOLCHAIN_HAS_THREADS || \
		!BR2_PACKAGE_HAS_UDEV
```

## package/libhdhomerun/Config.in
```kconfig
config BR2_PACKAGE_LIBHDHOMERUN
	bool "libhdhomerun"
	depends on BR2_TOOLCHAIN_HAS_THREADS
	depends on !BR2_STATIC_LIBS
	help
	  HDHomeRun is a network-attached digital television tuner
	  box, produced by the company SiliconDust USA, Inc.

	  http://www.silicondust.com

comment "libhdhomerun needs a toolchain w/ threads, dynamic library"
	depends on !BR2_TOOLCHAIN_HAS_THREADS || BR2_STATIC_LIBS
```

## package/libhid/Config.in
```kconfig
config BR2_PACKAGE_LIBHID
	bool "libhid"
	depends on BR2_TOOLCHAIN_HAS_THREADS # libusb
	select BR2_PACKAGE_LIBUSB
	select BR2_PACKAGE_LIBUSB_COMPAT
	help
	  Userspace library for accessing USB HID devices

	  https://directory.fsf.org/wiki/Libhid

comment "libhid needs a toolchain w/ threads"
	depends on !BR2_TOOLCHAIN_HAS_THREADS
```

## package/libhtp/Config.in
```kconfig
config BR2_PACKAGE_LIBHTP
	bool "libhtp"
	select BR2_PACKAGE_LIBICONV if !BR2_ENABLE_LOCALE
	select BR2_PACKAGE_ZLIB
	help
	  LibHTP is a security-aware parser for the HTTP protocol and
	  the related bits and pieces.

	  https://github.com/OISF/libhtp
```

## package/libhttpparser/Config.in
```kconfig
config BR2_PACKAGE_LIBHTTPPARSER
	bool "libhttpparser"
	depends on !BR2_STATIC_LIBS
	help
	  This is a parser for HTTP messages written in C. It
	  parses both requests and responses. The parser is
	  designed to be used in performance HTTP applications.
	  It does not make any syscalls nor allocations, it does
	  not buffer data, it can be interrupted at anytime.
	  Depending on your architecture, it only requires about
	  40 bytes of data per message stream (in a web server
	  that is per connection).

	  https://github.com/joyent/http-parser

comment "libhttpparser needs a toolchain w/ dynamic library"
	depends on BR2_STATIC_LIBS
```
