## package/libhttpserver/Config.in
```kconfig
config BR2_PACKAGE_LIBHTTPSERVER
	bool "libhttpserver"
	depends on BR2_INSTALL_LIBSTDCPP
	depends on BR2_TOOLCHAIN_HAS_THREADS
	select BR2_PACKAGE_LIBMICROHTTPD
	help
	  libhttpserver is a C++ library for building high performance
	  RESTfuls web servers. libhttpserver is built upon
	  libmicrohttpd to provide a simple API for developers to
	  create HTTP services in C++.

	  https://github.com/etr/libhttpserver

comment "libhttpserver needs a toolchain w/ C++, threads"
	depends on !BR2_INSTALL_LIBSTDCPP || !BR2_TOOLCHAIN_HAS_THREADS
```

## package/libical/Config.in
```kconfig
config BR2_PACKAGE_LIBICAL
	bool "libical"
	depends on BR2_INSTALL_LIBSTDCPP
	depends on !BR2_STATIC_LIBS
	depends on BR2_USE_WCHAR
	help
	  libical is an Open Source (MPL/LGPL) implementation of the IETF's
	  iCalendar Calendaring and Scheduling protocols.

	  http://libical.github.io/libical

comment "libical needs a toolchain w/ C++, dynamic library, wchar"
	depends on !BR2_INSTALL_LIBSTDCPP || !BR2_USE_WCHAR || \
		BR2_STATIC_LIBS
```

## package/libiconv/Config.in
```kconfig
config BR2_PACKAGE_LIBICONV
	bool "libiconv"
	depends on !BR2_ENABLE_LOCALE
	help
	  unicode conversion library

	  http://ftp.gnu.org/pub/gnu/libiconv

if BR2_PACKAGE_LIBICONV

config BR2_PACKAGE_LIBICONV_EXTRA_ENCODINGS
	bool "extra encodings"
	help
	  Provide support for a few extra encodings:

	  European languages
	    CP{437,737,775,852,853,855,857,858,860,861,863,865,869,1125}
	  Semitic languages
	    CP864
	  Japanese
	    EUC-JISX0213, Shift_JISX0213, ISO-2022-JP-3
	  Chinese
	    BIG5-2003 (experimental)
	  Turkmen
	    TDS565
	  Platform specifics
	    ATARIST, RISCOS-LATIN1

endif
```

## package/libid3tag/Config.in
```kconfig
config BR2_PACKAGE_LIBID3TAG
	bool "libid3tag"
	default n
	select BR2_PACKAGE_ZLIB
	depends on BR2_PACKAGE_LIBMAD
	help
	  ID3 tag reading library from the MAD project.

	  http://www.underbit.com/products/mad/
```

## package/libidn/Config.in
```kconfig
config BR2_PACKAGE_LIBIDN
	bool "libidn"
	help
	  Libidn's purpose is to encode and decode internationalized
	  domain names.

	  http://www.gnu.org/software/libidn/

if BR2_PACKAGE_LIBIDN

config BR2_PACKAGE_LIBIDN_BINARY
	bool "idn binary"
	help
	  Install idn command line tool

endif
```

## package/libidn2/Config.in
```kconfig
config BR2_PACKAGE_LIBIDN2
	bool "libidn2"
	help
	  Libidn2 is an implementation of the IDNA2008 + TR46
	  specifications (RFC 5890, RFC 5891, RFC 5892, RFC 5893,
	  TR 46).

	  http://www.gnu.org/software/libidn/

if BR2_PACKAGE_LIBIDN2

config BR2_PACKAGE_LIBIDN2_BINARY
	bool "idn2 binary"
	help
	  Install idn2 command line tool

endif
```

## package/libiio/Config.in
```kconfig
config BR2_PACKAGE_LIBIIO
	bool "libiio"
	select BR2_PACKAGE_LIBIIO_LOCAL_BACKEND if !BR2_PACKAGE_LIBIIO_XML_BACKEND
	help
	  Libiio is a library to ease the development of software
	  interfacing Linux Industrial I/O (IIO) devices.

	  http://wiki.analog.com/resources/tools-software/linux-software/libiio

if BR2_PACKAGE_LIBIIO

config BR2_PACKAGE_LIBIIO_LOCAL_BACKEND
	bool "Local backend"
	default y
	help
	  Enable the local backend of the library.

config BR2_PACKAGE_LIBIIO_XML_BACKEND
	bool "XML backend"
	default y
	select BR2_PACKAGE_LIBXML2
	help
	  Enable the XML backend of the library.

config BR2_PACKAGE_LIBIIO_NETWORK_BACKEND
	bool "Network backend"
	default y
	select BR2_PACKAGE_LIBIIO_XML_BACKEND
	help
	  Enable the network backend of the library.

config BR2_PACKAGE_LIBIIO_USB_BACKEND
	bool "USB backend"
	default y
	depends on BR2_TOOLCHAIN_HAS_THREADS # from libusb
	select BR2_PACKAGE_LIBIIO_XML_BACKEND
	select BR2_PACKAGE_LIBUSB
	help
	  Enable the USB backend of the library.

comment "The USB backend needs a toolchain w/ threads"
	depends on !BR2_TOOLCHAIN_HAS_THREADS

config BR2_PACKAGE_LIBIIO_SERIAL_BACKEND
	bool "Serial backend"
	default y
	select BR2_PACKAGE_LIBIIO_XML_BACKEND
	select BR2_PACKAGE_LIBSERIALPORT
	help
	  Enable the serial backend of the library.

config BR2_PACKAGE_LIBIIO_IIOD
	bool "IIO Daemon"
	default y
	depends on BR2_TOOLCHAIN_HAS_THREADS
	depends on !BR2_bfin
	select BR2_PACKAGE_LIBIIO_LOCAL_BACKEND
	help
	  Install the IIO Daemon.

config BR2_PACKAGE_LIBIIO_IIOD_USBD
	bool "USB support in the IIO Daemon (FunctionFS)"
	depends on BR2_PACKAGE_LIBIIO_IIOD
	depends on BR2_PACKAGE_LIBAIO_ARCH_SUPPORTS
	depends on BR2_TOOLCHAIN_HEADERS_AT_LEAST_3_18 # usb_functionfs_descs_head_v2
	select BR2_PACKAGE_LIBAIO
	help
	  Add support for USB through FunctionFS with IIOD.

comment "USB support in the IIO Daemon requires libaio, headers >= 3.18"
	depends on BR2_PACKAGE_LIBIIO_IIOD
	depends on !BR2_PACKAGE_LIBAIO_ARCH_SUPPORTS || \
		   !BR2_TOOLCHAIN_HEADERS_AT_LEAST_3_18

comment "IIO Daemon needs a toolchain w/ threads"
	depends on !BR2_TOOLCHAIN_HAS_THREADS
	depends on !BR2_bfin

comment "IIO Daemon is not yet available on Blackfin"
	depends on BR2_bfin

config BR2_PACKAGE_LIBIIO_TESTS
	bool "Install test programs"
	depends on BR2_TOOLCHAIN_HAS_THREADS
	help
	  Install the test programs (iio_info, iio_genxml, iio_readdev).

comment "IIO test programs need a toolchain w/ threads"
	depends on !BR2_TOOLCHAIN_HAS_THREADS

config BR2_PACKAGE_LIBIIO_BINDINGS_CSHARP
	bool "Install C# bindings"
	depends on BR2_PACKAGE_MONO
	help
	  Install the C# bindings.

config BR2_PACKAGE_LIBIIO_BINDINGS_PYTHON
	bool "Install Python bindings"
	depends on BR2_PACKAGE_PYTHON
	help
	  Install the Python bindings.

endif
```

## package/libimxvpuapi/Config.in
```kconfig
config BR2_PACKAGE_LIBIMXVPUAPI
	bool "libimxvpuapi"
	depends on BR2_arm # Only relevant for i.MX
	select BR2_PACKAGE_FREESCALE_IMX
	select BR2_PACKAGE_IMX_VPU
	help
	  This library provides an API for using the iMX6 VPU video
	  engine. It is an alternative to Freescale's VPU
	  wrapper. Both the wrapper and this library are layered on
	  top of imx-vpu, the low-level iMX6 VPU interface.

	  https://github.com/Freescale/libimxvpuapi
```

## package/libiqrf/Config.in
```kconfig
config BR2_PACKAGE_LIBIQRF
	bool "libiqrf"
	depends on BR2_TOOLCHAIN_HAS_THREADS # libusb
	select BR2_PACKAGE_LIBUSB
	help
	  This library implement specific protocol
	  which is used for communicating with iqrf devices
	  (http://iqrf.org) over usb. For usb access is used
	  libusb library.

	  https://github.com/nandra/libiqrf

comment "libiqrf needs a toolchain w/ threads"
	depends on !BR2_TOOLCHAIN_HAS_THREADS
```

## package/libiscsi/Config.in
```kconfig
config BR2_PACKAGE_LIBISCSI
	bool "libiscsi"
	depends on BR2_TOOLCHAIN_HAS_THREADS
	help
	  Libiscsi is a client-side library to implement the iSCSI
	  protocol that can be used to access resource of an iSCSI
	  Target.

	  The library is fully async with regards to iscsi commands and
	  scsi tasks, but a sync layer is also provided for ease of use
	  for simpler applications.

	  https://github.com/sahlberg/libiscsi

comment "libiscsi needs a toolchain w/ threads"
	depends on !BR2_TOOLCHAIN_HAS_THREADS
```

## package/libjson/Config.in
```kconfig
config BR2_PACKAGE_LIBJSON
	bool "libjson"
	depends on BR2_INSTALL_LIBSTDCPP
	help
	  A JSON reader and writer which is super-efficient and usually
	  runs circles around other JSON libraries.

	  http://sourceforge.net/projects/libjson/

comment "libjson needs a toolchain w/ C++"
	depends on !BR2_INSTALL_LIBSTDCPP
```

## package/libkcapi/Config.in
```kconfig
config BR2_PACKAGE_LIBKCAPI
	bool "libkcapi"
	depends on BR2_TOOLCHAIN_HAS_SYNC_4
	help
	  Linux Kernel Crypto API userspace interface library

	  http://www.chronox.de/libkcapi.html

if BR2_PACKAGE_LIBKCAPI

config BR2_PACKAGE_LIBKCAPI_ENCAPP
	bool "build enc application"

config BR2_PACKAGE_LIBKCAPI_HASHER
	bool "build hasher application"
	depends on !BR2_STATIC_LIBS # dlfcn.h

comment "hasher application needs a toolchain w/ dynamic library"
	depends on BR2_STATIC_LIBS

config BR2_PACKAGE_LIBKCAPI_RNGAPP
	bool "build rng read application"

config BR2_PACKAGE_LIBKCAPI_SPEED
	bool "build speed-test program"

config BR2_PACKAGE_LIBKCAPI_TEST
	bool "build test program"
	depends on BR2_USE_MMU # fork()

endif
```

## package/libkrb5/Config.in
```kconfig
config BR2_PACKAGE_LIBKRB5
	bool "libkrb5"
	# needs fork()
	depends on BR2_USE_MMU
	depends on !BR2_STATIC_LIBS
	help
	  Kerberos is a system for authenticating users and services
	  on a network. Kerberos is a trusted third-party service.
	  That means that there is a third party (the Kerberos server)
	  that is trusted by all the entities on the network (users
	  and services, usually called "principals"). This is the MIT
	  reference implementation of Kerberos V5.

	  https://web.mit.edu/kerberos/

comment "libkrb5 needs a toolchain w/ dynamic library"
	depends on BR2_USE_MMU
	depends on BR2_STATIC_LIBS
```

## package/libksba/Config.in
```kconfig
config BR2_PACKAGE_LIBKSBA
	bool "libksba"
	select BR2_PACKAGE_LIBGPG_ERROR
	help
	  CMS and X.509 library

	  https://www.gnupg.org/related_software/libksba/
```

## package/libldns/Config.in
```kconfig
config BR2_PACKAGE_LIBLDNS
	bool "libldns"
	help
	  The goal of ldns is to simplify DNS programming, it supports
	  recent RFCs like the DNSSEC documents, and allows developers
	  to easily create software conforming to current RFCs, and
	  experimental software for current Internet Drafts.

	  http://www.nlnetlabs.nl/projects/ldns
```

## package/liblinear/Config.in
```kconfig
config BR2_PACKAGE_LIBLINEAR
	bool "liblinear"
	depends on BR2_INSTALL_LIBSTDCPP
	help
	  liblinear is a linear classifier for data with millions of
	  instances and features.

	  http://www.csie.ntu.edu.tw/~cjlin/liblinear/

comment "liblinear needs a toolchain w/ C++"
	depends on !BR2_INSTALL_LIBSTDCPP
```

## package/libllcp/Config.in
```kconfig
config BR2_PACKAGE_LIBLLCP
	bool "libllcp"
	depends on BR2_TOOLCHAIN_HAS_THREADS # libusb
	select BR2_PACKAGE_LIBNFC
	help
	  Library extending libnfc with support for Logical Link Control
	  Protocol.

	  https://code.google.com/p/libllcp/
```

## package/liblo/Config.in
```kconfig
config BR2_PACKAGE_LIBLO
	bool "liblo"
	depends on BR2_TOOLCHAIN_HAS_THREADS
	help
	  liblo is an implementation of the Open Sound Control
	  protocol for POSIX systems

	  http://liblo.sourceforge.net/

comment "liblo needs a toolchain w/ threads"
	depends on !BR2_TOOLCHAIN_HAS_THREADS
```

## package/liblockfile/Config.in
```kconfig
config BR2_PACKAGE_LIBLOCKFILE
	bool "liblockfile"
	help
	  NFS-safe locking library.

	  https://github.com/miquels/liblockfile
```

## package/liblogging/Config.in
```kconfig
config BR2_PACKAGE_LIBLOGGING
	bool "liblogging"
	help
	  Liblogging is an easy to use library for
	  logging. It offers an enhanced replacement
	  for the syslog() call, but retains its ease of use.

	  https://www.rsyslog.com/liblogging/
```

## package/libloki/Config.in
```kconfig
config BR2_PACKAGE_LIBLOKI
	bool "libloki"
	depends on BR2_INSTALL_LIBSTDCPP
	depends on BR2_TOOLCHAIN_HAS_THREADS
	help
	  A C++ library of designs, containing flexible
	  implementations of common design patterns and idioms.

	  http://sourceforge.net/projects/loki-lib

comment "libloki needs a toolchain w/ C++, threads"
	depends on !BR2_INSTALL_LIBSTDCPP || !BR2_TOOLCHAIN_HAS_THREADS
```

## package/libmad/Config.in
```kconfig
config BR2_PACKAGE_LIBMAD
	bool "libmad"
	help
	  High-quality MPEG audio decoder. All computations are performed
	  with fixed-point integer arithmetic, making it ideal for systems
	  without a floating-point unit.

	  http://www.underbit.com/products/mad/

if BR2_PACKAGE_LIBMAD

choice
	prompt "Speed vs. accuracy"
	default BR2_PACKAGE_LIBMAD_OPTIMIZATION_DEFAULT

config BR2_PACKAGE_LIBMAD_OPTIMIZATION_DEFAULT
	bool "Default"
	help
	  Keep optimizations balanced between speed and accuracy.

config BR2_PACKAGE_LIBMAD_OPTIMIZATION_SPEED
	bool "Optimize for speed over accuracy"
	help
	  Compromise accuracy for speed.

config BR2_PACKAGE_LIBMAD_OPTIMIZATION_ACCURACY
	bool "Optimize for accuracy over speed"
	help
	  Compromise speed for accuracy.

endchoice

config BR2_PACKAGE_LIBMAD_SSO
	bool "Subband synthesis optimization"
	help
	  Use the subband synthesis optimization, with reduced accuracy.

config BR2_PACKAGE_LIBMAD_ASO
	bool "Architecture-specific optimizations"
	default y
	help
	  Use certain architecture-specific optimizations.

config BR2_PACKAGE_LIBMAD_STRICT_ISO
	bool "Strict ISO/IEC interpretations"
	help
	  Use strict ISO/IEC interpretations.

endif
```

## package/libmatroska/Config.in
```kconfig
config BR2_PACKAGE_LIBMATROSKA
	bool "libmatroska"
	select BR2_PACKAGE_LIBEBML
	depends on BR2_INSTALL_LIBSTDCPP
	depends on BR2_USE_WCHAR
	help
	  Extensible open standard audio/video container format access
	  library.

	  http://matroska.org

comment "libmatroska needs a toolchain w/ C++, wchar"
	depends on !BR2_INSTALL_LIBSTDCPP || !BR2_USE_WCHAR
```

## package/libmaxminddb/Config.in
```kconfig
config BR2_PACKAGE_LIBMAXMINDDB
	bool "libmaxminddb"
	help
	  C library for the MaxMind DB file format

	  The libmaxminddb library provides a C library for reading
	  MaxMind DB files, including the GeoIP2 databases from
	  MaxMind.  This is a custom binary format designed to
	  facilitate fast lookups of IP addresses while allowing for
	  great flexibility in the type of data associated with an
	  address.

	  The MaxMind DB format is an open format. The spec is
	  available at http://maxmind.github.io/MaxMind-DB/. This spec
	  is licensed under the Creative Commons
	  Attribution-ShareAlike 3.0 Unported License.

	  http://maxmind.github.io/libmaxminddb
```

## package/libmbim/Config.in
```kconfig
config BR2_PACKAGE_LIBMBIM
	bool "libmbim"
	depends on BR2_USE_WCHAR # libglib2
	depends on BR2_TOOLCHAIN_HAS_THREADS # libglib2
	depends on BR2_PACKAGE_HAS_UDEV
	select BR2_PACKAGE_LIBGUDEV if BR2_INIT_SYSTEMD
	select BR2_PACKAGE_LIBGLIB2
	help
	  libmbim is a glib-based library for talking to WWAN modems and
	  devices which speak the Mobile Interface Broadband Model (MBIM)
	  protocol.

	  http://www.freedesktop.org/wiki/Software/libmbim/

comment "libmbim needs udev /dev management and a toolchain w/ wchar, threads"
	depends on !BR2_USE_WCHAR || !BR2_TOOLCHAIN_HAS_THREADS || \
		!BR2_PACKAGE_HAS_UDEV
```
