## package/libmbus/Config.in
```kconfig
config BR2_PACKAGE_LIBMBUS
	bool "libmbus"
	help
	  libmbus is a library for communicating with energy metering
	  devices. It supports TCP and RS232 M-bus gateways.
	  (M-bus standard: http://www.m-bus.com/)

	  http://www.rscada.se/libmbus/
```

## package/libmcrypt/Config.in
```kconfig
config BR2_PACKAGE_LIBMCRYPT
	bool "libmcrypt"
	help
	  libmcrypt is a library that provides uniform interface to access
	  several encryption algorithms.

	  http://mcrypt.sourceforge.net/
```

## package/libmediaart/Config.in
```kconfig
comment "libmediaart needs a toolchain w/ wchar, threads"
	depends on BR2_USE_MMU
	depends on !BR2_USE_WCHAR || !BR2_TOOLCHAIN_HAS_THREADS

config BR2_PACKAGE_LIBMEDIAART
	bool "libmediaart"
	depends on BR2_USE_MMU # glib2
	depends on BR2_USE_WCHAR # glib2
	depends on BR2_TOOLCHAIN_HAS_THREADS # glib2
	select BR2_PACKAGE_LIBGLIB2
	help
	  Library tasked with managing, extracting and handling media
	  art caches

	  https://github.com/GNOME/libmediaart

if BR2_PACKAGE_LIBMEDIAART

choice
	prompt "media art backend"
	default BR2_PACKAGE_LIBMEDIAART_BACKEND_NONE

config BR2_PACKAGE_MEDIAART_BACKEND_NONE
	bool "none"
	help
	  With no backend, libmediaart will not be able to process MP3
	  album art.

config BR2_PACKAGE_MEDIAART_BACKEND_GDK_PIXBUF
	bool "gdk-pixbuf"
	select BR2_PACKAGE_GDK_PIXBUF

config BR2_PACKAGE_MEDIAART_BACKEND_QT
	bool "Qt"
	depends on BR2_PACKAGE_QT || BR2_PACKAGE_QT5
	select BR2_PACKAGE_QT_GUI_MODULE if BR2_PACKAGE_QT
	select BR2_PACKAGE_QT5BASE_GUI if BR2_PACKAGE_QT5

comment "Qt backend depends on Qt or Qt5"
	depends on !BR2_PACKAGE_QT && !BR2_PACKAGE_QT5

endchoice

endif # BR2_PACKAGE_MEDIAART
```

## package/libmemcached/Config.in
```kconfig
config BR2_PACKAGE_LIBMEMCACHED
	bool "libmemcached"
	depends on BR2_INSTALL_LIBSTDCPP
	depends on BR2_TOOLCHAIN_HAS_THREADS
	help
	  libMemcached is an open source C/C++ client library and tools
	  for the memcached server.
	  It has been designed to be light on memory usage, thread safe,
	  and provide full access to server side methods.

	  http://libmemcached.org/libMemcached.html

comment "libmemcached needs a toolchain w/ C++, threads"
	depends on !BR2_INSTALL_LIBSTDCPP || !BR2_TOOLCHAIN_HAS_THREADS
```

## package/libmhash/Config.in
```kconfig
config BR2_PACKAGE_LIBMHASH
	bool "libmhash"
	help
	  Mhash is a free (under GNU Lesser GPL) library which provides
	  a uniform interface to a large number of hash algorithms.
	  These algorithms can be used to compute checksums, message
	  digests, and other signatures.

	  http://mhash.sourceforge.net/
```

## package/libmicrohttpd/Config.in
```kconfig
config BR2_PACKAGE_LIBMICROHTTPD
	bool "libmicrohttpd"
	help
	  GNU libmicrohttpd is a small C library that makes it easy to
	  run an HTTP server as part of another application.

	  http://www.gnu.org/software/libmicrohttpd/

if BR2_PACKAGE_LIBMICROHTTPD

config BR2_PACKAGE_LIBMICROHTTPD_SSL
	bool "https support"
	depends on !BR2_STATIC_LIBS # gnutls
	depends on BR2_USE_WCHAR
	select BR2_PACKAGE_GNUTLS
	help
	  Enable HTTPS (SSL) support.

comment "libmicrohttpd https support needs a toolchain w/ wchar, dynamic library"
	depends on !BR2_USE_WCHAR || BR2_STATIC_LIBS

endif
```

## package/libminiupnpc/Config.in
```kconfig
config BR2_PACKAGE_LIBMINIUPNPC
	bool "libminiupnpc"
	depends on !BR2_BINFMT_FLAT
	depends on !BR2_STATIC_LIBS
	help
	  The UPnP protocol is supported by most home adsl/cable routers
	  and Microsoft Windows 2K/XP. The aim of the MiniUPnP project
	  is to bring a free software solution to support the "Internet
	  Gateway Device" part of the protocol.

	  Miniupnpc aims at the simplest library possible, with the
	  smallest footprint and no dependencies to other libraries such
	  as XML parsers or HTTP implementations. All the code is pure
	  ANSI C.

	  http://miniupnp.free.fr

comment "libminiupnpc needs a toolchain w/ dynamic library"
	depends on BR2_STATIC_LIBS
	depends on !BR2_BINFMT_FLAT
```

## package/libmms/Config.in
```kconfig
config BR2_PACKAGE_LIBMMS
	bool "libmms"
	depends on BR2_USE_WCHAR # glib2
	depends on BR2_TOOLCHAIN_HAS_THREADS # glib2
	select BR2_PACKAGE_LIBGLIB2
	help
	  LibMMS is a common library for parsing mms:// and mmsh://
	  type network streams. These are commonly used to stream
	  Windows Media Video content over the web. LibMMS itself is
	  only for receiving MMS stream, it doesn't handle sending at
	  all.

	  http://launchpad.net/libmms

comment "libmms needs a toolchain w/ wchar, threads"
	depends on !BR2_USE_WCHAR || !BR2_TOOLCHAIN_HAS_THREADS
```

## package/libmng/Config.in
```kconfig
config BR2_PACKAGE_LIBMNG
	bool "libmng"
	select BR2_PACKAGE_JPEG
	select BR2_PACKAGE_ZLIB
	help
	  The reference library for reading, displaying, writing and
	  examining Multiple-Image Network Graphics.

	  http://sourceforge.net/projects/libmng/
```

## package/libmnl/Config.in
```kconfig
config BR2_PACKAGE_LIBMNL
	bool "libmnl"
	help
	  libmnl is a minimalistic user-space library oriented
	  to Netlink developers.

	  http://netfilter.org/projects/libmnl/
```

## package/libmodbus/Config.in
```kconfig
config BR2_PACKAGE_LIBMODBUS
	bool "libmodbus"
	help
	  libmodbus is a free software library to send/receive data according
	  to the Modbus protocol. This library is written in C and supports
	  RTU (serial) and TCP (Ethernet) communications.

	  http://libmodbus.org
```

## package/libmodplug/Config.in
```kconfig
config BR2_PACKAGE_LIBMODPLUG
	bool "libmodplug"
	depends on BR2_INSTALL_LIBSTDCPP
	help
	  MOD music file decoder

	  http://modplug-xmms.sourceforge.net/

comment "libmodplug needs a toolchain w/ C++"
	depends on !BR2_INSTALL_LIBSTDCPP
```

## package/libmodsecurity/Config.in
```kconfig
config BR2_PACKAGE_LIBMODSECURITY
	bool "libmodsecurity"
	depends on BR2_INSTALL_LIBSTDCPP
	depends on !BR2_STATIC_LIBS
	depends on BR2_TOOLCHAIN_HAS_THREADS
	select BR2_PACKAGE_PCRE
	help
	  Libmodsecurity is one component of the ModSecurity
	  v3 project. The library codebase serves as an
	  interface to ModSecurity Connectors taking in web
	  traffic and applying traditional ModSecurity
	  processing. In general, it provides the capability
	  to load/interpret rules written in the ModSecurity
	  SecRules format and apply them to HTTP content
	  provided by your application via Connectors.

	  https://github.com/SpiderLabs/ModSecurity

comment "libmodsecurity needs a toolchain w/ C++, dynamic library, threads"
	depends on !BR2_INSTALL_LIBSTDCPP || BR2_STATIC_LIBS || \
		!BR2_TOOLCHAIN_HAS_THREADS
```

## package/libmpd/Config.in
```kconfig
config BR2_PACKAGE_LIBMPD
	bool "libmpd"
	depends on BR2_USE_WCHAR # glib2
	depends on BR2_TOOLCHAIN_HAS_THREADS # glib2
	select BR2_PACKAGE_LIBGLIB2
	select BR2_PACKAGE_LIBICONV if !BR2_ENABLE_LOCALE
	help
	  High-level client library for accessing Music Player Daemon.
	  LibMpd is a library that provides high-level, callback-based
	  access to Music Player Daemon (mpd).

	  http://gmpcwiki.sarine.nl/index.php?title=Libmpd

comment "libmpd requires a toolchain with WCHAR and threading support"
	depends on !BR2_USE_WCHAR || !BR2_TOOLCHAIN_HAS_THREADS
```

## package/libmpeg2/Config.in
```kconfig
config BR2_PACKAGE_LIBMPEG2
	bool "libmpeg2"
	help
	  MPEG1/MPEG2 video decoder library

	  http://libmpeg2.sourceforge.net/

if BR2_PACKAGE_LIBMPEG2

config BR2_PACKAGE_LIBMPEG2_BINS
	bool "mpeg2 binaries"
	help
	  Install mpeg2dec, corrupt_mpeg2 and extract_mpeg2 programs as
	  well.

endif
```

## package/libmspack/Config.in
```kconfig
config BR2_PACKAGE_LIBMSPACK
	bool "libmspack"
	help
	  libmspack is a portable library for some loosely related
	  Microsoft compression formats

	  https://www.cabextract.org.uk/libmspack
```

## package/libnatpmp/Config.in
```kconfig
config BR2_PACKAGE_LIBNATPMP
	bool "libnatpmp"
	depends on !BR2_BINFMT_FLAT
	depends on !BR2_STATIC_LIBS
	help
	  libnatpmp is an attempt to make a portable and fully compliant
	  implementation of the NAT-PMP protocol for the client side. It
	  is based on non blocking sockets and all calls of the API are
	  asynchronous. It is therefore very easy to integrate the
	  NAT-PMP code to any event driven code.

	  http://miniupnp.free.fr/libnatpmp.html

comment "libnatpmp needs a toolchain w/ dynamic library"
	depends on BR2_STATIC_LIBS
	depends on !BR2_BINFMT_FLAT
```

## package/libndp/Config.in
```kconfig
config BR2_PACKAGE_LIBNDP
	bool "libndp"
	help
	  This package contains a library which provides a wrapper
	  for IPv6 Neighbor Discovery Protocol. It also provides a tool
	  named ndptool for sending and receiving NDP messages.

	  https://github.com/jpirko/libndp
```

## package/libnet/Config.in
```kconfig
config BR2_PACKAGE_LIBNET
	bool "libnet"
	help
	  libnet provides a portable framework for low-level network
	  packet construction.

	  http://sourceforge.net/projects/libnet-dev
```

## package/libnetconf2/Config.in
```kconfig
config BR2_PACKAGE_LIBNETCONF2
	bool "libnetconf2"
	depends on BR2_TOOLCHAIN_HAS_THREADS
	depends on !BR2_STATIC_LIBS
	depends on BR2_USE_MMU
	select BR2_PACKAGE_LIBYANG
	help
	  libnetconf2 is a NETCONF library in C intended for building
	  NETCONF clients and servers.

	  https://github.com/CESNET/libnetconf2

comment "libnetconf2 needs a toolchain w/ threads, dynamic libraray"
	depends on BR2_USE_MMU
	depends on BR2_STATIC_LIBS || !BR2_TOOLCHAIN_HAS_THREADS
```

## package/libnetfilter_acct/Config.in
```kconfig
config BR2_PACKAGE_LIBNETFILTER_ACCT
	bool "libnetfilter_acct"
	select BR2_PACKAGE_LIBMNL
	help
	  libnetfilter_acct is the userspace library providing interface
	  to extended accounting infrastructure.

	  http://www.netfilter.org/projects/libnetfilter_acct/
```

## package/libnetfilter_conntrack/Config.in
```kconfig
config BR2_PACKAGE_LIBNETFILTER_CONNTRACK
	bool "libnetfilter_conntrack"
	depends on BR2_LARGEFILE
	select BR2_PACKAGE_LIBMNL
	select BR2_PACKAGE_LIBNFNETLINK
	help
	  libnetfilter_conntrack is a userspace library providing
	  a programming interface (API) to the in-kernel
	  connection tracking state table.

	  http://www.netfilter.org/projects/libnetfilter_conntrack/

comment "libnetfilter_conntrack needs a toolchain w/ largefile"
	depends on !BR2_LARGEFILE
```

## package/libnetfilter_cthelper/Config.in
```kconfig
config BR2_PACKAGE_LIBNETFILTER_CTHELPER
	bool "libnetfilter_cthelper"
	select BR2_PACKAGE_LIBMNL
	help
	  libnetfilter_cthelper is the userspace library that provides
	  the programming interface to the user-space helper
	  infrastructure available since Linux kernel 3.6.

	  http://www.netfilter.org/projects/libnetfilter_cthelper/
```

## package/libnetfilter_cttimeout/Config.in
```kconfig
config BR2_PACKAGE_LIBNETFILTER_CTTIMEOUT
	bool "libnetfilter_cttimeout"
	select BR2_PACKAGE_LIBMNL
	help
	  libnetfilter_cttimeout is the userspace library that provides
	  the programming interface to the fine-grain
	  connection tracking timeout infrastructure.

	  http://www.netfilter.org/projects/libnetfilter_cttimeout/
```

## package/libnetfilter_log/Config.in
```kconfig
config BR2_PACKAGE_LIBNETFILTER_LOG
	bool "libnetfilter_log"
	select BR2_PACKAGE_LIBNFNETLINK
	help
	  libnetfilter_log is a userspace library providing interface
	  to packets that have been logged by the kernel packet filter.

	  http://www.netfilter.org/projects/libnetfilter_log/
```
