## package/libnetfilter_queue/Config.in
```kconfig
config BR2_PACKAGE_LIBNETFILTER_QUEUE
	bool "libnetfilter_queue"
	select BR2_PACKAGE_LIBNFNETLINK
	select BR2_PACKAGE_LIBMNL
	help
	  libnetfilter_queue is the userspace library that provides
	  the programming interface to the fine-grain
	  connection tracking timeout infrastructure.

	  http://www.netfilter.org/projects/libnetfilter_queue/
```

## package/libnfc-llcp/Config.in
```kconfig
config BR2_PACKAGE_LIBNFC_LLCP
	bool "libnfc-llcp"
	depends on BR2_TOOLCHAIN_HAS_THREADS # libusb
	select BR2_PACKAGE_LIBNFC
	help
	  Library extending libnfc with support for Logical Link Control
	  Protocol.

	  http://code.google.com/p/nfc-tools/source/browse/trunk/libnfc-llcp/
```

## package/libnfc/Config.in
```kconfig
config BR2_PACKAGE_LIBNFC
	bool "libnfc"
	help
	  Public platform independent Near Field Communication (NFC)
	  library.

	  http://www.libnfc.org/

if BR2_PACKAGE_LIBNFC

config BR2_PACKAGE_LIBNFC_ACR122_PCSC
	bool "acr122_pcsc driver"
	depends on BR2_TOOLCHAIN_HAS_THREADS # pcsc-lite
	depends on BR2_USE_MMU # pcsc-lite
	depends on !BR2_STATIC_LIBS # pcsc-lite
	select BR2_PACKAGE_PCSC_LITE
	help
	  support for acr112_pcsc driver

comment "acr122_pcsc driver needs a toolchain w/ threads, dynamic library"
	depends on BR2_USE_MMU
	depends on !BR2_TOOLCHAIN_HAS_THREADS || BR2_STATIC_LIBS

config BR2_PACKAGE_LIBNFC_ACR122_USB
	bool "acr122_usb driver"
	depends on BR2_TOOLCHAIN_HAS_THREADS
	select BR2_PACKAGE_LIBUSB
	select BR2_PACKAGE_LIBUSB_COMPAT
	help
	  support for acr122_usb driver

comment "acr122_usb driver needs a toolchain w/ threads"
	depends on !BR2_TOOLCHAIN_HAS_THREADS

config BR2_PACKAGE_LIBNFC_ACR122S
	bool "acr122s driver"
	help
	  support for acr122s driver

config BR2_PACKAGE_LIBNFC_ARYGON
	bool "arygon driver"
	default y
	help
	  support for arygon driver

config BR2_PACKAGE_LIBNFC_PN532_I2C
	bool "pn532_i2c driver"
	help
	  support for pn532_i2c driver

config BR2_PACKAGE_LIBNFC_PN532_SPI
	bool "pn532_spi driver"
	help
	  support for pn532_spi driver

config BR2_PACKAGE_LIBNFC_PN532_UART
	bool "pn532_uart driver"
	help
	  support for pn532_uart driver

config BR2_PACKAGE_LIBNFC_PN53X_USB
	bool "pn53x_usb driver"
	default y
	depends on BR2_TOOLCHAIN_HAS_THREADS
	select BR2_PACKAGE_LIBUSB
	select BR2_PACKAGE_LIBUSB_COMPAT
	help
	  support for pn53x_usb driver

comment "pn53x_usb driver needs a toolchain w/ threads"
	depends on !BR2_TOOLCHAIN_HAS_THREADS

config BR2_PACKAGE_LIBNFC_EXAMPLES
	bool "build libnfc examples"
	select BR2_PACKAGE_READLINE

endif
```

## package/libnfnetlink/Config.in
```kconfig
config BR2_PACKAGE_LIBNFNETLINK
	bool "libnfnetlink"
	help
	  libnfnetlink is the low-level library for netfilter related
	  kernel/userspace communication.
	  It provides a generic messaging infrastructure for in-kernel
	  netfilter subsystems (such as nfnetlink_log, nfnetlink_queue,
	  nfnetlink_conntrack) and their respective users
	  and/or management tools in userspace.

	  http://www.netfilter.org/projects/libnfnetlink/
```

## package/libnfs/Config.in
```kconfig
config BR2_PACKAGE_LIBNFS
	bool "libnfs"
	depends on BR2_TOOLCHAIN_HAS_NATIVE_RPC || BR2_TOOLCHAIN_HAS_THREADS # libtirpc
	select BR2_PACKAGE_LIBTIRPC if !BR2_TOOLCHAIN_HAS_NATIVE_RPC
	help
	  nfs userspace implementation.

	  http://github.com/sahlberg/libnfs

comment "libnfs needs a toolchain w/ threads"
	depends on !(BR2_TOOLCHAIN_HAS_THREADS || BR2_TOOLCHAIN_HAS_NATIVE_RPC)
```

## package/libnftnl/Config.in
```kconfig
config BR2_PACKAGE_LIBNFTNL
	bool "libnftnl"
	depends on BR2_INET_IPV6
	depends on BR2_LARGEFILE
	depends on BR2_TOOLCHAIN_HAS_THREADS
	# bad headers, no sa_family_t in linux/socket.h
	depends on !(BR2_TOOLCHAIN_EXTERNAL_CODESOURCERY_POWERPC201103 || BR2_TOOLCHAIN_EXTERNAL_CODESOURCERY_POWERPC201009)
	select BR2_PACKAGE_LIBMNL
	help
	  libnftnl is a userspace library providing a low-level
	  netlink programming interface (API) to the in-kernel
	  nf_tables subsystem. The library libnftnl has been
	  previously known as libnftables. This library is
	  currently used by nftables.

	  http://netfilter.org/projects/libnftnl/index.html

if BR2_PACKAGE_LIBNFTNL

config BR2_PACKAGE_LIBNFTNL_JSON
	bool "enable JSON support"
	select BR2_PACKAGE_JANSSON
	help
	  Enable JSON parsing support

config BR2_PACKAGE_LIBNFTNL_XML
	bool "enable XML support"
	select BR2_PACKAGE_MXML
	help
	  Enable XML parsing support

endif

comment "libnftnl needs a toolchain w/ threads, IPv6, largefile"
	depends on !BR2_TOOLCHAIN_HAS_THREADS || !BR2_INET_IPV6 || \
		!BR2_LARGEFILE
```

## package/libnice/Config.in
```kconfig
config BR2_PACKAGE_LIBNICE
	bool "libnice"
	depends on !BR2_STATIC_LIBS # gnutls
	depends on BR2_USE_WCHAR # libglib2
	depends on BR2_TOOLCHAIN_HAS_THREADS # libglib2
	depends on BR2_USE_MMU # fork()
	select BR2_PACKAGE_GNUTLS
	select BR2_PACKAGE_LIBGLIB2
	help
	  Libnice is an implementation of the IETF's Interactive
	  Connectivity Establishment (ICE) standard (RFC 5245) and the
	  Session Traversal Utilities for NAT (STUN) standard (RFC
	  5389).

	  It provides a GLib-based library, libnice and a Glib-free
	  library, libstun as well as GStreamer elements.

	  http://nice.freedesktop.org/wiki/

comment "libnice needs a toolchain w/ wchar, threads, dynamic library"
	depends on BR2_USE_MMU
	depends on !BR2_USE_WCHAR || !BR2_TOOLCHAIN_HAS_THREADS || \
		BR2_STATIC_LIBS
```

## package/libnl/Config.in
```kconfig
config BR2_PACKAGE_LIBNL
	bool "libnl"
	depends on BR2_TOOLCHAIN_HAS_THREADS
	help
	  A library for applications dealing with netlink socket.

	  http://people.suug.ch/~tgr/libnl/

if BR2_PACKAGE_LIBNL

config BR2_PACKAGE_LIBNL_TOOLS
	bool "install tools"
	# uses <dlfcn.h>
	depends on !BR2_STATIC_LIBS
	help
	  Install binary tools.

comment "libnl tools needs a toolchain w/ dynamic library"
	depends on BR2_STATIC_LIBS
endif

comment "libnl needs a toolchain w/ threads"
	depends on !BR2_TOOLCHAIN_HAS_THREADS
```

## package/libnpth/Config.in
```kconfig
config BR2_PACKAGE_LIBNPTH
	bool "libnpth"
	depends on BR2_TOOLCHAIN_HAS_THREADS
	depends on BR2_USE_MMU # fork()
	help
	  nPth is a library to provide the GNU Pth API and thus a
	  non-preemptive threads implementation.

	  https://www.gnupg.org/related_software/npth/index.html

comment "libnpth needs a toolchain w/ threads support"
	depends on !BR2_TOOLCHAIN_HAS_THREADS
	depends on BR2_USE_MMU
```

## package/libnspr/Config.in
```kconfig
config BR2_PACKAGE_LIBNSPR_ARCH_SUPPORT
	def_bool y

if BR2_PACKAGE_LIBNSPR_ARCH_SUPPORT

config BR2_PACKAGE_LIBNSPR
	bool "libnspr"
	depends on BR2_TOOLCHAIN_HAS_THREADS
	depends on !BR2_STATIC_LIBS
	help
	  NSPR is the Netscape Portable Runtime library which provides
	  a platform-neutral API for system level and libc like
	  functions. The library is used by the Mozilla project as well
	  as others.

	  http://www.mozilla.org/projects/nspr/

comment "libnspr needs a toolchain w/ threads, dynamic library"
	depends on !BR2_TOOLCHAIN_HAS_THREADS || BR2_STATIC_LIBS

endif
```

## package/libnss/Config.in
```kconfig
config BR2_PACKAGE_LIBNSS
	bool "libnss"
	depends on BR2_TOOLCHAIN_HAS_THREADS # libnspr
	depends on BR2_PACKAGE_LIBNSPR_ARCH_SUPPORT # libnspr
	depends on !BR2_STATIC_LIBS
	select BR2_PACKAGE_LIBNSPR
	select BR2_PACKAGE_SQLITE
	select BR2_PACKAGE_ZLIB
	help
	  Network Security Services (NSS) is a set of libraries designed
	  to support development of security-enabled client and server
	  applications. Applications built with NSS can support SSL v2
	  and v3, TLS, PKCS #5, PKCS #7, PKCS #11, PKCS #12, S/MIME,
	  and X.509 v3 certificates.

	  http://www.mozilla.org/projects/security/pki/nss/

if BR2_PACKAGE_LIBNSS

config BR2_PACKAGE_LIBNSS_ARCH
	string
	default "aarch64" if BR2_aarch64_be
	default "ppc"     if BR2_powerpc
	default "ppc64"   if BR2_powerpc64
	default "ppc64le" if BR2_powerpc64le
	default BR2_ARCH

endif

comment "libnss needs a toolchain w/ threads, dynamic library"
	depends on BR2_PACKAGE_LIBNSPR_ARCH_SUPPORT
	depends on !BR2_TOOLCHAIN_HAS_THREADS || BR2_STATIC_LIBS
```

## package/liboauth/Config.in
```kconfig
config BR2_PACKAGE_LIBOAUTH
	bool "liboauth"
	select BR2_PACKAGE_OPENSSL
	help
	  liboauth is a collection of c functions implementing the oAuth
	  Core 1.0 Rev A standard API. liboauth provides basic functions
	  to escape and encode parameters according to oAuth specs and
	  offers high-level functions to sign requests or verify
	  signatures.

	  http://liboauth.sourceforge.net/
```

## package/libogg/Config.in
```kconfig
config BR2_PACKAGE_LIBOGG
	bool "libogg"
	default n
	select BR2_PACKAGE_PKGCONFIG
	help
	  Ogg is the name of Xiph.org's container format for audio,
	  video, and metadata
```

## package/liboil/Config.in
```kconfig
config BR2_PACKAGE_LIBOIL
	bool "liboil"
	depends on BR2_DEPRECATED
	help
	  Library of simple functions that are optimized for various CPUs.

	  http://liboil.freedesktop.org/
```

## package/libolm/Config.in
```kconfig
config BR2_PACKAGE_LIBOLM
	bool "libolm"
	depends on BR2_INSTALL_LIBSTDCPP
	depends on BR2_TOOLCHAIN_GCC_AT_LEAST_4_8 # C++11
	help
	  libolm is an implementation of the Double Ratchet
	  cryptographic ratchet in C++

	  https://gitlab.matrix.org/matrix-org/olm

comment "libolm needs a toolchain w/ C++, gcc >= 4.8"
	depends on !BR2_INSTALL_LIBSTDCPP || !BR2_TOOLCHAIN_GCC_AT_LEAST_4_8
```

## package/libopenh264/Config.in
```kconfig
config BR2_PACKAGE_LIBOPENH264_ARCH_SUPPORTS
	bool
	default y if BR2_arm || BR2_armeb || BR2_aarch64 || BR2_i386 || \
		BR2_mips || BR2_mipsel || BR2_mips64 || BR2_mips64el || \
		BR2_x86_64

config BR2_PACKAGE_LIBOPENH264
	bool "libopenh264"
	depends on BR2_INSTALL_LIBSTDCPP
	depends on !BR2_STATIC_LIBS
	depends on BR2_TOOLCHAIN_HAS_THREADS
	depends on BR2_PACKAGE_LIBOPENH264_ARCH_SUPPORTS
	help
	  OpenH264 is a codec library which supports H.264 encoding and
	  decoding.

	  http://www.openh264.org

comment "libopenh264 needs a toolchain w/ C++, dynamic library, threads"
	depends on !BR2_INSTALL_LIBSTDCPP || !BR2_TOOLCHAIN_HAS_THREADS || \
		BR2_STATIC_LIBS
	depends on BR2_PACKAGE_LIBOPENH264_ARCH_SUPPORTS
```

## package/libopenssl/Config.in
```kconfig
if BR2_PACKAGE_LIBOPENSSL

# 4xx PowerPC cores seem to have trouble with openssl's ASM
# optimizations
config BR2_PACKAGE_LIBOPENSSL_TARGET_ARCH_LINUX_PPC
	bool
	default y if BR2_powerpc
	depends on !BR2_powerpc_401
	depends on !BR2_powerpc_403
	depends on !BR2_powerpc_405
	depends on !BR2_powerpc_405fp
	depends on !BR2_powerpc_440
	depends on !BR2_powerpc_440fp

config BR2_PACKAGE_LIBOPENSSL_TARGET_ARCH
	string
	# Use "gcc" minimalistic target to disable DSO
	# no-asm is needed with generic architectures such as gcc, see
	# https://github.com/openssl/openssl/issues/9839
	default "gcc no-asm"			if BR2_STATIC_LIBS
	# Doesn't work for thumb-only (Cortex-M?)
	default "linux-armv4"			if BR2_ARM_CPU_HAS_ARM
	default "linux-aarch64"			if BR2_aarch64
	default "linux-ppc"			if BR2_PACKAGE_LIBOPENSSL_TARGET_ARCH_LINUX_PPC
	default "linux-ppc64"			if BR2_powerpc64
	default "linux-ppc64le"			if BR2_powerpc64le
	default "linux-x86"			if BR2_i386
	default "linux-x86_64"			if BR2_x86_64
	# no-asm is needed with generic architectures such as
	# linux-generic{32,64}, see
	# https://github.com/openssl/openssl/issues/9839
	default "linux-generic64 no-asm"	if BR2_ARCH_IS_64 && !BR2_MIPS_NABI32
	default "linux-generic32 no-asm"

config BR2_PACKAGE_LIBOPENSSL_BIN
	bool "openssl binary"
	help
	  Install the openssl binary and the associated helper scripts
	  to the target file system. This is a command line tool for
	  doing various cryptographic stuff.

config BR2_PACKAGE_LIBOPENSSL_ENGINES
	bool "openssl additional engines"
	help
	  Install additional encryption engine libraries.

endif # BR2_PACKAGE_LIBOPENSSL
```

## package/liboping/Config.in
```kconfig
config BR2_PACKAGE_LIBOPING
	bool "liboping"
	help
	  liboping is a C library to generate ICMP echo requests,
	  better known as "ping packets".

	  http://noping.cc/
```

## package/libopusenc/Config.in
```kconfig
config BR2_PACKAGE_LIBOPUSENC
	bool "libopusenc"
	select BR2_PACKAGE_OPUS
	help
	  The libopusenc library provides a high-level API for
	  encoding opus audio files and live streams.

	  http://opus-codec.org
```

## package/libosip2/Config.in
```kconfig
config BR2_PACKAGE_LIBOSIP2
	bool "libosip2"
	help
	  GNU SIP (Session Initiation Protocol)
	  This library aims to provide multimedia and telecom software
	  developers an easy and powerful interface to initiate and
	  control SIP based sessions in their applications.
	  SIP is a open standard replacement from IETF for H323.

	  http://www.gnu.org/software/osip/
```

## package/libostree/Config.in
```kconfig
config BR2_PACKAGE_LIBOSTREE
	bool "libostree"
	depends on BR2_PACKAGE_LIBGPG_ERROR_ARCH_SUPPORTS # libgpgme
	depends on !BR2_STATIC_LIBS # libfuse
	depends on BR2_TOOLCHAIN_HAS_THREADS # libglib2
	depends on BR2_USE_WCHAR # libglib2
	depends on BR2_USE_MMU # e2fsprogs, libfuse,libglib2, libgpgme
	# doesn't build with musl due to lack of TEMP_FAILURE_RETRY()
	depends on !BR2_TOOLCHAIN_USES_MUSL
	select BR2_PACKAGE_E2FSPROGS
	select BR2_PACKAGE_LIBFUSE
	select BR2_PACKAGE_LIBGLIB2
	select BR2_PACKAGE_LIBGPGME
	select BR2_PACKAGE_XZ
	help
	  OSTree is an upgrade system for Linux-based operating
	  systems.

	  https://ostree.readthedocs.io/en/latest/

comment "libostree needs a uClibc or glibc toolchain w/ threads, dynamic library, wchar"
	depends on !BR2_TOOLCHAIN_HAS_THREADS || BR2_STATIC_LIBS \
		|| !BR2_USE_WCHAR || BR2_TOOLCHAIN_USES_MUSL
	depends on BR2_PACKAGE_LIBGPG_ERROR_ARCH_SUPPORTS
	depends on BR2_USE_MMU
```

## package/libp11/Config.in
```kconfig
config BR2_PACKAGE_LIBP11
	bool "libp11"
	depends on !BR2_STATIC_LIBS # dlopen
	select BR2_PACKAGE_OPENSSL
	help
	  OpenSSL engine for PKCS#11 modules. Part of the OpenSC
	  project.

	  https://github.com/OpenSC/OpenSC/wiki

comment "libp11 needs a toolchain w/ dynamic library"
	depends on BR2_STATIC_LIBS
```

## package/libp11/Config.in.host
```kconfig
config BR2_PACKAGE_HOST_LIBP11
	bool "host libp11"
	help
	  OpenSSL engine for PKCS#11 modules. Part of the OpenSC
	  project.

	  https://github.com/OpenSC/OpenSC/wiki
```

## package/libpagekite/Config.in
```kconfig
config BR2_PACKAGE_LIBPAGEKITE
	bool "libpagekite"
	depends on BR2_TOOLCHAIN_HAS_THREADS
	select BR2_PACKAGE_LIBEV
	select BR2_PACKAGE_OPENSSL
	help
	  PageKite is a protocol for dynamic, tunneled reverse proxying
	  of arbitrary TCP byte streams. It is particularly well suited
	  for making a HTTP server on a device without a public IP
	  address visible to the wider Internet, but can also be used
	  for a variety of other things, including SSH access.

	  libpagekite is a tight, fast implementation of the PageKite
	  protocol in C, suitable for high-performance or embedded
	  applications.

	  In addition to the libpagekite library, this package installs
	  the pagekitec, sshkite and httpkite tools.

	  https://pagekite.net
	  https://github.com/pagekite/libpagekite

comment "libpagekite needs a toolchain with threads"
	depends on !BR2_TOOLCHAIN_HAS_THREADS
```

## package/libpam-nfc/Config.in
```kconfig
config BR2_PACKAGE_LIBPAM_NFC
	bool "libpam-nfc"
	select BR2_PACKAGE_LIBNFC
	help
	  NFC-based PAM authentification module.

	  https://github.com/nfc-tools/pam_nfc
```
