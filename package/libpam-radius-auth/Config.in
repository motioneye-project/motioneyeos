## package/libpam-radius-auth/Config.in
```kconfig
config BR2_PACKAGE_LIBPAM_RADIUS_AUTH
	bool "libpam-radius-auth"
	help
	  This is the PAM to RADIUS authentication module. It allows
	  any PAM-capable machine to become a RADIUS client for
	  authentication and accounting requests. You will need a
	  RADIUS server to perform the actual authentication.

	  http://freeradius.org/pam_radius_auth/
```

## package/libpam-tacplus/Config.in
```kconfig
config BR2_PACKAGE_LIBPAM_TACPLUS
	bool "libpam-tacplus"
	help
	  TACACS+ protocol client library and PAM module in C. This
	  PAM module support authentication, authorization (account
	  management) and accounting (session management)performed
	  using TACACS+ protocol designed by Cisco.

	  https://github.com/jeroennijhof/pam_tacplus
```

## package/libpcap/Config.in
```kconfig
config BR2_PACKAGE_LIBPCAP
	bool "libpcap"
	select BR2_PACKAGE_BLUEZ5_UTILS_HEADERS if BR2_PACKAGE_BLUEZ5_UTILS
	help
	  A system-independent library for user-level network packet
	  capture.

	  http://www.tcpdump.org/
```

## package/libpciaccess/Config.in
```kconfig
config BR2_PACKAGE_LIBPCIACCESS
	bool "libpciaccess"
	help
	  X.Org libpciaccess

	  Generic PCI access library

	  https://gitlab.freedesktop.org/xorg/lib/libpciaccess
```

## package/libpfm4/Config.in
```kconfig
config BR2_PACKAGE_LIBPFM4
	bool "libpfm4"
	depends on BR2_TOOLCHAIN_HAS_THREADS_NPTL
	help
	  A helper library to help encode Performance Events to use with
	  Operating system kernels performance monitoring interfaces.

	  http://perfmon2.sourceforge.net/

comment "libpfm4 needs a toolchain w/ NPTL"
	depends on !BR2_TOOLCHAIN_HAS_THREADS_NPTL
```

## package/libphidget/Config.in
```kconfig
config BR2_PACKAGE_LIBPHIDGET
	bool "libphidget"
	depends on BR2_TOOLCHAIN_HAS_THREADS # libusb
	depends on !BR2_PREFER_STATIC_LIB
	select BR2_PACKAGE_LIBUSB
	help
	  The libphidget library provides an API for controlling Phidgets
	  USB devices. The library translates API function calls to libusb
	  function calls to control attached Phidgets devices that provide
	  GPIO's, DAC's, accelerometers, servo motors, and other capabilities
	  either singly or on combo devices.

	  To use libphidget for controlling locally attached devices you
	  need to set up the userspace USB device tree /dev/bus/usb. See
	  file udev/99-phidgets.rules.

	  The libphidget library also contains an API for sending commands
	  to a local or remote phidgetwebservice using HTTP. The
	  phidgetwebservice then translates HTTP requests to libphidget API
	  function calls to control locally attached Phidgets devices.

	  http://phidgets.com/

comment "libphidget needs a toolchain w/ threads, dynamic library"
	depends on !BR2_TOOLCHAIN_HAS_THREADS
	depends on BR2_PREFER_STATIC_LIB
```

## package/libpjsip/Config.in
```kconfig
config BR2_PACKAGE_LIBPJSIP
	bool "libpjsip"
	depends on BR2_INSTALL_LIBSTDCPP
	depends on BR2_TOOLCHAIN_HAS_THREADS
	select BR2_PACKAGE_LIBSRTP
	help
	  PJSIP is a free and open source multimedia communication
	  library written in C language implementing standard based
	  protocols such as: SIP, SDP, RTP, STUN, TURN, and ICE.

	  http://www.pjsip.org

comment "libpjsip needs a toolchain w/ C++, threads"
	depends on !BR2_INSTALL_LIBSTDCPP || !BR2_TOOLCHAIN_HAS_THREADS
```

## package/libplatform/Config.in
```kconfig
config BR2_PACKAGE_LIBPLATFORM
	bool
	help
	  Platform support library used by libCEC and binary add-ons for Kodi

	  https://github.com/Pulse-Eight/platform
```

## package/libplayer/Config.in
```kconfig
config BR2_PACKAGE_LIBPLAYER
	bool "libplayer"
	depends on BR2_TOOLCHAIN_HAS_THREADS
	help
	  libplayer provides a generic A/V API that relies on various
	  multimedia player for Linux systems. It currently supports
	  MPlayer, xine VLC and GStreamer only

	  http://libplayer.geexbox.org/

if BR2_PACKAGE_LIBPLAYER

config BR2_PACKAGE_LIBPLAYER_GSTREAMER
	bool "gstreamer backend"
	depends on BR2_USE_WCHAR # glib2
	depends on BR2_TOOLCHAIN_HAS_THREADS # glib2
	depends on BR2_USE_MMU # glib2
	depends on !BR2_STATIC_LIBS # gstreamer
	select BR2_PACKAGE_GSTREAMER

comment "gstreamer backend needs a toolchain w/ wchar, threads, dynamic library"
	depends on BR2_USE_MMU
	depends on !BR2_USE_WCHAR || !BR2_TOOLCHAIN_HAS_THREADS || \
		BR2_STATIC_LIBS
endif

comment "libplayer needs a toolchain w/ threads"
	depends on !BR2_TOOLCHAIN_HAS_THREADS
```

## package/libplist/Config.in
```kconfig
config BR2_PACKAGE_LIBPLIST
	bool "libplist"
	depends on BR2_INSTALL_LIBSTDCPP
	depends on BR2_TOOLCHAIN_HAS_THREADS
	help
	  libplist is a client for manipulating Apple Property List
	  (.plist) files

	  http://www.libimobiledevice.org/

comment "libplist needs a toolchain w/ C++, threads"
	depends on !BR2_INSTALL_LIBSTDCPP || !BR2_TOOLCHAIN_HAS_THREADS
```

## package/libpng/Config.in
```kconfig
config BR2_PACKAGE_LIBPNG
	bool "libpng"
	select BR2_PACKAGE_ZLIB
	help
	  Library for handling PNG (Portable Network Graphics)
	  images.

	  http://www.libpng.org/
```

## package/libpqxx/Config.in
```kconfig
config BR2_PACKAGE_LIBPQXX
	bool "libpqxx"
	depends on BR2_PACKAGE_POSTGRESQL
	depends on BR2_TOOLCHAIN_HAS_THREADS
	depends on BR2_TOOLCHAIN_GCC_AT_LEAST_4_8 # C++11
	depends on BR2_INSTALL_LIBSTDCPP
	help
	  libpqxx is the official C++ client API for PostgreSQL, the
	  enterprise-strength open-source relational database.

	  http://pqxx.org/development/libpqxx/

comment "libpqxx needs toolchain w/ C++, gcc >= 4.8, threads"
	depends on BR2_PACKAGE_POSTGRESQL
	depends on !BR2_INSTALL_LIBSTDCPP || \
		!BR2_TOOLCHAIN_GCC_AT_LEAST_4_8 || \
		!BR2_TOOLCHAIN_HAS_THREADS
```

## package/libpri/Config.in
```kconfig
config BR2_PACKAGE_LIBPRI
	bool "libpri"
	depends on BR2_USE_MMU # fork()
	depends on BR2_LINUX_KERNEL
	depends on BR2_TOOLCHAIN_HAS_THREADS
	select BR2_PACKAGE_DAHDI_LINUX
	select BR2_PACKAGE_DAHDI_TOOLS
	help
	  libpri is an open source library that encapsulates the
	  protocols used to communicate over ISDN Primary Rate
	  Interfaces (T1, E1, J1).

	  http://www.asterisk.org/downloads/libpri

comment "libpri needs a kernel to be built"
	depends on BR2_USE_MMU
	depends on !BR2_LINUX_KERNEL

comment "libpri needs a toolchain w/ threads"
	depends on BR2_USE_MMU
	depends on !BR2_TOOLCHAIN_HAS_THREADS
```

## package/libpthread-stubs/Config.in
```kconfig
config BR2_PACKAGE_LIBPTHREAD_STUBS
	bool "libpthread-stubs"
	depends on BR2_TOOLCHAIN_HAS_THREADS
	help
	  This library provides weak aliases for pthread functions not
	  provided in libc or otherwise available by default.

	  http://xcb.freedesktop.org/

comment "libpthread-stubs needs a toolchain w/ threads"
	depends on !BR2_TOOLCHAIN_HAS_THREADS
```

## package/libpwquality/Config.in
```kconfig
config BR2_PACKAGE_LIBPWQUALITY
	bool "libpwquality"
	help
	  This is a library for password quality checks and generation
	  of random passwords that pass the checks.  This library uses
	  the cracklib and cracklib dictionaries to perform some of
	  the checks.

	  https://github.com/libpwquality/libpwquality

if BR2_PACKAGE_LIBPWQUALITY

config BR2_PACKAGE_LIBPWQUALITY_TOOLS
	bool "install tools"
	help
	  Install libpwquality command line tools generating/checking
	  passwords.

endif
```

## package/libqmi/Config.in
```kconfig
config BR2_PACKAGE_LIBQMI
	bool "libqmi"
	depends on BR2_USE_WCHAR # libglib2
	depends on BR2_TOOLCHAIN_HAS_THREADS # libglib2
	depends on BR2_USE_MMU # libglib2
	select BR2_PACKAGE_LIBGLIB2
	help
	  libqmi is a glib-based library for talking to WWAN modems and devices
	  which speak the Qualcomm MSM Interface (QMI) protocol.

	  http://www.freedesktop.org/wiki/Software/libqmi/

comment "libqmi needs a toolchain w/ wchar, threads"
	depends on BR2_USE_MMU
	depends on !BR2_USE_WCHAR || !BR2_TOOLCHAIN_HAS_THREADS
```

## package/libqrencode/Config.in
```kconfig
config BR2_PACKAGE_LIBQRENCODE
	bool "libqrencode"
	help
	  libqrencode is a C library for encoding data in a QR Code
	  symbol, a kind of 2D symbology that can be scanned by handy
	  terminals such as a mobile phone with CCD. The capacity of
	  QR Code is up to 7000 digits or 4000 characters, and is
	  highly robust.

	  http://fukuchi.org/works/qrencode/index.html

if BR2_PACKAGE_LIBQRENCODE

config BR2_PACKAGE_LIBQRENCODE_TOOLS
	bool "libqrencode tools"
	select BR2_PACKAGE_LIBPNG
	help
	  Build command-line tools

endif #BR2_PACKAGE_LIBQRENCODE
```

## package/libraw/Config.in
```kconfig
config BR2_PACKAGE_LIBRAW
	bool "libraw"
	depends on BR2_INSTALL_LIBSTDCPP
	help
	  libraw is a raw image manipulation library

	  http://www.libraw.org/

comment "libraw needs a toolchain w/ C++"
	depends on !BR2_INSTALL_LIBSTDCPP
```

## package/libraw1394/Config.in
```kconfig
config BR2_PACKAGE_LIBRAW1394
	bool "libraw1394"
	help
		Library for direct access to IEEE 1394 bus.

		Through libraw1394/raw1394, applications can directly
		send to and receive from other nodes without requiring
		a kernel driver for the protocol in question.

		http://www.linux1394.org/
```

## package/libressl/Config.in
```kconfig
if BR2_PACKAGE_LIBRESSL

config BR2_PACKAGE_LIBRESSL_BIN
	bool "openssl binary"
	help
	  Install the openssl binary to the target file system. This is
	  a command line tool for doing various cryptographic stuff.

endif
```

## package/libroxml/Config.in
```kconfig
config BR2_PACKAGE_LIBROXML
	bool "roxml"
	depends on BR2_TOOLCHAIN_HAS_THREADS
	help
	  libroxml is a light and powerful xml parsing library with
	  xpath handling. Roxml is a binary using libroxml to explore
	  xml file from shell scripts.

	  http://www.libroxml.net

comment "libroxml needs a toolchain w/ threads"
	depends on !BR2_TOOLCHAIN_HAS_THREADS
```

## package/librsvg/Config.in
```kconfig
config BR2_PACKAGE_LIBRSVG
	bool "librsvg"
	depends on BR2_USE_WCHAR # glib2
	depends on BR2_TOOLCHAIN_HAS_THREADS # glib2
	depends on BR2_USE_MMU # glib2
	depends on BR2_INSTALL_LIBSTDCPP # pango
	depends on BR2_TOOLCHAIN_HAS_SYNC_4 # pango -> harfbuzz
	depends on BR2_TOOLCHAIN_GCC_AT_LEAST_4_8 # pango -> harfbuzz
	select BR2_PACKAGE_CAIRO
	select BR2_PACKAGE_CAIRO_PNG
	select BR2_PACKAGE_GDK_PIXBUF
	select BR2_PACKAGE_LIBCROCO
	select BR2_PACKAGE_LIBGLIB2
	select BR2_PACKAGE_LIBXML2
	select BR2_PACKAGE_PANGO
	help
	  The rsvg library is an efficient renderer for Scalable
	  Vector Graphics (SVG) pictures.

	  https://wiki.gnome.org/Projects/LibRsvg

comment "librsvg needs a toolchain w/ wchar, threads, C++, gcc >= 4.8"
	depends on BR2_USE_MMU
	depends on BR2_TOOLCHAIN_HAS_SYNC_4
	depends on !BR2_USE_WCHAR || !BR2_TOOLCHAIN_HAS_THREADS || \
		!BR2_TOOLCHAIN_GCC_AT_LEAST_4_8 || \
		!BR2_INSTALL_LIBSTDCPP
```

## package/librsync/Config.in
```kconfig
config BR2_PACKAGE_LIBRSYNC
	bool "librsync"
	select BR2_PACKAGE_ZLIB
	select BR2_PACKAGE_BZIP2
	select BR2_PACKAGE_POPT
	help
	  librsync implements the rolling-checksum algorithm of
	  remote file synchronization that was popularized by the
	  rsync utility and is used in rproxy.

	  https://github.com/librsync/librsync
```

## package/librtas/Config.in
```kconfig
config BR2_PACKAGE_LIBRTAS
	bool "librtas"
	depends on BR2_powerpc || BR2_powerpc64 || BR2_powerpc64le
	depends on BR2_TOOLCHAIN_USES_GLIBC
	help
	  The librtas package provides an interface for Run-Time Abstraction
	  Services (RTAS) calls on PAPR platforms. The libraries allow users to
	  examine and manipulate hardware, and parse RTAS events.

	  http://librtas.sourceforge.net/

comment "librtas needs an (e)glibc toolchain"
	depends on BR2_powerpc || BR2_powerpc64 || BR2_powerpc64le
	depends on !BR2_TOOLCHAIN_USES_GLIBC
```

## package/librtlsdr/Config.in
```kconfig
config BR2_PACKAGE_LIBRTLSDR
	bool "librtlsdr"
	depends on BR2_TOOLCHAIN_HAS_THREADS
	select BR2_PACKAGE_LIBUSB
	help
	  Library and command line programs for accessing
	  RTL2832U SDR dongles.

	  http://sdr.osmocom.org/trac/wiki/rtl-sdr/

if BR2_PACKAGE_LIBRTLSDR

config BR2_PACKAGE_LIBRTLSDR_DETACH_DRIVER
	bool "Detach kernel driver"
	default y
	help
	  Enable this option if you would like librtlsdr to
	  automatically detach any kernel driver associated to the
	  RTL2832U USB device on startup if one is loaded.

endif

comment "librtlsdr needs a toolchain w/ threads"
	depends on !BR2_TOOLCHAIN_HAS_THREADS
```
