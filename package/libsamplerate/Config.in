## package/libsamplerate/Config.in
```kconfig
config BR2_PACKAGE_LIBSAMPLERATE
	bool "libsamplerate"
	help
	  Secret Rabbit Code (aka libsamplerate) is a Sample Rate
	  Converter for audio. One example of where such a thing would
	  be useful is converting audio from the CD sample rate of
	  44.1kHz to the 48kHz sample rate used by DAT players.

	  http://www.mega-nerd.com/SRC/
```

## package/libscrypt/Config.in
```kconfig
config BR2_PACKAGE_LIBSCRYPT
	bool "libscrypt"
	# Unconditionally builds a shared library
	depends on !BR2_STATIC_LIBS
	help
	  This is a library that implements the secure password
	  hashing function "scrypt".

	  http://www.lolware.net/libscrypt.html

comment "libscrypt needs a toolchain w/ dynamic library"
	depends on BR2_STATIC_LIBS
```

## package/libseccomp/Config.in
```kconfig
config BR2_PACKAGE_LIBSECCOMP
	bool "libseccomp"
	depends on BR2_aarch64 || BR2_mips || BR2_mipsel || BR2_mips64 || \
		BR2_mips64el || BR2_i386 || BR2_x86_64
	depends on BR2_TOOLCHAIN_HEADERS_AT_LEAST_3_12
	help
	  High level interface to the Linux Kernel's seccomp filter

	  The libseccomp library provides an easy to use, platform independent,
	  interface to the Linux Kernel's syscall filtering mechanism: seccomp.
	  The libseccomp API is designed to abstract away the underlying BPF
	  based syscall filter language and present a more conventional
	  function-call based filtering interface that should be familiar to,
	  and easily adopted by application developers.

	  https://github.com/seccomp/libseccomp

comment "libseccomp needs a toolchain w/ headers >= 3.12"
	depends on BR2_aarch64 || BR2_mips || BR2_mipsel || BR2_mips64 || \
		BR2_mips64el || BR2_i386 || BR2_x86_64
	depends on !BR2_TOOLCHAIN_HEADERS_AT_LEAST_3_12
```

## package/libsecret/Config.in
```kconfig
config BR2_PACKAGE_LIBSECRET
	bool "libsecret"
	depends on BR2_USE_WCHAR # gettext dep in libglib2
	depends on BR2_TOOLCHAIN_HAS_THREADS # libglib2
	depends on BR2_USE_MMU # libglib2
	select BR2_PACKAGE_LIBGLIB2
	help
	  libsecret is a library for storing and retrieving passwords
	  and other secrets. It communicates with the "Secret Service"
	  using DBus. gnome-keyring and ksecretservice are both
	  implementations of a Secret Service.

	  https://wiki.gnome.org/Libsecret

comment "libsecret needs a toolchain w/ wchar, threads"
	depends on BR2_USE_MMU
	depends on !BR2_USE_WCHAR || !BR2_TOOLCHAIN_HAS_THREADS
```

## package/libselinux/Config.in
```kconfig
config BR2_PACKAGE_LIBSELINUX
	bool "libselinux"
	depends on BR2_TOOLCHAIN_HAS_THREADS
	depends on !BR2_STATIC_LIBS
	select BR2_PACKAGE_LIBSEPOL
	select BR2_PACKAGE_PCRE
	select BR2_PACKAGE_MUSL_FTS if !BR2_TOOLCHAIN_USES_GLIBC
	help
	  libselinux is the runtime SELinux library that provides
	  interfaces (e.g. library functions for the SELinux kernel
	  APIs like getcon(), other support functions like
	  getseuserbyname()) to SELinux-aware applications. libselinux
	  may use the shared libsepol to manipulate the binary policy
	  if necessary (e.g. to downgrade the policy format to an
	  older version supported by the kernel) when loading policy.

	  http://selinuxproject.org/page/Main_Page

comment "libselinux needs a toolchain w/ threads, dynamic library"
	depends on !BR2_TOOLCHAIN_HAS_THREADS || BR2_STATIC_LIBS
```

## package/libsemanage/Config.in
```kconfig
config BR2_PACKAGE_LIBSEMANAGE
	bool "libsemanage"
	depends on BR2_PACKAGE_AUDIT_ARCH_SUPPORTS
	depends on BR2_TOOLCHAIN_HAS_THREADS
	depends on !BR2_STATIC_LIBS
	select BR2_PACKAGE_AUDIT
	select BR2_PACKAGE_LIBSELINUX
	select BR2_PACKAGE_BZIP2
	help
	  libsemanage is the policy management library. It uses
	  libsepol for binary policy manipulation and libselinux for
	  interacting with the SELinux system. It also exec's helper
	  programs for loading policy and for checking whether the
	  file_contexts configuration is valid (load_policy and
	  setfiles from policycoreutils) presently, although this may
	  change at least for the bootstrapping case (for rpm).

	  http://selinuxproject.org/page/Main_Page

comment "libsemanage needs a toolchain w/ threads, dynamic library"
	depends on BR2_PACKAGE_AUDIT_ARCH_SUPPORTS
	depends on !BR2_TOOLCHAIN_HAS_THREADS || BR2_STATIC_LIBS
```

## package/libsepol/Config.in
```kconfig
config BR2_PACKAGE_LIBSEPOL
	bool "libsepol"
	depends on BR2_TOOLCHAIN_HAS_THREADS # pthread
	help
	  Libsepol is the binary policy manipulation library. It doesn't
	  depend upon or use any of the other SELinux components.

	  http://selinuxproject.org/page/Main_Page

if BR2_PACKAGE_LIBSEPOL

config BR2_PACKAGE_LIBSEPOL_POLICY_VERSION
	int "Policy version"
	default 31 if BR2_TOOLCHAIN_HEADERS_AT_LEAST_4_13
	default 30 if BR2_TOOLCHAIN_HEADERS_AT_LEAST_4_3
	default 29 if BR2_TOOLCHAIN_HEADERS_AT_LEAST_3_14
	default 28 if BR2_TOOLCHAIN_HEADERS_AT_LEAST_3_5
	default 26 if BR2_TOOLCHAIN_HEADERS_AT_LEAST_2_6
	default 25
	help
	  The maximum SELinux policy version your kernel supports.

	  Here's a handy table to help you choose:
	  kernel version   SElinux policy max version
	  < 2.6.x          25
	  >= 2.6 < 3.5     26
	  >= 3.5 < 3.14    28 (27 and 28 were added at the same time)
	  >= 3.14 < 4.3    29
	  >= 4.3 < 4.13    30
	  >= 4.13          31

endif

comment "libsepol needs a toolchain w/ threads"
	depends on !BR2_TOOLCHAIN_HAS_THREADS
```

## package/libserial/Config.in
```kconfig
config BR2_PACKAGE_LIBSERIAL
	bool "libserial"
	depends on BR2_INSTALL_LIBSTDCPP
	depends on BR2_TOOLCHAIN_GCC_AT_LEAST_5 # C++14
	depends on BR2_TOOLCHAIN_HAS_THREADS # boost
	depends on BR2_USE_WCHAR # boost
	select BR2_PACKAGE_BOOST
	help
	  Simplified serial port programming in C++ under POSIX
	  operating systems.

	  http://libserial.sourceforge.net/

comment "libserial needs a toolchain w/ C++, gcc >= 5, threads, wchar"
	depends on !BR2_INSTALL_LIBSTDCPP || \
		!BR2_TOOLCHAIN_GCC_AT_LEAST_5 || \
		!BR2_TOOLCHAIN_HAS_THREADS || !BR2_USE_WCHAR
```

## package/libserialport/Config.in
```kconfig
config BR2_PACKAGE_LIBSERIALPORT
	bool "libserialport"
	help
	  Serial port access library.

	  This library is a part of the sigrok software suite.

	  http://sigrok.org/wiki/Libserialport
```

## package/libsexy/Config.in
```kconfig
config BR2_PACKAGE_LIBSEXY
	bool "libsexy"
	depends on BR2_PACKAGE_LIBGTK2
	select BR2_PACKAGE_LIBXML2
	help
	  libsexy is a collection of GTK+ widgets that extend the
	  functionality of such standard widgets as GtkEntry and
	  GtkLabel by subclassing them and working around the
	  limitations of the widgets.

	  http://www.chipx86.com/wiki/Libsexy
```

## package/libshairplay/Config.in
```kconfig
config BR2_PACKAGE_LIBSHAIRPLAY
	bool "libshairplay"
	depends on BR2_INET_IPV6
	depends on BR2_TOOLCHAIN_HAS_THREADS
	depends on BR2_USE_MMU # avahi
	depends on !BR2_PREFER_STATIC_LIB # avahi
	select BR2_PACKAGE_AVAHI
	select BR2_PACKAGE_AVAHI_DAEMON
	select BR2_PACKAGE_AVAHI_LIBDNSSD_COMPATIBILITY # runtime
	help
	  libshairplay is a client library that emulates an airplay
	  server.

	  https://github.com/juhovh/shairplay

comment "libshairplay needs a toolchain w/ IPv6, threads, dynamic library"
	depends on BR2_USE_MMU
	depends on !BR2_INET_IPV6 || !BR2_TOOLCHAIN_HAS_THREADS || BR2_PREFER_STATIC_LIB
```

## package/libshout/Config.in
```kconfig
config BR2_PACKAGE_LIBSHOUT
	bool "libshout"
	select BR2_PACKAGE_LIBOGG
	select BR2_PACKAGE_LIBVORBIS
	help
	  Libshout is a library for communicating with and sending data to an
	  icecast server. It handles the socket connection, the timing of the
	  data, and prevents bad data from getting to the icecast server.

	  http://icecast.org/download/
```

## package/libsidplay2/Config.in
```kconfig
config BR2_PACKAGE_LIBSIDPLAY2
	bool "libsidplay2"
	depends on BR2_INSTALL_LIBSTDCPP
	help
	  Sidplay 2 is the second in the Sidplay series originally
	  developed by Michael Schwendt. This version is written by
	  Simon White and is cycle accurate for improved sound
	  reproduction. Sidplay 2 is capable of playing all C64 mono and
	  stereo file formats.

	  http://sourceforge.net/projects/sidplay2

comment "libsidplay2 needs a toolchain w/ C++"
	depends on !BR2_INSTALL_LIBSTDCPP
```

## package/libsigc/Config.in
```kconfig
config BR2_PACKAGE_LIBSIGC
	bool "libsigc++"
	depends on BR2_INSTALL_LIBSTDCPP
	help
	  libsigc++ implements a typesafe callback system for standard C++.
	  It allows you to define signals and to connect those signals to
	  any callback function, either global or a member function,
	  regardless of whether it is static or virtual.

	  http://libsigc.sourceforge.net/

comment "libsigc++ needs a toolchain w/ C++"
	depends on !BR2_INSTALL_LIBSTDCPP
```

## package/libsigrok/Config.in
```kconfig
config BR2_PACKAGE_LIBSIGROK
	bool "libsigrok"
	# libglib2
	depends on BR2_USE_WCHAR
	depends on BR2_TOOLCHAIN_HAS_THREADS
	depends on BR2_USE_MMU
	depends on BR2_ENABLE_LOCALE
	depends on !BR2_STATIC_LIBS # libzip
	# std=c11
	depends on BR2_TOOLCHAIN_GCC_AT_LEAST_4_7
	select BR2_PACKAGE_LIBZIP
	select BR2_PACKAGE_LIBGLIB2
	help
	  Libsigrok is a shared library written in C, which provides
	  the basic hardware access drivers for logic analyzers and
	  other supported devices, as well as input/output file format
	  support.

	  This library is a part of the sigrok software suite.

	  http://sigrok.org/wiki/Libsigrok

if BR2_PACKAGE_LIBSIGROK

config BR2_PACKAGE_LIBSIGROKCXX
	bool "build C++ bindings"
	depends on BR2_INSTALL_LIBSTDCPP
	depends on BR2_TOOLCHAIN_GCC_AT_LEAST_4_9 # glibmm
	depends on BR2_HOST_GCC_AT_LEAST_4_9 # host-doxygen
	select BR2_PACKAGE_GLIBMM
	select BR2_PACKAGE_HOST_DOXYGEN
	help
	  Build libsigrok C++ bindings as well.

comment "C++ bindings need a toolchain w/ C++, gcc >= 4.9, host gcc >= 4.9"
	depends on !BR2_INSTALL_LIBSTDCPP || \
		!BR2_TOOLCHAIN_GCC_AT_LEAST_4_9 || \
		!BR2_HOST_GCC_AT_LEAST_4_9

endif

comment "libsigrok needs a toolchain w/ wchar, locale, threads, dynamic library, gcc >= 4.7"
	depends on BR2_USE_MMU
	depends on !BR2_USE_WCHAR || !BR2_TOOLCHAIN_HAS_THREADS \
		|| !BR2_TOOLCHAIN_GCC_AT_LEAST_4_7 || BR2_STATIC_LIBS \
		|| !BR2_ENABLE_LOCALE
```

## package/libsigrokdecode/Config.in
```kconfig
config BR2_PACKAGE_LIBSIGROKDECODE
	bool "libsigrokdecode"
	select BR2_PACKAGE_LIBGLIB2
	select BR2_PACKAGE_PYTHON3
	depends on !BR2_PACKAGE_PYTHON # python3
	depends on BR2_USE_WCHAR # libglib2/python3
	depends on BR2_TOOLCHAIN_HAS_THREADS # libglib2/python3
	depends on BR2_USE_MMU # libglib2/python3
	help
	  Libsigrokdecode is a shared library written in C, which
	  provides (streaming) protocol decoding functionality. Say
	  yes here if you want to add this functionality to your
	  buildroot-generated sigrok suite.

	  This library is a part of the sigrok software suite.

	  http://sigrok.org/wiki/Libsigrokdecode

comment "libsigrokecode needs a toolchain w/ wchar, threads"
	depends on BR2_USE_MMU
	depends on !BR2_PACKAGE_PYTHON
	depends on !BR2_USE_WCHAR || !BR2_TOOLCHAIN_HAS_THREADS

comment "libsigrokdecode is not compatible with python"
	depends on BR2_USE_MMU
	depends on BR2_PACKAGE_PYTHON
```

## package/libsigsegv/Config.in
```kconfig
config BR2_PACKAGE_LIBSIGSEGV_ARCH_SUPPORTS
	bool
	default y if BR2_TOOLCHAIN_HAS_UCONTEXT

config BR2_PACKAGE_LIBSIGSEGV
	bool "libsigsegv"
	depends on BR2_PACKAGE_LIBSIGSEGV_ARCH_SUPPORTS
	help
	  Library for handling page faults in user mode.

	  http://www.gnu.org/software/libsigsegv/
```

## package/libsilk/Config.in
```kconfig
config BR2_PACKAGE_LIBSILK
	bool "libsilk"
	help
	  SILK is an audio compression format and audio codec.

	  http://tools.ietf.org/html/draft-vos-silk-01
```

## package/libsndfile/Config.in
```kconfig
config BR2_PACKAGE_LIBSNDFILE
	bool "libsndfile"
	help
	  Libsndfile is a C library for reading and writing files
	  containing sampled sound (such as MS Windows WAV and the
	  Apple/SGI AIFF format) through one standard library interface.

	  http://www.mega-nerd.com/libsndfile/
```

## package/libsoc/Config.in
```kconfig
config BR2_PACKAGE_LIBSOC
	bool "libsoc"
	depends on BR2_TOOLCHAIN_HAS_THREADS
	help
	  libsoc is a C library for interfacing with common SoC
	  peripherals through generic kernel interfaces

	  https://github.com/jackmitch/libsoc

comment "libsoc needs a toolchain w/ threads"
	depends on !BR2_TOOLCHAIN_HAS_THREADS
```

## package/libsocketcan/Config.in
```kconfig
config BR2_PACKAGE_LIBSOCKETCAN
	bool "libsocketcan"
	help
	  SocketCAN library to control CAN devices from C code.

	  http://git.pengutronix.de/?p=tools/libsocketcan.git;a=summary
```

## package/libsodium/Config.in
```kconfig
config BR2_PACKAGE_LIBSODIUM
	bool "libsodium"
	help
	  A modern and easy-to-use crypto library.

	  http://libsodium.org/

if BR2_PACKAGE_LIBSODIUM

config BR2_PACKAGE_LIBSODIUM_FULL
	bool "all functions"
	default y
	help
	  Build all seldom used and obsolete functions. Without
	  this option, only the minimal set of normally used
	  functions is built.

endif
```

## package/libsoil/Config.in
```kconfig
config BR2_PACKAGE_LIBSOIL
	bool "libsoil"
	depends on BR2_PACKAGE_HAS_LIBGL
	depends on !BR2_STATIC_LIBS
	help
	  SOIL is a tiny C library used primarily for uploading
	  textures into OpenGL.

	  http://www.lonesock.net/soil.html

comment "libsoil needs an OpenGL backend and a toolchain w/ dynamic library"
	depends on !BR2_PACKAGE_HAS_LIBGL || BR2_STATIC_LIBS
```

## package/libsoundtouch/Config.in
```kconfig
config BR2_PACKAGE_LIBSOUNDTOUCH
	bool "libsoundtouch"
	depends on BR2_INSTALL_LIBSTDCPP
	help
	  SoundTouch is an open-source audio processing library for
	  changing the Tempo, Pitch and Playback Rates of audio streams
	  or audio files.

	  http://www.surina.net/soundtouch

comment "libsoundtouch needs a toolchain w/ C++"
	depends on !BR2_INSTALL_LIBSTDCPP
```

## package/libsoup/Config.in
```kconfig
config BR2_PACKAGE_LIBSOUP
	bool "libsoup"
	depends on BR2_USE_WCHAR # glib2 and gnutls
	depends on BR2_TOOLCHAIN_HAS_THREADS # glib2
	depends on BR2_USE_MMU # glib2
	select BR2_PACKAGE_LIBXML2
	select BR2_PACKAGE_LIBGLIB2
	select BR2_PACKAGE_SQLITE
	help
	  libsoup is an HTTP client/server library. It uses GObject
	  and the GLib main loop, to integrate well with GNOME
	  applications.

	  https://wiki.gnome.org/Projects/libsoup

if BR2_PACKAGE_LIBSOUP

config BR2_PACKAGE_LIBSOUP_GNOME
	bool "libsoup-gnome"
	help
	  Build libsoup-gnome library.

config BR2_PACKAGE_LIBSOUP_SSL
	bool "https support"
	depends on !BR2_STATIC_LIBS # gnutls
	select BR2_PACKAGE_GLIB_NETWORKING
	select BR2_PACKAGE_GNUTLS
	help
	  Enable HTTPS (SSL) support.

comment "libsoup https support needs a toolchain w/ dynamic library"
	depends on BR2_STATIC_LIBS

endif

comment "libsoup needs a toolchain w/ wchar, threads"
	depends on BR2_USE_MMU
	depends on !BR2_USE_WCHAR || !BR2_TOOLCHAIN_HAS_THREADS
```
