## package/libsoxr/Config.in
```kconfig
config BR2_PACKAGE_LIBSOXR
	bool "libsoxr"
	help
	  The SoX Resampler library `libsoxr' performs one-dimensional
	  sample-rate conversion. It may be used, for example, to
	  resample PCM-encoded audio.

	  It aims to give fast and high quality results for any constant
	  (rational or irrational) resampling ratio. Phase-response,
	  preserved bandwidth, aliasing, and rejection level parameters
	  are all configurable; alternatively, simple `preset'
	  configurations may be selected. An experimental, variable-rate
	  resampling mode of operation is also included.

	  http://sourceforge.net/projects/soxr/
```

## package/libspatialindex/Config.in
```kconfig
config BR2_PACKAGE_LIBSPATIALINDEX
	bool "libspatialindex"
	depends on BR2_INSTALL_LIBSTDCPP
	help
	  The purpose of libspatialindex is to provide:

	  * An extensible framework that will support robust spatial
	    indexing methods.

	  * Support for sophisticated spatial queries. Range, point
	    location, nearest neighbor and k-nearest neighbor as well
	    as parametric queries (defined by spatial constraints)
	    should be easy to deploy and run.

	  * Easy to use interfaces for inserting, deleting and updating
	    information.

	  * Wide variety of customization capabilities. Basic index and
	    storage characteristics like the page size, node capacity,
	    minimum fan-out, splitting algorithm, etc. should be easy
	    to customize.

	  * Index persistence. Internal memory and external memory
	    structures should be supported. Clustered and non-clustered
	    indices should be easy to be persisted.

	  https://libspatialindex.github.io

comment "libspatialindex needs a toolchain w/ C++"
	depends on !BR2_INSTALL_LIBSTDCPP
```

## package/libsquish/Config.in
```kconfig
config BR2_PACKAGE_LIBSQUISH
	bool "libsquish"
	depends on BR2_INSTALL_LIBSTDCPP
	help
	  The libSquish library compresses images with the DXT standard
	  (also known as S3TC). This standard is mainly used by OpenGL
	  and DirectX for the lossy compression of RGBA textures.

	  http://sourceforge.net/projects/libsquish

comment "libsquish needs a toolchain w/ C++"
	depends on !BR2_INSTALL_LIBSTDCPP
```

## package/libsrtp/Config.in
```kconfig
config BR2_PACKAGE_LIBSRTP
	bool "libsrtp"
	help
	  This package provides an implementation of the Secure
	  Real-time Transport Protocol (SRTP), the Universal Security
	  Transform (UST), and a supporting cryptographic kernel.

	  https://github.com/cisco/libsrtp
```

## package/libss7/Config.in
```kconfig
config BR2_PACKAGE_LIBSS7
	bool "libss7"
	depends on BR2_LINUX_KERNEL
	depends on BR2_TOOLCHAIN_HAS_THREADS
	select BR2_PACKAGE_DAHDI_LINUX
	select BR2_PACKAGE_DAHDI_TOOLS
	help
	  libss7 is an open source library that encapsulates the
	  protocols used to communicate using Signaling System 7
	  over ISDN (T1, E1).

	  http://www.asterisk.org/downloads/libss7

comment "libss7 needs a kernel to be built"
	depends on !BR2_LINUX_KERNEL

comment "libss7 needs a toolchain w/ threads"
	depends on !BR2_TOOLCHAIN_HAS_THREADS
```

## package/libssh/Config.in
```kconfig
config BR2_PACKAGE_LIBSSH
	bool "libssh"
	depends on BR2_USE_MMU # fork()
	depends on !BR2_STATIC_LIBS
	depends on BR2_TOOLCHAIN_HAS_THREADS
	select BR2_PACKAGE_OPENSSL if !(BR2_PACKAGE_MBEDTLS || BR2_PACKAGE_LIBGCRYPT)
	help
	  libssh is a multiplatform C library implementing the SSHv2
	  and SSHv1 protocol on client and server side. With libssh,
	  you can remotely execute programs, transfer files, use a
	  secure and transparent tunnel for your remote applications.

	  http://www.libssh.org/

if BR2_PACKAGE_LIBSSH

config BR2_PACKAGE_LIBSSH_SERVER
	bool "server"
	help
	  Enable libssh server support

choice
	prompt "Crypto Backend"
	help
	  Select crypto library to be used in libssh.

config BR2_PACKAGE_LIBSSH_MBEDTLS
	bool "mbedtls"
	depends on BR2_PACKAGE_MBEDTLS

config BR2_PACKAGE_LIBSSH_LIBGCRYPT
	bool "gcrypt"
	depends on BR2_PACKAGE_LIBGCRYPT

config BR2_PACKAGE_LIBSSH_OPENSSL
	bool "openssl"
	depends on BR2_PACKAGE_OPENSSL

endchoice

endif

comment "libssh needs a toolchain w/ dynamic library, threads"
	depends on BR2_USE_MMU
	depends on BR2_STATIC_LIBS || !BR2_TOOLCHAIN_HAS_THREADS
```

## package/libssh2/Config.in
```kconfig
config BR2_PACKAGE_LIBSSH2
	bool "libssh2"
	help
	  libssh2 is a client-side C library implementing the SSH2
	  protocol as defined by Internet Drafts: SECSH-TRANS(22),
	  SECSH-USERAUTH(25), SECSH-CONNECTION(23), SECSH-ARCH(20),
	  SECSH-FILEXFER(06)*, SECSH-DHGEX(04), and SECSH-NUMBERS(10)

	  http://www.libssh2.org/

if BR2_PACKAGE_LIBSSH2

choice
	prompt "Crypto Backend"
	help
	  Select crypto library to be used in libssh2.

config BR2_PACKAGE_LIBSSH2_MBEDTLS
	bool "mbedtls"
	select BR2_PACKAGE_MBEDTLS

config BR2_PACKAGE_LIBSSH2_LIBGCRYPT
	bool "gcrypt"
	depends on BR2_PACKAGE_LIBGPG_ERROR_ARCH_SUPPORTS # libgcrypt -> libgpg-error
	select BR2_PACKAGE_LIBGCRYPT

config BR2_PACKAGE_LIBSSH2_OPENSSL
	bool "openssl"
	select BR2_PACKAGE_OPENSSL

endchoice
endif
```

## package/libstrophe/Config.in
```kconfig
config BR2_PACKAGE_LIBSTROPHE
	bool "libstrophe"
	select BR2_PACKAGE_OPENSSL
	select BR2_PACKAGE_LIBXML2 if !BR2_PACKAGE_EXPAT
	depends on BR2_TOOLCHAIN_HAS_THREADS
	help
	  libstrophe is a lightweight XMPP client library written in C.
	  It has minimal dependencies and is configurable for various
	  environments. It runs well on both Linux, Unix, and Windows
	  based platforms.

	  https://github.com/strophe/libstrophe

comment "libstrophe needs a toolchain w/ threads"
        depends on !BR2_TOOLCHAIN_HAS_THREADS
```

## package/libsvg/Config.in
```kconfig
config BR2_PACKAGE_LIBSVG
	bool "libsvg"
	select BR2_PACKAGE_LIBPNG
	select BR2_PACKAGE_LIBJPEG
	select BR2_PACKAGE_LIBXML2 if !BR2_PACKAGE_EXPAT
	help
	  Libsvg provides a parser for SVG content in files or buffers.
	  Libsvg does not do any rendering, but instead provides a
	  function-based interface that can be used by various rendering
	  engines.

	  http://cairographics.org/snapshots/
```

## package/libsvgtiny/Config.in
```kconfig
config BR2_PACKAGE_LIBSVGTINY
	bool "libsvgtiny"
	select BR2_PACKAGE_LIBXML2
	help
	  Libsvgtiny is an implementation of SVG Tiny, written in C.
	  It is currently in development for use with NetSurf and is
	  intended to be suitable for use in other projects too.

	  http://www.netsurf-browser.org/projects/libsvgtiny/
```

## package/libsysfs/Config.in
```kconfig
config BR2_PACKAGE_LIBSYSFS
	bool "libsysfs"
	help
	  These are a set of utilities built upon sysfs, a filesystem in
	  Linux 2.6 kernels that exposes a system's device tree.

	  http://linux-diag.sourceforge.net/Sysfsutils.html
```

## package/libtasn1/Config.in
```kconfig
config BR2_PACKAGE_LIBTASN1
	bool "libtasn1"
	help
	  ASN.1 library

	  http://www.gnu.org/software/libtasn1
```

## package/libtelnet/Config.in
```kconfig
config BR2_PACKAGE_LIBTELNET
	bool "libtelnet"
	help
	  libtelnet provides safe and correct handling of the core
	  TELNET protocol.  In addition to the base TELNET protocol,
	  libtelnet also implements the Q method of TELNET option
	  negotiation.  libtelnet can be used for writing servers,
	  clients, or proxies.

	  https://github.com/seanmiddleditch/libtelnet
```

## package/libtheora/Config.in
```kconfig
config BR2_PACKAGE_LIBTHEORA
	bool "libtheora"
	select BR2_PACKAGE_LIBOGG
	select BR2_PACKAGE_LIBVORBIS
	help
	  A library for the free and open video compression format
	  "Theora" from the Xiph.org Foundation.

	  http://www.theora.org/
```

## package/libtirpc/Config.in
```kconfig
config BR2_PACKAGE_LIBTIRPC
	bool "libtirpc"
	depends on BR2_TOOLCHAIN_HAS_THREADS
	help
	  Libtirpc is a port of Sun's Transport-Independent RPC
	  library to Linux.

	  http://sourceforge.net/projects/libtirpc/

comment "libtirpc needs a toolchain w/ threads"
	depends on !BR2_TOOLCHAIN_HAS_THREADS
```

## package/libtommath/Config.in
```kconfig
config BR2_PACKAGE_LIBTOMMATH
	bool "libtommath"
	help
	  LibTomMath is a free open source portable number theoretic
	  multiple-precision integer library written entirely in C.

	  http://www.libtom.net
```

## package/libtool/Config.in
```kconfig
config BR2_PACKAGE_LIBTOOL
	bool "libtool"
	help
	  Library that hides the complexity of using shared/static
	  libraries on different platforms behind a consistent, portable
	  interface.

	  http://www.gnu.org/software/libtool/
```

## package/libtorrent-rasterbar/Config.in
```kconfig
comment "libtorrent-rasterbar needs a toolchain w/ C++, threads, wchar, gcc >= 4.9"
	depends on BR2_TOOLCHAIN_SUPPORTS_VARIADIC_MI_THUNK
	depends on !BR2_TOOLCHAIN_HAS_GCC_BUG_64735
	depends on !BR2_INSTALL_LIBSTDCPP || !BR2_TOOLCHAIN_HAS_THREADS || !BR2_USE_WCHAR || \
		!BR2_HOST_GCC_AT_LEAST_4_9 || !BR2_TOOLCHAIN_GCC_AT_LEAST_4_9

comment "libtorrent-rasterbar needs exception_ptr"
	depends on BR2_TOOLCHAIN_SUPPORTS_VARIADIC_MI_THUNK
	depends on BR2_TOOLCHAIN_HAS_GCC_BUG_64735

config BR2_PACKAGE_LIBTORRENT_RASTERBAR
	bool "libtorrent-rasterbar"
	depends on BR2_INSTALL_LIBSTDCPP # boost
	depends on BR2_HOST_GCC_AT_LEAST_4_9 # C++11
	depends on BR2_TOOLCHAIN_GCC_AT_LEAST_4_9 # C++11
	depends on BR2_TOOLCHAIN_HAS_THREADS # boost
	depends on BR2_TOOLCHAIN_SUPPORTS_VARIADIC_MI_THUNK
	depends on BR2_USE_WCHAR # boost
	depends on !BR2_TOOLCHAIN_HAS_GCC_BUG_64735 # exception_ptr
	select BR2_PACKAGE_BOOST
	select BR2_PACKAGE_BOOST_SYSTEM
	select BR2_PACKAGE_OPENSSL
	help
	  libtorrent is a feature complete C++ bittorrent implementation
	  focusing on efficiency and scalability.

	  https://www.libtorrent.org/
```

## package/libtorrent/Config.in
```kconfig
config BR2_PACKAGE_LIBTORRENT
	bool "libtorrent"
	depends on BR2_INSTALL_LIBSTDCPP
	depends on BR2_TOOLCHAIN_HAS_THREADS
	depends on BR2_TOOLCHAIN_HAS_SYNC_1 && BR2_TOOLCHAIN_HAS_SYNC_4
	select BR2_PACKAGE_ZLIB
	help
	  BitTorrent library written in C++ for *nix

	  https://github.com/rakshasa/libtorrent

comment "libtorrent needs a toolchain w/ C++, threads"
	depends on BR2_TOOLCHAIN_HAS_SYNC_1 && BR2_TOOLCHAIN_HAS_SYNC_4
	depends on !BR2_INSTALL_LIBSTDCPP || !BR2_TOOLCHAIN_HAS_THREADS
```

## package/libtpl/Config.in
```kconfig
config BR2_PACKAGE_LIBTPL
	bool "libtpl"
	help
	  Easily store and retrieve binary data in C

	  http://tpl.sourceforge.net/
```

## package/libubootenv/Config.in
```kconfig
config BR2_PACKAGE_LIBUBOOTENV
	bool "libubootenv"
	select BR2_PACKAGE_ZLIB
	help
	  libubootenv is a library that provides a hardware independent
	  way to access to U-Boot environment.

	  The package provides the fw_printenv / fw_setenv utilities,
	  new tools build from the library and not from U-Boot.

	  https://github.com/sbabic/libubootenv/
```

## package/libubox/Config.in
```kconfig
config BR2_PACKAGE_LIBUBOX
	bool "libubox"
	depends on !BR2_PREFER_STATIC_LIB
	help
	  This library originates from the OpenWrt project to
	  handle the configuration file infrastructure, but can
	  also be used for the same purposes in projects other
	  than OpenWrt.

	  http://nbd.name/gitweb.cgi?p=luci2/libubox.git;a=summary

comment "libubox needs a toolchain w/ dynamic library"
	depends on BR2_PREFER_STATIC_LIB
```

## package/libucl/Config.in
```kconfig
config BR2_PACKAGE_LIBUCL
	bool "libucl"
	help
	  Universal configuration library parser

	  Libucl is a parser and C API to parse and generate ucl
	  objects. Libucl consist of several groups of functions:
	  parser, emitting, conversion, generation, iteration,
	  validation, and utility. These functions can be used to work
	  with several formats: JSON, compact JSON, configuration
	  (nginx like), and YAML. Libucl has clear design that should
	  be very convenient for reading and writing and makes for an
	  ideal parser with high performance.

	  https://github.com/vstakhov/libucl
```

## package/libudfread/Config.in
```kconfig
config BR2_PACKAGE_LIBUDFREAD
	bool "libudfread"
	help
	  UDF reader

	  https://code.videolan.org/videolan/libudfread
```

## package/libuecc/Config.in
```kconfig
config BR2_PACKAGE_LIBUECC
	bool "libuecc"
	depends on !BR2_STATIC_LIBS
	help
	  Very small Elliptic Curve Cryptography library

	  http://git.universe-factory.net/libuecc

comment "libuecc needs a toolchain w/ dynamic library"
	depends on BR2_STATIC_LIBS
```
