## package/libuhttpd/Config.in
```kconfig
config BR2_PACKAGE_LIBUHTTPD
	bool "libuhttpd"
	select BR2_PACKAGE_LIBEV
	help
	  A lightweight and fully asynchronous HTTP server
	  library based on libev

	  https://github.com/zhaojh329/libuhttpd
```

## package/libuio/Config.in
```kconfig
config BR2_PACKAGE_LIBUIO
	bool "libuio"
	select BR2_PACKAGE_ARGP_STANDALONE if BR2_TOOLCHAIN_USES_UCLIBC || BR2_TOOLCHAIN_USES_MUSL
	help
	  libuio is a light-weight C programming library to handle UIO
	  (Userspace I/O) device discovery and binding task.

	  http://github.com/Linutronix/libuio
```

## package/libump/Config.in
```kconfig
config BR2_PACKAGE_LIBUMP
	bool "libump"
	depends on BR2_TOOLCHAIN_USES_GLIBC
	depends on BR2_arm
	help
	  The ARMs Universal Memory Provider userspace library.
	  This library is a requirement for ARMs binary Mali driver.

	  http://github.com/linux-sunxi/libump

comment "libump needs a (e)glibc toolchain"
	depends on BR2_arm
	depends on !BR2_TOOLCHAIN_USES_GLIBC
```

## package/libungif/Config.in
```kconfig
config BR2_PACKAGE_LIBUNGIF
	bool "libungif"
	depends on !BR2_PACKAGE_GIFLIB
	depends on BR2_DEPRECATED_SINCE_2015_02 # giflib
	help
	  libungif is a library for handling the uncompressed GIF image format.

	  http://sourceforge.net/projects/libungif
```

## package/libunistring/Config.in
```kconfig
config BR2_PACKAGE_LIBUNISTRING
	bool "libunistring"
	help
	  The libunistring library provides functions for manipulating
	  Unicode strings and for manipulating C strings according to
	  the Unicode standard.

	  http://www.gnu.org/software/libunistring/
```

## package/libunwind/Config.in
```kconfig
# libunwind is only available for a certain subset of the
# architectures (as visible in the list of architectures supported
# with the glibc C library below).
#
# In addition to this, on some architectures libunwind requires the
# *context() function from the C library, which are only available on
# certain architectures in uClibc, and not available at all on
# musl. But on some other architectures, libunwind works without using
# the *context() functions, which allows it to be built with musl.
config BR2_PACKAGE_LIBUNWIND_ARCH_SUPPORTS
	bool
	default y if BR2_TOOLCHAIN_USES_GLIBC && \
		(BR2_ARM_CPU_HAS_ARM || BR2_mips || BR2_mipsel || BR2_mips64 || \
		 BR2_mips64el || BR2_powerpc || BR2_sh || BR2_i386 || BR2_x86_64)
	default y if BR2_TOOLCHAIN_USES_UCLIBC && \
		(BR2_ARM_CPU_HAS_ARM || BR2_mips || BR2_mipsel || \
		 BR2_mips64 || BR2_mips64el || BR2_x86_64)
	default y if BR2_TOOLCHAIN_USES_MUSL && \
		(BR2_ARM_CPU_HAS_ARM || BR2_x86_64)

config BR2_PACKAGE_LIBUNWIND
	bool "libunwind"
	depends on BR2_TOOLCHAIN_HAS_THREADS
	depends on BR2_PACKAGE_LIBUNWIND_ARCH_SUPPORTS
	help
	  C API to determine the call-chain of a program.

	  http://www.nongnu.org/libunwind/index.html

comment "libunwind needs a toolchain w/ threads"
	depends on BR2_PACKAGE_LIBUNWIND_ARCH_SUPPORTS
	depends on !BR2_TOOLCHAIN_HAS_THREADS
```

## package/libupnp/Config.in
```kconfig
config BR2_PACKAGE_LIBUPNP
	bool "libupnp"
	depends on BR2_LARGEFILE
	depends on BR2_TOOLCHAIN_HAS_THREADS
	help
	  The portable SDK for UPnP(tm) Devices (libupnp) provides developers
	  with an API and open source code for building control points,
	  devices, and bridges that are compliant with Version 1.0 of the
	  Universal Plug and Play Device Architecture Specification

	  http://pupnp.sourceforge.net/

comment "libupnp needs a toolchain w/ largefile, threads"
	depends on !(BR2_LARGEFILE && BR2_TOOLCHAIN_HAS_THREADS)
```

## package/libupnp18/Config.in
```kconfig
config BR2_PACKAGE_LIBUPNP18
	bool "libupnp18"
	depends on BR2_TOOLCHAIN_HAS_THREADS
	depends on !BR2_PACKAGE_LIBUPNP
	help
	  The portable SDK for UPnP(tm) Devices (libupnp) provides
	  developers with an API and open source code for building
	  control points, devices, and bridges that are compliant with
	  Version 1.0 of the Universal Plug and Play Device Architecture
	  Specification

	  http://pupnp.sourceforge.net/

comment "libupnp18 needs a toolchain w/ threads"
	depends on !BR2_PACKAGE_LIBUPNP
	depends on !BR2_TOOLCHAIN_HAS_THREADS
```

## package/libupnpp/Config.in
```kconfig
config BR2_PACKAGE_LIBUPNPP
	bool "libupnpp"
	depends on BR2_INSTALL_LIBSTDCPP
	depends on BR2_TOOLCHAIN_HAS_THREADS # libupnp
	depends on BR2_TOOLCHAIN_GCC_AT_LEAST_4_9
	select BR2_PACKAGE_EXPAT
	select BR2_PACKAGE_LIBCURL
	select BR2_PACKAGE_LIBUPNP18 if !BR2_PACKAGE_LIBUPNP
	help
	  The libupnpp C++ library wraps libupnp for easier use by
	  upmpdcli and upplay.

	  http://www.lesbonscomptes.com/upmpdcli/

comment "libupnpp needs a toolchain w/ C++, threads, gcc >= 4.9"
	depends on !BR2_INSTALL_LIBSTDCPP || !BR2_TOOLCHAIN_HAS_THREADS || !BR2_TOOLCHAIN_GCC_AT_LEAST_4_9
```

## package/liburcu/Config.in
```kconfig
config BR2_PACKAGE_LIBURCU_ARCH_SUPPORTS
	bool
	default y
	depends on BR2_arm || BR2_armeb || BR2_aarch64 || BR2_aarch64_be || \
		BR2_i386 || BR2_mips || BR2_mips64 || BR2_mipsel || \
		BR2_mips64el || BR2_nios2 || BR2_powerpc || BR2_powerpc64 || \
		BR2_powerpc64le || BR2_riscv || BR2_sparc64 || BR2_x86_64
	depends on BR2_USE_MMU # fork() in test

config BR2_PACKAGE_LIBURCU
	bool "liburcu"
	depends on BR2_PACKAGE_LIBURCU_ARCH_SUPPORTS
	depends on BR2_TOOLCHAIN_HAS_THREADS
	help
	  Userspace implementation of the Read-Copy-Update (RCU)
	  synchronization mechanism. This library is mainly used by
	  the LTTng tracing infrastructure, but can be used for other
	  purposes as well.

	  On ARM, because of bug:
	    http://gcc.gnu.org/bugzilla/show_bug.cgi?id=58854
	  liburcu cannot be built using gcc 4.8.0, 4.8.1 or 4.8.2
	  without the following bug fix:
	    http://gcc.gnu.org/viewcvs/gcc?view=revision&revision=204665

	  http://lttng.org/urcu

comment "liburcu needs a toolchain w/ threads"
	depends on BR2_PACKAGE_LIBURCU_ARCH_SUPPORTS
	depends on !BR2_TOOLCHAIN_HAS_THREADS
```

## package/liburiparser/Config.in
```kconfig
config BR2_PACKAGE_LIBURIPARSER
	bool "liburiparser"
	help
	  uriparser is a strictly RFC 3986 compliant URI parsing and
	  handling library written in C.

	  http://uriparser.sourceforge.net
```

## package/libusb-compat/Config.in
```kconfig
config BR2_PACKAGE_LIBUSB_COMPAT
	bool "libusb-compat"
	depends on BR2_PACKAGE_LIBUSB
	help
	  libusb-0.1 compatibility layer for libusb-1.0.

	  http://libusb.sourceforge.net/
```

## package/libusb/Config.in
```kconfig
config BR2_PACKAGE_LIBUSB
	bool "libusb"
	depends on BR2_TOOLCHAIN_HAS_THREADS
	help
	  Userspace library for accessing USB devices

	  http://libusb.info/

if BR2_PACKAGE_LIBUSB

config BR2_PACKAGE_LIBUSB_EXAMPLES
	bool "build libusb examples"

endif

comment "libusb needs a toolchain w/ threads"
	depends on !BR2_TOOLCHAIN_HAS_THREADS
```

## package/libusbgx/Config.in
```kconfig
config BR2_PACKAGE_LIBUSBGX
	bool "libusbgx"
	depends on BR2_TOOLCHAIN_HAS_THREADS
	select BR2_PACKAGE_LIBCONFIG
	help
	  libusbgx is a C library encapsulating the kernel USB
	  gadget-configfs userspace API functionality.

	  https://github.com/libusbgx/libusbgx

comment "libusbgx needs a toolchain w/ threads"
	depends on !BR2_TOOLCHAIN_HAS_THREADS
```

## package/libuv/Config.in
```kconfig
config BR2_PACKAGE_LIBUV
	bool "libuv"
	depends on BR2_TOOLCHAIN_HAS_THREADS_NPTL # pthread_barrier_*
	depends on BR2_USE_MMU # fork()
	depends on !BR2_STATIC_LIBS
	depends on BR2_TOOLCHAIN_HAS_SYNC_4
	help
	  libuv is a multi-platform support library with a focus
	  on asynchronous I/O.

	  https://github.com/libuv/libuv

comment "libuv needs a toolchain w/ NPTL, dynamic library"
	depends on !BR2_TOOLCHAIN_HAS_THREADS_NPTL || BR2_STATIC_LIBS
	depends on BR2_USE_MMU
	depends on BR2_TOOLCHAIN_HAS_SYNC_4
```

## package/libuwsc/Config.in
```kconfig
config BR2_PACKAGE_LIBUWSC
	bool "libuwsc"
	select BR2_PACKAGE_LIBEV
	help
	  A Lightweight and fully asynchronous WebSocket client
	  library based on libev.

	  https://github.com/zhaojh329/libuwsc
```

## package/libv4l/Config.in
```kconfig
config BR2_PACKAGE_LIBV4L
	bool "libv4l"
	depends on BR2_LARGEFILE
	depends on BR2_TOOLCHAIN_HAS_THREADS
	depends on BR2_USE_MMU # fork()
	depends on BR2_INSTALL_LIBSTDCPP
	depends on BR2_TOOLCHAIN_HEADERS_AT_LEAST_3_0 # media headers
	select BR2_PACKAGE_ARGP_STANDALONE if BR2_TOOLCHAIN_USES_UCLIBC
	select BR2_PACKAGE_LIBICONV if !BR2_ENABLE_LOCALE
	help
	  libv4l is a collection of libraries which adds a thin abstraction
	  layer on top of video4linux2 devices. libv4l consists of 3 different
	  libraries: libv4lconvert, libv4l1 and libv4l2.

	  http://freshmeat.net/projects/libv4l

if BR2_PACKAGE_LIBV4L

comment "libv4l JPEG support not enabled"
	depends on !BR2_PACKAGE_JPEG

config BR2_PACKAGE_LIBV4L_UTILS
	bool "v4l-utils tools"
	help
	  v4l-utils is a collection of various video4linux and DVB utilities.
	  Enable this if you want to build the following tools:
	  cx18-ctl, ir-keytable, ivtv-ctl, v4l2-ctl, v4l2-sysfs-path and
	  others.

endif

comment "libv4l needs a toolchain w/ largefile, threads and C++, headers >= 3.0"
	depends on BR2_USE_MMU
	depends on !BR2_LARGEFILE || !BR2_TOOLCHAIN_HAS_THREADS \
		|| !BR2_INSTALL_LIBSTDCPP || !BR2_TOOLCHAIN_HEADERS_AT_LEAST_3_0
```

## package/libva-intel-driver/Config.in
```kconfig
config BR2_PACKAGE_LIBVA_INTEL_DRIVER
	bool "libva-intel-driver"
	select BR2_PACKAGE_LIBVA
	select BR2_PACKAGE_LIBDRM
	select BR2_PACKAGE_LIBDRM_INTEL
	select BR2_PACKAGE_XLIB_LIBX11 if BR2_PACKAGE_XORG7
	select BR2_PACKAGE_XLIB_LIBXEXT if BR2_PACKAGE_XORG7
	select BR2_PACKAGE_XLIB_LIBXFIXES if BR2_PACKAGE_XORG7
	depends on BR2_i386 || BR2_x86_64
	depends on BR2_TOOLCHAIN_HAS_THREADS # libdrm/libpthread-stubs
	depends on !BR2_STATIC_LIBS # libva
	help
	  VA-API back-end driver for Intel graphics chips

	  https://01.org/linuxgraphics/community/vaapi

comment "libva intel driver needs a toolchain w/ threads, dynamic library"
	depends on !BR2_TOOLCHAIN_HAS_THREADS || BR2_STATIC_LIBS
	depends on BR2_i386 || BR2_x86_64
```

## package/libva-utils/Config.in
```kconfig
config BR2_PACKAGE_LIBVA_UTILS
	bool "libva-utils"
	depends on BR2_INSTALL_LIBSTDCPP
	depends on !BR2_STATIC_LIBS # libva
	depends on BR2_TOOLCHAIN_HAS_THREADS # libva
	select BR2_PACKAGE_LIBVA
	help
	  Libva-utils is a collection of tests for VA-API (Video
	  Acceleration API)

	  https://01.org/linuxmedia/vaapi

comment "libva-utils needs a toolchain w/ C++, threads, dynamic library"
	depends on !BR2_INSTALL_LIBSTDCPP || \
		BR2_STATIC_LIBS || !BR2_TOOLCHAIN_HAS_THREADS
```

## package/libva/Config.in
```kconfig
config BR2_PACKAGE_LIBVA
	bool "libva"
	depends on BR2_TOOLCHAIN_HAS_THREADS # libdrm/libpthread-stubs
	depends on !BR2_STATIC_LIBS
	select BR2_PACKAGE_LIBDRM
	select BR2_PACKAGE_XLIB_LIBX11 if BR2_PACKAGE_XORG7
	select BR2_PACKAGE_XLIB_LIBXEXT if BR2_PACKAGE_XORG7
	select BR2_PACKAGE_XLIB_LIBXFIXES if BR2_PACKAGE_XORG7
	help
	  The main motivation for VA-API (Video Acceleration API) is to enable
	  hardware accelerated video decode/encode at various entry-points (VLD,
	  IDCT, Motion Compensation etc.) for the prevailing coding standards
	  today (MPEG-2, MPEG-4 ASP/H.263, MPEG-4 AVC/H.264, and VC-1/VMW3).

	  https://01.org/linuxmedia/vaapi

comment "libva needs a toolchain w/ threads, dynamic library"
	depends on !BR2_TOOLCHAIN_HAS_THREADS || BR2_STATIC_LIBS
```

## package/libvdpau/Config.in
```kconfig
config BR2_PACKAGE_LIBVDPAU
	bool "libvdpau"
	depends on BR2_TOOLCHAIN_HAS_THREADS
	depends on BR2_INSTALL_LIBSTDCPP
	depends on BR2_PACKAGE_XORG7
	select BR2_PACKAGE_XLIB_LIBX11
	select BR2_PACKAGE_XLIB_LIBXEXT
	help
	  VDPAU is the Video Decode and Presentation API for UNIX.
	  It provides an interface to video decode acceleration and
	  presentation hardware present in modern GPUs.

	  http://freedesktop.org/wiki/Software/VDPAU

comment "libvdpau needs a toolchain w/ threads, C++"
	depends on BR2_PACKAGE_XORG7
	depends on !BR2_TOOLCHAIN_HAS_THREADS || !BR2_INSTALL_LIBSTDCPP
```

## package/libvips/Config.in
```kconfig
config BR2_PACKAGE_LIBVIPS
	bool "libvips"
	depends on BR2_USE_WCHAR # gettext, libglib2
	depends on BR2_TOOLCHAIN_HAS_THREADS # libglib2
	depends on BR2_USE_MMU # fork()
	# C++ support is required to build libvips
	# https://github.com/jcupitt/libvips/issues/231
	depends on BR2_INSTALL_LIBSTDCPP
	select BR2_PACKAGE_LIBGLIB2
	select BR2_PACKAGE_LIBXML2
	select BR2_PACKAGE_GETTEXT if BR2_NEEDS_GETTEXT_IF_LOCALE
	help
	  libvips is a 2D image processing library. Compared to
	  similar libraries, libvips runs quickly and uses little
	  memory.

	  http://www.vips.ecs.soton.ac.uk/

comment "libvips needs a toolchain w/ wchar, threads, C++"
        depends on BR2_USE_MMU
        depends on !BR2_USE_WCHAR || !BR2_TOOLCHAIN_HAS_THREADS || \
		!BR2_INSTALL_LIBSTDCPP
```

## package/libvncserver/Config.in
```kconfig
config BR2_PACKAGE_LIBVNCSERVER
	bool "libvncserver"
	depends on BR2_USE_MMU # VNCommand.c uses fork()
	# binutils issue (bad expression)
	depends on !BR2_nios2
	depends on !BR2_STATIC_LIBS
	select BR2_PACKAGE_LZO
	help
	  libvncserver is a VNC server/client library.

	  https://libvnc.github.io/

if BR2_PACKAGE_LIBVNCSERVER

config BR2_PACKAGE_LIBVNCSERVER_TIGHTPNG
	bool "TightPNG encoding support"
	select BR2_PACKAGE_JPEG
	select BR2_PACKAGE_LIBPNG
	help
	  TightPNG encoding speeds up HTML5 based VNC clients like
	  noVNC.

	  http://wiki.qemu.org/VNC_Tight_PNG

endif

comment "libvncserver needs a toolchain w/ dynamic library"
	depends on BR2_USE_MMU
	depends on !BR2_nios
	depends on BR2_STATIC_LIBS
```

## package/libvorbis/Config.in
```kconfig
config BR2_PACKAGE_LIBVORBIS
	bool "libvorbis"
	default n
	help
	  Library for the Vorbis open source audio decoder
	  Ogg Vorbis is a fully open, non-proprietary, patent-and-royalty-free, 
	  general-purpose compressed audio format for mid to high quality
	  (8kHz-48.0kHz, 16+ bit, polyphonic) audio and music at fixed and 
	  variable bitrates from 16 to 128 kbps/channel.

	  This places Vorbis in the same competitive class as audio representations
	  such as MPEG-4 (AAC), and similar to, but higher performance than
	  MPEG-1/2 audio layer 3, MPEG-4 audio (TwinVQ), WMA and PAC.


config BR2_PACKAGE_LIBVORBIS_HEADERS
	bool "libvorbis target headers"
	default n
	depends on BR2_PACKAGE_LIBVORBIS
	help
	  Add target headers for the Vorbis open source audio decoder

config BR2_PACKAGE_LIBVORBIS_TREMOR
	bool "libvorbis integer implementation"
	default y if BR2_arm || BR2_av32
	default n
	depends on BR2_PACKAGE_LIBVORBIS
	help
	  Use the Tremor fixed point implementation
	  Not yet implemented
```

## package/libvpx/Config.in
```kconfig
config BR2_PACKAGE_LIBVPX
	bool "libvpx"
	depends on BR2_TOOLCHAIN_HAS_THREADS
	help
	  A high-quality, open video format that's freely available to
	  everyone.

	  http://webmproject.org

comment "libvpx needs a toolchain w/ threads"
	depends on !BR2_TOOLCHAIN_HAS_THREADS
```
