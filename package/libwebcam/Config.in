## package/libwebsock/Config.in
```kconfig
config BR2_PACKAGE_LIBWEBSOCK
	bool "libwebsock"
	depends on BR2_TOOLCHAIN_HAS_THREADS
	select BR2_PACKAGE_LIBEVENT
	help
	  C library for easy WebSockets servers.

	  This library allows a developer to quickly develop WebSocket
	  servers by focusing on the actual logic of your WebSocket
	  implementation instead of the details of the WebSocket
	  protocol or even specifics of C sockets.

	  https://github.com/payden/libwebsock

comment "libwebsock needs a toolchain w/ threads"
	depends on !BR2_TOOLCHAIN_HAS_THREADS
```

## package/libwebsockets/Config.in
```kconfig
config BR2_PACKAGE_LIBWEBSOCKETS
	bool "libwebsockets"
	select BR2_PACKAGE_ZLIB
	help
	  Libwebsockets is a lightweight pure C library built to use
	  minimal CPU and memory resources, and provide fast throughput
	  in both directions.

	  http://libwebsockets.org/
```

## package/libwpe/Config.in
```kconfig
comment "libwpe needs a toolchain w/ C++, dynamic library and an OpenEGL-capable backend"
	depends on !BR2_PACKAGE_HAS_LIBEGL || !BR2_INSTALL_LIBSTDCPP || BR2_STATIC_LIBS

config BR2_PACKAGE_LIBWPE
	bool "libwpe"
	depends on !BR2_STATIC_LIBS # dlfcn.h
	depends on BR2_INSTALL_LIBSTDCPP
	depends on BR2_PACKAGE_HAS_LIBEGL
	select BR2_PACKAGE_LIBXKBCOMMON
	help
	  Base library for the WPE WebKit port.

	  https://wpewebkit.org/
```

## package/libxkbcommon/Config.in
```kconfig
config BR2_PACKAGE_LIBXKBCOMMON
	bool "libxkbcommon"
	select BR2_PACKAGE_LIBXCB if BR2_PACKAGE_XORG7
	help
	  xkbcommon is a keymap compiler and support library which
	  processes a reduced subset of keymaps as defined by the XKB
	  specification.

	  http://xkbcommon.org/
```

## package/libxml-parser-perl/Config.in
```kconfig
config BR2_PACKAGE_LIBXML_PARSER_PERL
       bool "libxml-parser-perl"
       select BR2_PACKAGE_EXPAT
       # Hide from configuration as we only support the host package
       # for the moment
       depends on BR2_HOST_ONLY
       help
         The Perl XML::Parser module.

	 http://www.cpan.org/modules/by-module/XML/
```

## package/libxml2/Config.in
```kconfig
config BR2_PACKAGE_LIBXML2
	bool "libxml2"
	help
	  XML C Parser

	  http://xmlsoft.org/

config BR2_PACKAGE_HOST_LIBXML2_PYTHON
	bool
```

## package/libxmlpp/Config.in
```kconfig
config BR2_PACKAGE_LIBXMLPP
	bool "libxml++"
	depends on BR2_TOOLCHAIN_GCC_AT_LEAST_4_9 # C++11
	depends on BR2_INSTALL_LIBSTDCPP
	depends on BR2_USE_WCHAR # glibmm -> libglib2
	depends on BR2_TOOLCHAIN_HAS_THREADS # glibmm -> libglib2
	depends on BR2_USE_MMU # glibmm -> libglib2
	select BR2_PACKAGE_LIBXML2
	select BR2_PACKAGE_GLIBMM
	help
	  libxml++ is a C++ wrapper for the libxml XML parser library.

	  http://libxmlplusplus.sourceforge.net/

comment "libxml++ needs a toolchain w/ C++, wchar, threads, gcc >= 4.9"
	depends on !BR2_TOOLCHAIN_GCC_AT_LEAST_4_9 || !BR2_USE_WCHAR \
		||!BR2_TOOLCHAIN_HAS_THREADS || !BR2_INSTALL_LIBSTDCPP
	depends on BR2_USE_MMU
```

## package/libxmlrpc/Config.in
```kconfig
config BR2_PACKAGE_LIBXMLRPC
	bool "libxmlrpc"
	depends on BR2_TOOLCHAIN_HAS_THREADS
	select BR2_PACKAGE_LIBCURL
	help
	  XML-RPC is a quick-and-easy way to make procedure calls over
	  the Internet. It converts the procedure call into an XML
	  document, sends it to a remote server using HTTP, and gets
	  back the response as XML.

	  http://xmlrpc-c.sourceforge.net/

comment "libxmlrpc needs a toolchain w/ threads"
	depends on !BR2_TOOLCHAIN_HAS_THREADS
```

## package/libxslt/Config.in
```kconfig
config BR2_PACKAGE_LIBXSLT
	bool "libxslt"
	default n
	select BR2_PACKAGE_PKGCONFIG
	help
	  Install the xslt library which is used
	  to transform XML files to other XML files.

	  XSLT is designed for use as part of XSL,
	  which is a stylesheet language for XML.
	  In addition to XSLT, XSL includes an XML vocabulary
	  for specifying formatting.
	  XSL specifies the styling of an XML document by using XSLT
	  to describe how the document is transformed into another
	  XML document that uses the formatting vocabulary.

	  http://www.w3.org/TR/xslt
```

## package/libyaml/Config.in
```kconfig
config BR2_PACKAGE_LIBYAML
	bool "libyaml"
	help
	  LibYAML is a YAML 1.1 parser and emitter written in C.

	  http://pyyaml.org/wiki/LibYAML
```

## package/libyang/Config.in
```kconfig
config BR2_PACKAGE_LIBYANG
	bool "libyang"
	depends on BR2_TOOLCHAIN_HAS_THREADS
	depends on !BR2_STATIC_LIBS
	select BR2_PACKAGE_PCRE
	select BR2_PACKAGE_PCRE_UCP
	help
	  Libyang is YANG data modeling language parser and toolkit
	  written (and providing API) in C.

	  https://github.com/CESNET/libyang

comment "libyang needs a toolchain w/ threads, dynamic library"
	depends on !BR2_TOOLCHAIN_HAS_THREADS || BR2_STATIC_LIBS
```

## package/libyuv/Config.in
```kconfig
config BR2_PACKAGE_LIBYUV
	bool "libyuv"
	depends on BR2_INSTALL_LIBSTDCPP
	depends on !BR2_STATIC_LIBS
	help
	  libyuv is an open source project that includes YUV scaling
	  and conversion functionality.

	  https://chromium.googlesource.com/libyuv/libyuv/

comment "libyuv needs a toolchain w/ C++, dynamic library"
	depends on !BR2_INSTALL_LIBSTDCPP || BR2_STATIC_LIBS
```

## package/libzip/Config.in
```kconfig
config BR2_PACKAGE_LIBZIP
	bool "libzip"
	depends on !BR2_STATIC_LIBS # dlsym()
	select BR2_PACKAGE_MUSL_FTS if !BR2_TOOLCHAIN_USES_GLIBC
	select BR2_PACKAGE_ZLIB
	help
	  C library for reading, creating, and modifying zip archives.
	  This package also contains zipcmp, ziptorrent and zipmerge
	  utilities.

	  https://libzip.org/

comment "libzip needs a toolchain w/ dynamic library"
	depends on BR2_STATIC_LIBS
```

## package/lightning/Config.in
```kconfig
comment "lightning needs a toolchain w/ dynamic library"
	depends on BR2_sparc || BR2_i386 || BR2_x86_64 || BR2_mips || \
		BR2_mipsel || BR2_arm || BR2_powerpc || BR2_RISCV_64
	depends on BR2_STATIC_LIBS

config BR2_PACKAGE_LIGHTNING
	bool "lightning"
	depends on BR2_sparc || BR2_i386 || BR2_x86_64 || BR2_mips || \
		BR2_mipsel || BR2_arm || BR2_powerpc || BR2_RISCV_64
	depends on !BR2_STATIC_LIBS
	help
	  GNU lightning is a library that generates
	  assembly language code at run-time.

	  https://www.gnu.org/software/lightning/

if BR2_PACKAGE_LIGHTNING

config BR2_PACKAGE_LIGHTNING_DISASSEMBLER
	bool "enable disassembler"
	depends on !BR2_nios2 # binutils
	depends on BR2_USE_WCHAR # binutils
	select BR2_PACKAGE_BINUTILS
	select BR2_PACKAGE_ZLIB
	help
	  Enable the GNU lightning disassembler.

comment "lightning disassembler needs a toolchain w/ wchar"
	depends on !BR2_nios2
	depends on !BR2_USE_WCHAR

endif
```

## package/lighttpd/Config.in
```kconfig
config BR2_PACKAGE_LIGHTTPD
	bool "lighttpd"
	depends on BR2_USE_MMU # fork()
	help
	  lighttpd a secure, fast, compliant and very flexible web-server
	  which has been optimized for high-performance environments. It
	  has a very low memory footprint compared to other webservers and
	  takes care of cpu-load. Its advanced feature-set (FastCGI, CGI,
	  Auth, Output-Compression, URL-Rewriting and many more) make
	  lighttpd the perfect webserver-software for every server that
	  is suffering load problems.

	  http://www.lighttpd.net/

if BR2_PACKAGE_LIGHTTPD

config BR2_PACKAGE_LIGHTTPD_OPENSSL
	bool "openssl support"
	select BR2_PACKAGE_OPENSSL
	help
	  Enable OpenSSL support for lighttpd.

config BR2_PACKAGE_LIGHTTPD_ZLIB
	bool "zlib support"
	select BR2_PACKAGE_ZLIB
	help
	  Enable zlib support for lighttpd mod_compress.

config BR2_PACKAGE_LIGHTTPD_BZIP2
	bool "bzip2 support"
	select BR2_PACKAGE_BZIP2
	help
	  Enable bzip2 support for lighttpd mod_compress.

config BR2_PACKAGE_LIGHTTPD_PCRE
	bool "pcre support"
	select BR2_PACKAGE_PCRE
	help
	  Enable PCRE support. Needed to support mod_rewrite

config BR2_PACKAGE_LIGHTTPD_WEBDAV
	bool "webdav support"
	select BR2_PACKAGE_LIBXML2
	select BR2_PACKAGE_SQLITE
	help
	  Enable webdav support. Needed to support mod_webdav

config BR2_PACKAGE_LIGHTTPD_LUA
	bool "lua support"
	depends on BR2_PACKAGE_LIGHTTPD
	select BR2_PACKAGE_LUA
	help
	  Enable Lua support. Needed to support mod_magnet

endif
```

## package/linenoise/Config.in
```kconfig
config BR2_PACKAGE_LINENOISE
	bool "linenoise"
	help
	  A small self-contained alternative to readline and libedit

	  https://github.com/antirez/linenoise
```

## package/linknx/Config.in
```kconfig
config BR2_PACKAGE_LINKNX
	bool "linknx"
	depends on BR2_INSTALL_LIBSTDCPP
	depends on BR2_USE_MMU # libpthsem
	select BR2_PACKAGE_LIBPTHSEM
	select BR2_PACKAGE_LIBCURL # for autoreconf
	select BR2_PACKAGE_ARGP_STANDALONE \
	       if BR2_TOOLCHAIN_USES_UCLIBC || BR2_TOOLCHAIN_USES_MUSL
	help
	  Linknx is an automation platform providing high level
	  functionalities to EIB/KNX installation.

	  http://linknx.sourceforge.net/
	  https://github.com/linknx/linknx

comment "linknx needs a toolchain w/ C++"
	depends on BR2_USE_MMU
	depends on !BR2_INSTALL_LIBSTDCPP
```

## package/links/Config.in
```kconfig
config BR2_PACKAGE_LINKS
	bool "links"
	depends on BR2_USE_MMU # fork()
	help
	  Graphics and text mode WWW browser (kind of like lynx).

	  http://links.twibright.com/

config BR2_PACKAGE_LINKS_GRAPHICS
	bool "use graphics"
	depends on BR2_PACKAGE_LINKS && (BR2_PACKAGE_DIRECTFB || BR2_PACKAGE_XORG7)
	select BR2_PACKAGE_XLIB_LIBXT if BR2_PACKAGE_XORG7
	select BR2_PACKAGE_LIBPNG
	help
	  Enable graphics output for DirectFB or X11.
	  Otherwise links will be text-mode only.
```

## package/linphone/Config.in
```kconfig
config BR2_PACKAGE_LINPHONE
	bool "linphone"
	depends on BR2_USE_MMU
	depends on BR2_INSTALL_LIBSTDCPP
	depends on !BR2_STATIC_LIBS # belle-sip, mediastreamer
	depends on BR2_TOOLCHAIN_HAS_THREADS # belr, belle-sip, mediastreamer
	# belr, belle-sip, mediastreamer
	depends on !BR2_TOOLCHAIN_HAS_GCC_BUG_64735
	depends on BR2_USE_WCHAR # belle-sip
	select BR2_PACKAGE_BELLE_SIP
	select BR2_PACKAGE_BELR
	select BR2_PACKAGE_LIBXML2
	select BR2_PACKAGE_MEDIASTREAMER
	select BR2_PACKAGE_SQLITE
	help
	  Linphone is an internet phone or Voice Over IP phone (VoIP).

	  With linphone you can communicate freely with people over
	  the internet, with voice, video, and text instant messaging.
	  Linphone makes use of the SIP protocol, an open standard
	  for internet telephony. You can use Linphone with any SIP
	  VoIP operator, including our free SIP audio/video service.
	  linphone is free-software (or open-source), you can download
	  and redistribute it freely.
	  Linphone is available for desktop computers: Linux, Windows,
	  MacOSX, and for mobile phones: Android, iPhone, Blackberry.

	  Linphone support in Buildroot is limited to the commandline
	  client, linphonec, and video support is not enabled.

	  http://www.linphone.org/

comment "linphone needs a toolchain w/ threads, C++, dynamic library, wchar"
	depends on BR2_USE_MMU
	depends on !BR2_INSTALL_LIBSTDCPP || BR2_STATIC_LIBS || \
		!BR2_TOOLCHAIN_HAS_THREADS || !BR2_USE_WCHAR

comment "linphone needs a toolchain not affected by GCC bug 64735"
	depends on BR2_TOOLCHAIN_HAS_GCC_BUG_64735
```

## package/linux-backports/Config.in
```kconfig
comment "linux-backports needs a Linux kernel to be built"
	depends on !BR2_LINUX_KERNEL

config BR2_PACKAGE_LINUX_BACKPORTS
	bool "linux-backports"
	depends on BR2_LINUX_KERNEL
	help
	  The linux-backports package includes many Linux drivers from
	  recent kernels, backported to older ones.

	  This version of linux-backports supports kernels starting from 3.0.

	  https://backports.wiki.kernel.org

if BR2_PACKAGE_LINUX_BACKPORTS

choice
	prompt "Linux kernel driver backports configuration"
	default BR2_PACKAGE_LINUX_BACKPORTS_USE_DEFCONFIG

config BR2_PACKAGE_LINUX_BACKPORTS_USE_DEFCONFIG
	bool "Using an in-tree defconfig file"

config BR2_PACKAGE_LINUX_BACKPORTS_USE_CUSTOM_CONFIG
	bool "Using a custom (def)config file"

endchoice

config BR2_PACKAGE_LINUX_BACKPORTS_DEFCONFIG
	string "Defconfig name"
	depends on BR2_PACKAGE_LINUX_BACKPORTS_USE_DEFCONFIG
	help
	  Name of the backports defconfig file to use, without the
	  leading defconfig-. The defconfig is located in defconfigs/
	  directory in the backports tree.

config BR2_PACKAGE_LINUX_BACKPORTS_CUSTOM_CONFIG_FILE
	string "Configuration file path"
	depends on BR2_PACKAGE_LINUX_BACKPORTS_USE_CUSTOM_CONFIG
	help
	  Path to the backports configuration file

	  Note: this can be a defconfig file or a complete .config file,
	  which can later be saved back with make linux-update-(def)config.

config BR2_PACKAGE_LINUX_BACKPORTS_CONFIG_FRAGMENT_FILES
	string "Additional configuration fragment files"
	help
	  A space-separated list of configuration fragment files, that
	  will be merged to the main linux-backports configuration file.

endif # BR2_PACKAGE_LINUX_BACKPORTS
```
