## package/linux-firmware/Config.in
```kconfig
config BR2_PACKAGE_LINUX_FIRMWARE
	bool "linux-firmware"
	help
	  This package provides various binary firmware files (closed
	  binary blobs) for such devices like LAN, WLAN cards etc.

	  https://git.kernel.org/?p=linux/kernel/git/firmware/linux-firmware.git

if BR2_PACKAGE_LINUX_FIRMWARE

menu "Audio firmware"

config BR2_PACKAGE_LINUX_FIRMWARE_INTEL_SST_DSP
	bool "Intel SST DSP"
	help
	  Firmware files for Intel Baytrail SST DSP audio.

endmenu # Audio

menu "Video firmware"

config BR2_PACKAGE_LINUX_FIRMWARE_AMDGPU
	bool "AMD GPU video card firmware"
	help
	  Firmware files for AMD GPU video cards.

config BR2_PACKAGE_LINUX_FIRMWARE_I915
	bool "Intel i915 video card firmware"
	help
	  Firmware files for the Intel i915 video cards.

config BR2_PACKAGE_LINUX_FIRMWARE_RADEON
	bool "AMD Radeon video card firmware"
	help
	  Firmware files for AMD Radeon video cards.

config BR2_PACKAGE_LINUX_FIRMWARE_QCOM_VENUS
	bool "Qualcomm Venus video codec accelerator"
	help
	  Firmware files for Qualcomm Venus video codec accelerator

config BR2_PACKAGE_LINUX_FIRMWARE_QCOM_ADRENO
	bool "Qualcomm Adreno GPU firmware"
	help
	  Firmware files for Qualcomm Adreno GPU firmware

endmenu # Video

menu "Bluetooth firmware"

config BR2_PACKAGE_LINUX_FIRMWARE_IBT
	bool "Intel Wireless Bluetooth"
	help
	  Firmware files for Intel 3160/7260/7265/8260/8265 Wireless
	  bluetooth support.

config BR2_PACKAGE_LINUX_FIRMWARE_MEDIATEK_MT7650
	bool "MediaTek MT7650"
	help
	  Firmware files for MediaTek MT7650 bluetooth support

config BR2_PACKAGE_LINUX_FIRMWARE_QUALCOMM_6174A_BT
	bool "Qualcomm Atheros Rome 6174A Bluetooth"
	help
	  Firmware files for QCA Rome 6174A bluetooth support.

config BR2_PACKAGE_LINUX_FIRMWARE_AR3011
	bool "Qualcomm Atheros 3011"
	help
	  Firmware files for Atheros bluetooth chipset AR3011.

config BR2_PACKAGE_LINUX_FIRMWARE_AR3012_USB
	bool "Qualcomm Atheros 3012 (USB)"
	help
	  Firmware files for Atheros bluetooth chipset AR3012 on USB.

config BR2_PACKAGE_LINUX_FIRMWARE_TI_CC2560
	bool "TI CC2560"
	help
	  Firmware files for Bluetooth modules CC2560 and CC2560A

endmenu # Bluetooth

menu "WiFi firmware"

config BR2_PACKAGE_LINUX_FIRMWARE_ATHEROS_6002
	bool "Atheros 6002"
	help
	  Firmware files for the Atheros AR6002 chip

config BR2_PACKAGE_LINUX_FIRMWARE_ATHEROS_6003
	bool "Atheros 6003"
	help
	  Firmware files for the Atheros AR6003 chip

config BR2_PACKAGE_LINUX_FIRMWARE_ATHEROS_6004
	bool "Atheros 6004"
	help
	  Firmware files for the Atheros AR6004 chip

config BR2_PACKAGE_LINUX_FIRMWARE_ATHEROS_7010
	bool "Atheros 7010"
	help
	  Firmware files for the Atheros 7010 module

config BR2_PACKAGE_LINUX_FIRMWARE_ATHEROS_9170
	bool "Atheros 9170"
	help
	  Firmware files for the Atheros 9170 module

config BR2_PACKAGE_LINUX_FIRMWARE_ATHEROS_9271
	bool "Atheros 9271"
	help
	  Firmware files for the Atheros 9271 module

config BR2_PACKAGE_LINUX_FIRMWARE_ATHEROS_10K_QCA998X
	bool "Atheros 10k (QCA998X)"
	help
	  Firmware files for the Atheros QCA988X module

config BR2_PACKAGE_LINUX_FIRMWARE_ATHEROS_10K_QCA6174
	bool "Atheros 10k (QCA6174)"
	help
	  Firmware files for the Atheros QCA6174 module

config BR2_PACKAGE_LINUX_FIRMWARE_BRCM_BCM43XX
	bool "Broadcom BRCM bcm43xx"
	help
	  Firmware files for the Broadcom bcm43xx SoftMAC and FullMAC.

config BR2_PACKAGE_LINUX_FIRMWARE_BRCM_BCM43XXX
	bool "Broadcom BRCM bcm43xxx"
	help
	  Firmware files for the Broadcom bcm43xxx, SoftMAC and FullMAC.

config BR2_PACKAGE_LINUX_FIRMWARE_IWLWIFI_3160
	bool "Intel iwlwifi 3160"
	help
	  Firmware files for the Intel Wifi 3160 devices supported by
	  the iwlwifi kernel driver.

config BR2_PACKAGE_LINUX_FIRMWARE_IWLWIFI_3168
	bool "Intel iwlwifi 3168"
	help
	  Firmware files for the Intel Wifi 3168 devices supported by
	  the iwlwifi kernel driver.

config BR2_PACKAGE_LINUX_FIRMWARE_IWLWIFI_5000
	bool "Intel iwlwifi 5000"
	help
	  Firmware files for the Intel Wifi 5000 devices supported by
	  the iwlwifi kernel driver.

config BR2_PACKAGE_LINUX_FIRMWARE_IWLWIFI_6000G2A
	bool "Intel iwlwifi 6000G2A"
	help
	  Firmware files for the Intel Wifi 6000G2A devices supported by
	  the iwlwifi kernel driver.

config BR2_PACKAGE_LINUX_FIRMWARE_IWLWIFI_6000G2B
	bool "Intel iwlwifi 6000G2B"
	help
	  Firmware files for the Intel Wifi 6000G2B devices supported by
	  the iwlwifi kernel driver.

config BR2_PACKAGE_LINUX_FIRMWARE_IWLWIFI_7260
	bool "Intel iwlwifi 7260"
	help
	  Firmware files for the Intel Wifi 7260 devices supported by
	  the iwlwifi kernel driver.

config BR2_PACKAGE_LINUX_FIRMWARE_IWLWIFI_7265
	bool "Intel iwlwifi 7265"
	help
	  Firmware files for the Intel Wifi 7265 devices supported by
	  the iwlwifi kernel driver.

config BR2_PACKAGE_LINUX_FIRMWARE_IWLWIFI_7265D
	bool "Intel iwlwifi 7265D"
	# needed for old kernel versions, where the non-D and D
	# firmwares were the same
	select BR2_PACKAGE_LINUX_FIRMWARE_IWLWIFI_7265
	help
	  Firmware files for the Intel Wifi 7265D devices supported by
	  the iwlwifi kernel driver.

config BR2_PACKAGE_LINUX_FIRMWARE_IWLWIFI_8000C
	bool "Intel iwlwifi 8000C"
	help
	  Firmware files for the Intel Wifi 8000C devices supported by
	  the iwlwifi kernel driver.

config BR2_PACKAGE_LINUX_FIRMWARE_IWLWIFI_8265
	bool "Intel iwlwifi 8265"
	help
	  Firmware files for the Intel Wifi 8265 devices supported by
	  the iwlwifi kernel driver.

config BR2_PACKAGE_LINUX_FIRMWARE_IWLWIFI_9XXX
	bool "Intel iwlwifi 9xxx"
	help
	  Firmware files for the Intel Wifi 9xxx devices supported by
	  the iwlwifi kernel driver.

config BR2_PACKAGE_LINUX_FIRMWARE_LIBERTAS_SD8686_V8
	bool "Libertas SD 8686 v8"
	help
	  Firmware files (version 8) for the Marvell SD8686 module

config BR2_PACKAGE_LINUX_FIRMWARE_LIBERTAS_SD8686_V9
	bool "Libertas SD 8686 v9"
	help
	  Firmware files (version 9) for the Marvell SD8686 module

config BR2_PACKAGE_LINUX_FIRMWARE_LIBERTAS_SD8688
	bool "Libertas SD 8688"
	help
	  Firmware files for the Marvell SD8688 module

config BR2_PACKAGE_LINUX_FIRMWARE_LIBERTAS_USB8388_V9
	bool "Libertas USB 8388 v9"
	help
	  Firmware files (version 9) for the Marvell USB8388 module

config BR2_PACKAGE_LINUX_FIRMWARE_LIBERTAS_USB8388_OLPC
	bool "Libertas USB 8388 OLPC"
	help
	  Firmware files (OLPC mesh capable version) for the Marvell
	  USB8388 module.

config BR2_PACKAGE_LINUX_FIRMWARE_LIBERTAS_USB_THINFIRM
	bool "Libertas USB Thin Firmware"
	help
	  Firmware files (soft MAC) for the Marvell USB modules

config BR2_PACKAGE_LINUX_FIRMWARE_MWIFIEX_SD8787
	bool "Marvell Wifi-Ex 8787 SDIO"
	help
	  Firmware files for the Marvell Wifi-Ex 8787 module on SDIO.

config BR2_PACKAGE_LINUX_FIRMWARE_MWIFIEX_SD8797
	bool "Marvell Wifi-Ex 8797 SDIO"
	help
	  Firmware files for the Marvell Wifi-Ex 8797 module on SDIO.

config BR2_PACKAGE_LINUX_FIRMWARE_MWIFIEX_USB8797
	bool "Marvell Wifi-Ex 8797 USB"
	help
	  Firmware files for the Marvell Wifi-Ex 8797 module on USB.

config BR2_PACKAGE_LINUX_FIRMWARE_MWIFIEX_USB8801
	bool "Marvell Wifi-Ex 8801 USB"
	help
	  Firmware files for the Marvell Wifi-Ex 8801 module on USB.

config BR2_PACKAGE_LINUX_FIRMWARE_MWIFIEX_SD8887
	bool "Marvell Wifi-Ex 8887 SDIO"
	help
	  Firmware files for the Marvell Wifi-Ex 8887 module on SDIO.

config BR2_PACKAGE_LINUX_FIRMWARE_MWIFIEX_SD8897
	bool "Marvell Wifi-Ex 8897 SDIO"
	help
	  Firmware files for the Marvell Wifi-Ex 8897 module on SDIO.

config BR2_PACKAGE_LINUX_FIRMWARE_MWIFIEX_USB8897
	bool "Marvell Wifi-Ex 8897 USB"
	help
	  Firmware files for the Marvell Wifi-Ex 8897 module on USB.

config BR2_PACKAGE_LINUX_FIRMWARE_MWIFIEX_PCIE8897
	bool "Marvell Wifi-Ex 8897 PCI-E"
	help
	  Firmware files for the Marvell Wifi-Ex 8897 module on PCI-E.

config BR2_PACKAGE_LINUX_FIRMWARE_MEDIATEK_MT7601U
	bool "MediaTek MT7601U"
	help
	  MediaTek MT7601U

config BR2_PACKAGE_LINUX_FIRMWARE_MEDIATEK_MT76X2E
	bool "MediaTek MT76x2e"
	help
	  MediaTek MT76x2e

config BR2_PACKAGE_LINUX_FIRMWARE_QUALCOMM_6174
	bool "Qualcomm Atheros 6174"
	help
	  Firmware files for the Qualcomm Atheros QCA6174 chip

config BR2_PACKAGE_LINUX_FIRMWARE_RALINK_RT61
	bool "Ralink rt2501/rt61"
	help
	  Ralink rt2501/rt61

config BR2_PACKAGE_LINUX_FIRMWARE_RALINK_RT73
	bool "Ralink rt73"
	help
	  Ralink rt73

config BR2_PACKAGE_LINUX_FIRMWARE_RALINK_RT2XX
	bool "Ralink rt27xx/rt28xx/rt30xx"
	help
	  Ralink rt27xx/rt28xx/rt30xx

config BR2_PACKAGE_LINUX_FIRMWARE_RTL_81XX
	bool "Realtek 81xx"
	help
	  Realtek 8188/8192

config BR2_PACKAGE_LINUX_FIRMWARE_RTL_87XX
	bool "Realtek 87xx"
	help
	  Realtek 8712/8723/8723be

config BR2_PACKAGE_LINUX_FIRMWARE_RTL_88XX
	bool "Realtek 88xx"
	help
	  Realtek rtl8821ae

config BR2_PACKAGE_LINUX_FIRMWARE_REDPINE_RS9113
	bool "Redpine rs9113"
	help
	  Firmware files for WLAN and Bluetooth modules rs9113

config BR2_PACKAGE_LINUX_FIRMWARE_TI_WL127X
	bool "TI wl127x"
	help
	  Firmware files for WLAN and Bluetooth modules wl1271 and
	  wl1273

config BR2_PACKAGE_LINUX_FIRMWARE_TI_WL128X
	bool "TI wl128x"
	help
	  Firmware files for WLAN and Bluetooth modules wl128x

config BR2_PACKAGE_LINUX_FIRMWARE_TI_WL18XX
	bool "TI wl18xx"
	help
	  Firmware files for WLAN and Bluetooth modules wl18xx

endmenu

menu "Ethernet firmware"

config BR2_PACKAGE_LINUX_FIRMWARE_BNX2X
	bool "Broadcom NetXtremeII"
	help
	  Firmware files for Broadcom NetXtreme 10Gb ethernet cards
	  (bnx2x)

config BR2_PACKAGE_LINUX_FIRMWARE_CXGB4_T4
	bool "Chelsio T4"
	help
	  Firmware files for Chelsio T4 1Gb and 10Gb ethernet cards
	  (cxgb4)

config BR2_PACKAGE_LINUX_FIRMWARE_CXGB4_T5
	bool "Chelsio T5"
	help
	  Firmware files for Chelsio T5 1Gb and 10Gb ethernet cards
	  (cxgb4)

config BR2_PACKAGE_LINUX_FIRMWARE_INTEL_E100
	bool "Intel e100 825xx"
	help
	  Firmware files for Intel 825xx handled by driver e100
	  (e100)

config BR2_PACKAGE_LINUX_FIRMWARE_QLOGIC_4X
	bool "QLogic FastLinQ 4xxxx"
	help
	  Firmware files for QLogic FastLinQ 4xxxx ethernet devices
	  (qede)

config BR2_PACKAGE_LINUX_FIRMWARE_RTL_8169
	bool "Realtek 8169"
	help
	  Firmware files for Realtek 8169 gigabit ethernet cards

endmenu

menu "DVB firmware"

config BR2_PACKAGE_LINUX_FIRMWARE_AS102
	bool "Abilis Systems as102"
	help
	  Firmware file for Abilis Systems single DVB-T receiver as102

config BR2_PACKAGE_LINUX_FIRMWARE_DIB0700
	bool "DiBcom dib0700"
	help
	  Firmware file for dib0700-based USB DVB tuner driver

config BR2_PACKAGE_LINUX_FIRMWARE_ITETECH_IT9135
	bool "ITEtech it9135"
	help
	  Firmware files for ITEtech it9135 (Ax and Bx) DVB-T USB tuner

config BR2_PACKAGE_LINUX_FIRMWARE_H5_DRXK
	bool "Terratec H5 DRX-K"
	help
	  Firmware file for Terratec H5 DRX-K based DVB tuner driver

config BR2_PACKAGE_LINUX_FIRMWARE_XCx000
	bool "Xceive/Cresta xc4000/xc5000/xc500c"
	help
	  Firmware file for xc4000/xc5000/xc5000c based DVB tuner driver

endmenu

menu "SoC Firmware"

config BR2_PACKAGE_LINUX_FIRMWARE_IMX_SDMA
	bool "Freescale i.MX SDMA"
	help
	  Firmware files for i.MX SDMA.

endmenu

menu "Fibre Channel Adapter Firmware"

config BR2_PACKAGE_LINUX_FIRMWARE_QLOGIC_2XXX
	bool "QLogic 2xxx Fibre Channel Adapters"
	help
	  Firmware files for ql2xxx adapters

endmenu

menu "Intel QuickAssist Firmware"

config BR2_PACKAGE_LINUX_FIRMWARE_QAT_DH895XCC
	bool "Support for DH895xCC"
	help
	  Firmware files for Intel DH895xCC devices

config BR2_PACKAGE_LINUX_FIRMWARE_QAT_C3XXX
	bool "Support for C3XXX"
	help
	  Firmware files for Intel C3XXX devices

config BR2_PACKAGE_LINUX_FIRMWARE_QAT_C62X
	bool "Support for C62X"
	help
	  Firmware files for Intel C62X devices

endmenu

endif
```

## package/linux-fusion/Config.in
```kconfig
comment "linux-fusion needs a Linux kernel to be built"
	depends on !BR2_LINUX_KERNEL

config BR2_PACKAGE_LINUX_FUSION
	bool "linux-fusion communication layer for DirectFB multi"
	depends on BR2_LINUX_KERNEL
	select BR2_LINUX_NEEDS_MODULES # not using kernel-module infra
	help
	  DirectFB Communication Layer allowing multiple DirectFB
	  applications to run concurrently

	  https://github.com/deniskropp/linux-fusion
```
