## package/linux-pam/Config.in
```kconfig
config BR2_PACKAGE_LINUX_PAM
	bool "linux-pam"
	depends on (BR2_ENABLE_LOCALE && BR2_USE_WCHAR)
	depends on !BR2_STATIC_LIBS
	depends on BR2_USE_MMU # fork()
	select BR2_PACKAGE_FLEX
	help
	  A Security Framework that Provides Authentication for
	  Applications

	  http://linux-pam.org

comment "linux-pam needs a toolchain w/ wchar, locale, dynamic library"
	depends on !(BR2_ENABLE_LOCALE && BR2_USE_WCHAR) \
		|| BR2_STATIC_LIBS
```

## package/linux-serial-test/Config.in
```kconfig
config BR2_PACKAGE_LINUX_SERIAL_TEST
	bool "linux-serial-test"
	help
	  Serial port test utility.

	  https://github.com/cbrake/linux-serial-test
```

## package/linux-tools/Config.in
```kconfig
menu "Linux Kernel Tools"

# No prompt, this is sourced by linux/Config.in as this
# is no real package and really belongs to the kernel.
config BR2_PACKAGE_LINUX_TOOLS
	bool

config BR2_PACKAGE_LINUX_TOOLS_CPUPOWER
	bool "cpupower"
	select BR2_PACKAGE_LINUX_TOOLS
	select BR2_PACKAGE_PCIUTILS
	help
	  cpupower is a collection of tools to examine and tune power
	  saving related features of your processor.

config BR2_PACKAGE_LINUX_TOOLS_GPIO
	bool "gpio"
	select BR2_PACKAGE_LINUX_TOOLS
	help
	  gpio is a collection of tools to get information about,
	  control and monitor gpios present on system.

	  These tools use new gpio ABI which will deprecate sysfs gpio
	  interface in the future.

	  These tools are available only from kernel version 4.8.

config BR2_PACKAGE_LINUX_TOOLS_IIO
	bool "iio"
	select BR2_PACKAGE_LINUX_TOOLS
	help
	  iio is a collection of tools to get information about,
	  control and monitor iio devices present on system.

	  These tools are available only from kernel version 4.7.

config BR2_PACKAGE_LINUX_TOOLS_PCI
	bool "pci"
	select BR2_PACKAGE_LINUX_TOOLS
	help
	  pcitest is a tool for testing capabilities related to a
	  PCI Endpoint (only works with specific Endpoints).

	  These tools are available only from kernel version 4.20.

config BR2_PACKAGE_LINUX_TOOLS_PERF
	bool "perf"
	depends on BR2_TOOLCHAIN_HAS_SYNC_4
	select BR2_PACKAGE_LINUX_TOOLS
	help
	  perf (sometimes "Perf Events" or perf tools, originally
	  "Performance Counters for Linux") - is a performance
	  analyzing tool in Linux, available from kernel version
	  2.6.31. User-space controlling utility, called 'perf' has
	  git-like interface with subcommands. It is capable of
	  statistical profiling of entire system (both kernel and user
	  code), single CPU or severals threads.

	  This will build and install the userspace 'perf'
	  command.

	  Your kernel must have CONFIG_PERF_EVENTS enabled to use perf
	  profiling. Buildroot automatically enables this in the kernel
	  configuration.

	  https://perf.wiki.kernel.org/

if BR2_PACKAGE_LINUX_TOOLS_PERF

config BR2_PACKAGE_LINUX_TOOLS_PERF_TUI
	bool "enable perf TUI"
	depends on BR2_USE_MMU # slang
	select BR2_PACKAGE_SLANG
	help
	  Enable the TUI interface for perf which requires a TTY and
	  enables zooming into DSOs and threads as well as other
	  features.

endif

config BR2_PACKAGE_LINUX_TOOLS_SELFTESTS
	bool"selftests"
	depends on BR2_PACKAGE_BUSYBOX_SHOW_OTHERS # bash
	depends on BR2_USE_MMU  # bash
	depends on !BR2_STATIC_LIBS
	select BR2_PACKAGE_LINUX_TOOLS
	select BR2_PACKAGE_BASH # runtime
	select BR2_PACKAGE_NCURSES
	select BR2_PACKAGE_NCURSES_TARGET_PROGS # runtime (tput)
	select BR2_PACKAGE_KMOD
	select BR2_PACKAGE_KMOD_TOOLS # runtime (modprobe -n)
	select BR2_PACKAGE_POPT
	select BR2_PACKAGE_LIBCAP_NG
	select BR2_PACKAGE_UTIL_LINUX
	select BR2_PACKAGE_UTIL_LINUX_SCHEDUTILS # runtime (taskset)
	help
	  Build and install (to /usr/lib/kselftests) kernel selftests.

	  Use of this option implies you know the process of using and
	  compiling the kernel selftests. The Makefile to build and
	  install these is very noisy and may appear to cause your
	  build to fail for strange reasons.

	  This is very much a use at your risk option and may not work
	  for every setup or every architecture.

comment "selftests needs BR2_PACKAGE_BUSYBOX_SHOW_OTHERS and a toolchain w/ dynamic library"
	depends on BR2_USE_MMU
	depends on !BR2_PACKAGE_BUSYBOX_SHOW_OTHERS || BR2_STATIC_LIBS

config BR2_PACKAGE_LINUX_TOOLS_TMON
	bool "tmon"
	select BR2_PACKAGE_LINUX_TOOLS
	select BR2_PACKAGE_NCURSES
	help
	  tmon is a terminal-based tool (using curses) that allows the
	  user to access thermal information about the system.

config BR2_PACKAGE_LINUX_TOOLS_HV
	bool "hv"
	depends on BR2_i386 || BR2_x86_64
	select BR2_PACKAGE_LINUX_TOOLS
	select BR2_PACKAGE_LINUX_TOOLS_HV_KVP_DAEMON if !BR2_PACKAGE_LINUX_TOOLS_HV_HAS_ONE
	help
	  Microsoft HyperV integration services

	  Relevant kernel configuration options: CONFIG_HYPERV,
	  CONFIG_HYPERV_UTILS.

if BR2_PACKAGE_LINUX_TOOLS_HV

config BR2_PACKAGE_LINUX_TOOLS_HV_HAS_ONE
	bool

config BR2_PACKAGE_LINUX_TOOLS_HV_KVP_DAEMON
	bool "hypervkvpd (hv_kvp_daemon)"
	help
	  HyperV uses hypervkvpd (Key/Value Pair daemon) to retrieve
	  status information from your virtualized guest OS

config BR2_PACKAGE_LINUX_TOOLS_HV_FCOPY_DAEMON
	bool "hypervfcopyd (hv_fcopy_daemon)"
	select BR2_PACKAGE_LINUX_TOOLS_HV_HAS_ONE
	help
	  HyperV uses hypervfcopyd (File Copy daemon) to easily transfer
	  files to and from your virtualized guest OS

config BR2_PACKAGE_LINUX_TOOLS_HV_VSS_DAEMON
	bool "hypervvssd (hv_vss_daemon)"
	select BR2_PACKAGE_LINUX_TOOLS_HV_HAS_ONE
	help
	  HyperV uses hypervvssd (Volume Snapshot Service daemon) to
	  freeze your filesystems during snapshots and backups

endif # BR2_PACKAGE_LINUX_TOOLS_HV

endmenu
```

## package/linux-zigbee/Config.in
```kconfig
comment "linux-zigbee needs a toolchain w/ threads"
	depends on !BR2_TOOLCHAIN_HAS_THREADS
	depends on BR2_USE_MMU

config BR2_PACKAGE_LINUX_ZIGBEE
	bool "linux-zigbee"
	depends on BR2_USE_MMU # fork()
	depends on BR2_TOOLCHAIN_HAS_THREADS # libnl
	select BR2_PACKAGE_LIBNL
	help
	  IEEE 802.15.4 is a standard for communication in small
	  low-rate wireless personal area networks (WPAN). While
	  802.15.4 is a MAC- and PHY- layer standard only, several
	  common protocols commonly sit on top of it such as ZigBee,
	  MiWi, and 6LoWPAN. The goal of this project is to create an
	  implementation of 802.15.4 and several of the protocols
	  which run on top of it (primarily 6LoWPAN) for Linux.

	  It's worth noting that the name linux-zigbee is somewhat of
	  a misnomer. While this project was originally started to
	  create a ZigBee implementation for Linux, licensing
	  restrictions put in place by the ZigBee Alliance make it
	  impossible for an implementation of ZigBee to ever become
	  part of the Linux kernel. Once this licensing issue was
	  discovered, this project's primary focus shifted to IEEE
	  802.15.4 and 6LoWPAN. Other higher-layer standards may be
	  added at a future time.

	  The 802.15.4 stack contains kernel components, which are
	  part of the mainline Linux kernel, and userspace components,
	  available in this package.

	  http://sourceforge.net/apps/trac/linux-zigbee/

if BR2_PACKAGE_LINUX_ZIGBEE

config BR2_PACKAGE_LINUX_ZIGBEE_TESTS
	bool "tests programs"
	help
	  Enable this option to install the Linux-ZigBee test programs
	  to the target.

config BR2_PACKAGE_LINUX_ZIGBEE_OLD_KERNEL_COMPAT
	bool "compatibility with older kernels"
	help
	  Enable this option to get compatibility of the Linux-ZigBee
	  userspace tools with old kernels. Recent kernels know the
	  802.15.4 line discipline as N_IEEE802154 with the value 25,
	  but some older kernels had it with the values 22 or 19.

config BR2_PACKAGE_LINUX_ZIGBEE_LEASEFILE
	string "path for persistent lease storage"
	default "/var/run/izcoordinator.leases"

endif
```

## package/linux/Config.in
```kconfig
#

config BR2_PACKAGE_LINUX
	bool"linux"
	default n
	help
	  Add help text here.
```

## package/linuxconsoletools/Config.in
```kconfig
config BR2_PACKAGE_LINUXCONSOLETOOLS
	bool "linuxconsoletools"
	select BR2_PACKAGE_LINUXCONSOLETOOLS_INPUTATTACH if \
	       !BR2_PACKAGE_LINUXCONSOLETOOLS_JOYSTICK && \
	       !BR2_PACKAGE_LINUXCONSOLETOOLS_FORCEFEEDBACK
	help
	  Linuxconsoletools contains the inputattach utility
	  to attach legacy serial devices to the Linux kernel
	  input layer and joystick utilities to calibrate and
	  test joysticks and joypads.

	  http://sf.net/projects/linuxconsole/

if BR2_PACKAGE_LINUXCONSOLETOOLS

config BR2_PACKAGE_LINUXCONSOLETOOLS_INPUTATTACH
	bool "inputattach"
	default y
	help
	  The inputattach utility attaches legacy serial devices
	  to the Linux kernel input layer.

config BR2_PACKAGE_LINUXCONSOLETOOLS_JOYSTICK
	bool "joystick utilities"
	help
	  Joystick utilities (jstest, jscal, jscal-store,
	  jscal-restore, evdev-joystick).

config BR2_PACKAGE_LINUXCONSOLETOOLS_FORCEFEEDBACK
	bool "force-feedback utilities"
	depends on !BR2_STATIC_LIBS
	select BR2_PACKAGE_SDL2
	help
	  Build force-feedback driver utilities (fftest,
	  ffmvforce, ffset, ffcfstress).

comment "force-feedback utilities need a toolchain w/ dynamic library"
	depends on BR2_STATIC_LIBS

endif
```

## package/linuxptp/Config.in
```kconfig
config BR2_PACKAGE_LINUXPTP
	bool "linuxptp"
	help
	  The Linux PTP Project is the Precision Time Protocol
	  implementation according to IEEE standard 1588 for Linux.

	  The dual design goals are to provide a robust implementation
	  of the standard and to use the most relevant and modern
	  Application Programming Interfaces (API) offered by the
	  Linux kernel. Supporting legacy APIs and other platforms is
	  not a goal.

	  http://linuxptp.sourceforge.net/
```

## package/liquid-dsp/Config.in
```kconfig
comment "liquid-dsp requires a glibc or musl toolchain w/ dynamic library"
	depends on !(BR2_TOOLCHAIN_USES_GLIBC || BR2_TOOLCHAIN_USES_MUSL) || BR2_STATIC_LIBS

config BR2_PACKAGE_LIQUID_DSP
	bool "liquid-dsp"
	depends on BR2_TOOLCHAIN_USES_GLIBC || BR2_TOOLCHAIN_USES_MUSL
	depends on !BR2_STATIC_LIBS
	help
	  Liquid-DSP is a free and open-source signal processing
	  library for software-defined radios written in C.  Its
	  purpose is to provide a set of extensible DSP modules that
	  do no rely on external dependencies or cumbersome
	  frameworks.

	  http://liquidsdr.org/

if BR2_PACKAGE_LIQUID_DSP

config BR2_PACKAGE_LIQUID_DSP_FAST
	bool "optimize for speed over accuracy"
	help
	  Optimize for speed over accuracy.

endif
```

## package/lirc-tools/Config.in
```kconfig
config BR2_PACKAGE_LIRC_TOOLS
	bool "lirc-tools"
	depends on BR2_USE_MMU # fork()
	depends on BR2_TOOLCHAIN_HAS_THREADS
	depends on !BR2_TOOLCHAIN_USES_MUSL # GLOB_BRACE
	# dlopen()
	depends on !BR2_STATIC_LIBS
	help
	  LIRC is a package that supports receiving and sending IR
	  signals of the most common IR remote controls. It contains a
	  daemon that decodes and sends IR signals, a mouse daemon
	  that translates IR signals to mouse movements and a couple
	  of user programs that allow to control your computer with a
	  remote control.

	  It requires the kernel LIRC interface driver, make sure to
	  enable the kernel drivers to support your hardware.

	  http://www.lirc.org/

comment "lirc-tools needs a uClibc or (e)glibc toolchain w/ threads, dynamic library"
	depends on BR2_USE_MMU
	depends on !BR2_TOOLCHAIN_HAS_THREADS || BR2_STATIC_LIBS \
		|| BR2_TOOLCHAIN_USES_MUSL
```

## package/lite/Config.in
```kconfig
config BR2_PACKAGE_LITE
	bool "LiTE (toolbox engine)"
	depends on BR2_PACKAGE_DIRECTFB
	help
	  LiTE stands for LiTE is a Toolbox Engine.
	  Its role is to facilitate the functions of DirectFB so that a
	  toolbox could be written on top of DirectFB with less effort.
	  As such LiTE has abstractions for the underlying graphics and
	  event systems.

	  See http://www.directfb.org/wiki/index.php/LiTE:Architecture
```

## package/live555/Config.in
```kconfig
config BR2_PACKAGE_LIVE555
	bool "live555"
	depends on BR2_INSTALL_LIBSTDCPP
	help
	  LIVE555 Streaming Media forms a set of C++ libraries for multimedia
	  streaming, using open standard protocols (RTP/RTCP, RTSP, SIP).

	  http://www.live555.com/liveMedia/

comment "live555 needs a toolchain w/ C++"
	depends on !BR2_INSTALL_LIBSTDCPP
```

## package/ljlinenoise/Config.in
```kconfig
config BR2_PACKAGE_LJLINENOISE
	bool "ljlinenoise"
	# ljsyscall is specifically for LuaJIT, not Lua.
	depends on BR2_PACKAGE_LUAJIT
	select BR2_PACKAGE_LJSYSCALL # runtime
	help
	  ljlinenoise is a pure LuaJIT port of linenoise,
	  a small alternative to readline and libedit.

	  https://fperrad.frama.io/ljlinenoise/

comment "ljlinenoise needs LuaJIT"
	depends on !BR2_PACKAGE_LUAJIT
```

## package/ljsyscall/Config.in
```kconfig
config BR2_PACKAGE_LJSYSCALL
	bool "ljsyscall"
	# ljsyscall is specifically for LuaJIT, not Lua.
	depends on BR2_PACKAGE_LUAJIT
	help
	  An FFI implementation of the Linux and NetBSD kernel ABIs for
	  LuaJIT.

	  http://www.myriabit.com/ljsyscall/

comment "ljsyscall needs LuaJIT"
	depends on !BR2_PACKAGE_LUAJIT
```

## package/lksctp-tools/Config.in
```kconfig
config BR2_PACKAGE_LKSCTP_TOOLS
	bool "lksctp-tools"
	depends on BR2_USE_MMU # fork()
	depends on BR2_TOOLCHAIN_HAS_THREADS
	depends on !BR2_STATIC_LIBS # dlopen()
	help
	  The lksctp-tools project provides a Linux user space library
	  for SCTP (libsctp) including C language header files
	  (netinet/sctp.h) for accessing SCTP specific application
	  programming interfaces not provided by the standard sockets,
	  and also some helper utilities around SCTP.

	  http://lksctp.sourceforge.net/

comment "lksctp-tools needs a toolchain w/ threads, dynamic library"
	depends on BR2_USE_MMU
	depends on !BR2_TOOLCHAIN_HAS_THREADS || BR2_STATIC_LIBS
```

## package/lld/Config.in.host
```kconfig
config BR2_PACKAGE_HOST_LLD
	bool "host lld"
	depends on BR2_PACKAGE_LLVM_ARCH_SUPPORTS # llvm
	help
	  LLD is a linker from the LLVM project that is a drop-in
	  replacement for system linkers, and runs much faster than
	  them. It also provides features that are useful for
	  toolchain developers.

	  https://lld.llvm.org/
```

## package/lldpd/Config.in
```kconfig
config BR2_PACKAGE_LLDPD
	bool "lldpd"
	depends on BR2_USE_MMU # fork()
	select BR2_PACKAGE_LIBEVENT
	help
	  lldpd is a 802.1ab implementation (LLDP) to help you locate
	  neighbors of all your equipments.

	  LLDP allows you to know exactly on which port is a server
	  (and reciprocally).

	  LLDP is an industry standard protocol designed to supplant
	  proprietary Link-Layer protocols such as EDP or CDP. The
	  goal of LLDP is to provide an inter-vendor compatible
	  mechanism to deliver Link-Layer notifications to adjacent
	  network devices.

	  lldpd is an ISC-licensed implementation of LLDP for various
	  Unixes. It also supports some proprietary protocols.

	  https://vincentbernat.github.io/lldpd/

if BR2_PACKAGE_LLDPD

config BR2_PACKAGE_LLDPD_CDP
	bool "CDP"
	default y
	help
	  Enable Cisco Discovery Protocol

config BR2_PACKAGE_LLDPD_FDP
	bool "FDP"
	default y
	help
	  Enable Foundry Discovery Protocol

config BR2_PACKAGE_LLDPD_EDP
	bool "EDP"
	default y
	help
	  Enable Extreme Discovery Protocol

config BR2_PACKAGE_LLDPD_SONMP
	bool "SONMP"
	default y
	help
	  Enable SynOptics Network Management

config BR2_PACKAGE_LLDPD_LLDPMED
	bool "LLDP-MED"
	default y
	help
	  Enable LLDP-MED extension

config BR2_PACKAGE_LLDPD_DOT1
	bool "DOT1"
	default y
	help
	  Enable Dot1 extension (VLAN stuff)

config BR2_PACKAGE_LLDPD_DOT3
	bool "DOT3"
	default y
	help
	  Enable Dot3 extension (PHY stuff)

config BR2_PACKAGE_LLDPD_CUSTOM_TLV
	bool "Custom TLV"
	default y
	help
	  Enable Custom TLV support

endif
```
