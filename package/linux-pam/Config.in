## package/llvm/Config.in
```kconfig
config BR2_PACKAGE_LLVM_ARCH_SUPPORTS
	bool
	default y if BR2_i386
	default y if BR2_x86_64
	default y if BR2_aarch64
	default y if BR2_arm || BR2_armeb

config BR2_PACKAGE_LLVM_TARGET_ARCH
	string
	default "AArch64" if BR2_aarch64
	default "ARM" if BR2_arm || BR2_armeb
	default "X86" if BR2_i386 || BR2_x86_64

config BR2_PACKAGE_LLVM
	bool "llvm"
	depends on BR2_PACKAGE_LLVM_ARCH_SUPPORTS
	depends on BR2_TOOLCHAIN_GCC_AT_LEAST_4_8
	depends on BR2_TOOLCHAIN_HAS_THREADS
	depends on BR2_INSTALL_LIBSTDCPP
	depends on !BR2_TOOLCHAIN_HAS_GCC_BUG_64735 # std::shared_future
	depends on !BR2_STATIC_LIBS
	depends on BR2_USE_WCHAR # std::wstring
	help
	  The LLVM Project is a collection of modular and reusable
	  compiler and toolchain technologies.

	  http://llvm.org

if BR2_PACKAGE_LLVM

config BR2_PACKAGE_LLVM_AMDGPU
	bool "AMDGPU backend"
	help
	  Build AMDGPU target. Select this option if you are going
	  to install mesa3d with llvm and use Gallium Radeon driver.

config BR2_PACKAGE_LLVM_RTTI
	bool "enable rtti"
	help
	  Build LLVM with run-time type information. LLVM can be built
	  without rtti, but turning it off changes the ABI of C++
	  programs.

	  This features is needed to build the Gallium Nouveau driver
	  or the Clover OpenCL state tracker when llvm support is
	  enabled.

	  https://llvm.org/docs/HowToSetUpLLVMStyleRTTI.html

endif

comment "llvm needs a toolchain w/ wchar, threads, C++, gcc >= 4.8, dynamic library"
	depends on BR2_PACKAGE_LLVM_ARCH_SUPPORTS
	depends on !BR2_TOOLCHAIN_HAS_THREADS || !BR2_INSTALL_LIBSTDCPP || \
		!BR2_TOOLCHAIN_GCC_AT_LEAST_4_8 \
		|| BR2_STATIC_LIBS || !BR2_USE_WCHAR

comment "llvm needs a toolchain not affected by GCC bug 64735"
	depends on BR2_PACKAGE_LLVM_ARCH_SUPPORTS
	depends on BR2_TOOLCHAIN_HAS_GCC_BUG_64735
```

## package/lm-sensors/Config.in
```kconfig
config BR2_PACKAGE_LM_SENSORS
	bool "lm-sensors"
	help
	  Lm-sensors is a hardware health monitoring package for
	  Linux. It allows you to access information from
	  temperature, voltage, and fan speed sensors. It
	  works with most newer systems.

	  https://hwmon.wiki.kernel.org

if BR2_PACKAGE_LM_SENSORS
comment "lm-sensors tools"

config BR2_PACKAGE_LM_SENSORS_SENSORS
	bool "sensors"
	default y
	help
	  Sensors is used to show the current readings of all sensor
	  chips.

config BR2_PACKAGE_LM_SENSORS_FANCONTROL
	bool "fancontrol"
	help
	  Script for temperature driven fan control

config BR2_PACKAGE_LM_SENSORS_ISADUMP
	bool "isadump"
	depends on BR2_i386 || BR2_x86_64
	help
	  Isadump is a small helper program to examine registers
	  visible through the ISA bus.

config BR2_PACKAGE_LM_SENSORS_ISASET
	bool "isaset"
	depends on BR2_i386 || BR2_x86_64
	help
	  Isaset is a small helper program to set register visible
	  through the ISA bus.

config BR2_PACKAGE_LM_SENSORS_PWMCONFIG
	bool "pwmconfig"
	help
	  Pwmconfig searches your sensors for pulse width modulation
	  (PWM) controls, and tests each one to see if it controls a fan
	  on your motherboard.

config BR2_PACKAGE_LM_SENSORS_SENSORS_DETECT
	bool "sensors-detect"
	depends on BR2_PACKAGE_PERL
	help
	  Sensors-detect is an interactive program for detecting
	  available hardware monitoring chips.

comment "sensors-detect needs perl"
	depends on !BR2_PACKAGE_PERL

endif
```

## package/lmbench/Config.in
```kconfig
config BR2_PACKAGE_LMBENCH
	bool "lmbench"
	depends on BR2_TOOLCHAIN_HAS_NATIVE_RPC || BR2_TOOLCHAIN_HAS_THREADS # libtirpc
	select BR2_PACKAGE_LIBTIRPC if !BR2_TOOLCHAIN_HAS_NATIVE_RPC
	depends on BR2_USE_MMU # fork()
	help
	  LMbench is a suite of simple, portable,
	  ANSI/C microbenchmarks for UNIX/POSIX.

	  http://sourceforge.net/projects/lmbench/

comment "lmbench needs a toolchain w/ threads"
	depends on BR2_USE_MMU
	depends on !(BR2_TOOLCHAIN_HAS_THREADS || BR2_TOOLCHAIN_HAS_NATIVE_RPC)
```

## package/lockdev/Config.in
```kconfig
config BR2_PACKAGE_LOCKDEV
	bool "lockdev"
	help
	  Library for locking devices.

	  No upstream site, primary site is Debian.
```

## package/lockfile-progs/Config.in
```kconfig
config BR2_PACKAGE_LOCKFILE_PROGS
	bool "lockfile programs"
	select BR2_PACKAGE_LIBLOCKFILE
	help
	  Build lockfile utility programs.
```

## package/log4cplus/Config.in
```kconfig
config BR2_PACKAGE_LOG4CPLUS
	bool "log4cplus"
	depends on BR2_INSTALL_LIBSTDCPP
	depends on BR2_USE_WCHAR
	depends on BR2_TOOLCHAIN_HAS_THREADS
	depends on BR2_TOOLCHAIN_GCC_AT_LEAST_4_8 # C++11
	depends on !BR2_TOOLCHAIN_HAS_GCC_BUG_64735 # std::future
	help
	  log4cplus is a simple to use C++ logging API providing
	  thread-safe, flexible, and arbitrarily granular control
	  over log management and configuration. It is modelled
	  after the Java log4j API.

	  http://sourceforge.net/projects/log4cplus

comment "log4cplus needs a toolchain w/ C++, wchar, threads, gcc >= 4.8"
	depends on !BR2_INSTALL_LIBSTDCPP || !BR2_USE_WCHAR || \
		!BR2_TOOLCHAIN_HAS_THREADS || !BR2_TOOLCHAIN_GCC_AT_LEAST_4_8

comment "log4cplus needs a toolchain not affected by GCC bug 64735"
	depends on BR2_TOOLCHAIN_HAS_GCC_BUG_64735
```

## package/log4cpp/Config.in
```kconfig
config BR2_PACKAGE_LOG4CPP
	bool "log4cpp"
	depends on BR2_INSTALL_LIBSTDCPP
	depends on BR2_TOOLCHAIN_HAS_THREADS
	help
	  Log4cpp is library of C++ classes for flexible logging to
	  files, syslog, IDSA and other destinations.  It is modeled
	  after the Log4j Java library, staying as close to their API
	  as is reasonable.

	  http://log4cpp.sourceforge.net/

comment "log4cpp needs a toolchain w/ C++, threads"
	depends on !BR2_INSTALL_LIBSTDCPP || !BR2_TOOLCHAIN_HAS_THREADS
```

## package/log4cxx/Config.in
```kconfig
config BR2_PACKAGE_LOG4CXX
	bool "log4cxx"
	select BR2_PACKAGE_APR
	select BR2_PACKAGE_APR_UTIL
	# apr really needs shared library support
	depends on !BR2_PREFER_STATIC_LIB
	depends on BR2_INSTALL_LIBSTDCPP
	depends on BR2_TOOLCHAIN_HAS_THREADS
	depends on BR2_USE_MMU # apr
	help
	  Apache log4cxx is a logging framework for C++ patterned
	  after Apache log4j.

	  http://apache.linux-mirror.org/logging/log4cxx/0.10.0

comment "log4cxx needs a toolchain w/ C++, threads, dynamic library"
	depends on !BR2_INSTALL_LIBSTDCPP || !BR2_TOOLCHAIN_HAS_THREADS || \
		BR2_PREFER_STATIC_LIB
	depends on BR2_USE_MMU
```

## package/logrotate/Config.in
```kconfig
config BR2_PACKAGE_LOGROTATE
	bool "logrotate"
	depends on BR2_USE_WCHAR
	depends on BR2_USE_MMU # fork()
	select BR2_PACKAGE_POPT
	help
	  A simple program to rotate logs.

	  https://github.com/logrotate/logrotate

comment "logrotate needs a toolchain w/ wchar"
	depends on BR2_USE_MMU
	depends on !BR2_USE_WCHAR
```
