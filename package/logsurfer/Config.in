## package/logsurfer/Config.in
```kconfig
config BR2_PACKAGE_LOGSURFER
	bool "logsurfer"
	depends on BR2_USE_MMU # fork()
	help
	  Logsurfer is a program for monitoring system logs in
	  real-time, and reporting on the occurrence of events.

	  http://www.crypt.gen.nz/logsurfer/
```

## package/lpc3250loader/Config.in.host
```kconfig
config BR2_PACKAGE_HOST_LPC3250LOADER
	bool "host lpc3250loader"
	help
	  lpc3250loader is a tool to load/burn programs (in particular kickstart
	  and S1L) on an LPC3250 platform.

	  https://gitorious.org/lpc3250loader
```

## package/lpeg/Config.in
```kconfig
config BR2_PACKAGE_LPEG
	bool "lpeg"
	help
	  LPeg is a new pattern-matching library for Lua,
	  based on Parsing Expression Grammars (PEGs).

	  http://www.inf.puc-rio.br/~roberto/lpeg.html
```

## package/lpty/Config.in
```kconfig
config BR2_PACKAGE_LPTY
	bool "lpty"
	help
	  A simple facility for lua to control other programs via
	  PTYs.

	  http://www.tset.de/lpty/
```

## package/lrandom/Config.in
```kconfig
config BR2_PACKAGE_LRANDOM
	bool "lrandom"
	help
	  A library for generating random numbers
	  based on the Mersenne Twister

	  http://www.tecgraf.puc-rio.br/~lhf/ftp/lua/#lrandom
```

## package/lrzip/Config.in
```kconfig
config BR2_PACKAGE_LRZIP
	bool "lrzip"
	depends on BR2_USE_MMU # fork()
	depends on BR2_USE_WCHAR
	depends on BR2_TOOLCHAIN_HAS_THREADS
	depends on BR2_INSTALL_LIBSTDCPP
	select BR2_PACKAGE_ZLIB
	select BR2_PACKAGE_LZO
	select BR2_PACKAGE_BZIP2
	help
	  A compression utility that excels at compressing large files
	  (usually > 10-50 MB). Larger files and/or more free RAM means
	  that the utility will be able to more effectively compress
	  your files (ie: faster / smaller size), especially if the
	  filesize(s) exceed 100 MB. You can either choose to optimise
	  for speed (fast compression / decompression) or size,
	  but not both.

	  https://github.com/ckolivas/lrzip

comment "lrzip needs a toolchain w/ wchar, threads, C++"
	depends on BR2_USE_MMU
	depends on !BR2_USE_WCHAR || !BR2_TOOLCHAIN_HAS_THREADS || \
		!BR2_INSTALL_LIBSTDCPP
```

## package/lrzsz/Config.in
```kconfig
config BR2_PACKAGE_LRZSZ
	bool "lrzsz"
	# It could technically build in a static-only environment, but
	# it unconditionally redefines the error() and error_at_line()
	# functions, which clashes with the definition from
	# uClibc. Since the autotools packaging dates back from 1998,
	# lots of work is needed to fix it, and do some proper tests
	# on the availability of such functions.
	depends on !BR2_STATIC_LIBS
	help
	  Portable and fast implementation of the X/Y/Zmodem protocols.

	  http://www.ohse.de/uwe/software/lrzsz.html

comment "lrzsz needs a toolchain w/ dynamic library"
	depends on BR2_STATIC_LIBS
```

## package/lshw/Config.in
```kconfig
config BR2_PACKAGE_LSHW
	bool "lshw"
	depends on BR2_INSTALL_LIBSTDCPP
	depends on BR2_USE_WCHAR
	select BR2_PACKAGE_HWDATA # runtime
	select BR2_PACKAGE_HWDATA_PCI_IDS
	select BR2_PACKAGE_HWDATA_USB_IDS
	help
	  lshw (Hardware Lister) is a small tool to provide
	  detailed information on the hardware configuration of the
	  machine.

	  http://ezix.org/project/wiki/HardwareLiSter

comment "lshw needs a toolchain w/ C++, wchar"
	depends on !BR2_INSTALL_LIBSTDCPP || !BR2_USE_WCHAR
```

## package/lsof/Config.in
```kconfig
config BR2_PACKAGE_LSOF
	bool "lsof"
	depends on BR2_USE_MMU # fork()
	depends on BR2_PACKAGE_BUSYBOX_SHOW_OTHERS
	help
	  lsof (LiSt Open Files)
	  The lsof tool lists information about files opened by
	  processes.

	  https://github.com/lsof-org/lsof
```

## package/lsqlite3/Config.in
```kconfig
config BR2_PACKAGE_LSQLITE3
	bool "lsqlite3"
	select BR2_PACKAGE_SQLITE
	help
	  A binding for Lua to the SQLite3 database library.

	  http://lua.sqlite.org/
```

## package/lsscsi/Config.in
```kconfig
config BR2_PACKAGE_LSSCSI
	bool "lsscsi"
	help
	  lsscsi - list SCSI devices (or hosts) and their attributes

	  http://sg.danny.cz/scsi/lsscsi.html
```

## package/lsuio/Config.in
```kconfig
config BR2_PACKAGE_LSUIO
	bool "lsuio"
	help
	  list available userspace I/O (UIO) devices

	  http://www.osadl.org/UIO.uio.0.html
```

## package/ltp-testsuite/Config.in
```kconfig
config BR2_PACKAGE_LTP_TESTSUITE_ARCH_SUPPORTS
	bool
	# Needs __sync*() built-ins for 4-byte data, except on a few
	# architectures for which a specific implementation is
	# provided in ltp-testsuite
	default y if BR2_TOOLCHAIN_HAS_SYNC_4
	default y if BR2_arc
	# does not build on nios2, cachectl.h issue
	depends on !BR2_nios2

config BR2_PACKAGE_LTP_TESTSUITE
	bool "ltp-testsuite"
	depends on BR2_USE_MMU # fork()
	depends on BR2_TOOLCHAIN_HAS_THREADS_NPTL
	depends on BR2_PACKAGE_LTP_TESTSUITE_ARCH_SUPPORTS
	select BR2_PACKAGE_LIBTIRPC if !BR2_TOOLCHAIN_HAS_NATIVE_RPC
	select BR2_PACKAGE_MUSL_FTS if !BR2_TOOLCHAIN_USES_GLIBC
	help
	  The Linux Test Project provides a huge testsuite for Linux.

	  http://linux-test-project.github.io

comment "ltp-testsuite needs a toolchain w/ NPTL"
	depends on BR2_PACKAGE_LTP_TESTSUITE_ARCH_SUPPORTS
	depends on BR2_USE_MMU
	depends on !BR2_TOOLCHAIN_HAS_THREADS_NPTL
```

## package/ltrace/Config.in
```kconfig
config BR2_PACKAGE_LTRACE_ARCH_SUPPORTS
	bool
	default y if BR2_aarch64
	default y if BR2_arm
	default y if BR2_i386
	default y if BR2_mips
	default y if BR2_mipsel
	default y if BR2_powerpc
	default y if BR2_sparc
	default y if BR2_x86_64
	default y if BR2_xtensa

config BR2_PACKAGE_LTRACE
	bool "ltrace"
	depends on BR2_USE_WCHAR # elfutils
	depends on !BR2_STATIC_LIBS # elfutils
	depends on BR2_TOOLCHAIN_USES_UCLIBC || BR2_TOOLCHAIN_USES_GLIBC # elfutils
	depends on BR2_PACKAGE_LTRACE_ARCH_SUPPORTS
	select BR2_PACKAGE_ELFUTILS
	help
	  Debugging program which runs a specified command until it
	  exits. While the command is executing, ltrace intercepts and
	  records the dynamic library calls which are called by the
	  executed process and the signals received by that process.

	  http://ltrace.org

comment "ltrace needs a uClibc or glibc toolchain w/ wchar, dynamic library"
	depends on BR2_PACKAGE_LTRACE_ARCH_SUPPORTS
	depends on !BR2_USE_WCHAR || BR2_STATIC_LIBS \
		|| !(BR2_TOOLCHAIN_USES_UCLIBC || BR2_TOOLCHAIN_USES_GLIBC)
```

## package/ltris/Config.in
```kconfig
config BR2_PACKAGE_LTRIS
	bool "LTris"
	depends on BR2_USE_MMU # fork()
	select BR2_PACKAGE_SDL
	help
	  LTris is a tetris clone, using SDL. It optionally requires
	  SDL_mixer for audio support. A display with minimum 640x480
	  resolution and a keyboard are recommended.

	  http://lgames.sourceforge.net/index.php?project=LTris

if BR2_PACKAGE_LTRIS

config BR2_PACKAGE_LTRIS_AUDIO
	bool "audio support"
	default y
	select BR2_PACKAGE_SDL_MIXER
	help
	  Activates audio support in LTris. Will add SDL_mixer.

endif
```

## package/ltt/Config.in
```kconfig
config BR2_PACKAGE_LTT
	bool "LTT (Linux Trace Toolkit)"
	depends on BROKEN
	help
	  A suite of tools designed to extract program execution
	  details from the Linux operating system and interpret them.

	  http://www.opersys.com/LTT/
	  The package is obsolete and has been replaced by ltt-ng
```

## package/lttng-babeltrace/Config.in
```kconfig
config BR2_PACKAGE_LTTNG_BABELTRACE
	bool "lttng-babeltrace"
	select BR2_PACKAGE_UTIL_LINUX
	select BR2_PACKAGE_UTIL_LINUX_LIBUUID
	select BR2_PACKAGE_LIBGLIB2
	select BR2_PACKAGE_POPT
	depends on BR2_USE_WCHAR # libglib2, util-linux
	depends on BR2_TOOLCHAIN_HAS_THREADS # libglib2
	depends on BR2_USE_MMU # libglib2
	help
	  The Babeltrace project provides trace read and write
	  libraries, as well as a trace converter application. Plugins
	  can be created for any trace format to allow its conversion
	  to/from another trace format.

	  Babeltrace is the reference implementation of the Common
	  Trace Format (see <http://diamon.org/docs/ctf/>). Babeltrace
	  can decode and display LTTng traces, since the latter are
	  written using the CTF format.

	  Having this tool on the target is not mandatory. You can
	  transfer the binary trace output from the target to your
	  development workstation, and use babeltrace here. Buildroot
	  automatically builds a host babeltrace in
	  $(O)/host/usr/bin/babeltrace as a dependency of the
	  lttng-tools package.

	  http://www.efficios.com/babeltrace

comment "lttng-babeltrace needs a toolchain w/ wchar, threads"
	depends on BR2_USE_MMU
	depends on !BR2_USE_WCHAR || !BR2_TOOLCHAIN_HAS_THREADS
```

## package/lttng-libust/Config.in
```kconfig
config BR2_PACKAGE_LTTNG_LIBUST
	bool "lttng-libust"
	select BR2_PACKAGE_LIBURCU
	select BR2_PACKAGE_UTIL_LINUX
	select BR2_PACKAGE_UTIL_LINUX_LIBUUID
	depends on BR2_USE_WCHAR # util-linux
	# liburcu only works on some architectures and requires threads support"
	depends on BR2_arm || BR2_armeb || BR2_i386 || BR2_powerpc || BR2_x86_64
	depends on !BR2_TOOLCHAIN_HAS_GCC_BUG_58854 # liburcu/gcc-4.8.x bug
	depends on BR2_TOOLCHAIN_HAS_THREADS
	depends on !BR2_STATIC_LIBS
	help
	  Userspace tracing library for the LTTng 2.x tracing
	  infrastructure. It allows userspace programs to create
	  custom trace events that are integrated with all other
	  events gathered by LTTng.

	  http://lttng.org

comment "lttng-libust needs a toolchain w/ dynamic library, wchar, threads"
	depends on BR2_arm || BR2_armeb || BR2_i386 || BR2_powerpc || BR2_x86_64
	depends on BR2_STATIC_LIBS || !BR2_USE_WCHAR || !BR2_TOOLCHAIN_HAS_THREADS
	depends on !BR2_TOOLCHAIN_HAS_GCC_BUG_58854 # liburcu/gcc-4.8.x bug

comment "lttng-libust needs a toolchain not affected by GCC bug 58854"
	depends on BR2_TOOLCHAIN_HAS_GCC_BUG_58854
```

## package/lttng-modules/Config.in
```kconfig
config BR2_PACKAGE_LTTNG_MODULES
	bool "lttng-modules"
	depends on BR2_LINUX_KERNEL
	help
	  Linux kernel modules for the LTTng 2.x kernel tracing
	  infrastructure.

	  Make sure your target kernel has the following config
	  options enabled:

	    * CONFIG_MODULES: loadable module support
	    * CONFIG_KALLSYMS: this is necessary until the few
	      required missing symbols are exported to GPL
	      modules from mainline
	    * CONFIG_HIGH_RES_TIMERS: needed for LTTng 2.x
	      clock source
	    * CONFIG_TRACEPOINTS: kernel tracepoint instrumentation
	      (enabled as a side-effect of any of the
	      perf/ftrace/blktrace instrumentation features)

	  The following kernel configuration options will
	  affect the features available from LTTng:

	    * CONFIG_HAVE_SYSCALL_TRACEPOINTS: system call tracing
	    * CONFIG_PERF_EVENTS: performance counters
	    * CONFIG_EVENT_TRACING: needed to allow block layer tracing
	    * CONFIG_KPROBES: dynamic probes
	    * CONFIG_KRETPROBES: dynamic function entry/return probes
	    * CONFIG_KALLSYMS_ALL: state dump of mapping between block
	      device number and name

	  The packaged version is compatible with Linux 2.6.38 to 3.16.

	  http://lttng.org

comment "lttng-modules needs a Linux kernel to be built"
	depends on !BR2_LINUX_KERNEL
```

## package/lttng-tools/Config.in
```kconfig
config BR2_PACKAGE_LTTNG_TOOLS
	bool "lttng-tools"
	# liburcu only works on some architectures and requires thread support
	depends on BR2_PACKAGE_LIBURCU_ARCH_SUPPORTS
	depends on BR2_TOOLCHAIN_HAS_THREADS
	depends on !BR2_STATIC_LIBS # uses dlfcn
	select BR2_PACKAGE_LIBURCU
	select BR2_PACKAGE_LIBXML2
	select BR2_PACKAGE_POPT
	select BR2_PACKAGE_UTIL_LINUX
	select BR2_PACKAGE_UTIL_LINUX_LIBUUID
	help
	  Userspace utilities for the LTTng 2.x tracing
	  infrastructure.

	  Those utilities are required on the target system to start
	  and stop tracing sessions. Analysis of the trace can be done
	  on the host machine using the babeltrace utility. This
	  utility is automatically built by Buildroot in
	  $(O)/host/bin/babeltrace, as a dependency of
	  lttng-tools. However, there is also a lttng-babeltrace
	  package for the target, if babeltrace on the target is
	  interesting.

	  If userspace tracing is desired, you need to enable
	  lttng-libust.

	  http://lttng.org

comment "lttng-tools needs a toolchain w/ threads, dynamic library"
	depends on BR2_PACKAGE_LIBURCU_ARCH_SUPPORTS
	depends on !BR2_TOOLCHAIN_HAS_THREADS || BR2_STATIC_LIBS
```

## package/lua-basexx/Config.in
```kconfig
config BR2_PACKAGE_LUA_BASEXX
	bool "lua-basexx"
	help
	  A Lua library which provides base2(bitfield), base16(hex),
	  base32(crockford/rfc), base64(rfc/url), base85(z85) decoding
	  and encoding.

	  https://github.com/aiq/basexx
```

## package/lua-binaryheap/Config.in
```kconfig
config BR2_PACKAGE_LUA_BINARYHEAP
	bool "lua-binaryheap"
	help
	  Binary heap implementation in pure Lua.

	  https://github.com/Tieske/binaryheap.lua
```

## package/lua-bit32/Config.in
```kconfig
config BR2_PACKAGE_LUA_BIT32
	bool "lua-bit32"
	help
	  bit32 is the native Lua 5.2 bit manipulation library, in the
	  version from Lua 5.3; it is compatible with Lua 5.1, 5.2 and
	  5.3.

	  http://www.lua.org/manual/5.2/manual.html#6.7
```

## package/lua-cjson/Config.in
```kconfig
config BR2_PACKAGE_LUA_CJSON
	bool "lua-cjson"
	depends on BR2_PACKAGE_HAS_LUAINTERPRETER
	help
	  The Lua CJSON module provides JSON support for Lua.
	  It features:
	  - Fast, standards compliant encoding/parsing routines
	  - Full support for JSON with UTF-8, including decoding
	    surrogate pairs
	  - Optional run-time support for common exceptions to the JSON
	    specification (infinity, NaN, ...)
	  - No dependencies on other libraries

	  (C-module)

	  http://www.kyne.com.au/~mark/software/lua-cjson.php
```

## package/lua-coat/Config.in
```kconfig
config BR2_PACKAGE_LUA_COAT
	bool "lua-coat"
	help
	  Yet Another Lua Object-Oriented Model

	  http://fperrad.github.io/lua-Coat/
```
