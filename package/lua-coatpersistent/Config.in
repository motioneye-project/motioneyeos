## package/lua-coatpersistent/Config.in
```kconfig
config BR2_PACKAGE_LUA_COATPERSISTENT
	bool "lua-coatpersistent"
	depends on BR2_PACKAGE_LSQLITE3 || BR2_PACKAGE_LUASQL_SQLITE3
	select BR2_PACKAGE_DADO # runtime
	select BR2_PACKAGE_LUA_COAT # runtime
	help
	  An ORM for lua-Coat.

	  https://fperrad.frama.io/lua-CoatPersistent/

comment "lua-coatpersistent needs lsqlite3 or luasql-sqlite3"
	depends on !BR2_PACKAGE_LSQLITE3 && !BR2_PACKAGE_LUASQL_SQLITE3
```

## package/lua-codegen/Config.in
```kconfig
config BR2_PACKAGE_LUA_CODEGEN
	bool "lua-codegen"
	help
	  A template engine.

	  https://fperrad.frama.io/lua-CodeGen
```

## package/lua-compat53/Config.in
```kconfig
config BR2_PACKAGE_LUA_COMPAT53
	bool "lua-compat53"
	depends on !BR2_PACKAGE_LUA_5_3
	help
	  Compatibility module providing Lua-5.3-style APIs for Lua 5.2
	  and 5.1.

	  https://github.com/keplerproject/lua-compat-5.3
```

## package/lua-cqueues/Config.in
```kconfig
config BR2_PACKAGE_LUA_CQUEUES
	bool "lua-cqueues"
	depends on BR2_TOOLCHAIN_HAS_THREADS
	select BR2_PACKAGE_OPENSSL
	help
	  Continuation Queues: Embeddable asynchronous networking,
	  threading, and notification framework for Lua on Unix.

	  http://25thandclement.com/~william/projects/cqueues.html

comment "lua-cqueues needs a toolchain w/ threads"
	depends on !BR2_TOOLCHAIN_HAS_THREADS
```

## package/lua-csnappy/Config.in
```kconfig
config BR2_PACKAGE_LUA_CSNAPPY
	bool "lua-csnappy"
	help
	  lua-csnappy is a binding of the csnappy library
	  which implements the Google's Snappy (de)compressor.

	  https://fperrad.frama.io/lua-csnappy/
```

## package/lua-curl/Config.in
```kconfig
config BR2_PACKAGE_LUA_CURL
	bool "lua-curl"
	select BR2_PACKAGE_LIBCURL
	help
	  Lua binding to libcurl.

	  https://lua-curl.github.io/
```

## package/lua-datafile/Config.in
```kconfig
config BR2_PACKAGE_LUA_DATAFILE
	bool "lua-datafile"
	help
	  datafile is a library for avoiding hardcoded paths
	  when loading resource files in Lua modules.

	  https://github.com/hishamhm/datafile
```

## package/lua-ev/Config.in
```kconfig
config BR2_PACKAGE_LUA_EV
	bool "lua-ev"
	select BR2_PACKAGE_LIBEV
	help
	  Get access to the libev library from Lua.

	  https://github.com/brimworks/lua-ev
```

## package/lua-fifo/Config.in
```kconfig
config BR2_PACKAGE_LUA_FIFO
	bool "lua-fifo"
	help
	  A lua library/'class' that implements a FIFO.

	  https://github.com/daurnimator/fifo.lua
```

## package/lua-flu/Config.in
```kconfig
config BR2_PACKAGE_LUA_FLU
	bool "lua-flu"
	depends on !BR2_STATIC_LIBS # libfuse
	depends on BR2_TOOLCHAIN_HAS_THREADS # libfuse
	depends on BR2_USE_MMU # libfuse
	select BR2_PACKAGE_ATTR
	select BR2_PACKAGE_LIBFUSE
	help
	  Flu is a Lua binding for FUSE, which is a library allowing
	  creation of filesystem drivers run in userspace. Flu is a high
	  level binding, using basic Lua types rather than userdata
	  whenever possible.

	  http://piratery.net/flu/

comment "lua-flu needs a toolchain w/ threads, dynamic library"
	depends on BR2_USE_MMU
	depends on !BR2_TOOLCHAIN_HAS_THREADS || BR2_STATIC_LIBS
```

## package/lua-gd/Config.in
```kconfig
config BR2_PACKAGE_LUA_GD
	bool "lua-gd"
	select BR2_PACKAGE_GD
	help
	  GD (graphics library) bindings for Lua.

	  https://ittner.github.io/lua-gd/
```

## package/lua-http/Config.in
```kconfig
config BR2_PACKAGE_LUA_HTTP
	bool "lua-http"
	depends on BR2_TOOLCHAIN_HAS_THREADS    # luaossl & lua-cqueues
	select BR2_PACKAGE_LPEG # runtime
	select BR2_PACKAGE_LUA_BASEXX # runtime
	select BR2_PACKAGE_LUA_COMPAT53 if !BR2_PACKAGE_LUA_5_3 # runtime
	select BR2_PACKAGE_LUA_CQUEUES # runtime
	select BR2_PACKAGE_LUA_FIFO # runtime
	select BR2_PACKAGE_LUA_LPEG_PATTERNS # runtime
	select BR2_PACKAGE_LUABITOP if BR2_PACKAGE_LUA_5_1 # runtime
	select BR2_PACKAGE_LUAOSSL # runtime
	help
	  HTTP library for Lua.

	  https://daurnimator.github.io/lua-http/

comment "lua-http needs a toolchain w/ threads"
	depends on !BR2_TOOLCHAIN_HAS_THREADS
```

## package/lua-iconv/Config.in
```kconfig
config BR2_PACKAGE_LUA_ICONV
	bool "lua-iconv"
	select BR2_PACKAGE_LIBICONV if !BR2_ENABLE_LOCALE
	help
	  Lua binding to the POSIX 'iconv' library

	  http://ittner.github.io/lua-iconv/
```

## package/lua-livr-extra/Config.in
```kconfig
config BR2_PACKAGE_LUA_LIVR_EXTRA
	bool "lua-livr-extra"
	select BR2_PACKAGE_LUA_LIVR # runtime
	help
	  more LIVR rules.

	  https://fperrad.frama.io/lua-LIVR-extra
```

## package/lua-livr/Config.in
```kconfig
config BR2_PACKAGE_LUA_LIVR
	bool "lua-livr"
	help
	  Lightweight validator supporting Language Independent
	  Validation Rules Specification (LIVR).

	  https://fperrad.frama.io/lua-LIVR
```

## package/lua-lpeg-patterns/Config.in
```kconfig
config BR2_PACKAGE_LUA_LPEG_PATTERNS
	bool "lua-lpeg-patterns"
	select BR2_PACKAGE_LPEG # runtime
	help
	  a collection of LPEG patterns.

	  https://github.com/daurnimator/lpeg_patterns
```

## package/lua-lunitx/Config.in
```kconfig
config BR2_PACKAGE_LUA_LUNITX
	bool "lua-lunitx"
	help
	  Lunitx is a unit testing framework for lua, written in lua.

	  https://github.com/dcurrie/lunit
```

## package/lua-lyaml/Config.in
```kconfig
config BR2_PACKAGE_LUA_LYAML
	bool "lua-lyaml"
	select BR2_PACKAGE_LIBYAML
	help
	  This is a Lua binding for the fast libYAML C library for
	  converting between `%YAML 1.1` and Lua tables, with a
	  flexible Lua language API to load and save YAML documents.

	  http://github.com/gvvaughan/lyaml
```

## package/lua-markdown/Config.in
```kconfig
config BR2_PACKAGE_LUA_MARKDOWN
	bool "lua-markdown"
	help
	  A pure-lua implementation of the Markdown text-to-html
	  markup system.

	  https://github.com/mpeterv/markdown
```

## package/lua-messagepack/Config.in
```kconfig
config BR2_PACKAGE_LUA_MESSAGEPACK
	bool "lua-messagepack"
	help
	  A pure Lua implementation of the MessagePack serialization
	  format.

	  https://fperrad.frama.io/lua-MessagePack/
```

## package/lua-msgpack-native/Config.in
```kconfig
config BR2_PACKAGE_LUA_MSGPACK_NATIVE
	bool "lua-msgpack-native"
	depends on BR2_PACKAGE_LUA_5_1 || BR2_PACKAGE_LUAJIT
	help
	  This is a native, C language implementation of msgpack
	  (http://msgpack.org) library/protocol for Lua language

	  https://github.com/kengonakajima/lua-msgpack-native

comment "lua-msgpack-native needs Lua 5.1 or LuaJIT"
	depends on !BR2_PACKAGE_LUA_5_1
	depends on !BR2_PACKAGE_LUAJIT
```

## package/lua-periphery/Config.in
```kconfig
config BR2_PACKAGE_LUA_PERIPHERY
	bool "lua-periphery"
	help
	  A library for GPIO, SPI, I2C, MMIO, and Serial peripheral I/O
	  interface access in userspace Linux with Lua.

	  https://github.com/vsergeev/lua-periphery
```

## package/lua-resty-http/Config.in
```kconfig
config BR2_PACKAGE_LUA_RESTY_HTTP
	bool "lua-resty-http"
	help
	  Lua HTTP client cosocket driver for OpenResty / ngx_lua.

	  https://github.com/ledgetech/lua-resty-http
```

## package/lua-rotas/Config.in
```kconfig
config BR2_PACKAGE_LUA_ROTAS
	bool "lua-rotas"
	help
	  a web server router.

	  https://fperrad.frama.io/lua-Rotas
```

## package/lua-sailor/Config.in
```kconfig
config BR2_PACKAGE_LUA_SAILOR
	bool "lua-sailor"
	select BR2_PACKAGE_CGILUA # runtime
	select BR2_PACKAGE_LBASE64 # runtime
	select BR2_PACKAGE_LUA_DATAFILE # runtime
	select BR2_PACKAGE_LUA_VALUA # runtime
	select BR2_PACKAGE_LUAFILESYSTEM # runtime
	select BR2_PACKAGE_WSAPI_XAVANTE # runtime
	select BR2_PACKAGE_XAVANTE # runtime
	help
	  Sailor is a web framework written in Lua that follows the MVC
	  design pattern.

	  http://sailorproject.org/
```
