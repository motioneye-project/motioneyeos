## package/lua-sdl2/Config.in
```kconfig
config BR2_PACKAGE_LUA_SDL2
	bool "lua-sdl2"
	depends on !BR2_STATIC_LIBS
	select BR2_PACKAGE_SDL2
	help
	  Lua-SDL2 is a pure C binding of SDL2 to Lua 5.1, Lua 5.2,
	  Lua 5.3, and LuaJIT.

	  https://github.com/Tangent128/luasdl2

comment "lua-sdl2 needs a toolchain w/ dynamic library"
	depends on BR2_STATIC_LIBS
```

## package/lua-silva/Config.in
```kconfig
config BR2_PACKAGE_LUA_SILVA
	bool "lua-silva"
	help
	  your string matcher expert.

	  https://fperrad.frama.io/lua-Silva
```

## package/lua-std-debug/Config.in
```kconfig
config BR2_PACKAGE_LUA_STD_DEBUG
	bool "lua-std-debug"
	help
	  Manage an overall debug state, and associated hint
	  substates.

	  http://lua-stdlib.github.io/_debug
```

## package/lua-std-normalize/Config.in
```kconfig
config BR2_PACKAGE_LUA_STD_NORMALIZE
	bool "lua-std-normalize"
	select BR2_PACKAGE_LUA_STD_DEBUG # runtime
	help
	  This module can inject deterministic versions of core Lua
	  functions that do not behave identically across all
	  supported Lua implementations into your module's lexical
	  environment.  Each function is as thin and fast a version as
	  is possible in each Lua implementation, evaluating to the
	  Lua C implementation with no overhead when semantics allow.

	  https://lua-stdlib.github.io/normalize
```

## package/lua-stdlib/Config.in
```kconfig
config BR2_PACKAGE_LUA_STDLIB
	bool "lua-stdlib"
	help
	  lua-stdlib is a library of modules for common programming
	  tasks, including list, table and functional operations,
	  objects, pickling, pretty-printing and command-line option
	  parsing.

	  https://github.com/lua-stdlib/lua-stdlib/
```

## package/lua-testmore/Config.in
```kconfig
config BR2_PACKAGE_LUA_TESTMORE
	bool "lua-testmore"
	help
	  an Unit Testing Framework.

	  https://fperrad.frama.io/lua-TestMore/
```

## package/lua-utf8/Config.in
```kconfig
config BR2_PACKAGE_LUA_UTF8
	bool "lua-utf8"
	help
	  This module adds UTF-8 support to Lua.
	  It's compatible with Lua "string" module.

	  http://github.com/starwing/luautf8
```

## package/lua-valua/Config.in
```kconfig
config BR2_PACKAGE_LUA_VALUA
	bool "lua-valua"
	help
	  This module provides tools for validating values, very useful
	  in forms, but also usable elsewhere. It works in appended
	  chains. Create a new validation object and start chaining
	  your test functions.

	  https://github.com/sailorproject/valua
```

## package/lua/Config.in
```kconfig
config BR2_PACKAGE_LUA
	bool "lua"
	select BR2_PACKAGE_HAS_LUAINTERPRETER
	help
	  Lua is a powerful, fast, light-weight, embeddable scripting language.

	  http://www.lua.org/

if BR2_PACKAGE_LUA

config BR2_PACKAGE_PROVIDES_LUAINTERPRETER
	default "lua"

choice
	prompt "Lua Version"
	default BR2_PACKAGE_LUA_5_1
	help
	  Select the version of Lua API/ABI you wish to use.

	config BR2_PACKAGE_LUA_5_1
		bool "Lua 5.1.x"

	config BR2_PACKAGE_LUA_5_2
		bool "Lua 5.2.x"

	config BR2_PACKAGE_LUA_5_3
		bool "Lua 5.3.x"

endchoice

config BR2_PACKAGE_LUAINTERPRETER_ABI_VERSION
	default "5.1"	if BR2_PACKAGE_LUA_5_1
	default "5.2"	if BR2_PACKAGE_LUA_5_2
	default "5.3"	if BR2_PACKAGE_LUA_5_3

if BR2_PACKAGE_LUA_5_3
config BR2_PACKAGE_LUA_32BITS
	bool "Use 32 bit numbers"
	default y if !BR2_ARCH_IS_64
	help
	  Use a 32 bit data type for numbers / integers instead of the
	  default 64 bit type.  This option is particularly attractive
	  for small machines and embedded systems.

endif

choice
	prompt "Lua command-line editing"
	default BR2_PACKAGE_LUA_EDITING_NONE

config BR2_PACKAGE_LUA_EDITING_NONE
	bool "none"
	help
	  None.

config BR2_PACKAGE_LUA_READLINE
	bool "readline support"
	select BR2_PACKAGE_READLINE
	select BR2_PACKAGE_NCURSES
	help
	  Enables command-line editing in the Lua interpreter.

config BR2_PACKAGE_LUA_LINENOISE
	bool "linenoise support"
	select BR2_PACKAGE_LINENOISE
	help
	  Enables command-line editing in the Lua interpreter.

endchoice

endif
```

## package/luabitop/Config.in
```kconfig
config BR2_PACKAGE_LUABITOP
	bool "luabitop"
	depends on !BR2_PACKAGE_LUA_5_3
	help
	  Lua BitOp is a C extension module for Lua 5.1/5.2 which adds
	  bitwise operations on numbers.

	  http://bitop.luajit.org

comment "luabitop needs a Lua 5.1/5.2 interpreter"
	depends on BR2_PACKAGE_LUA_5_3
```

## package/luacjson/Config.in
```kconfig
config BR2_PACKAGE_LUACJSON
	bool "luacjson"
	help
	  The Lua CJSON module provides JSON support for Lua. It features:
	  - Fast, standards compliant encoding/parsing routines
	  - Full support for JSON with UTF-8, including decoding surrogate pairs
	  - Optional run-time support for common exceptions to the JSON
	    specification (infinity, NaN, ...)
	  - No dependencies on other libraries

	  (C-module)

	  http://www.kyne.com.au/~mark/software/lua-cjson.php
```

## package/luacrypto/Config.in
```kconfig
config BR2_PACKAGE_LUACRYPTO
	bool "luacrypto"
	select BR2_PACKAGE_OPENSSL
	help
	  LuaCrypto provides a Lua frontend to the OpenSSL cryptographic
	  library.
	  The OpenSSL features that are currently exposed are digests
	  (MD5, SHA-1, HMAC, and more) and crypto-grade random number
	  generators communication.

	  http://luacrypto.luaforge.net
```

## package/luadbi-sqlite3/Config.in
```kconfig
config BR2_PACKAGE_LUADBI_SQLITE3
	bool "luadbi-sqlite3"
	select BR2_PACKAGE_LUADBI # runtime dependency
	select BR2_PACKAGE_SQLITE
	help
	  LuaDBI is a database interface library for Lua.
	  And this is the SQLite3 backend.

	  https://github.com/mwild1/luadbi
```

## package/luadbi/Config.in
```kconfig
config BR2_PACKAGE_LUADBI
	bool "luadbi"
	help
	  LuaDBI is a database interface library for Lua.
	  It is designed to provide a RDBMS agnostic API for handling
	  database operations. LuaDBI also provides support for
	  prepared statement handles, placeholders and bind parameters
	  for all database operations.

	  https://github.com/mwild1/luadbi
```

## package/luaexpat/Config.in
```kconfig
config BR2_PACKAGE_LUAEXPAT
	bool "luaexpat"
	depends on BR2_PACKAGE_HAS_LUAINTERPRETER
	select BR2_PACKAGE_EXPAT
	help
	  LuaExpat is a SAX XML parser based on the Expat library.

	  http://matthewwild.co.uk/projects/luaexpat/
```

## package/luaexpatutils/Config.in
```kconfig
config BR2_PACKAGE_LUAEXPATUTILS
	bool "luaexpatutils"
	select BR2_PACKAGE_LUAEXPAT
	help
	  lxp.doc is a module that provides useful features for working with
	  XML formats in LOM format as used by the LuaExpat project from Kepler.

	  https://github.com/stevedonovan/LuaExpatUtils
```

## package/luafilesystem/Config.in
```kconfig
config BR2_PACKAGE_LUAFILESYSTEM
	bool "luafilesystem"
	help
	  LuaFileSystem offers a portable way to access
	  the underlying directory structure and file attributes.

	  http://keplerproject.github.com/luafilesystem/
```

## package/luainterpreter/Config.in
```kconfig
config BR2_PACKAGE_HAS_LUAINTERPRETER
	bool

config BR2_PACKAGE_PROVIDES_LUAINTERPRETER
	string
	depends on BR2_PACKAGE_HAS_LUAINTERPRETER

config BR2_PACKAGE_LUAINTERPRETER_ABI_VERSION
	string

config BR2_PACKAGE_PROVIDES_HOST_LUAINTERPRETER
	string
	default "host-lua"
```

## package/luajit/Config.in
```kconfig
config BR2_PACKAGE_LUAJIT_ARCH_SUPPORTS
	bool
	default y if BR2_i386 || \
		(BR2_x86_64 && BR2_HOSTARCH='x86_64') || \
		BR2_powerpc || BR2_arm || BR2_armeb || \
		((BR2_mips || BR2_mipsel) && !BR2_MIPS_SOFT_FLOAT && \
		!BR2_mips_32r6 && !BR2_mips_64r6)

config BR2_PACKAGE_LUAJIT
	bool "luajit"
	select BR2_PACKAGE_HAS_LUAINTERPRETER
	depends on !BR2_STATIC_LIBS # dlopen
	# Luajit is only available for some target architectures, and
	# has some complexity wrt 32/64. See luajit.mk for details.
	depends on BR2_PACKAGE_LUAJIT_ARCH_SUPPORTS
	# luajit.mk uses the "-m32" compiler option to build 32bit
	# binaries, so check if that option is supported. See
	# luajit.mk for details.
	select BR2_HOSTARCH_NEEDS_IA32_COMPILER if !BR2_ARCH_IS_64
	help
	  LuaJIT implements the full set of language features defined
	  by Lua 5.1. The virtual machine (VM) is API- and
	  ABI-compatible to the standard Lua interpreter and can be
	  deployed as a drop-in replacement.

	  http://luajit.org/

if BR2_PACKAGE_LUAJIT

config BR2_PACKAGE_PROVIDES_LUAINTERPRETER
	default "luajit"

config BR2_PACKAGE_LUAINTERPRETER_ABI_VERSION
	default "5.1"

endif

comment "luajit needs a toolchain w/ dynamic library"
	depends on BR2_STATIC_LIBS
```

## package/luajson/Config.in
```kconfig
config BR2_PACKAGE_LUAJSON
	bool "luajson"
	select BR2_PACKAGE_LPEG # runtime
	help
	  LuaJSON is a customizable JSON decoder/encoder
	  using LPEG for parsing.

	  http://github.com/harningt/luajson
```

## package/lualogging/Config.in
```kconfig
config BR2_PACKAGE_LUALOGGING
	bool "lualogging"
	help
	  LuaLogging provides a simple API to use logging features in Lua.
	  Its design was based on log4j. LuaLogging currently supports,
	  through the use of appenders, console, file, rolling file, email,
	  socket and SQL outputs.

	  http://www.keplerproject.org/lualogging/
```

## package/luaossl/Config.in
```kconfig
config BR2_PACKAGE_LUAOSSL
	bool "luaossl"
	depends on BR2_TOOLCHAIN_HAS_THREADS
	select BR2_PACKAGE_OPENSSL
	help
	  luaossl is a comprehensive binding to OpenSSL for Lua 5.1,
	  5.2, and later.

	  It includes support for certificate and key management,
	  key generation, signature verification, and deep bindings
	  to the distinguished name, alternative name, and X.509v3
	  extension interfaces. It also binds OpenSSL's bignum, message
	  digest, HMAC, cipher, and CSPRNG interfaces.

	  http://25thandclement.com/~william/projects/luaossl.html

comment "luaossl needs a toolchain w/ threads"
	depends on !BR2_TOOLCHAIN_HAS_THREADS
```

## package/luaposix/Config.in
```kconfig
config BR2_PACKAGE_LUAPOSIX
	bool "luaposix"
	depends on BR2_PACKAGE_HAS_LUAINTERPRETER
	# "bit32" is included in Lua 5.2+. luajit has an equivalent
	# "bit" module, but since it has a different name, luaposix
	# doesn't find it.
	select BR2_PACKAGE_LUA_BIT32 if BR2_PACKAGE_LUA_5_1 || BR2_PACKAGE_LUAJIT
	help
	  This is a POSIX binding for LuaJIT, Lua 5.1, 5.2 and 5.3;
	  like most libraries it simply binds to C APIs on the
	  underlying system, so it won't work on non-POSIX systems.
	  However, it does try to detect the level of POSIX conformance
	  of the underlying system and bind only available APIs.

	  https://github.com/luaposix/luaposix
```

## package/luasec/Config.in
```kconfig
config BR2_PACKAGE_LUASEC
	bool "luasec"
	select BR2_PACKAGE_OPENSSL
	select BR2_PACKAGE_LUASOCKET # runtime
	help
	  A binding for OpenSSL library to provide TLS/SSL communication
	  over LuaSocket.

	  https://github.com/brunoos/luasec/wiki
```

## package/luasocket/Config.in
```kconfig
config BR2_PACKAGE_LUASOCKET
	bool "luasocket"
	depends on BR2_PACKAGE_HAS_LUA_INTERPRETER
	help
	  LuaSocket is the most comprehensive networking support library
	  for the Lua language.
	  It provides easy access to TCP, UDP, DNS, SMTP,
	  FTP, HTTP, MIME and much more.

	  http://luaforge.net/projects/luasocket/
```
