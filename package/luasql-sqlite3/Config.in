## package/luasql-sqlite3/Config.in
```kconfig
config BR2_PACKAGE_LUASQL_SQLITE3
	bool "luasql-sqlite3"
	select BR2_PACKAGE_SQLITE
	help
	  LuaSQL is a simple interface from Lua to a DBMS.

	  http://keplerproject.github.io/luasql/
```

## package/luasql/Config.in
```kconfig
config BR2_PACKAGE_LUASQL
	bool "luasql"
	help
	  LuaSQL is a simple interface from Lua to a DBMS.

	  http://www.keplerproject.org/luasql

if BR2_PACKAGE_LUASQL
choice
	prompt "LuaSQL Driver"
	help
	  Select backend driver for LuaSQL.

config BR2_PACKAGE_LUASQL_DRIVER_SQLITE3
	bool "SQLite3"
	select BR2_PACKAGE_SQLITE
	help
	  Select if you wish to use the SQLite3 LuaSQL driver.

endchoice
endif
```

## package/luasyslog/Config.in
```kconfig
config BR2_PACKAGE_LUASYSLOG
	bool "luasyslog"
	select BR2_PACKAGE_LUALOGGING # runtime
	help
	  Syslog logging for Lua.

	  https://luarocks.org/modules/luarocks/luasyslog
```

## package/lugaru/Config.in
```kconfig
config BR2_PACKAGE_LUGARU
	bool "lugaru"
	depends on BR2_INSTALL_LIBSTDCPP
	depends on BR2_PACKAGE_HAS_LIBGL # libglu
	depends on BR2_PACKAGE_OPENAL_ARCH_SUPPORTS
	depends on BR2_PACKAGE_XORG7 # SDL2 OpenGL (GLX)
	depends on BR2_TOOLCHAIN_GCC_AT_LEAST_4_7 # C++11
	depends on BR2_TOOLCHAIN_HAS_THREADS_NPTL # openal
	depends on BR2_USE_MMU # SDL2 OpenGL (GLX)
	depends on !BR2_STATIC_LIBS # SDL2
	select BR2_PACKAGE_JPEG
	select BR2_PACKAGE_LIBGLU # GL/glu.h
	select BR2_PACKAGE_LIBPNG
	select BR2_PACKAGE_LIBVORBIS
	select BR2_PACKAGE_OPENAL
	select BR2_PACKAGE_SDL2
	select BR2_PACKAGE_SDL2_OPENGL
	select BR2_PACKAGE_ZLIB
	help
	  Lugaru (pronounced Loo-GAH-roo) is a cross-platform
	  third-person action game. The main character, Turner, is an
	  anthropomorphic rebel bunny rabbit with impressive combat
	  skills. In his quest to find those responsible for
	  slaughtering his village, he uncovers a far-reaching
	  conspiracy involving the corrupt leaders of the rabbit
	  republic and the starving wolves from a nearby den. Turner
	  takes it upon himself to fight against their plot and save
	  his fellow rabbits from slavery.

	  https://osslugaru.gitlab.io/

comment "lugaru needs X11 and a toolchain w/ C++, OpenGL backend, gcc >= 4.7, NPTL, dynamic library"
	depends on BR2_PACKAGE_OPENAL_ARCH_SUPPORTS
	depends on BR2_PACKAGE_XORG7
	depends on BR2_USE_MMU
	depends on !BR2_INSTALL_LIBSTDCPP || !BR2_PACKAGE_HAS_LIBGL || \
		!BR2_TOOLCHAIN_GCC_AT_LEAST_4_7 || !BR2_TOOLCHAIN_HAS_THREADS_NPTL || \
		BR2_STATIC_LIBS
```

## package/luksmeta/Config.in
```kconfig
config BR2_PACKAGE_LUKSMETA
	bool "luksmeta"
	depends on BR2_TOOLCHAIN_HAS_THREADS # cryptsetup -> lvm2
	depends on BR2_USE_MMU # cryptsetup -> lvm2
	depends on !BR2_STATIC_LIBS # cryptsetup -> lvm2
	depends on BR2_TOOLCHAIN_HAS_SYNC_4 # cryptsetup -> json-c
	select BR2_PACKAGE_CRYPTSETUP
	help
	  LUKSMeta is a simple library and utility for storing
	  metadata in the LUKSv1 header.

	  https://github.com/latchset/luksmeta

comment "luksmeta needs a toolchain w/ threads, dynamic library"
	depends on BR2_USE_MMU
	depends on BR2_TOOLCHAIN_HAS_SYNC_4
	depends on BR2_STATIC_LIBS || !BR2_TOOLCHAIN_HAS_THREADS
```

## package/lutok/Config.in
```kconfig
config BR2_PACKAGE_LUTOK
	bool "lutok"
	depends on BR2_INSTALL_LIBSTDCPP
	depends on BR2_PACKAGE_HAS_LUAINTERPRETER
	depends on !BR2_PACKAGE_LUAJIT
	help
	  Lutok is a lightweight C++ API library for Lua.

	  https://github.com/jmmv/lutok

comment "lutok needs a toolchain w/ C++ and full Lua"
	depends on !BR2_INSTALL_LIBSTDCPP || BR2_PACKAGE_LUAJIT
	depends on BR2_PACKAGE_HAS_LUAINTERPRETER
```

## package/luv/Config.in
```kconfig
config BR2_PACKAGE_LUV
	bool "luv"
	depends on BR2_TOOLCHAIN_HAS_THREADS_NPTL # libuv
	depends on BR2_USE_MMU # libuv
	depends on !BR2_STATIC_LIBS # libuv
	depends on BR2_TOOLCHAIN_HAS_SYNC_4 # libuv
	select BR2_PACKAGE_LIBUV
	help
	  libuv bindings for LuaJIT and Lua.

	  https://github.com/luvit/luv

comment "luv needs a toolchain w/ NPTL, dynamic library"
	depends on !BR2_TOOLCHAIN_HAS_THREADS_NPTL || BR2_STATIC_LIBS
	depends on BR2_USE_MMU
	depends on BR2_TOOLCHAIN_HAS_SYNC_4
```

## package/luvi/Config.in
```kconfig
config BR2_PACKAGE_LUVI
	bool "luvi"
	depends on BR2_TOOLCHAIN_HAS_THREADS_NPTL # libuv
	depends on BR2_USE_MMU # libuv
	depends on !BR2_STATIC_LIBS # libuv
	depends on BR2_PACKAGE_LUAJIT
	depends on BR2_TOOLCHAIN_HAS_SYNC_4 # libuv
	select BR2_PACKAGE_LIBUV
	select BR2_PACKAGE_LUV
	help
	  A project in-between luv and luvit. The goal of this is to
	  make building luvit and derivatives much easier.

	  luvi extends LuaJIT with asynchronous I/O and several optional
	  modules to run Lua applications and build self-contained
	  binaries on systems that don't have a compiler.

	  The luvi core can be extended with several Lua modules by
	  adding its bundled Lua binding libraries.
	  To get the Lua module...
	    * 'rex' select PCRE (BR2_PACKAGE_PCRE)
	    * 'ssl' select OpenSSL (BR2_PACKAGE_OPENSSL)
	    * 'zlib' select zlib (BR2_PACKAGE_ZLIB)

	  https://github.com/luvit/luvi

comment "luvi needs a toolchain w/ NPTL, dynamic library"
	depends on !BR2_TOOLCHAIN_HAS_THREADS_NPTL || BR2_STATIC_LIBS
	depends on BR2_USE_MMU
	depends on BR2_TOOLCHAIN_HAS_SYNC_4

comment "luvi needs LuaJIT"
	depends on !BR2_PACKAGE_LUAJIT
```

## package/lvm2/Config.in
```kconfig
config BR2_PACKAGE_LVM2
	bool "lvm2 & device mapper"
	depends on BR2_TOOLCHAIN_HAS_THREADS
	depends on BR2_USE_MMU # needs fork()
	depends on !BR2_STATIC_LIBS # It fails to build statically
	# http://lists.busybox.net/pipermail/buildroot/2016-August/170592.html
	depends on !BR2_TOOLCHAIN_USES_MUSL
	help
	  This is LVM2, the rewrite of The Linux Logical Volume Manager.
	  LVM supports enterprise level volume management of disk and disk
	  subsystems by grouping arbitrary disks into volume groups. The total
	  capacity of volume groups can be allocated to logical volumes, which
	  are accessed as regular block devices.

	  The Linux Kernel Device Mapper is the LVM
	  (Linux Logical Volume Management) Team's implementation of a
	  minimalistic kernel-space driver that handles volume management,
	  while keeping knowledge of the underlying device layout in
	  user-space. This makes it useful for not only LVM, but EVMS,
	  software raid, and other drivers that create "virtual" block devices.

if BR2_PACKAGE_LVM2

config BR2_PACKAGE_LVM2_STANDARD_INSTALL
	bool "standard install instead of only dmsetup"
	default y if !BR2_PACKAGE_LVM2_DMSETUP_ONLY # legacy 2013.11
	help
	  Install the standard suite of lvm2 programs. When this option is not
	  set, only dmsetup is installed.

config BR2_PACKAGE_LVM2_APP_LIBRARY
	bool "install application library"
	select BR2_PACKAGE_LVM2_STANDARD_INSTALL
	help
	  Install application library (liblvm2app).

endif

comment "lvm2 needs a glibc or uClibc toolchain w/ threads, dynamic library"
	depends on BR2_USE_MMU
	depends on BR2_STATIC_LIBS || !BR2_TOOLCHAIN_HAS_THREADS || BR2_TOOLCHAIN_USES_MUSL
```

## package/lxc/Config.in
```kconfig
config BR2_PACKAGE_LXC
	bool "lxc"
	depends on BR2_TOOLCHAIN_HAS_THREADS
	depends on BR2_USE_MMU # fork()
	# build system forcefully builds a shared library
	depends on !BR2_STATIC_LIBS
	depends on BR2_TOOLCHAIN_HEADERS_AT_LEAST_3_0 # setns() system call
	help
	  Linux Containers (LXC), provides the ability to group and
	  isolate of a set of processes in a jail by virtualizing and
	  accounting the kernel resources. It is similar to
	  Linux-Vserver or Openvz.

	  https://linuxcontainers.org/

comment "lxc needs a toolchain w/ threads, headers >= 3.0, dynamic library"
	depends on BR2_USE_MMU
	depends on !BR2_TOOLCHAIN_HAS_THREADS \
		|| !BR2_TOOLCHAIN_HEADERS_AT_LEAST_3_0 \
		|| BR2_STATIC_LIBS
```

## package/lxdoom/Config.in
```kconfig
config BR2_PACKAGE_LXDOOM
	bool "lxdoom"
	default n
	help
	  This is the linux version of the popular doom game.
config BR2_PACKAGE_LXDOOM_WAD
	bool "lxdoom-wad"
	default n
	depends on BR2_PACKAGE_LXDOOM
	help
	  This is the shareware wad data files for the doom game.
```

## package/lynx/Config.in
```kconfig
config BR2_PACKAGE_LYNX
	bool "lynx"
	depends on BR2_USE_MMU
	select BR2_PACKAGE_SLANG if !BR2_PACKAGE_NCURSES
	select BR2_PACKAGE_OPENSSL if !BR2_PACKAGE_GNUTLS
	help
	  The Text Web-Browser.

	  http://lynx.invisible-island.net/
```

## package/lz4/Config.in
```kconfig
config BR2_PACKAGE_LZ4
	bool "lz4"
	help
	  LZ4 is a very fast lossless compression algorithm, providing
	  compression speed at 400 MB/s per core, scalable with
	  multi-cores CPU. It also features an extremely fast decoder,
	  with speed in multiple GB/s per core, typically reaching RAM
	  speed limits on multi-core systems.

	  http://www.lz4.org/
```

## package/lzip/Config.in
```kconfig
comment "lzip needs a toolchain w/ C++"
	depends on !BR2_INSTALL_LIBSTDCPP

config BR2_PACKAGE_LZIP
	bool "lzip"
	depends on BR2_INSTALL_LIBSTDCPP
	help
	  Lzip is a lossless data compressor with a user interface
	  similar to the one of gzip or bzip2.
	  Lzip is about as fast as gzip, compresses most files more than
	  bzip2, and is better than both from a data recovery
	  perspective. Lzip is a clean implementation of the LZMA
	  algorithm.

	  http://www.nongnu.org/lzip/lzip.html
```

## package/lzlib/Config.in
```kconfig
config BR2_PACKAGE_LZLIB
	bool "lzlib"
	select BR2_PACKAGE_ZLIB
	depends on BR2_PACKAGE_LUA
	help
	  This package provides a library to access zlib library
	  functions and also to read/write gzip files using an
	  interface similar to the base io package.

	  https://github.com/LuaDist/lzlib
```

## package/lzma/Config.in
```kconfig
config BR2_PACKAGE_LZMA
	bool "lzma"
	depends on BR2_INSTALL_LIBSTDCPP
	depends on BR2_DEPRECATED
	help
	  Lempel Ziv compression method (LZMA) is a compression
	  algorithm with high compression ratio.

	  http://tukaani.org/lzma/

comment "lzma needs a toolchain w/ C++"
	depends on BR2_DEPRECATED
	depends on !BR2_INSTALL_LIBSTDCPP
```

## package/lzo/Config.in
```kconfig
config BR2_PACKAGE_LZO
	bool "lzo"
	help
	  Portable lossless data compression library written in ANSI C.

	  http://www.oberhumer.com/opensource/lzo/
```

## package/m4/Config.in
```kconfig
config BR2_PACKAGE_M4
	bool "m4"
	depends on BR2_USE_WCHAR
	# uses fork()
	depends on BR2_USE_MMU
	help
	  An implementation of the traditional Unix macro processor.

	  http://www.gnu.org/software/m4/m4.html

comment "m4 needs a toolchain w/ wchar"
	depends on !BR2_USE_WCHAR
```

## package/macchanger/Config.in
```kconfig
config BR2_PACKAGE_MACCHANGER
	bool "macchanger"
	help
	  A GNU/Linux utility for viewing/manipulating the MAC address of
	  network interfaces

	  http://www.alobbs.com/macchanger
```

## package/madplay/Config.in
```kconfig
config BR2_PACKAGE_MADPLAY
	bool "madplay"
	select BR2_PACKAGE_LIBMAD
	select BR2_PACKAGE_LIBID3TAG
	select BR2_PACKAGE_GETTEXT if BR2_NEEDS_GETTEXT_IF_LOCALE
	help
	  Command-line front-end to libmad, a high-quality MPEG audio decoder.
	  It currently supports MPEG-1 and the MPEG-2 extension to lower
	  sampling frequencies, as well as the de facto MPEG 2.5 format. All
	  three audio layers — Layer I, Layer II, and Layer III (i.e. MP3) —
	  are fully implemented.

	  http://www.underbit.com/products/mad/

if BR2_PACKAGE_MADPLAY

config BR2_PACKAGE_MADPLAY_ALSA
	bool
	default y
	depends on BR2_PACKAGE_ALSA_LIB

endif
```

## package/magiccube4d/Config.in
```kconfig
config BR2_PACKAGE_MAGICCUBE4D
	bool "magiccube4d"
	help
	  Another rubiks cube-like game in 4D

	  http://avr32linux.org/twiki/bin/viewfile/Main
```

## package/make/Config.in
```kconfig
config BR2_PACKAGE_MAKE
	bool "make"
	select BR2_PACKAGE_GETTEXT if BR2_NEEDS_GETTEXT_IF_LOCALE
	# We no longer support a toolchain on the target
	depends on BR2_DEPRECATED
	help
	  A tool which controls the generation of executables and other
	  non-source files of a program from the program's source files.

	  http://www.gnu.org/software/make/
```

## package/makedevs/Config.in
```kconfig
config BR2_PACKAGE_MAKEDEVS
       bool "makedevs"
       help
         The makedevs utility allows to create a set of device files
         according to a configuration file.
```

## package/mali-t76x/Config.in
```kconfig
config BR2_PACKAGE_MALI_T76X
	bool "mali-t76x"
	select BR2_PACKAGE_MESA3D_HEADERS
	select BR2_PACKAGE_HAS_LIBEGL
	select BR2_PACKAGE_HAS_LIBGLES
	depends on BR2_TOOLCHAIN_USES_GLIBC
	depends on BR2_ARM_EABIHF
	depends on BR2_arm
	help
	  Install the binary user-space components for the ARM Mali Midgard
	  T76X GPU. This package requires a kernel with the ARM Mali Midgard
	  GPU Kernel Drivers enabled.

	  Source: http://malideveloper.arm.com/resources/drivers/

if BR2_PACKAGE_MALI_T76X

config BR2_PACKAGE_PROVIDES_LIBEGL
	default "mali-t76x"

config BR2_PACKAGE_PROVIDES_LIBGLES
	default "mali-t76x"

endif

comment "mali-t76x needs an (e)glibc toolchain with armhf enabled"
	depends on BR2_arm
	depends on !BR2_TOOLCHAIN_USES_GLIBC || !BR2_ARM_EABIHF
```

## package/mariadb/Config.in
```kconfig
config BR2_PACKAGE_MARIADB
	bool "mariadb"
	depends on BR2_INSTALL_LIBSTDCPP
	depends on BR2_USE_MMU # fork()
	depends on BR2_TOOLCHAIN_HAS_THREADS
	depends on BR2_PACKAGE_LIBAIO_ARCH_SUPPORTS
	depends on !BR2_PACKAGE_MYSQL
	select BR2_PACKAGE_LIBAIO
	select BR2_PACKAGE_LIBXML2
	select BR2_PACKAGE_NCURSES
	select BR2_PACKAGE_OPENSSL
	select BR2_PACKAGE_READLINE
	help
	  MariaDB is one of the most popular database servers in the world.
	  It's made by the original developers of MySQL and guaranteed to
	  stay open source.

	  http://www.mariadb.org/

if BR2_PACKAGE_MARIADB

config BR2_PACKAGE_MARIADB_SERVER
	bool "mariadb server"
	help
	  Install the mariadb server on the target.

endif

comment "mariadb needs a toolchain w/ C++, threads"
	depends on BR2_USE_MMU
	depends on BR2_PACKAGE_LIBAIO_ARCH_SUPPORTS
	depends on !BR2_INSTALL_LIBSTDCPP || !BR2_TOOLCHAIN_HAS_THREADS
```
