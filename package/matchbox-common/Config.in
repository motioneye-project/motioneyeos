## package/matchbox-common/Config.in
```kconfig
config BR2_PACKAGE_MATCHBOX_COMMON
	bool "matchbox-common"
	depends on BR2_PACKAGE_MATCHBOX_PANEL || BR2_PACKAGE_MATCHBOX_DESKTOP
	select BR2_PACKAGE_MATCHBOX_LIB
	help
	  Common desktop folders and matchbox-session script.

	  http://git.yoctoproject.org/cgit/cgit.cgi/matchbox-common/

config BR2_PACKAGE_MATCHBOX_COMMON_PDA
	bool "PDA style app folder"
	depends on BR2_PACKAGE_MATCHBOX_COMMON
```

## package/matchbox-desktop/Config.in
```kconfig
config BR2_PACKAGE_MATCHBOX_DESKTOP
	bool "matchbox-desktop"
	select BR2_PACKAGE_MATCHBOX_LIB
	select BR2_PACKAGE_ZLIB
	help
	  A PDA style application launcher or 'item browser'.
```

## package/matchbox-fakekey/Config.in
```kconfig
config BR2_PACKAGE_MATCHBOX_FAKEKEY
	bool "matchbox-fakekey"
	select BR2_PACKAGE_MATCHBOX_LIB
	select BR2_PACKAGE_XLIB_LIBXTST
	help
	  Library for simulating key press events under X11.

	  http://git.yoctoproject.org/cgit/cgit.cgi/libfakekey/
```

## package/matchbox-keyboard/Config.in
```kconfig
config BR2_PACKAGE_MATCHBOX_KEYBOARD
	bool "matchbox-keyboard"
	select BR2_PACKAGE_XLIB_LIBXTST
	select BR2_PACKAGE_XLIB_LIBXFT if !BR2_PACKAGE_CAIRO
	select BR2_PACKAGE_MATCHBOX_FAKEKEY
	select BR2_PACKAGE_MATCHBOX_LIB
	help
	  Virtual Keyboard

	  http://git.yoctoproject.org/cgit/cgit.cgi/matchbox-keyboard/
```

## package/matchbox-lib/Config.in
```kconfig
config BR2_PACKAGE_MATCHBOX_LIB
	bool "matchbox-lib"
	select BR2_PACKAGE_XLIB_LIBXEXT
	help
	  Matchbox common functionality library.
```

## package/matchbox-panel/Config.in
```kconfig
config BR2_PACKAGE_MATCHBOX_PANEL
	bool "matchbox-panel"
	select BR2_PACKAGE_MATCHBOX_LIB
	help
	  A flexible always present 'window bar' for holding
	  application launchers.

	  http://git.yoctoproject.org/cgit/cgit.cgi/matchbox-panel/
```

## package/matchbox-startup-monitor/Config.in
```kconfig
config BR2_PACKAGE_MATCHBOX_STARTUP_MONITOR
	bool "matchbox-startup-monitor"
	select BR2_PACKAGE_MATCHBOX_LIB
	select BR2_PACKAGE_STARTUP_NOTIFICATION
	help
	  Matchbox Panel Startup Monitor Applet.

	  http://git.yoctoproject.org/cgit.cgi/mb-applet-startup-monitor/
```

## package/matchbox/Config.in
```kconfig
menuconfig BR2_PACKAGE_MATCHBOX
	bool "matchbox"
	depends on BR2_PACKAGE_XORG7
	depends on BR2_USE_MMU # fork()
	select BR2_PACKAGE_FONTCONFIG
	select BR2_PACKAGE_EXPAT
	select BR2_PACKAGE_MATCHBOX_LIB
	help
	  Matchbox is an Open Source base environment for the X Window
	  System running on non-desktop embedded platforms such as
	  handhelds, set-top boxes, kiosks and anything else for which
	  screen space, input mechanisms or system resources are limited.

	  https://www.yoctoproject.org/tools-resources/projects/matchbox

if BR2_PACKAGE_MATCHBOX

config BR2_PACKAGE_MATCHBOX_SM
	bool "session manager"
	select BR2_PACKAGE_XLIB_LIBSM
	help
	  Enable support for the Session Manager.

comment "matchbox utilities"

source "package/matchbox-common/Config.in"
source "package/matchbox-desktop/Config.in"
source "package/matchbox-fakekey/Config.in"
source "package/matchbox-keyboard/Config.in"
source "package/matchbox-lib/Config.in"
source "package/matchbox-panel/Config.in"
source "package/matchbox-startup-monitor/Config.in"

endif
```

## package/matchbox/matchbox-desktop/Config.in
```kconfig
config BR2_PACKAGE_MATCHBOX_DESKTOP
	bool "Matchbox Desktop"
	select BR2_PACKAGE_ZLIB
	help
	  A PDA style application launcher or 'item browser'.
```

## package/matchbox/matchbox-panel/Config.in
```kconfig
config BR2_PACKAGE_MATCHBOX_PANEL
	bool "Matchbox Panel"
	select BR2_PACKAGE_MATCHBOX_LIB
	help
	  A flexible always present 'window bar' for holding
	  application launchers.
```

## package/matchbox/matchbox-startup-monitor/Config.in
```kconfig
config BR2_PACKAGE_MATCHBOX_STARTUP_MONITOR
	bool
	default y if BR2_PACKAGE_STARTUP_NOTIFICATION
```

## package/matio/Config.in
```kconfig
config BR2_PACKAGE_MATIO
	bool "matio"
	select BR2_PACKAGE_ZLIB
	help
	  matio is an C library for reading and writing MATLAB MAT
	  files.

	  https://sourceforge.net/projects/matio
```

## package/mbedtls/Config.in
```kconfig
config BR2_PACKAGE_MBEDTLS
	bool "mbedtls"
	help
	  mbed TLS (formerly known as PolarSSL) makes it trivially easy
	  for developers to include cryptographic and SSL/TLS
	  capabilities in their (embedded) products, facilitating this
	  functionality with a minimal coding footprint.

	  https://tls.mbed.org/

if BR2_PACKAGE_MBEDTLS

config BR2_PACKAGE_MBEDTLS_PROGRAMS
	bool "mbedtls programs"
	depends on BR2_USE_MMU # fork()
	help
	  This option enables the installation and the build of
	  mbed TLS companion programs.

config BR2_PACKAGE_MBEDTLS_COMPRESSION
	bool "enable compression support"
	select BR2_PACKAGE_ZLIB
	help
	  Enable support for compression of the content data before it
	  enters the secure channel as described in RFC 3749.

	  Warning: TLS compression may make you vulnerable to the CRIME
	  attack. You should not enable it unless you know for sure CRIME
	  and similar attacks are not applicable to your particular
	  situation.

endif
```

## package/mbuffer/Config.in
```kconfig
config BR2_PACKAGE_MBUFFER
	bool "mbuffer"
	depends on !BR2_STATIC_LIBS # dlopen()
	depends on BR2_TOOLCHAIN_HAS_THREADS
	help
	  mbuffer is a tool for buffering data streams with a large set
	  of unique features.

	  http://www.maier-komor.de/mbuffer.html

comment "mbuffer needs a toolchain w/ dynamic library, threads"
	depends on BR2_STATIC_LIBS || !BR2_TOOLCHAIN_HAS_THREADS
```

## package/mc/Config.in
```kconfig
config BR2_PACKAGE_MC
	bool "mc"
	depends on BR2_USE_WCHAR # libglib2
	depends on BR2_TOOLCHAIN_HAS_THREADS # libglib2
	depends on BR2_USE_MMU # libglib2, slang
	select BR2_PACKAGE_LIBGLIB2
	# mc prefers slang, but can use ncurses too
	select BR2_PACKAGE_SLANG if !BR2_PACKAGE_NCURSES
	help
	  GNU Midnight Commander is a visual file manager, licensed
	  under GNU General Public License. It can use either SLang
	  (preferred) or ncurses for screen handling; if neither is
	  enabled SLang will be automatically chosen.

	  https://www.midnight-commander.org

comment "mc needs a toolchain w/ threads, wchar"
	depends on !BR2_TOOLCHAIN_HAS_THREADS || !BR2_USE_WCHAR
	depends on BR2_USE_MMU
```

## package/mcelog/Config.in
```kconfig
config BR2_PACKAGE_MCELOG
	bool "mcelog"
	depends on BR2_i386 || BR2_x86_64
	depends on BR2_USE_MMU # fork()
	help
	  mcelog processes machine checks (in particular memory and
	  CPU hardware errors) on modern x86 Linux systems.

	  http://www.mcelog.org/
```

## package/mcrypt/Config.in
```kconfig
config BR2_PACKAGE_MCRYPT
	bool "mcrypt"
	depends on BR2_USE_MMU # fork()
	select BR2_PACKAGE_LIBMCRYPT
	select BR2_PACKAGE_LIBMHASH
	help
	  MCrypt is a replacement for the old crypt() package and crypt(1)
	  command, with extensions.
	  It allows developers to use a wide range of encryption functions,
	  without making drastic changes to their code.

	  http://mcrypt.sourceforge.net/
```

## package/mdadm/Config.in
```kconfig
config BR2_PACKAGE_MDADM
	bool "mdadm"
	depends on !BR2_STATIC_LIBS # dlfcn.h
	depends on BR2_USE_MMU # fork()
	help
	  Utility for managing Linux Software RAID arrays.

	  https://raid.wiki.kernel.org/index.php/A_guide_to_mdadm

comment "mdadm needs a toolchain w/ dynamic library"
	depends on BR2_STATIC_LIBS
	depends on BR2_USE_MMU
```

## package/mdevd/Config.in
```kconfig
config BR2_PACKAGE_MDEVD
	bool "mdevd"
	depends on BR2_USE_MMU # skalibs
	select BR2_PACKAGE_SKALIBS
	help
	  mdevd is a small daemon managing kernel hotplug events,
	  similarly to udevd.

	  http://skarnet.org/software/mdevd/
```

## package/mdnsresponder/Config.in
```kconfig
config BR2_PACKAGE_MDNSRESPONDER
	bool "mDNSResponder"
	help
	  The mDNSResponder project is a component of Bonjour,
	  Apple's initiative for zero-configuration networking.

	  http://developer.apple.com/networking/bonjour/index.html

config BR2_PACKAGE_MDNSRESPONDER_UTILS
	bool "client and utils"
	depends on BR2_PACKAGE_MDNSRESPONDER
	help
	  Install the client applications and debug utils
```

## package/media-ctl/Config.in
```kconfig
config BR2_PACKAGE_MEDIA_CTL
	bool "media-ctl"
	help
	  Media controller control application

	  Useful mostly with ARM OMAP processors to configure and
	  control the image subsystem

	  http://git.ideasonboard.org/media-ctl.git
```

## package/mediastreamer/Config.in
```kconfig
config BR2_PACKAGE_MEDIASTREAMER
	bool "mediastreamer"
	depends on BR2_INSTALL_LIBSTDCPP
	depends on !BR2_STATIC_LIBS
	depends on BR2_TOOLCHAIN_HAS_THREADS # ortp
	depends on !BR2_TOOLCHAIN_HAS_GCC_BUG_64735 # ortp
	select BR2_PACKAGE_MBEDTLS
	select BR2_PACKAGE_ORTP
	help
	  Mediastreamer is a powerful and lightweighted streaming
	  engine specialized for voice/video telephony applications.

	  It is the library that is responsible for all the receiving
	  and sending of multimedia streams in linphone, including
	  voice/video capture, encoding and decoding, and rendering.

	  http://www.linphone.org/technical-corner/mediastreamer2

comment "mediastreamer needs a toolchain w/ threads, C++, dynamic library"
	depends on !BR2_INSTALL_LIBSTDCPP || \
		!BR2_TOOLCHAIN_HAS_THREADS || BR2_STATIC_LIBS

comment "mediastreamer needs a toolchain not affected by GCC bug 64735"
	depends on BR2_TOOLCHAIN_HAS_GCC_BUG_64735
```
