## package/metacity/Config.in
```kconfig
config BR2_PACKAGE_METACITY
	bool "metacity"
	depends on BR2_PACKAGE_LIBGTK2
	depends on BR2_PACKAGE_XORG7
	select BR2_PACKAGE_XLIB_LIBX11
	# Metacity configure.ac pretends it can be built without
	# Composite, but in reality, it doesn't build.
	select BR2_PACKAGE_XLIB_LIBXCOMPOSITE
	select BR2_PACKAGE_XLIB_LIBXFIXES
	select BR2_PACKAGE_XLIB_LIBXRENDER
	select BR2_PACKAGE_XLIB_LIBXDAMAGE
	# We do not directly depend on Xft, but they are needed to get
	# Xft support in Pango, which we require.
	select BR2_PACKAGE_XLIB_LIBXFT
	help
	  Metacity is a window manager for the X Window System.

	  https://wiki.gnome.org/Projects/Metacity
```

## package/mfgtools/Config.in.host
```kconfig
config BR2_PACKAGE_HOST_MFGTOOLS
	bool "host mfgtools"
	depends on BR2_arm
	help
	  This package contains the Freescale manufacturing tool.
	  It is designed to program firmware to i.MX boards during
	  production. The communication is done over USB using the
	  Freescale UTP protocol.

	  https://github.com/codeauroraforum/mfgtools
```

## package/mfoc/Config.in
```kconfig
config BR2_PACKAGE_MFOC
	bool "mfoc"
	select BR2_PACKAGE_LIBNFC
	help
	  Mifare Classic Offline Cracker

	  https://github.com/nfc-tools/mfoc
```

## package/microcom/Config.in
```kconfig
config BR2_PACKAGE_MICROCOM
	depends on BR2_DEPRECATED
	bool "microcom"
	help
	  A minicom-like serial terminal emulator with scripting support.

	  http://microcom.port5.com/
```

## package/microperl/Config.in
```kconfig
config BR2_PACKAGE_MICROPERL
	bool "microperl"
	# needs fork()
	depends on BR2_USE_MMU
	help
	  Perl without operating-specific functions such as readdir.

if BR2_PACKAGE_MICROPERL

config BR2_PACKAGE_MICROPERL_MODULES
	string "additional modules"
	help
	  List of space-separated microperl modules to copy to the rootfs.

	  Examples: warnings.pm Getopt/Std.pm Time::Local

	  Module dependencies are not automatic so check your needs.
	  You can't use XS modules like IO.

menu "module bundles"

config BR2_PACKAGE_MICROPERL_BUNDLE_CGI
	bool "CGI"
	help
	  Copy required modules to do CGI scripting.

endmenu

endif
```

## package/micropython-lib/Config.in
```kconfig
config BR2_PACKAGE_MICROPYTHON_LIB
	bool "micropython-lib"
	depends on BR2_PACKAGE_MICROPYTHON
	select BR2_PACKAGE_PCRE # runtime
	help
	  Core Python libraries ported to MicroPython.

	  http://micropython.org
```

## package/micropython/Config.in
```kconfig
config BR2_PACKAGE_MICROPYTHON
	bool "micropython"
	depends on BR2_TOOLCHAIN_HAS_THREADS
	depends on !BR2_STATIC_LIBS
	select BR2_PACKAGE_LIBFFI
	help
	  Micro Python is a lean and fast implementation of the Python
	  3 programming language that is optimised to run on a
	  microcontroller.

	  http://micropython.org

comment "micropython needs a toolchain w/ threads, dynamic library"
	depends on !BR2_TOOLCHAIN_HAS_THREADS || BR2_STATIC_LIBS
```

## package/microwin/Config.in
```kconfig
config BR2_PACKAGE_MICROWIN
	bool "microwin"
	# Old, unmaintained graphics stack
	depends on BR2_DEPRECATED
	help
	 Microwindows Graphical User Interface for small and
	 embedded enviroments.
	
	 http://microwindows.censoft.com/
```

## package/midori/Config.in
```kconfig
comment "midori needs libgtk3 and a glibc toolchain w/ C++, gcc >= 5, host gcc >= 4.8"
	depends on BR2_PACKAGE_WEBKITGTK_ARCH_SUPPORTS
	depends on !BR2_INSTALL_LIBSTDCPP || !BR2_PACKAGE_LIBGTK3 || \
		!BR2_HOST_GCC_AT_LEAST_4_8 || !BR2_TOOLCHAIN_GCC_AT_LEAST_5 || \
		!BR2_TOOLCHAIN_USES_GLIBC

config BR2_PACKAGE_MIDORI
	bool "midori"
	depends on BR2_PACKAGE_LIBGPG_ERROR_ARCH_SUPPORTS # libgcrypt, gcr, gnupg2
	depends on BR2_PACKAGE_LIBGTK3
	depends on BR2_INSTALL_LIBSTDCPP # webkitgtk
	depends on BR2_HOST_GCC_AT_LEAST_4_8 # webkitgtk -> icu
	depends on BR2_TOOLCHAIN_GCC_AT_LEAST_5 # webkitgtk
	depends on BR2_TOOLCHAIN_USES_GLIBC # webkitgtk
	depends on BR2_PACKAGE_WEBKITGTK_ARCH_SUPPORTS
	# GCR can only be used with the X11 backend
	select BR2_PACKAGE_GCR if BR2_PACKAGE_LIBGTK3_X11
	select BR2_PACKAGE_GRANITE
	select BR2_PACKAGE_LIBSOUP
	select BR2_PACKAGE_LIBSOUP_GNOME
	select BR2_PACKAGE_LIBXML2
	select BR2_PACKAGE_SQLITE
	select BR2_PACKAGE_WEBKITGTK
	select BR2_PACKAGE_LIBICONV if !BR2_ENABLE_LOCALE
	help
	  Midori is a lightweight web browser based on WebKit

	  http://www.midori-browser.org/
```

## package/mii-diag/Config.in
```kconfig
config BR2_PACKAGE_MII_DIAG
	bool "mii-diag"
	help
	  mii-diag allows you to manipulate the MII registers of
	  network cards.

	  https://launchpad.net/ubuntu/+source/mii-diag
```

## package/mimic/Config.in
```kconfig
comment "mimic needs a toolchain w/ wchar"
	depends on !BR2_USE_WCHAR

config BR2_PACKAGE_MIMIC
	bool "mimic"
	depends on BR2_USE_WCHAR
	help
	  Mimic is a fast, lightweight Text-to-speech engine developed
	  by Mycroft A.I. and VocaliD, based on Carnegie Mellon
	  University's Flite (Festival-Lite) software. Mimic takes in
	  text and reads it out loud to create a high quality voice.

	  https://github.com/MycroftAI/mimic

if BR2_PACKAGE_MIMIC

choice
	prompt "audio backend"
	default BR2_PACKAGE_MIMIC_AUDIO_BACKEND_NONE

config BR2_PACKAGE_MIMIC_AUDIO_BACKEND_NONE
	bool "none"
	help
	  With no backend, mimic will only be able to produce .wav
	  files.

config BR2_PACKAGE_MIMIC_AUDIO_BACKEND_ALSA
	bool "alsa"
	depends on BR2_PACKAGE_ALSA_LIB

config BR2_PACKAGE_MIMIC_AUDIO_BACKEND_PORTAUDIO
	bool "alsa via portaudio"
	depends on BR2_PACKAGE_PORTAUDIO

config BR2_PACKAGE_MIMIC_AUDIO_BACKEND_PULSEAUDIO
	bool "pulseaudio"
	depends on BR2_PACKAGE_PULSEAUDIO

endchoice

endif # BR2_PACKAGE_MIMIC
```

## package/minetest-game/Config.in
```kconfig
config BR2_PACKAGE_MINETEST_GAME
	bool "minetest-game"
	depends on BR2_PACKAGE_MINETEST
	help
	  The main subgame for the Minetest engine.

	  https://github.com/minetest/minetest_game
```

## package/minetest/Config.in
```kconfig
config BR2_PACKAGE_MINETEST
	bool "minetest"
	depends on BR2_INSTALL_LIBSTDCPP # irrlicht
	depends on BR2_TOOLCHAIN_GCC_AT_LEAST_4_9 # C++11
	depends on BR2_TOOLCHAIN_HAS_THREADS
	depends on BR2_PACKAGE_XORG7 # irrlicht
	depends on BR2_PACKAGE_HAS_LIBGL # irrlicht
	depends on BR2_PACKAGE_LUAJIT_ARCH_SUPPORTS
	select BR2_PACKAGE_IRRLICHT
	select BR2_PACKAGE_GMP
	select BR2_PACKAGE_JSONCPP
	select BR2_PACKAGE_LUAJIT
	select BR2_PACKAGE_SQLITE
	select BR2_PACKAGE_ZLIB
	# At least one option must be enabled
	select BR2_PACKAGE_MINETEST_CLIENT if !BR2_PACKAGE_MINETEST_SERVER
	help
	  Minetest is a near-infinite-world block sandbox game and a
	  game engine, inspired by InfiniMiner, Minecraft, and the
	  like.

	  http://www.minetest.net

if BR2_PACKAGE_MINETEST

config BR2_PACKAGE_MINETEST_CLIENT
	bool "minetest client"
	select BR2_PACKAGE_BZIP2
	select BR2_PACKAGE_LIBPNG
	select BR2_PACKAGE_JPEG
	select BR2_PACKAGE_XLIB_LIBXXF86VM
	help
	  Build Minetest client.

config BR2_PACKAGE_MINETEST_SERVER
	bool "minetest server"
	help
	  Build Minetest server.

config BR2_PACKAGE_MINETEST_SOUND
	bool "enable sound"
	depends on BR2_PACKAGE_MINETEST_CLIENT
	depends on BR2_PACKAGE_OPENAL_ARCH_SUPPORTS
	depends on BR2_TOOLCHAIN_HAS_THREADS_NPTL # openal
	select BR2_PACKAGE_LIBVORBIS
	select BR2_PACKAGE_OPENAL

comment "sound support needs a toolchain w/ threads NPTL"
	depends on BR2_PACKAGE_MINETEST_CLIENT
	depends on BR2_PACKAGE_OPENAL_ARCH_SUPPORTS
	depends on !BR2_TOOLCHAIN_HAS_THREADS_NPTL

endif

comment "minetest needs a toolchain w/ C++, gcc >= 4.9, threads"
	depends on BR2_PACKAGE_LUAJIT_ARCH_SUPPORTS
	depends on !BR2_INSTALL_LIBSTDCPP \
		|| !BR2_TOOLCHAIN_GCC_AT_LEAST_4_9 \
		|| !BR2_TOOLCHAIN_HAS_THREADS

comment "minetest needs X11 and an OpenGL provider"
	depends on BR2_PACKAGE_LUAJIT_ARCH_SUPPORTS
	depends on (BR2_INSTALL_LIBSTDCPP \
		&& BR2_TOOLCHAIN_GCC_AT_LEAST_4_9 \
		&& BR2_TOOLCHAIN_HAS_THREADS)
	depends on !BR2_PACKAGE_HAS_LIBGL || !BR2_PACKAGE_XORG7
```

## package/mini-snmpd/Config.in
```kconfig
config BR2_PACKAGE_MINI_SNMPD
	bool "mini-snmpd"
	help
	  Mini SNMPd is a minimal implementation targeted at small or
	  embedded UNIX systems with limited resources

	  http://troglobit.com/mini-snmpd.html
```
