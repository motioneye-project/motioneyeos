## package/memcached/Config.in
```kconfig
config BR2_PACKAGE_MEMCACHED
	bool "memcached"
	depends on BR2_TOOLCHAIN_HAS_THREADS
	depends on BR2_USE_MMU # fork()
	select BR2_PACKAGE_LIBEVENT
	help
	  Memcached is an in-memory key-value store for small chunks
	  of arbitrary data (strings, objects) from results of database calls,
	  API calls, or page rendering.

	  http://www.memcached.org/

comment "memcached needs a toolchain w/ threads"
	depends on !BR2_TOOLCHAIN_HAS_THREADS
	depends on BR2_USE_MMU
```

## package/memstat/Config.in
```kconfig
config BR2_PACKAGE_MEMSTAT
	bool "memstat"
	help
	  Memstat lists all the processes, executables, and shared
	  libraries that are using up virtual memory. It's helpful to
	  see how the shared memory is used and which 'old' libs are
	  loaded.

	  http://sourceforge.net/projects/memstattool
```

## package/memtester/Config.in
```kconfig
config BR2_PACKAGE_MEMTESTER
	bool "memtester"
	help
	  A userspace utility for testing the memory subsystem for
	  faults.

	  http://pyropus.ca/software/memtester/
```

## package/memtool/Config.in
```kconfig
config BR2_PACKAGE_MEMTOOL
	bool "memtool"
	help
	  Development tool to modify memory mapped registers.

	  memtool allows one to read and write memory mapped registers
	  via /dev/mem. The commands are inspired by the respective
	  commands of the barebox bootloader.  This is handy during
	  driver development to inspect and modify register
	  settings. It can also be used to modify regular files and
	  character devices (e.g. to paint to /dev/fb0).

	  http://www.pengutronix.de/software/memtool/index_en.html
```

## package/mender-artifact/Config.in.host
```kconfig
config BR2_PACKAGE_HOST_MENDER_ARTIFACT
	bool "host mender-artifact"
	depends on BR2_PACKAGE_HOST_GO_HOST_ARCH_SUPPORTS
	help
	  The mender-artifact tool is a CLI implementation of the
	  Mender artifacts library.

	  A Mender artifact can be recognized by its .mender suffix.
	  Mender artifacts can contain binaries, metadata, checksums,
	  signatures and scripts that are used during a deployment.
	  The artifact format acts as a wrapper, and uses the tar
	  format to bundle several files into one.

	  In its simplest form, an artifact contains just a rootfs
	  image, along with its checksum, id and device type
	  compatibility.

	  https://github.com/mendersoftware/mender-artifact
```

## package/mender-grubenv/Config.in
```kconfig
config BR2_PACKAGE_MENDER_GRUBENV
	bool "mender-grubenv"
	depends on BR2_TARGET_GRUB2_ARCH_SUPPORTS
	depends on BR2_PACKAGE_MENDER # runtime
	# grubenv provides it's own fw_printenv.
	depends on !BR2_PACKAGE_UBOOT_TOOLS_FWPRINTENV
	depends on BR2_TARGET_GRUB2
	help
	  Contains the boot scripts and tools used by Mender to
	  integrate with the GRUB bootloader.

	  The following Grub modules must be selected for this package:
	  loadenv hashsum echo halt gcry_sha256 test

	  https://github.com/mendersoftware/grub-mender-grubenv

if BR2_PACKAGE_MENDER_GRUBENV

config BR2_PACKAGE_MENDER_GRUBENV_DEFINES
	string "path to grubenv defines"
	help
	  Specify a path to the mender grubenv defines file.
	  If no path is specified, the example file in the source
	  directory will be used.

	  The example file in the source directory sets the following:
	  mender_rootfsa_part=2
	  mender_rootfsb_part=3
	  mender_kernel_root_base=/dev/mmcblk0p
	  mender_grub_storage_device=hd0
	  kernel_imagetype=bzImage

endif

comment "mender-grubenv needs a grub2 bootloader"
	depends on BR2_TARGET_GRUB2_ARCH_SUPPORTS
	depends on BR2_PACKAGE_MENDER
	depends on !BR2_TARGET_GRUB2

comment "mender-grubenv does not work with uboot-tools fw_printenv"
	depends on BR2_TARGET_GRUB2_ARCH_SUPPORTS
	depends on BR2_PACKAGE_MENDER
	depends on BR2_PACKAGE_UBOOT_TOOLS_FWPRINTENV
```

## package/mender/Config.in
```kconfig
config BR2_PACKAGE_MENDER
	bool "mender"
	depends on BR2_PACKAGE_HOST_GO_TARGET_ARCH_SUPPORTS
	depends on BR2_PACKAGE_HOST_GO_TARGET_CGO_LINKING_SUPPORTS
	depends on BR2_TOOLCHAIN_HAS_THREADS
	select BR2_PACKAGE_XZ
	select BR2_PACKAGE_UBOOT_TOOLS if BR2_TARGET_UBOOT # runtime
	select BR2_PACKAGE_UBOOT_TOOLS_FWPRINTENV if BR2_TARGET_UBOOT # runtime
	help
	  Mender is an open source over-the-air (OTA) software updater
	  for embedded Linux devices. Mender comprises a client
	  running at the embedded device, as well as a server that
	  manages deployments across many devices.

	  https://github.com/mendersoftware/mender

comment "mender needs a toolchain w/ threads"
	depends on BR2_PACKAGE_HOST_GO_TARGET_ARCH_SUPPORTS
	depends on BR2_PACKAGE_HOST_GO_TARGET_CGO_LINKING_SUPPORTS
	depends on !BR2_TOOLCHAIN_HAS_THREADS
```

## package/menu-cache/Config.in
```kconfig
config BR2_PACKAGE_MENU_CACHE
	bool "menu-cache"
	depends on BR2_USE_WCHAR # libglib2
	depends on BR2_TOOLCHAIN_HAS_THREADS # libglib2
	depends on BR2_USE_MMU # libglib2
	select BR2_PACKAGE_LIBGLIB2
	select BR2_PACKAGE_LIBFM_EXTRA
	help
	  Small library from LXDE project used for application menu
	  integration

	  http://wiki.lxde.org/

comment "menu-cache needs a toolchain w/ wchar, threads"
	depends on BR2_USE_MMU
	depends on !BR2_USE_WCHAR || !BR2_TOOLCHAIN_HAS_THREADS
```

## package/mesa3d-demos/Config.in
```kconfig
config BR2_PACKAGE_MESA3D_DEMOS
	bool "mesa3d-demos"
	depends on BR2_PACKAGE_HAS_LIBGL || BR2_PACKAGE_HAS_LIBGLES \
		|| BR2_PACKAGE_HAS_LIBEGL || BR2_PACKAGE_HAS_LIBOPENVG
	select BR2_PACKAGE_LIBGLEW if BR2_PACKAGE_XORG7 && BR2_PACKAGE_HAS_LIBGL
	select BR2_PACKAGE_LIBGLU if BR2_PACKAGE_XORG7 && BR2_PACKAGE_HAS_LIBGL
	select BR2_PACKAGE_XLIB_LIBX11 if BR2_PACKAGE_XORG7 && BR2_PACKAGE_HAS_LIBGL
	select BR2_PACKAGE_XLIB_LIBXEXT if BR2_PACKAGE_XORG7 && BR2_PACKAGE_HAS_LIBGL
	help
	  OpenGL demos from the Mesa 3D project.

	  http://mesa3d.org
```

## package/mesa3d-headers/Config.in
```kconfig
config BR2_PACKAGE_MESA3D_HEADERS
	bool
	help
	  Mesa 3D, an open-source implementation of the OpenGL
	  specification.

	  This package only installs headers needed by other packages.

	  http://mesa3d.org
```
