## package/minicom/Config.in
```kconfig
config BR2_PACKAGE_MINICOM
	bool "minicom"
	depends on BR2_USE_WCHAR
	select BR2_PACKAGE_LIBICONV if !BR2_ENABLE_LOCALE
	select BR2_PACKAGE_NCURSES
	help
	  Minicom is a menu driven communications program.
	  It emulates ANSI and VT102 terminals. It has a
	  dialing directory and auto zmodem download.

	  http://alioth.debian.org/projects/minicom

comment "minicom requires a toolchain with WCHAR support"
	depends on !BR2_USE_WCHAR
```

## package/minidlna/Config.in
```kconfig
config BR2_PACKAGE_MINIDLNA
	bool "minidlna"
	depends on !BR2_STATIC_LIBS
	depends on BR2_USE_WCHAR # flac
	depends on BR2_USE_MMU # fork
	depends on BR2_TOOLCHAIN_HAS_THREADS
	depends on BR2_PACKAGE_FFMPEG_ARCH_SUPPORTS
	select BR2_PACKAGE_FFMPEG
	select BR2_PACKAGE_FLAC
	select BR2_PACKAGE_LIBVORBIS # selects libogg
	select BR2_PACKAGE_LIBOGG
	select BR2_PACKAGE_LIBID3TAG # selects zlib
	select BR2_PACKAGE_LIBEXIF
	select BR2_PACKAGE_JPEG
	select BR2_PACKAGE_SQLITE
	help
	  MiniDLNA (aka ReadyDLNA) is server software with the aim of being
	  fully compliant with DLNA/UPnP-AV clients.

	  http://minidlna.sourceforge.net/

comment "minidlna needs a toolchain w/ dynamic library, threads, wchar"
	depends on BR2_USE_MMU
	depends on BR2_PACKAGE_FFMPEG_ARCH_SUPPORTS
	depends on !BR2_TOOLCHAIN_HAS_THREADS || !BR2_USE_WCHAR || \
		BR2_STATIC_LIBS
```

## package/minimodem/Config.in
```kconfig
config BR2_PACKAGE_MINIMODEM
	bool "minimodem"
	select BR2_PACKAGE_FFTW
	select BR2_PACKAGE_FFTW_SINGLE
	select BR2_PACKAGE_LIBSNDFILE if !BR2_PACKAGE_ALSA_LIB_PCM && !BR2_PACKAGE_PULSEAUDIO
	help
	  Minimodem is a command-line program which decodes (or
	  generates) audio modem tones at any specified baud rate,
	  using various framing protocols. It acts a general-purpose
	  software FSK modem, and includes support for various
	  standard FSK protocols such as Bell103, Bell202, RTTY,
	  TTY/TDD NOAA SAME, and Caller-ID.

	  http://www.whence.com/minimodem/
```

## package/minizip/Config.in
```kconfig
config BR2_PACKAGE_MINIZIP
	bool "minizip"
	depends on BR2_USE_WCHAR
	select BR2_PACKAGE_LIBICONV if !BR2_ENABLE_LOCALE
	help
	  Enables to extract files from a .zip archive file.
	  It is compatible with PKZip 2.04g, WinZip, InfoZip,
	  MimarSinan Codex Suite 2002 tools, and compatible sofware.

	  https://github.com/nmoinvaz/minizip

config BR2_PACKAGE_MINIZIP_DEMOS
	bool "minizip"
	depends on BR2_PACKAGE_MINIZIP
	help
	  Enable minizip binary tool.

comment "minizip needs a toolchain w/ wchar"
	depends on !BR2_USE_WCHAR
```

## package/miraclecast/Config.in
```kconfig
config BR2_PACKAGE_MIRACLECAST
	bool "miraclecast"
	depends on BR2_PACKAGE_SYSTEMD
	depends on BR2_TOOLCHAIN_USES_GLIBC
	depends on BR2_USE_WCHAR # glib2
	depends on BR2_TOOLCHAIN_HAS_THREADS # glib2
	depends on BR2_USE_MMU # glib2
	select BR2_PACKAGE_LIBGLIB2
	select BR2_PACKAGE_GSTREAMER1
	select BR2_PACKAGE_READLINE
	help
	  The MiracleCast project provides software to connect external
	  monitors to your system via Wifi. It is compatible to the
	  Wifi-Display specification also known as Miracast. MiracleCast
	  implements the Display-Source as well as Display-Sink side.

	  https://github.com/albfan/miraclecast

comment "miraclecast needs systemd and a glibc toolchain w/ threads and wchar"
	depends on BR2_USE_MMU
	depends on !BR2_TOOLCHAIN_USES_GLIBC || !BR2_USE_WCHAR \
		|| !BR2_TOOLCHAIN_HAS_THREADS || !BR2_PACKAGE_SYSTEMD
```

## package/mjpegtools/Config.in
```kconfig
config BR2_PACKAGE_MJPEGTOOLS
	bool "mjpegtools"
	depends on BR2_USE_MMU # fork
	depends on BR2_INSTALL_LIBSTDCPP
	depends on BR2_TOOLCHAIN_HAS_THREADS
	select BR2_PACKAGE_JPEG
	help
	  The mjpegtools programs are a set of tools
	  that can do recording of videos and playback,
	  simple cut-and-paste editing and the MPEG
	  compression of audio and video under Linux.

	  http://mjpeg.sourceforge.net

comment "mjpegtools needs a toolchain w/ C++, threads"
	depends on BR2_USE_MMU
	depends on !BR2_INSTALL_LIBSTDCPP || !BR2_TOOLCHAIN_HAS_THREADS
```

## package/mjpg-streamer/Config.in
```kconfig
config BR2_PACKAGE_MJPG_STREAMER
	bool "mjpg-streamer"
	depends on BR2_TOOLCHAIN_HEADERS_AT_LEAST_3_16 # V4L2_EVENT_SOURCE_CHANGE
	depends on BR2_TOOLCHAIN_HAS_THREADS
	depends on BR2_USE_MMU # fork()
	depends on !BR2_STATIC_LIBS # plugins need dlopen()
	select BR2_PACKAGE_JPEG
	help
	  MJPG-streamer takes JPGs from Linux-UVC compatible webcams,
	  filesystem or other input plugins and streams them as
	  M-JPEG via HTTP to webbrowsers, VLC and other software.

	  https://github.com/jacksonliam/mjpg-streamer

comment "mjpg-streamer needs a toolchain w/ threads, headers >= 3.16, dynamic library"
	depends on BR2_USE_MMU
	depends on !BR2_TOOLCHAIN_HAS_THREADS || \
		!BR2_TOOLCHAIN_HEADERS_AT_LEAST_3_16 || BR2_STATIC_LIBS
```

## package/mkdosfs/Config.in
```kconfig
config BR2_PACKAGE_MKDOSFS
	bool "mkdosfs"
	help
	  Creates a DOS FAT filesystem on a device.

	  ftp://ftp.uni-erlangen.de/pub/Linux/LOCAL/dosfstools/
```

## package/mke2fs/Config.in
```kconfig
config BR2_PACKAGE_MKE2FS
	bool "mke2fs"
	default n
	help
	  Create ext2 filesystems.

	  http://e2fsprogs.sourceforge.net/
```

## package/mke2img/Config.in.host
```kconfig
config BR2_PACKAGE_HOST_MKE2IMG
	bool "host mke2img"
	select BR2_PACKAGE_HOST_E2FSPROGS
	select BR2_PACKAGE_HOST_GENEXT2FS
	help
	  Easily create filesystems of the extend familly: ext2/3/4.

	  This tool is bundled by, and specific to Buildroot. However, it can
	  be used from post-images scripts is needed.

	  https://code.google.com/p/mke2img/
```

## package/mksh/Config.in
```kconfig
config BR2_PACKAGE_MKSH
	bool "mksh"
	depends on BR2_USE_MMU # fork()
	help
	  The MirBSD Korn Shell,

	  mksh is a successor of pdksh but not affiliated with the
	  pdksh developers or contributors. mksh is not affiliated
	  with the AT&T Korn Shell, its past or present owners,
	  other than that both attempt to implement the Korn Shell
	  programming language.

	  mksh targets users who desire a compact, fast, reliable,
	  secure shell not cut off modern extensions; a shell with
	  Unicode support; an actively developed, current, and
	  portable product; one with developers that listen to
	  their users' requests and implement them if they
	  actually make sense.

	  mksh aims to replace pdksh in all but very rare use cases
	  (such as support for checking the Unix mbox) and in all
	  operating environments
	  (thus including patches from pdksh on e.g. Debian).

	  http://mirbsd.de/mksh
```

## package/mmc-utils/Config.in
```kconfig
config BR2_PACKAGE_MMC_UTILS
	bool "mmc-utils"
	depends on BR2_TOOLCHAIN_HEADERS_AT_LEAST_3_0
	help
	  MMC utils

	  https://git.kernel.org/cgit/linux/kernel/git/cjb/mmc-utils.git

comment "mmc-utils needs a toolchain w/ headers >= 3.0"
	depends on !BR2_TOOLCHAIN_HEADERS_AT_LEAST_3_0
```

## package/moarvm/Config.in
```kconfig
config BR2_PACKAGE_MOARVM
	bool "moarvm"
	depends on BR2_TOOLCHAIN_HAS_THREADS_NPTL # libuv
	depends on !BR2_STATIC_LIBS # libuv
	depends on BR2_USE_MMU # libuv
	depends on BR2_PACKAGE_LIBATOMIC_OPS_ARCH_SUPPORTS # libatomic_ops
	# needs AO_fetch_compare_and_swap, not implemented for sparcv8/sparcv9
	depends on !BR2_sparc64 && !BR2_sparc
	depends on BR2_TOOLCHAIN_HAS_SYNC_4 # libuv
	select BR2_PACKAGE_LIBUV
	select BR2_PACKAGE_LIBTOMMATH
	select BR2_PACKAGE_LIBATOMIC_OPS
	# dyncall does not work on MIPS; libffi needs to be used.
	# See: https://github.com/MoarVM/MoarVM/issues/222
	select BR2_PACKAGE_LIBFFI if BR2_mips || BR2_mipsel || BR2_mips64 || BR2_mips64el
	help
	  Short for "Metamodel On A Runtime", MoarVM is a virtual
	  machine built especially for Rakudo Perl 6 and the NQP
	  Compiler Toolchain.

	  http://moarvm.com

comment "moarvm needs a toolchain w/ NPTL, dynamic library"
	depends on !BR2_TOOLCHAIN_HAS_THREADS_NPTL || BR2_STATIC_LIBS
	depends on BR2_USE_MMU
	depends on BR2_PACKAGE_LIBATOMIC_OPS_ARCH_SUPPORTS
	depends on !BR2_sparc64 && !BR2_sparc
	depends on BR2_TOOLCHAIN_HAS_SYNC_4
```

## package/modem-manager/Config.in
```kconfig
config BR2_PACKAGE_MODEM_MANAGER
	bool "modemmanager"
	depends on BR2_PACKAGE_HAS_UDEV
	select BR2_PACKAGE_DBUS
	depends on BR2_INET_IPV6
	depends on BR2_LARGEFILE # acl
	depends on BR2_USE_WCHAR # libglib2 and gnutls
	depends on BR2_TOOLCHAIN_HAS_THREADS # dbus, libglib2
	depends on BR2_USE_MMU # dbus
	select BR2_PACKAGE_DBUS_GLIB
	help
	  ModemManager is a DBus-activated daemon which controls mobile
	  broadband (2G/3G/4G) devices and connections.

	  http://www.freedesktop.org/wiki/Software/ModemManager/

if BR2_PACKAGE_MODEM_MANAGER

config BR2_PACKAGE_MODEM_MANAGER_LIBMBIM
	bool "MBIM support"
	select BR2_PACKAGE_LIBMBIM
	help
	  This option enables support for MBIM protocol

config BR2_PACKAGE_MODEM_MANAGER_LIBQMI
	bool "QMI support"
	select BR2_PACKAGE_LIBQMI
	help
	  This option enables support for QMI protocol
endif

comment "modemmanager needs udev /dev management and a toolchain w/ largefile, wchar, threads, IPv6"
	depends on !BR2_INET_IPV6 || !BR2_LARGEFILE || !BR2_USE_WCHAR || \
		!BR2_TOOLCHAIN_HAS_THREADS || !BR2_PACKAGE_HAS_UDEV
```

## package/modplugtools/Config.in
```kconfig
config BR2_PACKAGE_MODPLUGTOOLS
	bool "modplugtools"
	depends on BR2_INSTALL_LIBSTDCPP # libmodplug
	select BR2_PACKAGE_LIBAO
	select BR2_PACKAGE_LIBMODPLUG
	help
	  This installs the 'modplug123' command line tool to play music files
	  in the tracker formats supported by libmodplug: MOD, S3M, XM etc.
	  Audio output is handled by libao.

	  http://modplug-xmms.sourceforge.net/

comment "modplugtools needs a toolchain w/ C++"
	depends on !BR2_INSTALL_LIBSTDCPP
```

## package/module-init-tools/Config.in
```kconfig
config BR2_PACKAGE_MODULE_INIT_TOOLS
	bool "module-init-tools"
	help
	  The module-init-tools package contains a set of programs for
	  loading, inserting, and removing kernel modules for Linux
	  (versions 2.5.48 and above). It serves the same function that
	  the "modutils" package serves for Linux 2.4.

	  http://www.kernel.org/pub/linux/utils/kernel/module-init-tools/
```

## package/modutils/Config.in
```kconfig
config BR2_PACKAGE_MODUTILS
	bool "modutils"
	default n
	depends on !BR2_PACKAGE_MODULE_INIT_TOOLS
	help
	  The modutils packages includes the kerneld program for automatic 
	  loading and unloading of modules, as well as other module 
	  management programs. Examples of loaded and unloaded modules are 
	  device drivers and filesystems, as well as some other things.

	  linux v.<2.6

	  http://www.kernel.org/pub/linux/utils/kernel/modutils/v2.4
```

## package/mongodb/Config.in
```kconfig
# from https://docs.mongodb.com/manual/installation/#supported-platforms
config BR2_PACKAGE_MONGODB_ARCH_SUPPORTS
	bool
	# ARM needs LDREX/STREX, so ARMv6+
	default y if BR2_arm && !BR2_ARM_CPU_ARMV4 && !BR2_ARM_CPU_ARMV5
	default y if BR2_aarch64 || BR2_x86_64

config BR2_PACKAGE_MONGODB
	bool "mongodb"
	depends on BR2_PACKAGE_MONGODB_ARCH_SUPPORTS
	depends on BR2_TOOLCHAIN_USES_GLIBC # needs glibc malloc_usable_size
	depends on BR2_USE_WCHAR
	depends on BR2_TOOLCHAIN_HAS_THREADS
	depends on BR2_INSTALL_LIBSTDCPP
	depends on BR2_TOOLCHAIN_GCC_AT_LEAST_7 # C++17
	select BR2_PACKAGE_BOOST
	select BR2_PACKAGE_BOOST_FILESYSTEM
	select BR2_PACKAGE_BOOST_IOSTREAMS
	select BR2_PACKAGE_BOOST_PROGRAM_OPTIONS
	select BR2_PACKAGE_BOOST_SYSTEM
	select BR2_PACKAGE_PCRE
	select BR2_PACKAGE_PCRE_UTF # runtime
	select BR2_PACKAGE_SNAPPY
	select BR2_PACKAGE_SQLITE
	select BR2_PACKAGE_YAML_CPP
	select BR2_PACKAGE_ZLIB
	help
	  MongoDB is a cross-platform document-oriented database
	  (NoSQL).

	  It uses JSON-like documents with dynamic schemas (BSON),
	  making the integration of data in certain types of
	  applications easier and faster.

	  https://www.mongodb.org/

comment "mongodb needs a glibc toolchain w/ wchar, threads, C++, gcc >= 7"
	depends on !BR2_USE_WCHAR || !BR2_TOOLCHAIN_HAS_THREADS || \
		!BR2_INSTALL_LIBSTDCPP || !BR2_TOOLCHAIN_USES_GLIBC || \
		!BR2_TOOLCHAIN_GCC_AT_LEAST_7
	depends on BR2_PACKAGE_MONGODB_ARCH_SUPPORTS
```

## package/mongoose/Config.in
```kconfig
config BR2_PACKAGE_MONGOOSE
	bool "mongoose"
	depends on BR2_TOOLCHAIN_HAS_THREADS
	depends on BR2_USE_MMU # fork()
	help
	  Mongoose is an embedded networking library, which can turn
	  anything into a web server

	  https://github.com/cesanta/mongoose

comment "mongoose needs a toolchain w/ threads"
	depends on BR2_USE_MMU
	depends on !BR2_TOOLCHAIN_HAS_THREADS
```

## package/mongrel2/Config.in
```kconfig
# mongrel2 uses {get,make,swap}context() functions, which are
# available in glibc for all architectures and in uClibc only for a
# subset of the architectures
config BR2_PACKAGE_MONGREL2_LIBC_SUPPORTS
	bool
	default y if BR2_TOOLCHAIN_USES_GLIBC
	default y if BR2_TOOLCHAIN_USES_UCLIBC && \
		(BR2_arm || BR2_armeb || BR2_i386 || BR2_mips || BR2_mipsel || BR2_mips64 || BR2_mips64el || BR2_sparc || BR2_x86_64)

comment "mongrel2 needs a uClibc or glibc toolchain w/ C++, threads, dynamic library"
	depends on !BR2_INSTALL_LIBSTDCPP || \
		!BR2_TOOLCHAIN_HAS_THREADS || BR2_STATIC_LIBS || \
		!BR2_PACKAGE_MONGREL2_LIBC_SUPPORTS

config BR2_PACKAGE_MONGREL2
	bool "mongrel2"
	depends on BR2_INSTALL_LIBSTDCPP # zeromq
	depends on BR2_TOOLCHAIN_HAS_THREADS # zeromq
	depends on !BR2_STATIC_LIBS # uses dlopen()
	depends on BR2_PACKAGE_MONGREL2_LIBC_SUPPORTS
	select BR2_PACKAGE_SQLITE
	select BR2_PACKAGE_ZEROMQ
	help
	  Mongrel2 is an application, language, and network architecture
	  agnostic web server that focuses on web applications using
	  modern browser technologies.

	  Mongrel2 supports 17 languages and platforms, HTTP, Flash
	  sockets, WebSockets, Long Polling, and many ways to deploy
	  and hack on it.

	  http://www.mongrel2.org
```

## package/monit/Config.in
```kconfig
config BR2_PACKAGE_MONIT
	bool "monit"
	depends on BR2_TOOLCHAIN_HAS_THREADS
	help
	  Monit is a free open source utility for managing and
	  monitoring, processes, programs, files, directories and
	  filesystems on a UNIX system. Monit conducts automatic
	  maintenance and repair and can execute meaningful causal
	  actions in error situations.

	  http://mmonit.com/monit/

comment "monit needs a toolchain w/ threads"
       depends on !BR2_TOOLCHAIN_HAS_THREADS
```

## package/monkey/Config.in
```kconfig
config BR2_PACKAGE_MONKEY
	bool "monkey"
	depends on BR2_TOOLCHAIN_HAS_THREADS
	depends on !BR2_STATIC_LIBS # dlopen()
	depends on BR2_USE_MMU # fork()
	help
	  Monkey Server is a fast and lightweight web server for Linux
	  platforms.

	  http://monkey-project.com/

if BR2_PACKAGE_MONKEY

config BR2_PACKAGE_MONKEY_SSL
	bool "enable SSL/TLS"
	select BR2_PACKAGE_MBEDTLS
	help
	  Enable build of the SSL/TLS plugin.

endif

comment "monkey needs an toolchain w/ threads, dynamic library"
	depends on BR2_USE_MMU
	depends on !BR2_TOOLCHAIN_HAS_THREADS || BR2_STATIC_LIBS
```

## package/mono-gtksharp3/Config.in
```kconfig
config BR2_PACKAGE_MONO_GTKSHARP3
	bool "gtk# 3"
	depends on BR2_PACKAGE_LIBGTK3
	help
	  Gtk# is a .NET language binding for the GTK+ toolkit.
	  This package provides version 3 of the bindings.

	  http://www.mono-project.com/docs/gui/gtksharp/
```

## package/mono/Config.in
```kconfig
config BR2_PACKAGE_HOST_MONO_ARCH_SUPPORTS
	bool
	default y if BR2_HOSTARCH = "x86_64"
	default y if BR2_HOSTARCH = "x86"

config BR2_PACKAGE_MONO_ARCH_SUPPORTS
	bool
	default y if (BR2_arm || BR2_armeb || BR2_i386 || \
		      BR2_powerpc || BR2_x86_64)
	depends on BR2_PACKAGE_HOST_MONO_ARCH_SUPPORTS

config BR2_PACKAGE_MONO
	bool "mono"
	depends on BR2_PACKAGE_MONO_ARCH_SUPPORTS
	depends on BR2_TOOLCHAIN_HAS_THREADS
	depends on !BR2_STATIC_LIBS
	help
	  An open source, cross-platform, implementation of C#
	  and the CLR that is binary compatible with Microsoft.NET.

	  http://download.mono-project.com/sources/mono/

comment "mono needs a toolchain w/ threads, dynamic library"
	depends on BR2_PACKAGE_MONO_ARCH_SUPPORTS
	depends on !BR2_TOOLCHAIN_HAS_THREADS || BR2_STATIC_LIBS
```
