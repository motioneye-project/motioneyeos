## package/mosh/Config.in
```kconfig
comment "mosh needs a toolchain w/ C++, threads, dynamic library, wchar, gcc >= 4.8"
	depends on !BR2_TOOLCHAIN_HAS_THREADS || !BR2_INSTALL_LIBSTDCPP \
		|| BR2_STATIC_LIBS || !BR2_USE_WCHAR \
		|| !BR2_TOOLCHAIN_GCC_AT_LEAST_4_8
	depends on BR2_PACKAGE_PROTOBUF_ARCH_SUPPORTS

config BR2_PACKAGE_MOSH
	bool "mosh"
	depends on BR2_PACKAGE_PROTOBUF_ARCH_SUPPORTS
	depends on BR2_INSTALL_LIBSTDCPP # protobuf
	depends on BR2_TOOLCHAIN_HAS_THREADS # protobuf
	depends on BR2_TOOLCHAIN_GCC_AT_LEAST_4_8 # protobuf
	depends on !BR2_STATIC_LIBS # protobuf
	depends on BR2_USE_WCHAR
	select BR2_PACKAGE_PROTOBUF
	select BR2_PACKAGE_NCURSES
	select BR2_PACKAGE_NETTLE if !BR2_PACKAGE_OPENSSL
	select BR2_PACKAGE_ZLIB
	# runtime dependency
	select BR2_PACKAGE_OPENSSH if !BR2_PACKAGE_DROPBEAR_CLIENT
	help
	  Remote terminal application that supports intermittent
	  connectivity, allows roaming, and provides speculative local
	  echo and line editing of user keystrokes.

	  Mosh requires that the remote machine has a locale setting
	  matching the one on the client.

	  When using mosh with dropbear on a remote machine, the
	  client needs mosh with a version above 1.3.0 and the
	  --no-ssh-pty option needs to be passed when starting the
	  connection.

	  https://mosh.org
```

## package/mosquitto/Config.in
```kconfig
config BR2_PACKAGE_MOSQUITTO
	bool "mosquitto"
	help
	  Eclipse Mosquitto is an open source (EPL/EDL licensed) message
	  broker that implements the MQTT protocol versions 5.0, 3.1.1
	  and 3.1. Mosquitto is lightweight and is suitable for use on
	  all devices from low power single board computers to full
	  servers.

	  The MQTT protocol provides a lightweight method of carrying
	  out messaging using a publish/subscribe model. This makes it
	  suitable for Internet of Things messaging such as with low
	  power sensors or mobile devices such as phones,
	  embedded computers or microcontrollers.

	  The Mosquitto project also provides a C library for
	  implementing MQTT clients, and the very popular mosquitto_pub
	  and mosquitto_sub command line MQTT clients.

	  http://mosquitto.org/

config BR2_PACKAGE_MOSQUITTO_BROKER
	bool "install the mosquitto broker"
	default y
	depends on BR2_USE_MMU # fork()
	depends on !BR2_STATIC_LIBS # include <dlfcn.h>
	depends on BR2_PACKAGE_MOSQUITTO
	help
	  Build and install the mosquitto broker onto target.

comment "mosquitto broker needs a toolchain w/ dynamic library"
	depends on BR2_USE_MMU
	depends on BR2_STATIC_LIBS
	depends on BR2_PACKAGE_MOSQUITTO
```

## package/most/Config.in
```kconfig
config BR2_PACKAGE_MOST
	bool "most"
	depends on BR2_USE_MMU # slang
	select BR2_PACKAGE_SLANG
	help
	  most is a powerful pager, including features like multi
	  document support, hex view and unpack on-the-fly.

	  Note: this program depends on the slang library which is
	  rather large to be used just for this pager.

	  https://www.jedsoft.org/most/
```

## package/motion-mmal/Config.in
```kconfig
config BR2_PACKAGE_MOTION_MMAL
	bool "motion-mmal"
	depends on BR2_PACKAGE_RPI_FIRMWARE && BR2_PACKAGE_RPI_USERLAND
	help
```

## package/motion/Config.in
```kconfig
config BR2_PACKAGE_MOTION
	bool "motion"
	depends on BR2_USE_MMU # fork()
	depends on BR2_TOOLCHAIN_HAS_THREADS
	select BR2_PACKAGE_JPEG
	select BR2_PACKAGE_LIBMICROHTTPD
	help
	  Motion is a program that monitors the video signal from
	  cameras. It is able to detect if a significant part of
	  the picture has changed; in other words, it can detect motion.

	  libv4l has to be selected to be able to use a local camera.

	  https://motion-project.github.io

comment "motion needs a toolchain w/ threads"
	depends on BR2_USE_MMU
	depends on !BR2_TOOLCHAIN_HAS_THREADS
```

## package/mp4v2/Config.in
```kconfig
config BR2_PACKAGE_MP4V2
	bool "mp4v2"
	depends on BR2_INSTALL_LIBSTDCPP
	help
	  The MP4v2 library provides functions to read, create, and
	  modify mp4 files.

	  https://github.com/TechSmith/mp4v2/

if BR2_PACKAGE_MP4V2

config BR2_PACKAGE_MP4V2_UTIL
	bool "Install mp4 command line tools"
	help
	  Enable to install the mp4 command line tools mp4art,
	  mp4chaps, mp4extract, mp4info, mp4subtitle, mp4tags, and
	  mp4trackdump.

endif

comment "mp4v2 needs a toolchain w/ C++"
	depends on !BR2_INSTALL_LIBSTDCPP
```

## package/mpatrol/Config.in
```kconfig
config BR2_PACKAGE_MPATROL
	bool "mpatrol"
	default n
	depends on BR2_PACKAGE_GDB || BR2_PACKAGE_GCC_TARGET || BR2_PACKAGE_LIBELF

	help
	  A debugging tool that attempts to diagnose run-time errors that are
	  caused by the wrong use of dynamically allocated memory. It acts as
	  a malloc() debugger for debugging dynamic memory allocations, although
	  it can also trace and profile calls to malloc() and free() too.

	  http://www.cbmamiga.demon.co.uk/mpatrol/
```

## package/mpc/Config.in
```kconfig
config BR2_PACKAGE_MPC
	bool "mpc"
	select BR2_PACKAGE_MPFR
	select BR2_PACKAGE_GMP
	help
	  Mpc is a C library for the arithmetic of complex numbers with
	  arbitrarily high precision and correct rounding of the result.
	  It is built upon and follows the same principles as Mpfr.

	  http://www.multiprecision.org/
```

## package/mpd-mpc/Config.in
```kconfig
config BR2_PACKAGE_MPD_MPC
	bool "mpd-mpc"
	select BR2_PACKAGE_LIBMPDCLIENT
	help
	  A minimalist command line interface to MPD.

	  http://www.musicpd.org/clients/mpc/
```

## package/mpd/Config.in
```kconfig
menuconfig BR2_PACKAGE_MPD
	bool "mpd"
	depends on BR2_INSTALL_LIBSTDCPP
	depends on BR2_USE_WCHAR # libglib2
	depends on BR2_TOOLCHAIN_HAS_THREADS # libglib2
	select BR2_PACKAGE_LIBGLIB2
	select BR2_PACKAGE_LIBICONV if !BR2_ENABLE_LOCALE
	select BR2_PACKAGE_MPD_TREMOR if !(BR2_PACKAGE_MPD_MAD || BR2_PACKAGE_MPD_MPG123 || BR2_PACKAGE_MPD_VORBIS || BR2_PACKAGE_MPD_WAVPACK || BR2_PACKAGE_MPD_FLAC || BR2_PACKAGE_MPD_MUSEPACK || BR2_PACKAGE_MPD_FFMPEG)
	help
	  MPD is a flexible, powerful, server-side application
	  for playing music. Through plugins and libraries
	  it can play a variety of sound files while being
	  controlled by its network protocol.

	  http://www.musicpd.org

if BR2_PACKAGE_MPD

config BR2_PACKAGE_MPD_ALSA
	bool "alsa"
	default y
	select BR2_PACKAGE_ALSA_LIB
	select BR2_PACKAGE_ALSA_LIB_PCM
	select BR2_PACKAGE_ALSA_LIB_MIXER
	depends on BR2_TOOLCHAIN_HAS_THREADS # alsa-lib
	help
	  Enable alsa output support.

config BR2_PACKAGE_MPD_AO
	bool "ao"
	select BR2_PACKAGE_LIBAO
	help
	  Enable libao output support.

config BR2_PACKAGE_MPD_AUDIOFILE
	bool "audiofile"
	select BR2_PACKAGE_AUDIOFILE
	help
	  Enable audiofile input/streaming support.
	  Select this if you want to play back WAV files.

config BR2_PACKAGE_MPD_PULSEAUDIO
	bool "pulseaudio"
	depends on BR2_TOOLCHAIN_HAS_THREADS # pulseaudio
	depends on BR2_LARGEFILE # pulseaudio -> libsndfile
	select BR2_PACKAGE_PULSEAUDIO
	help
	  Enable pulseaudio output support.

config BR2_PACKAGE_MPD_BZIP2
	bool "bzip2"
	select BR2_PACKAGE_BZIP2
	help
	  Enable bzip2 archive support.

config BR2_PACKAGE_MPD_CURL
	bool "curl"
	select BR2_PACKAGE_LIBCURL
	help
	  Enable curl streaming (http) support.

config BR2_PACKAGE_MPD_FAAD2
	bool "faad2"
	select BR2_PACKAGE_FAAD2
	help
	  Enable faad2 input support.
	  Select this if you want to play back MP4/AAC files.

config BR2_PACKAGE_MPD_FLAC
	bool "flac"
	select BR2_PACKAGE_FLAC
	help
	  Enable flac input/streaming support.
	  Select this if you want to play back FLAC files.

config BR2_PACKAGE_MPD_FFMPEG
	bool "ffmpeg"
	select BR2_PACKAGE_FFMPEG
	depends on BR2_LARGEFILE
	depends on BR2_INET_IPV6
	help
	  Enable ffmpeg input support.
	  Select this if you want to play back files supported by ffmpeg.

comment "ffmpeg support requires a toolchain with LARGEFILE and IPV6 support"
	depends on !(BR2_LARGEFILE && BR2_INET_IPV6)

config BR2_PACKAGE_MPD_LAME
	bool "lame"
	select BR2_PACKAGE_LAME
	help
	  Enable lame (mp3) encoding support.

config BR2_PACKAGE_MPD_LIBCUE
	bool "libcue"
	select BR2_PACKAGE_LIBCUE
	help
	  Enable cue file support.

config BR2_PACKAGE_MPD_LIBSAMPLERATE
	bool "libsamplerate"
	select BR2_PACKAGE_LIBSAMPLERATE
	help
	  Enable libsamplerate input support.
	  Select this for software sample rate conversion.

config BR2_PACKAGE_MPD_LIBSNDFILE
	bool "libsndfile"
	select BR2_PACKAGE_LIBSNDFILE
	depends on BR2_LARGEFILE
	help
	  Enable libsndfile input/streaming support.
	  Select this if you want to play back WAV files.

comment "mpd-libsndfile requires a toolchain with LARGEFILE support"
	depends on !BR2_LARGEFILE

config BR2_PACKAGE_MPD_MAD
	bool "mad"
	default y
	select BR2_PACKAGE_LIBID3TAG
	select BR2_PACKAGE_LIBMAD
	help
	  Enable mad input support.
	  Select this if you want to play back MP3 files.

config BR2_PACKAGE_MPD_MPG123
	bool "mpg123"
	select BR2_PACKAGE_LIBID3TAG
	select BR2_PACKAGE_MPG123
	help
	  Enable mpg123 input support.
	  Select this if you want to play back MP3 files.

config BR2_PACKAGE_MPD_MUSEPACK
	bool "musepack"
	select BR2_PACKAGE_LIBCUEFILE
	select BR2_PACKAGE_LIBREPLAYGAIN
	select BR2_PACKAGE_MUSEPACK
	help
	  Enable musepack input support.
	  Select this if you want to play back MPC files.

config BR2_PACKAGE_MPD_SQLITE
	bool "sqlite"
	select BR2_PACKAGE_SQLITE
	help
	  Enable sqlite database support.
	  If you don't use sqlite it will use an ASCII database.

config BR2_PACKAGE_MPD_TCP
	bool "tcp sockets"
	default y
	help
	  Enable mpd to listen on tcp sockets.

	  You want this on if mpd and the client(s) work
	  on different machines (the usual scenario).

config BR2_PACKAGE_MPD_TREMOR
	bool "tremor"
	select BR2_PACKAGE_LIBOGG
	select BR2_PACKAGE_TREMOR
	help
	  Enable vorbis input support.
	  Select this if you want to play back OGG files on softfloat targets.

config BR2_PACKAGE_MPD_VORBIS
	bool "vorbis"
	select BR2_PACKAGE_LIBOGG
	select BR2_PACKAGE_LIBVORBIS
	help
	  Enable vorbis input/streaming support.
	  Select this if you want to play back OGG files on hardfloat targets.

config BR2_PACKAGE_MPD_WAVPACK
	bool "wavpack"
	select BR2_PACKAGE_WAVPACK
	help
	  Enable wavpack input support.
	  Select this if you want to play back WV files.

endif

comment "mpd requires a toolchain with C++, threading and WCHAR support"
	depends on !BR2_INSTALL_LIBSTDCPP || !BR2_USE_WCHAR || \
		!BR2_TOOLCHAIN_HAS_THREADS
```

## package/mpdecimal/Config.in
```kconfig
config BR2_PACKAGE_MPDECIMAL
	bool "mpdecimal"
	help
	  mpdecimal is a package for correctly-rounded arbitrary
	  precision decimal floating point arithmetic. Starting from
	  version 2.4, mpdecimal includes only the libmpdec
	  library. Further mpdecimal development will focus
	  exclusively on libmpdec.

	  http://www.bytereef.org/mpdecimal/
```

## package/mpfr/Config.in
```kconfig
config BR2_PACKAGE_MPFR
	bool "mpfr"
	default y if BR2_INSTALL_FORTRAN
	select BR2_PACKAGE_GMP
	help
	  C library for multiple-precision floating-point computations
	  with exact rounding.

	  http://www.mpfr.org/
```

## package/mpg123/Config.in
```kconfig
config BR2_PACKAGE_MPG123
	bool "mpg123"
	depends on BR2_USE_MMU # fork - in the application
	help
	  Fast, free and portable MPEG audio player for Unix. It supports
	  MPEG 1.0/2.0 layers 1, 2 and 3.

	  http://www.mpg123.de/
```

## package/mpir/Config.in
```kconfig
config BR2_PACKAGE_MPIR
	bool "mpir"
	select BR2_PACKAGE_GMP
	help
	  MPIR is a highly optimised library for bignum arithmetic
	  forked from the GMP bignum library.

	  http://www.mpir.org/
```

## package/mplayer/Config.in
```kconfig
config BR2_PACKAGE_MPLAYER_ARCH_SUPPORTS
	bool
	default y
	# Those architectures are not supported by MPlayer
	depends on !(BR2_bfin || BR2_sh2a || BR2_sh4a || BR2_sh4aeb \
		|| BR2_m68k || BR2_microblaze || BR2_nios2)
	# Broken support for <ARMv5
	depends on !BR2_ARM_CPU_ARMV4

config BR2_PACKAGE_MPLAYER
	bool "mplayer"
	depends on BR2_PACKAGE_MPLAYER_ARCH_SUPPORTS
	depends on BR2_TOOLCHAIN_HAS_SYNC_4
	depends on BR2_TOOLCHAIN_HAS_THREADS
	help
	  MPlayer is a movie player which runs on many systems and supports
	  many different file formats.

	  http://www.mplayerhq.hu/

comment "mplayer needs a toolchain w/ threads"
	depends on BR2_PACKAGE_MPLAYER_ARCH_SUPPORTS
	depends on BR2_TOOLCHAIN_HAS_SYNC_4
	depends on !BR2_TOOLCHAIN_HAS_THREADS

if BR2_PACKAGE_MPLAYER

config BR2_PACKAGE_MPLAYER_MPLAYER
	bool "Build and install mplayer"
	default y
	help
	  This will install the video player.

config BR2_PACKAGE_MPLAYER_MENCODER
	bool "Build and install mencoder"
	help
	  This will install the video encoder.

endif
```

## package/mpv/Config.in
```kconfig
config BR2_PACKAGE_MPV
	bool "mpv"
	depends on BR2_TOOLCHAIN_HAS_THREADS
	depends on BR2_PACKAGE_FFMPEG_ARCH_SUPPORTS
	depends on BR2_TOOLCHAIN_GCC_AT_LEAST_4_5
	depends on BR2_TOOLCHAIN_HAS_ATOMIC || BR2_TOOLCHAIN_HAS_SYNC_8
	select BR2_PACKAGE_LIBICONV if !BR2_ENABLE_LOCALE
	select BR2_PACKAGE_FFMPEG
	select BR2_PACKAGE_FFMPEG_SWSCALE
	select BR2_PACKAGE_ZLIB
	# Select xkbcommon for wayland to avoid being mysterious
	select BR2_PACKAGE_LIBXKBCOMMON if BR2_PACKAGE_WAYLAND
	# Select all necessary X11 dependencies if X.org is enabled
	select BR2_PACKAGE_XLIB_LIBX11 if BR2_PACKAGE_XORG7
	select BR2_PACKAGE_XLIB_LIBXEXT if BR2_PACKAGE_XORG7
	select BR2_PACKAGE_XLIB_LIBXINERAMA if BR2_PACKAGE_XORG7
	select BR2_PACKAGE_XLIB_LIBXSCRNSAVER if BR2_PACKAGE_XORG7
	select BR2_PACKAGE_XLIB_LIBXRANDR if BR2_PACKAGE_XORG7
	help
	  mpv is a fork of mplayer2 and MPlayer. It shares some features
	  with the former projects while introducing many more.

	  https://mpv.io/

comment "mpv needs a toolchain w/ threads, gcc >= 4.5"
	depends on BR2_PACKAGE_FFMPEG_ARCH_SUPPORTS
	depends on BR2_TOOLCHAIN_HAS_ATOMIC || BR2_TOOLCHAIN_HAS_SYNC_8
	depends on !BR2_TOOLCHAIN_HAS_THREADS || \
		!BR2_TOOLCHAIN_GCC_AT_LEAST_4_5
```

## package/mraa/Config.in
```kconfig
config BR2_PACKAGE_MRAA
	bool "mraa"
	depends on BR2_TOOLCHAIN_HAS_THREADS
	depends on BR2_arm || BR2_i386 || BR2_x86_64
	help
	  mraa is a C/C++ library with bindings to javascript & python
	  to interface with the IO on Galileo, Edison & other
	  platforms, with a structured and sane API where port
	  names/numbering matches the board that you are on.

	  http://iotdk.intel.com/docs/master/mraa

comment "mraa needs a toolchain w/ threads"
	depends on !BR2_TOOLCHAIN_HAS_THREADS
```

## package/mrouted/Config.in
```kconfig
config BR2_PACKAGE_MROUTED
	bool "mrouted"
	depends on BR2_USE_MMU # fork()
	help
	  An implementation of the DVMRP multicast routing protocol.

	  http://github.com/troglobit/mrouted
```

## package/msgpack/Config.in
```kconfig
config BR2_PACKAGE_MSGPACK
	bool "msgpack"
	depends on BR2_INSTALL_LIBSTDCPP
	depends on BR2_TOOLCHAIN_HAS_SYNC_4
	help
	  MessagePack is an efficient binary serialization format.

	  It lets you exchange data among multiple languages like JSON
	  but it's faster and smaller.

	  http://msgpack.org/

comment "msgpack needs a toolchain w/ C++"
	depends on !BR2_INSTALL_LIBSTDCPP
	depends on BR2_TOOLCHAIN_HAS_SYNC_4
```

## package/msmtp/Config.in
```kconfig
config BR2_PACKAGE_MSMTP
	bool "msmtp"
	help
	  msmtp is an SMTP client. In the default mode, it transmits a
	  mail to an SMTP server (for example at a free mail provider)
	  which takes care of further delivery.

	  http://msmtp.sourceforge.net/
```
