## package/multimedia/gst-plugins-base/Config.in
```kconfig
menuconfig BR2_PACKAGE_GST_PLUGINS_BASE
	bool "gst-plugins-base"
	depends on BR2_PACKAGE_GSTREAMER
	select BR2_PACKAGE_XLIB_LIBX11 if BR2_PACKAGE_XORG7
	select BR2_PACKAGE_XLIB_LIBXEXT if BR2_PACKAGE_XORG7
	select BR2_PACKAGE_XLIB_LIBXV if BR2_PACKAGE_XORG7
	help
	  A basic set of well-supported plug-ins for GStreamer.

	  http://gstreamer.freedesktop.org/

if BR2_PACKAGE_GST_PLUGINS_BASE

comment "dependency-less plugins"

config BR2_PACKAGE_GST_PLUGINS_BASE_PLUGIN_ADDER
	bool "adder"

config BR2_PACKAGE_GST_PLUGINS_BASE_PLUGIN_APP
	bool "app"

config BR2_PACKAGE_GST_PLUGINS_BASE_PLUGIN_AUDIOCONVERT
	bool "audioconvert (mandatory for audio playback)"
	default y

config BR2_PACKAGE_GST_PLUGINS_BASE_PLUGIN_AUDIORATE
	bool "audiorate"

config BR2_PACKAGE_GST_PLUGINS_BASE_PLUGIN_AUDIORESAMPLE
	bool "audioresample (mandatory for audio playback)"
	default y

config BR2_PACKAGE_GST_PLUGINS_BASE_PLUGIN_AUDIOTESTSRC
	bool "audiotestsrc"

config BR2_PACKAGE_GST_PLUGINS_BASE_PLUGIN_ENCODING
	bool "encoding"

config BR2_PACKAGE_GST_PLUGINS_BASE_PLUGIN_FFMPEGCOLORSPACE
	bool "ffmpegcolorspace (mandatory for video playback)"
	default y

config BR2_PACKAGE_GST_PLUGINS_BASE_PLUGIN_GDP
	bool "gdp"

config BR2_PACKAGE_GST_PLUGINS_BASE_PLUGIN_PLAYBACK
	bool "playback (mandatory)"
	default y

config BR2_PACKAGE_GST_PLUGINS_BASE_PLUGIN_SUBPARSE
	bool "subparse"

config BR2_PACKAGE_GST_PLUGINS_BASE_PLUGIN_TCP
	bool "tcp"

config BR2_PACKAGE_GST_PLUGINS_BASE_PLUGIN_TYPEFIND
	bool "typefind (mandatory)"
	default y

config BR2_PACKAGE_GST_PLUGINS_BASE_PLUGIN_VIDEOTESTSRC
	bool "videotestsrc"

config BR2_PACKAGE_GST_PLUGINS_BASE_PLUGIN_VIDEORATE
	bool "videorate"

config BR2_PACKAGE_GST_PLUGINS_BASE_PLUGIN_VIDEOSCALE
	bool "videoscale (mandatory for video playback)"
	default y

config BR2_PACKAGE_GST_PLUGINS_BASE_PLUGIN_VOLUME
	bool "volume (mandatory for audio playback)"
	default y

comment "plugins with external dependencies (there may be more available)"

config BR2_PACKAGE_GST_PLUGINS_BASE_PLUGIN_OGG
	bool "ogg (*.ogg audio/video)"
	select BR2_PACKAGE_LIBOGG

config BR2_PACKAGE_GST_PLUGINS_BASE_PLUGIN_PANGO
	bool "pango font renderer"
	depends on BR2_INSTALL_LIBSTDCPP
	select BR2_PACKAGE_PANGO

comment "pango plugin requires a toolchain with C++ support"
	depends on !BR2_INSTALL_LIBSTDCPP

config BR2_PACKAGE_GST_PLUGINS_BASE_PLUGIN_THEORA
	bool "theora (*.ogg video)"
	select BR2_PACKAGE_LIBTHEORA

config BR2_PACKAGE_GST_PLUGINS_BASE_PLUGIN_TREMOR
	bool "tremor"
	select BR2_PACKAGE_TREMOR

config BR2_PACKAGE_GST_PLUGINS_BASE_PLUGIN_VORBIS
	bool "vorbis (*.ogg audio)"
	select BR2_PACKAGE_LIBVORBIS

endif
```

## package/multimedia/gst-plugins-good/Config.in
```kconfig
menuconfig BR2_PACKAGE_GST_PLUGINS_GOOD
	bool "gst-plugins-good"
	depends on BR2_PACKAGE_GSTREAMER
	select BR2_PACKAGE_GST_PLUGINS_BASE
	help
	  A set of well-supported plug-ins for GStreamer under the preferred
	  license.

	  http://gstreamer.freedesktop.org/

if BR2_PACKAGE_GST_PLUGINS_GOOD

config BR2_PACKAGE_GST_PLUGINS_GOOD_JPEG
	bool "jpeg (JPEG support)"
	select BR2_PACKAGE_JPEG

config BR2_PACKAGE_GST_PLUGINS_GOOD_PNG
	bool "png (PNG support)"
	select BR2_PACKAGE_LIBPNG

config BR2_PACKAGE_GST_PLUGINS_GOOD_BZ2
	bool "bz2 support"
	depends on BR2_PACKAGE_GST_PLUGINS_GOOD_PLUGIN_MATROSKA
	select BR2_PACKAGE_BZIP2
	help
	  Enable bz2 support for the following plugins:
	  matroska

config BR2_PACKAGE_GST_PLUGINS_GOOD_ZLIB
	bool "zlib support"
	depends on BR2_PACKAGE_GST_PLUGINS_GOOD_PLUGIN_QTDEMUX || BR2_PACKAGE_GST_PLUGINS_GOOD_PLUGIN_ID3DEMUX || BR2_PACKAGE_GST_PLUGINS_GOOD_PLUGIN_MATROSKA
	select BR2_PACKAGE_ZLIB
	help
	  Enable zlib support for the following plugins:
	  id3demux, qtdemux, matroska

comment "dependency-less plugins"

config BR2_PACKAGE_GST_PLUGINS_GOOD_PLUGIN_ALPHA
	bool "alpha"

config BR2_PACKAGE_GST_PLUGINS_GOOD_PLUGIN_APETAG
	bool "apetag"

config BR2_PACKAGE_GST_PLUGINS_GOOD_PLUGIN_AUDIOFX
	bool "audiofx"

config BR2_PACKAGE_GST_PLUGINS_GOOD_PLUGIN_AUDIOPARSERS
	bool "audioparsers"

config BR2_PACKAGE_GST_PLUGINS_GOOD_PLUGIN_AUPARSE
	bool "auparse"

config BR2_PACKAGE_GST_PLUGINS_GOOD_PLUGIN_AUTODETECT
	bool "autodetect"

config BR2_PACKAGE_GST_PLUGINS_GOOD_PLUGIN_AVI
	bool "avi (*.avi video)"
	default y

config BR2_PACKAGE_GST_PLUGINS_GOOD_PLUGIN_CUTTER
	bool "cutter"

config BR2_PACKAGE_GST_PLUGINS_GOOD_PLUGIN_DEBUGUTILS
	bool "debugutils"

config BR2_PACKAGE_GST_PLUGINS_GOOD_PLUGIN_DEINTERLACE
	bool "deinterlace"

config BR2_PACKAGE_GST_PLUGINS_GOOD_PLUGIN_EFFECTV
	bool "effectv"

config BR2_PACKAGE_GST_PLUGINS_GOOD_PLUGIN_EQUALIZER
	bool "equalizer"

config BR2_PACKAGE_GST_PLUGINS_GOOD_PLUGIN_FLV
	bool "flv"

config BR2_PACKAGE_GST_PLUGINS_GOOD_PLUGIN_FLX
	bool "flx"

config BR2_PACKAGE_GST_PLUGINS_GOOD_PLUGIN_GOOM
	bool "goom"

config BR2_PACKAGE_GST_PLUGINS_GOOD_PLUGIN_GOOM2K1
	bool "goom2k1"

config BR2_PACKAGE_GST_PLUGINS_GOOD_PLUGIN_ID3DEMUX
	bool "id3demux (*.mp3 audio)"

config BR2_PACKAGE_GST_PLUGINS_GOOD_PLUGIN_ICYDEMUX
	bool "icydemux"

config BR2_PACKAGE_GST_PLUGINS_GOOD_PLUGIN_IMAGEFREEZE
	bool "imagefreeze"

config BR2_PACKAGE_GST_PLUGINS_GOOD_PLUGIN_INTERLEAVE
	bool "interleave"

config BR2_PACKAGE_GST_PLUGINS_GOOD_PLUGIN_ISOMP4
	bool "isomp4"

config BR2_PACKAGE_GST_PLUGINS_GOOD_PLUGIN_LAW
	bool "law"

config BR2_PACKAGE_GST_PLUGINS_GOOD_PLUGIN_LEVEL
	bool "level"

config BR2_PACKAGE_GST_PLUGINS_GOOD_PLUGIN_MATROSKA
	bool "matroska"

config BR2_PACKAGE_GST_PLUGINS_GOOD_PLUGIN_MONOSCOPE
	bool "monoscope"

config BR2_PACKAGE_GST_PLUGINS_GOOD_PLUGIN_MULTIFILE
	bool "multifile"

config BR2_PACKAGE_GST_PLUGINS_GOOD_PLUGIN_MULTIPART
	bool "multipart"

config BR2_PACKAGE_GST_PLUGINS_GOOD_PLUGIN_REPLAYGAIN
	bool "replaygain"

config BR2_PACKAGE_GST_PLUGINS_GOOD_PLUGIN_RTP
	bool "rtp"

config BR2_PACKAGE_GST_PLUGINS_GOOD_PLUGIN_RTPMANAGER
	bool "rtpmanager"

config BR2_PACKAGE_GST_PLUGINS_GOOD_PLUGIN_RTSP
	bool "rtsp"

config BR2_PACKAGE_GST_PLUGINS_GOOD_PLUGIN_SHAPEWIPE
	bool "shapewipe"

config BR2_PACKAGE_GST_PLUGINS_GOOD_PLUGIN_SMPTE
	bool "smpte"

config BR2_PACKAGE_GST_PLUGINS_GOOD_PLUGIN_SPECTRUM
	bool "spectrum"

config BR2_PACKAGE_GST_PLUGINS_GOOD_PLUGIN_UDP
	depends on BR2_INET_IPV6
	bool "udp"

comment "udp requires a toolchain with IPv6 support"
	depends on !BR2_INET_IPV6

config BR2_PACKAGE_GST_PLUGINS_GOOD_PLUGIN_VIDEOBOX
	bool "videobox"

config BR2_PACKAGE_GST_PLUGINS_GOOD_PLUGIN_VIDEOCROP
	bool "videocrop"

config BR2_PACKAGE_GST_PLUGINS_GOOD_PLUGIN_VIDEOFILTER
	bool "videofilter"

config BR2_PACKAGE_GST_PLUGINS_GOOD_PLUGIN_VIDEOMIXER
	bool "videomixer"

config BR2_PACKAGE_GST_PLUGINS_GOOD_PLUGIN_WAVENC
	bool "wavenc"

config BR2_PACKAGE_GST_PLUGINS_GOOD_PLUGIN_WAVPARSE
	bool "wavparse (*.wav audio)"
	default y

config BR2_PACKAGE_GST_PLUGINS_GOOD_PLUGIN_Y4M
	bool "y4m"

config BR2_PACKAGE_GST_PLUGINS_GOOD_PLUGIN_V4L2
	bool "v4l2"

comment "plugins with external dependencies"

config BR2_PACKAGE_GST_PLUGINS_GOOD_PLUGIN_ANNODEX
	bool "annodex (XML Library)"
	select BR2_PACKAGE_LIBXML2

config BR2_PACKAGE_GST_PLUGINS_GOOD_PLUGIN_CAIRO
	bool "cairo"
	select BR2_PACKAGE_CAIRO
	select BR2_PACKAGE_CAIRO_PNG

config BR2_PACKAGE_GST_PLUGINS_GOOD_PLUGIN_FLAC
	bool "flac (libFLAC)"
	select BR2_PACKAGE_FLAC

config BR2_PACKAGE_GST_PLUGINS_GOOD_PLUGIN_OSS
	bool "ossaudio (OSS audio)"

config BR2_PACKAGE_GST_PLUGINS_GOOD_PLUGIN_OSS4
	bool "oss4 (Open Sound System 4)"

config BR2_PACKAGE_GST_PLUGINS_GOOD_PLUGIN_PULSE
	select BR2_PACKAGE_PULSEAUDIO
	bool "pulseaudio"

config BR2_PACKAGE_GST_PLUGINS_GOOD_PLUGIN_SOUPHTTPSRC
	bool "souphttpsrc (http client)"
	select BR2_PACKAGE_LIBSOUP

config BR2_PACKAGE_GST_PLUGINS_GOOD_PLUGIN_SPEEX
	bool "speex"
	select BR2_PACKAGE_SPEEX

endif
```
