## package/mtdev2tuio/Config.in
```kconfig
config BR2_PACKAGE_MTDEV2TUIO
	bool "mtdev2tuio"
	depends on BR2_TOOLCHAIN_HAS_THREADS # liblo
	select BR2_PACKAGE_LIBLO
	select BR2_PACKAGE_MTDEV
	help
	  mtdev2tuio is a simple application for converting touch
	  events captured from libmtdev to TUIO 1.1

	  https://github.com/olivopaolo/mtdev2tuio

comment "mtdev2tuio needs a toolchain w/ threads"
	depends on !BR2_TOOLCHAIN_HAS_THREADS
```

## package/mtools/Config.in
```kconfig
config BR2_PACKAGE_MTOOLS
	bool "mtools"
	depends on BR2_USE_WCHAR
	depends on BR2_USE_MMU # fork()
	# runtime UTF conversion support
	select BR2_TOOLCHAIN_GLIBC_GCONV_LIBS_COPY if BR2_TOOLCHAIN_USES_GLIBC
	help
	  Mtools is a collection of utilities to access MS-DOS disks
	  from Unix without mounting them. It supports Win'95 style
	  long file names, OS/2 Xdf disks and 2m disks (store up to
	  1992k on a high density 3 1/2 disk).

	  http://www.gnu.org/software/mtools/

comment "mtools needs a toolchain w/ wchar"
	depends on !BR2_USE_WCHAR
	depends on BR2_USE_MMU
```

## package/mtools/Config.in.host
```kconfig
config BR2_PACKAGE_HOST_MTOOLS
	bool "host mtools"
	help
	  Mtools is a collection of utilities to access MS-DOS disks from
	  Unix without mounting them. It supports Win'95 style long file
	  names, OS/2 Xdf disks and 2m disks (store up to 1992k on a high
	  density 3 1/2 disk).
	  
	  http://www.tux.org/pub/tux/mtools/
```

## package/mtr/Config.in
```kconfig
config BR2_PACKAGE_MTR
	bool "mtr"
	help
	  mtr combines the functionality of the 'traceroute' and 'ping'
	  programs in a single network diagnostic tool.

	  http://www.bitwizard.nl/mtr/
```

## package/multicat/Config.in
```kconfig
config BR2_PACKAGE_MULTICAT
	bool "multicat"
	depends on BR2_TOOLCHAIN_HAS_THREADS
	select BR2_PACKAGE_BITSTREAM
	help
	  Simple and efficient multicast and transport stream manipulation.

	  http://www.videolan.org/projects/multicat.html

comment 'multicat needs a toolchain w/ threads'
	depends on !BR2_TOOLCHAIN_HAS_THREADS
```

## package/multimedia/Config.in
```kconfig
menu "Audio and video applications"
source "package/multimedia/alsa-utils/Config.in"
source "package/multimedia/aumix/Config.in"
source "package/multimedia/bellagio/Config.in"
source "package/multimedia/faad2/Config.in"
source "package/multimedia/flac/Config.in"
source "package/multimedia/ffmpeg/Config.in"

# Gstreamer 0.10.x & Plugins
source "package/multimedia/gstreamer/Config.in"
source "package/multimedia/gst-plugins-base/Config.in"
source "package/multimedia/gst-plugins-good/Config.in"
source "package/multimedia/gst-plugins-bad/Config.in"
source "package/multimedia/gst-plugins-ugly/Config.in"
source "package/multimedia/gst-ffmpeg/Config.in"
source "package/multimedia/gst-dsp/Config.in"
source "package/multimedia/gst-fsl-plugins/Config.in"
source "package/multimedia/gst-omapfb/Config.in"
source "package/multimedia/gst-plugin-x170/Config.in"

# Gstreamer 1.x & Plugins
source "package/multimedia/gstreamer1/Config.in"
source "package/multimedia/gst1-plugins-base/Config.in"
source "package/multimedia/gst1-plugins-good/Config.in"
source "package/multimedia/gst1-plugins-bad/Config.in"
source "package/multimedia/gst1-plugins-ugly/Config.in"
source "package/multimedia/gst-omx/Config.in"

source "package/multimedia/lame/Config.in"
source "package/multimedia/libvpx/Config.in"
source "package/multimedia/madplay/Config.in"
source "package/multimedia/mpd/Config.in"
source "package/multimedia/mpg123/Config.in"
source "package/multimedia/mplayer/Config.in"
source "package/multimedia/musepack/Config.in"
source "package/multimedia/on2-8170-libs/Config.in"
source "package/opus-tools/Config.in"
source "package/multimedia/pulseaudio/Config.in"
source "package/multimedia/tidsp-binaries/Config.in"
source "package/tstools/Config.in"
source "package/multimedia/vorbis-tools/Config.in"
source "package/multimedia/wavpack/Config.in"
source "package/yavta/Config.in"
endmenu
```

## package/multimedia/alsa-lib/Config.in
```kconfig
config BR2_PACKAGE_ALSA_LIB
	bool "alsa-lib"
	# Temporary until
	# https://bugtrack.alsa-project.org/alsa-bug/view.php?id=4913
	# is fixed
	select BR2_PACKAGE_ALSA_LIB_PCM
	help
	  The Advanced Linux Sound Architecture (ALSA) provides audio and MIDI
	  functionality to the Linux operating system.

	  http://www.alsa-project.org/

config BR2_PACKAGE_ALSA_LIB_PYTHON
	bool "Python support for alsa-lib"
	depends on BR2_PACKAGE_ALSA_LIB
	depends on BR2_PACKAGE_PYTHON
	help
	  Add python support for alsa-lib.
	  Python will be built and libpython will be installed
	  in the target directory
	  http://www.alsa-project.org/

if BR2_PACKAGE_ALSA_LIB
menu "ALSA lib selection"

config BR2_PACKAGE_ALSA_LIB_DEVDIR
	string "directory with ALSA device files"
	default "/dev/snd"

config BR2_PACKAGE_ALSA_LIB_PCM_PLUGINS
	string "built PCM plugins"
	default "all"

config BR2_PACKAGE_ALSA_LIB_CTL_PLUGINS
	string "built control plugins"
	default "all"

config BR2_PACKAGE_ALSA_LIB_ALOAD
	bool "aload"
	default y

config BR2_PACKAGE_ALSA_LIB_MIXER
	bool "mixer"
	default y

config BR2_PACKAGE_ALSA_LIB_PCM
	bool "pcm"
	default y

config BR2_PACKAGE_ALSA_LIB_RAWMIDI
	bool "rawmidi"
	default y

config BR2_PACKAGE_ALSA_LIB_HWDEP
	bool "hwdep"
	default y

config BR2_PACKAGE_ALSA_LIB_SEQ
	bool "seq"
	default y

config BR2_PACKAGE_ALSA_LIB_ALISP
	bool "alisp"
	default y

config BR2_PACKAGE_ALSA_LIB_OLD_SYMBOLS
	bool "old-symbols"
	default y

endmenu

endif
```

## package/multimedia/alsa-utils/Config.in
```kconfig
config BR2_PACKAGE_ALSA_UTILS
	bool "alsa-utils"
	depends on BR2_LARGEFILE
	select BR2_PACKAGE_ALSA_LIB
	help
	  This package contains the command line utilities for the ALSA
	  project.

	  http://www.alsa-project.org/

comment "alsa-utils requires a toolchain with LARGEFILE support"
	depends on !BR2_LARGEFILE

if BR2_PACKAGE_ALSA_UTILS
menu "ALSA utils selection"

config BR2_PACKAGE_ALSA_UTILS_ALSACONF
	bool "alsaconf"

config BR2_PACKAGE_ALSA_UTILS_ALSACTL
	bool "alsactl"
	default y

config BR2_PACKAGE_ALSA_UTILS_ALSAMIXER
	bool "alsamixer"
	select BR2_PACKAGE_NCURSES
	select BR2_PACKAGE_NCURSES_TARGET_PANEL
	select BR2_PACKAGE_NCURSES_TARGET_FORM
	select BR2_PACKAGE_NCURSES_TARGET_MENU
	select BR2_PACKAGE_ALSA_LIB_MIXER
	depends on BR2_USE_WCHAR
	default y

comment "alsamixer requires a toolchain with WCHAR support"
	depends on !BR2_USE_WCHAR

config BR2_PACKAGE_ALSA_UTILS_AMIDI
	select BR2_PACKAGE_ALSA_LIB_RAWMIDI
	bool "amidi"

config BR2_PACKAGE_ALSA_UTILS_AMIXER
	select BR2_PACKAGE_ALSA_LIB_MIXER
	bool "amixer"

config BR2_PACKAGE_ALSA_UTILS_APLAY
	select BR2_PACKAGE_ALSA_LIB_PCM
	bool "aplay/arecord"

config BR2_PACKAGE_ALSA_UTILS_IECSET
	select BR2_PACKAGE_ALSA_LIB_PCM
	bool "iecset"

config BR2_PACKAGE_ALSA_UTILS_ACONNECT
	select BR2_PACKAGE_ALSA_LIB_SEQ
	bool "aconnect"

config BR2_PACKAGE_ALSA_UTILS_APLAYMIDI
	select BR2_PACKAGE_ALSA_LIB_SEQ
	bool "aplaymidi"

config BR2_PACKAGE_ALSA_UTILS_ARECORDMIDI
	select BR2_PACKAGE_ALSA_LIB_SEQ
	bool "arecordmidi"

config BR2_PACKAGE_ALSA_UTILS_ASEQDUMP
	select BR2_PACKAGE_ALSA_LIB_SEQ
	bool "aseqdump"

config BR2_PACKAGE_ALSA_UTILS_ASEQNET
	select BR2_PACKAGE_ALSA_LIB_SEQ
	bool "aseqnet"

config BR2_PACKAGE_ALSA_UTILS_SPEAKER_TEST
	select BR2_PACKAGE_ALSA_LIB_PCM
	bool "speaker-test"

endmenu

endif
```

## package/multimedia/bellagio/Config.in
```kconfig
config BR2_PACKAGE_BELLAGIO
	bool "bellagio"
	depends on BR2_INSTALL_LIBSTDCPP
	help
	  Bellagio is an opensource implementation of the
	  OpenMAX IL API.

	  OpenMAX Integration Layer (IL) is a standard API
	  to access Multimedia Components on mobile platforms.
	  It has been defined by the Khronos group.
	  By means of the OpenMAX IL API, multimedia frameworks
	  can access hardware accelerators on platforms that
	  provide it.

	  http://omxil.sourceforge.net/

comment "bellagio requires a toolchain with C++ support enabled"
	depends on !BR2_INSTALL_LIBSTDCPP
```

## package/multimedia/faad2/Config.in
```kconfig
config BR2_PACKAGE_FAAD2
	bool "faad2"
	help
	  FAAD2 is an open source MPEG-4 and MPEG-2 AAC decoder,

	  http://www.audiocoding.com/faad2.html
```

## package/multimedia/festival/Config.in
```kconfig
menuconfig BR2_PACKAGE_FESTIVAL
bool "festival text-to-speech system"
select BR2_PACKAGE_ALSA_LIB
select BR2_PACKAGE_SPEECH_TOOLS
help
	Text to speech system for Linux

if BR2_PACKAGE_FESTIVAL

	menu "speech tools"
		source "package/multimedia/festival/speech-tools/Config.in"
	endmenu

	menu "festival lexicons"
		source "package/multimedia/festival/lexicons/Config.in"
	endmenu

	menu "festival voices"
		source "package/multimedia/festival/voices/Config.in"
	endmenu

endif
```

## package/multimedia/festival/speech-tools/Config.in
```kconfig
config BR2_PACKAGE_SPEECH_TOOLS
	bool "speech tools for festival"
	depends on BR2_INSTALL_LIBSTDCPP
	help
	  Speech tools for the festival text to speech system

	  http://festvox.org/packed/festival/latest

comment "speech tools requires a toolchain with C++ support enabled"
	depends on !BR2_INSTALL_LIBSTDCPP
```

## package/multimedia/ffmpeg/Config.in
```kconfig
comment "ffmpeg requires a toolchain with LARGEFILE support"
	depends on !BR2_LARGEFILE

menuconfig BR2_PACKAGE_FFMPEG
	bool "ffmpeg"
	depends on BR2_LARGEFILE
	help
         FFmpeg is a complete, cross-platform solution to record, convert
         and stream audio and video.

	 http://www.ffmpeg.org

if BR2_PACKAGE_FFMPEG

config BR2_PACKAGE_FFMPEG_GPL
	bool "Enable GPL code"
	help
         allow use of GPL code, the resulting libs and binaries will
         be under GPL

config BR2_PACKAGE_FFMPEG_NONFREE
	bool "Enable nonfree code"
	help
         allow use of nonfree code, the resulting libs and binaries
         will be unredistributable

config BR2_PACKAGE_FFMPEG_FFMPEG
	bool "Build ffmpeg (the command line application)"
	default y
	help
         FFmpeg is a very fast video and audio converter.
         It can also grab from a live audio/video source.

         It is not needed if you want to link the FFmpeg libraries
         to your application.

config BR2_PACKAGE_FFMPEG_FFPLAY
	bool "Build ffplay"
	select BR2_PACKAGE_SDL
	help
         FFplay is a very simple and portable media player using the
         FFmpeg libraries and the SDL library.
         It is mostly used as a testbed for the various FFmpeg APIs.

config BR2_PACKAGE_FFMPEG_FFSERVER
	bool "Build ffserver"
	help
         FFserver is a streaming server for both audio and video.

endif
```

## package/multimedia/gst-plugins-bad/Config.in
```kconfig
menuconfig BR2_PACKAGE_GST_PLUGINS_BAD
	bool "gst-plugins-bad"
	depends on BR2_PACKAGE_GSTREAMER
	select BR2_PACKAGE_GST_PLUGINS_BASE
	help
	  A set of plug-ins for GStreamer that may be of poor quality or
	  lacking some features.

	  http://gstreamer.freedesktop.org/

if BR2_PACKAGE_GST_PLUGINS_BAD

comment "dependency-less plugins"

config BR2_PACKAGE_GST_PLUGINS_BAD_PLUGIN_ADPCMDEC
	bool "adpcmdec"

config BR2_PACKAGE_GST_PLUGINS_BAD_PLUGIN_ADPCMENC
	bool "adpcmenc"

config BR2_PACKAGE_GST_PLUGINS_BAD_PLUGIN_AIFF
	bool "aiff"

config BR2_PACKAGE_GST_PLUGINS_BAD_PLUGIN_ASFMUX
	bool "asfmux"

config BR2_PACKAGE_GST_PLUGINS_BAD_PLUGIN_APEXSINK
	bool "apexsink"
	select BR2_PACKAGE_OPENSSL

config BR2_PACKAGE_GST_PLUGINS_BAD_PLUGIN_AUDIOPARSERS
	bool "audioparsers"

config BR2_PACKAGE_GST_PLUGINS_BAD_PLUGIN_AUTOCONVERT
	bool "autoconvert"

config BR2_PACKAGE_GST_PLUGINS_BAD_PLUGIN_CAMERABIN
	bool "camerabin"

config BR2_PACKAGE_GST_PLUGINS_BAD_PLUGIN_COLOREFFECTS
	bool "coloreffects"

config BR2_PACKAGE_GST_PLUGINS_BAD_PLUGIN_COLORSPACE
	bool "colorspace"

config BR2_PACKAGE_GST_PLUGINS_BAD_PLUGIN_LEGACYRESAMPLE
	bool "legacyresample"

config BR2_PACKAGE_GST_PLUGINS_BAD_PLUGIN_BAYER
	bool "bayer"

config BR2_PACKAGE_GST_PLUGINS_BAD_PLUGIN_CDAUDIO
	bool "cdaudio"
	select BR2_PACKAGE_LIBCDAUDIO

config BR2_PACKAGE_GST_PLUGINS_BAD_PLUGIN_CDXAPARSE
	bool "cdxaparse"

config BR2_PACKAGE_GST_PLUGINS_BAD_PLUGIN_DATAURISRC
	bool "dataurisrc"

config BR2_PACKAGE_GST_PLUGINS_BAD_PLUGIN_DCCP
	bool "dccp"

config BR2_PACKAGE_GST_PLUGINS_BAD_PLUGIN_DEBUGUTILS
	bool "debugutils"

config BR2_PACKAGE_GST_PLUGINS_BAD_PLUGIN_DTMF
	bool "dtmf"

config BR2_PACKAGE_GST_PLUGINS_BAD_PLUGIN_DVBSUBOVERLAY
	bool "dvdsuboverlay"

config BR2_PACKAGE_GST_PLUGINS_BAD_PLUGIN_DVDSPU
	bool "dvdspu"

config BR2_PACKAGE_GST_PLUGINS_BAD_PLUGIN_FESTIVAL
	bool "festival"

config BR2_PACKAGE_GST_PLUGINS_BAD_PLUGIN_FREEZE
	bool "freeze"

config BR2_PACKAGE_GST_PLUGINS_BAD_PLUGIN_FREI0R
	bool "frei0r"

config BR2_PACKAGE_GST_PLUGINS_BAD_PLUGIN_GAUDIEFFECTS
	bool "gaudieffects"

config BR2_PACKAGE_GST_PLUGINS_BAD_PLUGIN_GEOMETRICTRANSFORM
	bool "geometrictransform"

config BR2_PACKAGE_GST_PLUGINS_BAD_PLUGIN_GSETTINGS
	bool "gsettings"

config BR2_PACKAGE_GST_PLUGINS_BAD_PLUGIN_H264PARSE
	bool "h264parse"

config BR2_PACKAGE_GST_PLUGINS_BAD_PLUGIN_HDVPARSE
	bool "hdvparse"

config BR2_PACKAGE_GST_PLUGINS_BAD_PLUGIN_INTERLACE
	bool "interlace"

config BR2_PACKAGE_GST_PLUGINS_BAD_PLUGIN_INVTELECINE
	bool "invtelecine"

config BR2_PACKAGE_GST_PLUGINS_BAD_PLUGIN_IVFPARSE
	bool "ivfparse"

config BR2_PACKAGE_GST_PLUGINS_BAD_PLUGIN_JP2KDECIMATOR
	bool "jp2kdecimator"

config BR2_PACKAGE_GST_PLUGINS_BAD_PLUGIN_JPEGFORMAT
	bool "jpegformat"

config BR2_PACKAGE_GST_PLUGINS_BAD_PLUGIN_LIBRFB
	bool "librfb"

config BR2_PACKAGE_GST_PLUGINS_BAD_PLUGIN_LIVEADDER
	bool "liveadder"

config BR2_PACKAGE_GST_PLUGINS_BAD_PLUGIN_MPEGDEMUX
	bool "mpegdemux"

config BR2_PACKAGE_GST_PLUGINS_BAD_PLUGIN_MPEGPSMUX
	bool "mpegpsmux"

config BR2_PACKAGE_GST_PLUGINS_BAD_PLUGIN_MPEGTSMUX
	bool "mpegtsmux"

config BR2_PACKAGE_GST_PLUGINS_BAD_PLUGIN_MPEG4VIDEOPARSE
	bool "mpeg4videoparse"

config BR2_PACKAGE_GST_PLUGINS_BAD_PLUGIN_MPEGVIDEOPARSE
	bool "mpegvideoparse"

config BR2_PACKAGE_GST_PLUGINS_BAD_PLUGIN_MVE
	bool "mve"

config BR2_PACKAGE_GST_PLUGINS_BAD_PLUGIN_MXF
	bool "mxf"

config BR2_PACKAGE_GST_PLUGINS_BAD_PLUGIN_NSF
	bool "nsf"

config BR2_PACKAGE_GST_PLUGINS_BAD_PLUGIN_NUVDEMUX
	bool "nuvdemux"

config BR2_PACKAGE_GST_PLUGINS_BAD_PLUGIN_PCAPPARSE
	bool "pcapparse"

config BR2_PACKAGE_GST_PLUGINS_BAD_PLUGIN_PNM
	bool "pnm"

config BR2_PACKAGE_GST_PLUGINS_BAD_PLUGIN_QTMUX
	bool "qtmux"

config BR2_PACKAGE_GST_PLUGINS_BAD_PLUGIN_RAWPARSE
	bool "rawparse"

config BR2_PACKAGE_GST_PLUGINS_BAD_PLUGIN_REAL
	bool "real"

config BR2_PACKAGE_GST_PLUGINS_BAD_PLUGIN_RTPMUX
	bool "rtpmux"

config BR2_PACKAGE_GST_PLUGINS_BAD_PLUGIN_SCALETEMPO
	bool "scaletempo"

config BR2_PACKAGE_GST_PLUGINS_BAD_PLUGIN_SDP
	bool "sdp"

config BR2_PACKAGE_GST_PLUGINS_BAD_PLUGIN_SEGMENTCLIP
	bool "segmentclip"

config BR2_PACKAGE_GST_PLUGINS_BAD_PLUGIN_SIREN
	bool "siren"

config BR2_PACKAGE_GST_PLUGINS_BAD_PLUGIN_SPEED
	bool "speed"

config BR2_PACKAGE_GST_PLUGINS_BAD_PLUGIN_SUBENC
	bool "subenc"

config BR2_PACKAGE_GST_PLUGINS_BAD_PLUGIN_STEREO
	bool "stereo"

config BR2_PACKAGE_GST_PLUGINS_BAD_PLUGIN_TTA
	bool "tta"

config BR2_PACKAGE_GST_PLUGINS_BAD_PLUGIN_VIDEOMAXRATE
	bool "videomaxrate"

config BR2_PACKAGE_GST_PLUGINS_BAD_PLUGIN_VIDEOMEASURE
	bool "videomeasure"

config BR2_PACKAGE_GST_PLUGINS_BAD_PLUGIN_VIDEOSIGNAL
	bool "videosignal"

config BR2_PACKAGE_GST_PLUGINS_BAD_PLUGIN_VMNC
	bool "vmnc"

config BR2_PACKAGE_GST_PLUGINS_BAD_PLUGIN_Y4M
	bool "y4m"

comment "plugins with external dependencies (there may be more available)"

config BR2_PACKAGE_GST_PLUGINS_BAD_PLUGIN_DIRECTFB
	bool "directfb"
	select BR2_PACKAGE_DIRECTFB

config BR2_PACKAGE_GST_PLUGINS_BAD_PLUGIN_DVB
	bool "dvb"

config BR2_PACKAGE_GST_PLUGINS_BAD_PLUGIN_FBDEV
	bool "fbdev"

config BR2_PACKAGE_GST_PLUGINS_BAD_PLUGIN_NEON
	bool "neon"
	select BR2_PACKAGE_NEON

config BR2_PACKAGE_GST_PLUGINS_BAD_PLUGIN_SDL
	bool "sdl"
	select BR2_PACKAGE_SDL

config BR2_PACKAGE_GST_PLUGINS_BAD_PLUGIN_VCD
	bool "vcd"

endif
```
