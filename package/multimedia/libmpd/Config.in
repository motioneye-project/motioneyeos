## package/multimedia/libmpd/Config.in
```kconfig
config BR2_PACKAGE_LIBMPD
	bool "libmpd"
	select BR2_PACKAGE_LIBGLIB2
	select BR2_PACKAGE_GETTEXT
	select BR2_PACKAGE_LIBINTL
	select BR2_PACKAGE_LIBICONV if !BR2_ENABLE_LOCALE
	select BR2_PACKAGE_PKGCONFIG
	help
	  High-level client library for accessing Music Player Daemon.
	  LibMpd is a library that provides high-level, callback-based
	  access to Music Player Daemon (mpd).

	  http://gmpcwiki.sarine.nl/index.php?title=Libmpd
```

## package/multimedia/libogg/Config.in
```kconfig
config BR2_PACKAGE_LIBOGG
	bool "libogg"
	help
	  Ogg is the name of Xiph.org's container format for audio,
	  video, and metadata
```

## package/multimedia/libreplaygain/Config.in
```kconfig
config BR2_PACKAGE_LIBREPLAYGAIN
	bool "libreplaygain"
	help
	  Replay Gain library from Musepack

	  http://www.musepack.net/
```

## package/multimedia/libtheora/Config.in
```kconfig
config BR2_PACKAGE_LIBTHEORA
	bool "libtheora"
	select BR2_PACKAGE_LIBOGG
	select BR2_PACKAGE_LIBVORBIS
	select BR2_PACKAGE_PKGCONFIG
	help
	  A library for the free and open video compression format "Theora"
	  from the Xiph.org Foundation.

	  http://www.theora.org/
```

## package/multimedia/libvpx/Config.in
```kconfig
config BR2_PACKAGE_LIBVPX
	bool "libvpx"
	help
	  A high-quality, open video format that's freely available to
	  everyone.

	  http://webmproject.org
```

## package/multimedia/mplayer/Config.in
```kconfig
config BR2_PACKAGE_MPLAYER
	bool "mplayer"
	help
	  MPlayer is a movie player which runs on many systems and supports
	  many different file formats.

	  http://www.mplayerhq.hu/

if BR2_PACKAGE_MPLAYER

config BR2_PACKAGE_MPLAYER_MPLAYER
	bool "Build and install mplayer"
	default y
	help
	  This will install the video player.

config BR2_PACKAGE_MPLAYER_MENCODER
	bool "Build and install mencoder"
	help
	  This will install the video encoder.

endif
```

## package/multimedia/portaudio/Config.in
```kconfig
config BR2_PACKAGE_PORTAUDIO
	bool "portaudio"
	help
	  PortAudio is a free, cross-platform, open-source,
	  audio I/O library.

	  http://www.portaudio.com/

if BR2_PACKAGE_PORTAUDIO

config BR2_PACKAGE_PORTAUDIO_ALSA
	bool "alsa support"
	select BR2_PACKAGE_ALSA_LIB
	default y
	help
	  Compile with ALSA support.

config BR2_PACKAGE_PORTAUDIO_OSS
	bool "oss support"
	help
	  Compile with OSS support.

config BR2_PACKAGE_PORTAUDIO_CXX
	bool "C++ bindings"
	depends on BR2_INSTALL_LIBSTDCPP
	help
	  Enables C++ bindings.

endif # BR2_PACKAGE_PORTAUDIO
```

## package/multimedia/pulseaudio/Config.in
```kconfig
config BR2_PACKAGE_PULSEAUDIO
	bool "pulseaudio"
	depends on BR2_USE_WCHAR
	select BR2_PACKAGE_LIBTOOL
	select BR2_PACKAGE_JSON_C
	select BR2_PACKAGE_LIBSNDFILE
	select BR2_PACKAGE_SPEEX
	select BR2_PACKAGE_LIBINTL if BR2_NEEDS_GETTEXT
	help
	  PulseAudio is a sound system for POSIX OSes, meaning that it
	  is a proxy for your sound applications. It allows you to do
	  advanced operations on your sound data as it passes between
	  your application and your hardware. Things like transferring
	  the audio to a different machine, changing the sample format
	  or channel count and mixing several sounds into one are
	  easily achieved using a sound server.

	  http://pulseaudio.org

comment "pulseaudio requires a toolchain with WCHAR support"
	depends on !BR2_USE_WCHAR
```

## package/multimedia/swfdec/Config.in
```kconfig
config BR2_PACKAGE_SWFDEC
	bool "swfdec"
	depends on BR2_USE_WCHAR # glib2
	depends on BR2_INSTALL_LIBSTDCPP # pango
	select BR2_PACKAGE_LIBOIL
	select BR2_PACKAGE_ALSA_LIB
	select BR2_PACKAGE_PANGO
	select BR2_PACKAGE_CAIRO
	select BR2_PACKAGE_CAIRO_PNG
	help
	  Library to play Flash files

	  http://swfdec.freedesktop.org/

config BR2_PACKAGE_SWFDEC_GTK_SUPPORT
	bool "gtk support"
	depends on BR2_PACKAGE_SWFDEC
	depends on BR2_PACKAGE_LIBGTK2
	select BR2_PACKAGE_LIBSOUP
	default y
	help
	  Swfdec-gtk library is used for easy integration
	  of swfdec in GTK applications

config BR2_PACKAGE_SWFDEC_GSTREAMER
	bool "gstreamer support"
	depends on BR2_PACKAGE_SWFDEC
	depends on BR2_PACKAGE_GSTREAMER
	select BR2_PACKAGE_GST_PLUGINS_BASE
	default y
	help
	  Enables GStreamer support

comment "swfdec requires a toolchain with WCHAR and C++ support"
	depends on !BR2_USE_WCHAR || !BR2_INSTALL_LIBSTDCPP
```

## package/multimedia/vlc/Config.in
```kconfig
config BR2_PACKAGE_VLC
	bool "vlc"
	# Improper ./configure options passed compared to the
        # multimedia libraries available in Buildroot.
	depends on BROKEN
	help
	  a free cross-platform media player

	  http://download.videolan.org/pub/videolan/vlc/0.8.6e
```

## package/murata-cyw-fw/Config.in
```kconfig
config BR2_PACKAGE_MURATA_CYW_FW
	bool "murata-cyw-fw"
	help
	  Murata Wireless firmware, NVRAM and Bluetooth HCD patch files.

	  https://github.com/murata-wireless/cyw-fmac-fw
	  https://github.com/murata-wireless/cyw-fmac-nvram
	  https://github.com/murata-wireless/cyw-bt-patch

if BR2_PACKAGE_MURATA_CYW_FW

config BR2_PACKAGE_MURATA_CYW_FW_CYW43012
	bool "CYW43012 (1LV)"
	help
	  Murata Wireless CYW43012 (1LV) module firmware files.

config BR2_PACKAGE_MURATA_CYW_FW_CYW43340
	bool "CYW43340/CYW43341 (1BW)"
	help
	  Murata Wireless CYW43340/CYW43341 (1BW) module firmware files.

config BR2_PACKAGE_MURATA_CYW_FW_CYW43362
	bool "CYW43362 (SN8000)"
	help
	  Murata Wireless CYW43362 (SN8000) module firmware files.

config BR2_PACKAGE_MURATA_CYW_FW_CYW4339
	bool "CYW4339 (1CK/ZP)"
	help
	  Murata Wireless CYW4339 (1CK/ZP) module firmware files.

choice
	prompt "CYW4339 module" if BR2_PACKAGE_MURATA_CYW_FW_CYW4339

config BR2_PACKAGE_MURATA_CYW_FW_CYW4339_1CK
	bool "1CK"

config BR2_PACKAGE_MURATA_CYW_FW_CYW4339_ZP
	bool "ZP"

endchoice

config BR2_PACKAGE_MURATA_CYW_FW_CYW43430
	bool "CYW43430/CYW4343W/CYW43364 (1DX/1FX/1LN)"
	help
	  Murata Wireless CYW43430/CYW4343W/CYW43364 (1DX/1FX/1LN)
	  module firmware files.

choice
	prompt "CYW43430/CYW4343W/CYW43364 module" if BR2_PACKAGE_MURATA_CYW_FW_CYW43430

config BR2_PACKAGE_MURATA_CYW_FW_CYW43430_1DX
	bool "1DX"

config BR2_PACKAGE_MURATA_CYW_FW_CYW43430_1FX
	bool "1FX"

config BR2_PACKAGE_MURATA_CYW_FW_CYW43430_1LN
	bool "1LN"

endchoice

config BR2_PACKAGE_MURATA_CYW_FW_CYW43455
	bool "CYW43455 (1HK/1LC/1MW)"
	help
	  Murata Wireless CYW43455 (1HK/1LC/1MW) module firmware files.

choice
	prompt "CYW43455 module" if BR2_PACKAGE_MURATA_CYW_FW_CYW43455

config BR2_PACKAGE_MURATA_CYW_FW_CYW43455_1HK
	bool "1HK"

config BR2_PACKAGE_MURATA_CYW_FW_CYW43455_1LC
	bool "1LC"

config BR2_PACKAGE_MURATA_CYW_FW_CYW43455_1MW
	bool "1MW"

endchoice

config BR2_PACKAGE_MURATA_CYW_FW_CYW4354
	bool "CYW4354 (1BB)"
	help
	  Murata Wireless CYW4354 (1BB) module firmware files.

config BR2_PACKAGE_MURATA_CYW_FW_CYW4356
	bool "CYW4356 (1CX)"
	help
	  Murata Wireless CYW4356 (1CX) module firmware files.

config BR2_PACKAGE_MURATA_CYW_FW_CYW4359
	bool "CYW4359 (1FD)"
	help
	  Murata Wireless CYW4359 (1FD) module firmware files.

endif
```

## package/musepack/Config.in
```kconfig
config BR2_PACKAGE_MUSEPACK
	bool "musepack"
	select BR2_PACKAGE_LIBCUEFILE
	select BR2_PACKAGE_LIBREPLAYGAIN
	help
	  Musepack is an audio compression format with a strong emphasis
	  on high quality. It's not lossless, but it is designed
	  for transparency, so that you won't be able to hear differences
	  between the original wave file and the much smaller MPC file.

	  http://www.musepack.net/
```

## package/musl-fts/Config.in
```kconfig
config BR2_PACKAGE_MUSL_FTS
	bool "musl-fts"
	depends on !BR2_TOOLCHAIN_USES_GLIBC
	help
	  The musl-fts package implements the fts(3) functions
	  fts_open, fts_read, fts_children, fts_set and fts_close,
	  which are missing in musl and uClibc-ng C libraries.

	  https://github.com/void-linux/musl-fts
```

## package/musl/Config.in
```kconfig
config BR2_PACKAGE_MUSL
	bool
	depends on BR2_TOOLCHAIN_USES_MUSL
	default y
	select BR2_PACKAGE_LINUX_HEADERS
	select BR2_TOOLCHAIN_HAS_SSP
	# Compatibility headers: cdefs.h, queue.h
	select BR2_PACKAGE_MUSL_COMPAT_HEADERS
```

## package/mutt/Config.in
```kconfig
config BR2_PACKAGE_MUTT
	bool "mutt"
	depends on BR2_USE_WCHAR
	depends on BR2_USE_MMU # fork()
	select BR2_PACKAGE_NCURSES
	help
	  Mutt is a sophisticated text-based Mail User Agent (MUA)

	  http://www.mutt.org/

if BR2_PACKAGE_MUTT

config BR2_PACKAGE_MUTT_IMAP
	bool "imap"
	help
	  IMAP support

config BR2_PACKAGE_MUTT_POP3
	bool "pop3"
	help
	  POP3 support

endif # BR2_PACKAGE_MUTT

comment "mutt needs a toolchain w/ wchar"
	depends on BR2_USE_MMU
	depends on !BR2_USE_WCHAR
```

## package/mxml/Config.in
```kconfig
config BR2_PACKAGE_MXML
	bool "Mini-XML"
	help
	  Lightweight XML Library

	  http://www.minixml.org
```

## package/mxsldr/Config.in.host
```kconfig
config BR2_PACKAGE_HOST_MXSLDR
	bool "host mxsldr"
	depends on BR2_arm || BR2_armeb
	help
	  This package contains tools to download and execute code on
	  Freescale i.MX23 and i.MX28 SoC's through the Serial
	  Download Protocol.

	  https://gitlab.denx.de/denx/mxsldr
```

## package/mysql/Config.in
```kconfig
config BR2_PACKAGE_MYSQL
	bool "MySQL"
	depends on BR2_INSTALL_LIBSTDCPP
	depends on BR2_USE_MMU # fork()
	depends on BR2_TOOLCHAIN_HAS_THREADS
	select BR2_PACKAGE_NCURSES
	select BR2_PACKAGE_READLINE
	help
	  The MySQL Open Source Database System

	  http://www.mysql.com/

if BR2_PACKAGE_MYSQL

config BR2_PACKAGE_MYSQL_SERVER
	bool "MySQL server"
	help
	  Install the MySQL server on the target.

endif

comment "MySQL needs a toolchain w/ C++, threads"
	depends on BR2_USE_MMU
	depends on !BR2_INSTALL_LIBSTDCPP || !BR2_TOOLCHAIN_HAS_THREADS
```

## package/mysql_client/Config.in
```kconfig
config BR2_PACKAGE_MYSQL_CLIENT
	bool "MySQL client"
	depends on BR2_INSTALL_LIBSTDCPP
	depends on BR2_USE_MMU # fork()
	depends on BR2_TOOLCHAIN_HAS_THREADS
	select BR2_PACKAGE_NCURSES
	select BR2_PACKAGE_READLINE
	help
	  MySQL client

comment "MySQL client needs a toolchain w/ C++, threads"
	depends on BR2_USE_MMU
	depends on !BR2_INSTALL_LIBSTDCPP || !BR2_TOOLCHAIN_HAS_THREADS
```

## package/nano/Config.in
```kconfig
config BR2_PACKAGE_NANO
	bool "nano"
	depends on BR2_USE_WCHAR
	# full version uses fork()
	select BR2_PACKAGE_NANO_TINY if !BR2_USE_MMU
	select BR2_PACKAGE_NCURSES
	help
	  A nice ncurses-based editor. Started out as a clone of pico.
	  Great editor for new users.

	  http://www.nano-editor.org/

if BR2_PACKAGE_NANO

config BR2_PACKAGE_NANO_TINY
	bool "optimize for size"
	default y
	help
	  Disable all features for the sake of size.

endif

comment "nano needs a toolchain w/ wchar"
	depends on !BR2_USE_WCHAR
```

## package/nanocom/Config.in
```kconfig
config BR2_PACKAGE_NANOCOM
	bool "nanocom"
	help
	  Nanocom is based upon microcom (http://microcom.port5.com/) but
	  removes the scripting and logging features while introducing support
	  for setting local/remote echo, parity and stop bits. It also follows
	  a more standard command line style using the getopt function.
	  Internally much of the code has been rewritten and reformatted, the
	  menu system in particular is almost entirely different.

	  http://nanocom.sourceforge.net/
```

## package/nanomsg/Config.in
```kconfig
config BR2_PACKAGE_NANOMSG
	bool "nanomsg"
	depends on BR2_TOOLCHAIN_HAS_THREADS
	help
	  nanomsg is a socket library that provides several common
	  communication patterns. It aims to make the networking layer
	  fast, scalable, and easy to use. Implemented in C, it works
	  on a wide range of operating systems with no further
	  dependencies.

	  http://nanomsg.org/

if BR2_PACKAGE_NANOMSG

config BR2_PACKAGE_NANOMSG_TOOLS
	bool "Build nanomsg tools"
	help
	  Build nanomsg tools

endif

comment "nanomsg needs a toolchain w/ threads"
	depends on !BR2_TOOLCHAIN_HAS_THREADS
```

## package/nbd/Config.in
```kconfig
config BR2_PACKAGE_NBD
	bool "nbd"
	depends on BR2_USE_WCHAR
	depends on BR2_TOOLCHAIN_HAS_THREADS
	depends on BR2_USE_MMU
	select BR2_PACKAGE_LIBGLIB2
	help
	  NBD is a set of utilities to configure network block devices,
	  allowing access to remote block devices over TCP/IP network.

	  http://nbd.sf.net/

if BR2_PACKAGE_NBD

config BR2_PACKAGE_NBD_CLIENT
	bool "nbd client"
	default y
	help
	  The client part of NBD.

config BR2_PACKAGE_NBD_SERVER
	bool "nbd server"
	help
	  The server part of NBD.

config BR2_PACKAGE_NBD_TRDUMP
	bool "nbd trdump"
	help
	  Utility to dump server logs in human-readable form.

endif

comment "nbd needs a toolchain w/ wchar, threads"
	depends on BR2_USE_MMU
	depends on !BR2_USE_WCHAR || !BR2_TOOLCHAIN_HAS_THREADS
```

## package/ncdu/Config.in
```kconfig
config BR2_PACKAGE_NCDU
	bool "ncdu"
	depends on BR2_USE_MMU # system()
	select BR2_PACKAGE_NCURSES
	help
	  ncdu is a disk usage analyzer with an ncurses interface

	  http://dev.yorhel.nl/ncdu
```
