## package/ncftp/Config.in
```kconfig
config BR2_PACKAGE_NCFTP
	bool "ncftp"
	# fork()
	depends on BR2_USE_MMU
	help
	  NcFTP Client (also known as just NcFTP) is a set of FREE application
	  programs implementing the File Transfer Protocol (FTP).

	  http://www.ncftp.com/ncftp/

if BR2_PACKAGE_NCFTP

config BR2_PACKAGE_NCFTP_GET
	bool "ncftpget"
	default y

config BR2_PACKAGE_NCFTP_PUT
	bool "ncftpput"
	default y

config BR2_PACKAGE_NCFTP_LS
	bool "ncftpls"
	default y

config BR2_PACKAGE_NCFTP_BATCH
	bool "ncftpbatch/ncftpspooler"
	default y

config BR2_PACKAGE_NCFTP_BOOKMARKS
	bool "ncftpbookmarks"
	select BR2_PACKAGE_NCURSES

endif
```

## package/ncmpc/Config.in
```kconfig
config BR2_PACKAGE_NCMPC
	bool "ncmpc"
	depends on BR2_USE_MMU # fork()
	depends on BR2_INSTALL_LIBSTDCPP
	depends on BR2_USE_WCHAR # boost
	depends on BR2_TOOLCHAIN_HAS_THREADS # boost
	depends on BR2_TOOLCHAIN_GCC_AT_LEAST_7 # C++17
	select BR2_PACKAGE_BOOST
	select BR2_PACKAGE_BOOST_SYSTEM
	select BR2_PACKAGE_LIBMPDCLIENT
	select BR2_PACKAGE_NCURSES
	help
	  ncmpc is a fully featured MPD client, which runs in a terminal
	  (using ncurses). Its goal is to provide a keyboard oriented
	  and consistent interface to MPD, without wasting resources.

	  http://www.musicpd.org/clients/ncmpc/

comment "ncmpc needs a toolchain w/ C++, wchar, threads, gcc >= 7"
	depends on BR2_USE_MMU
	depends on !BR2_INSTALL_LIBSTDCPP || !BR2_USE_WCHAR || \
		!BR2_TOOLCHAIN_HAS_THREADS || !BR2_TOOLCHAIN_GCC_AT_LEAST_7
```

## package/ncurses/Config.in
```kconfig
config BR2_PACKAGE_NCURSES
	bool "ncurses"
	help
	  The Ncurses (new curses) library is a free software
	  emulation of curses in System V Release 4.0, and more.

	  This package installs only a few vital termcap entries

	  http://www.gnu.org/software/ncurses/

if BR2_PACKAGE_NCURSES

config BR2_PACKAGE_NCURSES_WCHAR
	bool "enable wide char support"
	depends on BR2_USE_WCHAR
	help
	  Enable wide char & UTF-8 support in ncurses libraries

config BR2_PACKAGE_NCURSES_TARGET_PROGS
	bool "ncurses programs"
	help
	  Include ncurses programs in target (clear, reset, tput, ...)

config BR2_PACKAGE_NCURSES_ADDITIONAL_TERMINFO
	string "additional terminfo files to install"
	help
	  Whitespace separated list of terminfo files to install on the
	  target. A small number of vital terminfo files are always
	  installed. This list is in addition to the vital ones.

	  The terminfo filenames should have the single letter path
	  prefix. e.g. t/tmux.

endif
```

## package/ndisc6/Config.in
```kconfig
comment "ndisc6 needs a toolchain w/ IPv6"
	depends on BR2_USE_MMU
	depends on !BR2_INET_IPV6

config BR2_PACKAGE_NDISC6
	bool "ndisc6 tools"
	depends on BR2_INET_IPV6
	depends on BR2_USE_MMU # fork()
	select BR2_PACKAGE_GETTEXT if BR2_NEEDS_GETTEXT_IF_LOCALE
	help
	  NDisc6 is a small collection of useful tools for IPv6 networking

	  http://www.remlab.net/ndisc6/

if BR2_PACKAGE_NDISC6

config BR2_PACKAGE_NDISC6_NAME2ADDR
	bool "name2addr"
	help
	  name2addr perform DNS lookups from scripts.

config BR2_PACKAGE_NDISC6_NDISC6
	bool "ndisc6"
	help
	  ndisc6 performs ICMPv6 Neighbor Discovery in userland.

config BR2_PACKAGE_NDISC6_RDISC6
	bool "rdisc6"
	help
	  rdisc6 performs ICMPv6 Router Discovery in userland.

config BR2_PACKAGE_NDISC6_RDNSSD
	bool "rdnssd"
	help
	  IPv6 Recursive DNS Server discovery Daemon.

config BR2_PACKAGE_NDISC6_RLTRACEROUTE6
	bool "rltraceroute6"
	help
	  rltraceroute6 is an IPv6 traceroute implementation.

config BR2_PACKAGE_NDISC6_TCPTRACEROUTE6
	bool "tcptraceroute6"
	help
	  tcptraceroute6 is an TCP/IPv6 traceroute implementation.

config BR2_PACKAGE_NDISC6_TCPSPRAY
	bool "tcpspray"
	help
	  TCP/IP bandwidth measurement tool (Discard and Echo client).

endif
```

## package/ne10/Config.in
```kconfig
config BR2_PACKAGE_NE10_ARCH_SUPPORTS
	bool
	default y if BR2_aarch64
	default y if BR2_arm && (BR2_ARM_FPU_NEON || BR2_ARM_FPU_NEON_VFPV4)

config BR2_PACKAGE_NE10
	bool "ne10"
	depends on BR2_PACKAGE_NE10_ARCH_SUPPORTS
	help
	  The Ne10 project has been set up to provide a set of common,
	  useful functions which have been heavily optimized for the
	  ARM and AArch64 Architecture and provide consistent well
	  tested behavior that can be easily incorporated into
	  applications. C interfaces to the functions are provided for
	  both assembler and NEON implementations.

	  http://projectne10.github.io/Ne10/
```

## package/neard/Config.in
```kconfig
config BR2_PACKAGE_NEARD
	bool "neard"
	depends on BR2_USE_WCHAR # libglib2
	depends on BR2_TOOLCHAIN_HAS_THREADS # libnl, dbus, libglib2
	depends on BR2_USE_MMU # dbus, libglib2
	depends on !BR2_STATIC_LIBS # dlopen
	depends on BR2_TOOLCHAIN_HAS_SYNC_4
	select BR2_PACKAGE_DBUS
	select BR2_PACKAGE_LIBGLIB2
	select BR2_PACKAGE_LIBNL
	help
	  Near Field Communication (NFC) manager. This userspace
	  daemon is a part of the NFC stack provided by the Linux NFC
	  project.

	  http://git.kernel.org/?p=network/nfc/neard.git;a=summary

	  https://01.org/linux-nfc/

if BR2_PACKAGE_NEARD

config BR2_PACKAGE_NEARD_TOOLS
	bool "neard tools"
	help
	  Build and install neard tools.

endif

comment "neard needs a toolchain w/ wchar, threads, dynamic library"
	depends on BR2_USE_MMU
	depends on BR2_TOOLCHAIN_HAS_SYNC_4
	depends on !BR2_USE_WCHAR || !BR2_TOOLCHAIN_HAS_THREADS || BR2_STATIC_LIBS
```

## package/neardal/Config.in
```kconfig
config BR2_PACKAGE_NEARDAL
	bool "neardal"
	depends on BR2_USE_WCHAR # glib2
	depends on BR2_TOOLCHAIN_HAS_THREADS # dbus, glib2
	depends on BR2_USE_MMU # dbus
	select BR2_PACKAGE_DBUS
	select BR2_PACKAGE_DBUS_GLIB
	select BR2_PACKAGE_READLINE if !BR2_PACKAGE_LIBEDIT
	help
	  Provides a simple C API to exchange data with the neard NFC
	  manager daemon.

	  https://github.com/connectivity/neardal

if BR2_PACKAGE_NEARDAL

config BR2_PACKAGE_NEARDAL_NCL
	bool "ncl tool"
	help
	  Build and install neardal ncl command line interpreter tool.

endif

comment "neardal needs a toolchain w/ wchar, threads"
	depends on BR2_USE_MMU
	depends on !BR2_USE_WCHAR || !BR2_TOOLCHAIN_HAS_THREADS
```

## package/neon/Config.in
```kconfig
config BR2_PACKAGE_NEON
	bool "libneon"
	help
	  HTTP and WebDAV client library, with a C interface.

	  http://www.webdav.org/neon/

config BR2_PACKAGE_NEON_ZLIB
	bool "ZLIB support"
	depends on BR2_PACKAGE_NEON
	select BR2_PACKAGE_ZLIB
	help
	  build with ZLIB support

config BR2_PACKAGE_NEON_SSL
	bool "SSL support"
	depends on BR2_PACKAGE_NEON
	select BR2_PACKAGE_OPENSSL
	help
	  build with SSL support

choice
	prompt "XML Support"
	depends on BR2_PACKAGE_NEON
	help
	  Select which XML library to use...
	  none       do not build with XML support
	  expat      use expat
	  libxml2    use libxml2

config BR2_PACKAGE_NEON_NOXML
	bool "none"
	help
	  none       do not build with XML support

config BR2_PACKAGE_NEON_EXPAT
	bool "expat"
	select BR2_PACKAGE_EXPAT
	help
	  expat      use expat, a library for parsing XML.

config BR2_PACKAGE_NEON_LIBXML2
	bool "libxml2"
	select BR2_PACKAGE_LIBXML2
	help
	  libxml2    use libxml2, a library to read, modify and
	             write XML and HTML files.
endchoice
```

## package/net-tools/Config.in
```kconfig
config BR2_PACKAGE_NET_TOOLS
	bool "net-tools"
	depends on BR2_PACKAGE_BUSYBOX_SHOW_OTHERS
	help
	  A collection of programs that form the base set of the NET-3
	  networking distribution for the Linux operating system.
	  Includes: arp, hostname, ifconfig, netstat, rarp, route,
	  plipconfig, slattach, mii-tool, iptunnel and ipmaddr.

	  http://sourceforge.net/projects/net-tools/
```

## package/netatalk/Config.in
```kconfig
config BR2_PACKAGE_NETATALK
	bool "netatalk"
	depends on BR2_PACKAGE_LIBGPG_ERROR_ARCH_SUPPORTS # libgpg-error
	depends on BR2_TOOLCHAIN_HAS_THREADS
	depends on BR2_USE_MMU # fork()
	depends on !BR2_STATIC_LIBS
	select BR2_PACKAGE_BERKELEYDB
	select BR2_PACKAGE_OPENSSL
	select BR2_PACKAGE_LIBEVENT
	select BR2_PACKAGE_LIBGCRYPT
	select BR2_PACKAGE_LIBGPG_ERROR
	help
	  Netatalk can be used to turn a *NIX machine into an
	  extremely high-performance and reliable file server for
	  Macintosh computers.

	  http://netatalk.sourceforge.net/

comment "netatalk needs a toolchain w/ threads, dynamic library"
	depends on BR2_USE_MMU
	depends on !BR2_TOOLCHAIN_HAS_THREADS || BR2_STATIC_LIBS
```

## package/netcat-openbsd/Config.in
```kconfig
config BR2_PACKAGE_NETCAT_OPENBSD
	bool "netcat-openbsd"
	depends on BR2_PACKAGE_LIBBSD_ARCH_SUPPORTS
	depends on BR2_TOOLCHAIN_HAS_THREADS
	depends on BR2_TOOLCHAIN_USES_GLIBC
	depends on BR2_PACKAGE_BUSYBOX_SHOW_OTHERS
	depends on BR2_TOOLCHAIN_HEADERS_AT_LEAST_3_12
	select BR2_PACKAGE_LIBBSD
	help
	  A simple Unix utility which reads and writes data across
	  network connections using TCP or UDP protocol. It is
	  designed to be a reliable "back-end" tool that can be used
	  directly or easily driven by other programs and scripts. At
	  the same time it is a feature-rich network debugging and
	  exploration tool, since it can create almost any kind of
	  connection you would need and has several interesting
	  built-in capabilities.

	  This package contains the OpenBSD rewrite of netcat,
	  including support for IPv6, proxies, and Unix sockets.

	  https://packages.debian.org/sid/netcat-openbsd

comment "netcat-openbsd needs a glibc toolchain w/ threads, headers >= 3.12"
	depends on BR2_PACKAGE_LIBBSD_ARCH_SUPPORTS
	depends on !BR2_TOOLCHAIN_HAS_THREADS || !BR2_TOOLCHAIN_USES_GLIBC || \
		!BR2_TOOLCHAIN_HEADERS_AT_LEAST_3_12
	depends on BR2_PACKAGE_BUSYBOX_SHOW_OTHERS
```

## package/netcat/Config.in
```kconfig
config BR2_PACKAGE_NETCAT
	bool "netcat"
	depends on BR2_PACKAGE_BUSYBOX_SHOW_OTHERS
	help
	  Netcat is a featured networking utility which reads and writes data
	  across network connections, using the TCP/IP protocol.
	  It is designed to be a reliable "back-end" tool that can be used
	  directly or easily driven by other programs and scripts. At the
	  same time, it is a feature-rich network debugging and exploration
	  tool, since it can create almost any kind of connection you would
	  need and has several interesting built-in capabilities.

	  http://netcat.sourceforge.net/download.php
```

## package/netdata/Config.in
```kconfig
config BR2_PACKAGE_NETDATA
	bool "netdata"
	depends on BR2_TOOLCHAIN_HAS_THREADS_NPTL
	depends on BR2_USE_MMU # fork()
	depends on !BR2_STATIC_LIBS # libuv
	depends on BR2_TOOLCHAIN_HAS_SYNC_4 # libuv
	select BR2_PACKAGE_LIBUV
	select BR2_PACKAGE_UTIL_LINUX
	select BR2_PACKAGE_UTIL_LINUX_LIBUUID
	select BR2_PACKAGE_ZLIB
	help
	  Netdata is distributed, real-time, performance and health
	  monitoring for systems and applications. It is a highly
	  optimized monitoring agent you install on all your systems and
	  containers.

	  https://github.com/netdata/netdata

comment "netdata needs a toolchain w/ NPTL, dynamic library"
	depends on !BR2_TOOLCHAIN_HAS_THREADS_NPTL || BR2_STATIC_LIBS
	depends on BR2_USE_MMU
	depends on BR2_TOOLCHAIN_HAS_SYNC_4
```

## package/netifrc/Config.in
```kconfig
config BR2_PACKAGE_NETIFRC
	bool "netifrc"
	depends on BR2_PACKAGE_OPENRC
	help
	  netifrc is a collection of modules created to configure and
	  manage network interfaces via individual, per-interface
	  scripts.

	  https://wiki.gentoo.org/wiki/Netifrc

comment "netifrc needs openrc as init system"
	depends on !BR2_PACKAGE_OPENRC
```

## package/netkitbase/Config.in
```kconfig
config BR2_PACKAGE_NETKITBASE
	bool "netkitbase"
	depends on BR2_TOOLCHAIN_HAS_NATIVE_RPC
	depends on BR2_USE_MMU # fork()
	depends on BR2_DEPRECATED
	help
	  Old-style inetd.

	  ftp://ftp.uk.linux.org/pub/linux/Networking/netkit/

comment "netkitbase needs a toolchain w/ RPC"
	depends on BR2_USE_MMU && BR2_DEPRECATED
	depends on !BR2_TOOLCHAIN_HAS_NATIVE_RPC
```

## package/netkittelnet/Config.in
```kconfig
config BR2_PACKAGE_NETKITTELNET
	bool "netkittelnet"
	depends on BR2_TOOLCHAIN_HAS_NATIVE_RPC
	depends on BR2_DEPRECATED
	select BR2_PACKAGE_NETKITBASE
	help
	  Standard Linux telnet client and server.

	  ftp://ftp.uk.linux.org/pub/linux/Networking/netkit/

comment "netkittelnet needs a toolchain w/ RPC"
	depends on BR2_DEPRECATED
	depends on !BR2_TOOLCHAIN_HAS_NATIVE_RPC
```

## package/netperf/Config.in
```kconfig
config BR2_PACKAGE_NETPERF
	bool "netperf"
	help
	  Network performance benchmark tool

	  https://hewlettpackard.github.io/netperf/
```

## package/netplug/Config.in
```kconfig
config BR2_PACKAGE_NETPLUG
	bool "netplug"
	help
	  A Linux daemon that manages network interfaces in
	  response to network cables being plugged in and out.

	  http://www.red-bean.com/~bos/
```

## package/netsniff-ng/Config.in
```kconfig
config BR2_PACKAGE_NETSNIFF_NG
	bool "netsniff-ng"
	depends on BR2_TOOLCHAIN_HEADERS_AT_LEAST_3_0
	depends on BR2_TOOLCHAIN_HAS_THREADS
	depends on BR2_PACKAGE_LIBURCU_ARCH_SUPPORTS
	select BR2_PACKAGE_LIBNL
	select BR2_PACKAGE_LIBPCAP
	select BR2_PACKAGE_LIBNETFILTER_CONNTRACK
	select BR2_PACKAGE_LIBURCU
	help
	  netsniff-ng is a free, performant Linux network analyzer and
	  networking toolkit. If you will, the Swiss army knife for
	  network packets.

	  http://netsniff-ng.org

if BR2_PACKAGE_NETSNIFF_NG

config BR2_PACKAGE_NETSNIFF_NG_MAUSEZAHN
	bool "mausezahn"
	default y
	# Build with uClibc fails due to missing ceill()
	depends on !BR2_TOOLCHAIN_USES_UCLIBC
	select BR2_PACKAGE_LIBCLI
	select BR2_PACKAGE_LIBNET

comment "mausezahn needs glibc or musl toolchain"
	depends on BR2_TOOLCHAIN_USES_UCLIBC

endif

comment "netsniff-ng needs a toolchain w/ threads, headers >= 3.0"
	depends on BR2_PACKAGE_LIBURCU_ARCH_SUPPORTS
	depends on !BR2_TOOLCHAIN_HAS_THREADS  || \
			!BR2_TOOLCHAIN_HEADERS_AT_LEAST_3_0
```

## package/netsnmp/Config.in
```kconfig
config BR2_PACKAGE_NETSNMP
	bool "netsnmp"
	depends on BR2_USE_MMU # fork()
	help
	  Suite of applications used to implement SNMP v1, SNMP v2c, and
	  SNMP v3 using both IPv4 and IPv6.

	  http://net-snmp.sourceforge.net/

if BR2_PACKAGE_NETSNMP

config BR2_PACKAGE_NETSNMP_SERVER
	bool "server"
	default y
	help
	  The snmpd server.

config BR2_PACKAGE_NETSNMP_CLIENTS
	bool "clients"
	default y
	help
	  The net-snmp clients (snmpget, snmpwalk, etc).

config BR2_PACKAGE_NETSNMP_ENABLE_MIBS
	bool "Install MIB files on target and enable MIB loading code"
	default y
	help
	  The net-snmp package contains a selection of MIB files.
	  Say yes if you want those MIB files installed on the target
	  and enable the code that parses the MIB files.

config BR2_PACKAGE_NETSNMP_WITH_MIB_MODULES
	string "Build with these MIB modules"
	default "host ucd-snmp/dlmod agentx" if !BR2_STATIC_LIBS
	default "host agentx" if BR2_STATIC_LIBS
	help
	  Specify which MIB modules to include.

config BR2_PACKAGE_NETSNMP_WITHOUT_MIB_MODULES
	string "Build without these MIB modules"
	default "disman/event disman/schedule utilities"
	help
	  Specify which MIB modules to exclude.

config BR2_PACKAGE_NETSNMP_ENABLE_DEBUGGING
	bool "Enable debugging code"
	help
	  By default net-snmp is compiled without debugging support
	  (--disable-debugging). Enable this options if you need
	  debugging support, including the ability to log with
	  DEBUGMSG(), DEBUGMSGTL() and companion macros.

config BR2_PACKAGE_NETSNMP_OPENSSL_INTERNAL
	bool "Enable minimal internal OpenSSL code"
	depends on !BR2_PACKAGE_OPENSSL
	help
	  Enable a minimal internal copy of OpenSSL usable for USM
	  security. It will not enable the usage of SNMP over (D)TLS.

endif
```
