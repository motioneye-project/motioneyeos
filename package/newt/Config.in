## package/newt/Config.in
```kconfig
config BR2_PACKAGE_NEWT
	bool "newt"
	depends on BR2_USE_WCHAR
	depends on BR2_USE_MMU # slang
	depends on !BR2_STATIC_LIBS # unconditionally creates .so
	select BR2_PACKAGE_SLANG
	select BR2_PACKAGE_POPT
	help
	  Programming library for color text mode, widget based user
	  interfaces.

	  http://www.redhat.com/

comment "newt needs a toolchain w/ wchar, dynamic library"
	depends on BR2_USE_MMU
	depends on !BR2_USE_WCHAR || BR2_STATIC_LIBS
```

## package/nfacct/Config.in
```kconfig
config BR2_PACKAGE_NFACCT
	bool "nfacct"
	depends on BR2_LARGEFILE
	select BR2_PACKAGE_LIBNETFILTER_ACCT
	help
	  nfacct is the command line tool to create/retrieve/delete
	  netfilter accounting objects.

	  http://www.netfilter.org/projects/nfacct/

comment "nfacct needs a toolchain w/ largefile"
	depends on !BR2_LARGEFILE
```

## package/nfs-utils/Config.in
```kconfig
comment "nfs-utils needs a toolchain w/ threads"
	depends on BR2_USE_MMU
	depends on !BR2_TOOLCHAIN_HAS_THREADS

config BR2_PACKAGE_NFS_UTILS
	bool "nfs-utils"
	depends on BR2_TOOLCHAIN_HAS_THREADS # libtirpc, rpcbind
	depends on BR2_USE_MMU # fork()
	select BR2_PACKAGE_LIBTIRPC # IPv6 requires libtirpc
	select BR2_PACKAGE_RPCBIND # runtime
	help
	  The NFS Linux kernel server.

	  http://linux-nfs.org/

if BR2_PACKAGE_NFS_UTILS

config BR2_PACKAGE_NFS_UTILS_RPCDEBUG
	bool "rpcdebug"
	help
	  The RPC debugging utility

config BR2_PACKAGE_NFS_UTILS_RPC_LOCKD
	bool "rpc.lockd"
	help
	  NFS lock manager for Linux kernels older than 2.4

config BR2_PACKAGE_NFS_UTILS_RPC_NFSD
	bool "rpc.nfsd"
	default y
	help
	  NFS server

config BR2_PACKAGE_NFS_UTILS_RPC_RQUOTAD
	bool "rpc.rquotad"
	help
	  NFS remote quota server

endif
```

## package/nftables/Config.in
```kconfig
config BR2_PACKAGE_NFTABLES
	bool "nftables"
	depends on BR2_USE_WCHAR
	depends on BR2_TOOLCHAIN_HEADERS_AT_LEAST_3_12
	select BR2_PACKAGE_GMP
	select BR2_PACKAGE_LIBMNL
	select BR2_PACKAGE_LIBNFTNL
	help
	  nftables is the project that aims to replace the existing
	  {ip,ip6,arp,eb}tables framework.
	  Basically, this project provides a new packet filtering framework,
	  a new userspace utility and also a compatibility layer
	  for {ip,ip6}tables.

	  http://www.netfilter.org/projects/nftables/index.html

comment "nftables needs a toolchain w/ wchar, headers >= 3.12"
	depends on !BR2_USE_WCHAR || !BR2_TOOLCHAIN_HEADERS_AT_LEAST_3_12
```

## package/ng-spice-rework/Config.in
```kconfig
config BR2_PACKAGE_NG_SPICE_REWORK
	bool "ng-spice-rework"
	depends on BR2_PACKAGE_XORG7
	select BR2_PACKAGE_XLIB_LIBXAW
	help
	  Ngspice is a mixed-level/mixed-signal circuit simulator.

	  http://superb-west.dl.sourceforge.net/sourceforge/ngspice
```

## package/nghttp2/Config.in
```kconfig
config BR2_PACKAGE_NGHTTP2
	bool "nghttp2"
	help
	  nghttp2 is an implementation of HTTP/2 and its header
	  compression algorithm HPACK in C.

	  https://nghttp2.org/
```

## package/nginx-dav-ext/Config.in
```kconfig
config BR2_PACKAGE_NGINX_DAV_EXT
	bool "nginx-dav-ext"
	depends on BR2_PACKAGE_NGINX_HTTP_DAV_MODULE
	select BR2_PACKAGE_EXPAT
	help
	  NGINX WebDAV missing commands support (PROPFIND & OPTIONS).

	  https://github.com/arut/nginx-dav-ext-module
```

## package/nginx-modsecurity/Config.in
```kconfig
config BR2_PACKAGE_NGINX_MODSECURITY
	bool "nginx-modsecurity"
	depends on BR2_PACKAGE_NGINX_HTTP
	depends on BR2_INSTALL_LIBSTDCPP # libmodsecurity
	depends on !BR2_STATIC_LIBS # libmodsecurity
	depends on BR2_TOOLCHAIN_HAS_THREADS # libmodsecurity
	select BR2_PACKAGE_PCRE # libmodsecurity
	select BR2_PACKAGE_LIBMODSECURITY
	help
	  The ModSecurity-nginx connector is the connection
	  point between nginx and libmodsecurity
	  (ModSecurity v3).

	  https://github.com/SpiderLabs/ModSecurity-nginx

comment "nginx-modsecurity needs a toolchain w/ C++, dynamic library, threads"
	depends on BR2_PACKAGE_NGINX_HTTP
	depends on !BR2_INSTALL_LIBSTDCPP || BR2_STATIC_LIBS || \
		!BR2_TOOLCHAIN_HAS_THREADS
```

## package/nginx-upload/Config.in
```kconfig
config BR2_PACKAGE_NGINX_UPLOAD
	bool "nginx-upload"
	select BR2_PACKAGE_OPENSSL
	help
	  A module for nginx web server for handling file uploads
	  using multipart/form-data encoding (RFC 1867).

	  https://github.com/vkholodkov/nginx-upload-module
```

## package/nginx/Config.in
```kconfig
comment "nginx needs a toolchain w/ largefile"
	depends on !BR2_LARGEFILE
	depends on BR2_USE_MMU # fork()

menuconfig BR2_PACKAGE_NGINX
	bool "nginx"
	depends on BR2_LARGEFILE
	depends on BR2_USE_MMU # fork()
	help
	  nginx is an HTTP and reverse proxy server, as well as a mail proxy
	  server.

	  http://nginx.org/

if BR2_PACKAGE_NGINX

config BR2_PACKAGE_NGINX_FILE_AIO
	bool "file AIO support"
	# Does not build, because nginx hardcodes using SYS_eventfd,
	# but it's available on neither AArch64 nor ARC where only
	# eventfd() is available.  See
	# https://bugs.launchpad.net/linaro-aarch64/+bug/1160013
	depends on !BR2_aarch64
	depends on !BR2_arc

config BR2_PACKAGE_NGINX_HTTP
	bool "http server"
	default y

if BR2_PACKAGE_NGINX_HTTP

config BR2_PACKAGE_NGINX_HTTP_CACHE
	bool "http cache support"
	select BR2_PACKAGE_OPENSSL

comment "http modules"

config BR2_PACKAGE_NGINX_HTTP_SSL_MODULE
	bool "ngx_http_ssl_module"
	select BR2_PACKAGE_OPENSSL
	help
	  Enable ngx_http_ssl_module

config BR2_PACKAGE_NGINX_HTTP_SPDY_MODULE
	bool "ngx_http_spdy_module"
	select BR2_PACKAGE_ZLIB
	help
	  Enable ngx_http_spdy_module

config BR2_PACKAGE_NGINX_HTTP_REALIP_MODULE
	bool "ngx_http_realip_module"
	help
	  Enable ngx_http_realip_module

config BR2_PACKAGE_NGINX_HTTP_ADDITION_MODULE
	bool "ngx_http_addition_module"
	help
	  Enable ngx_http_addition_module

config BR2_PACKAGE_NGINX_HTTP_XSLT_MODULE
	bool "ngx_http_xslt_module"
	select BR2_PACKAGE_LIBXML2
	select BR2_PACKAGE_LIBXSLT
	help
	  Enable ngx_http_xslt_module

config BR2_PACKAGE_NGINX_HTTP_IMAGE_FILTER_MODULE
	bool "ngx_http_image_filter_module"
	select BR2_PACKAGE_GD
	select BR2_PACKAGE_JPEG
	select BR2_PACKAGE_LIBPNG
	help
	  Enable ngx_http_image_filter_module

config BR2_PACKAGE_NGINX_HTTP_SUB_MODULE
	bool "ngx_http_sub_module"
	help
	  Enable ngx_http_sub_module

config BR2_PACKAGE_NGINX_HTTP_DAV_MODULE
	bool "ngx_http_dav_module"
	help
	  Enable ngx_http_dav_module

config BR2_PACKAGE_NGINX_HTTP_FLV_MODULE
	bool "ngx_http_flv_module"
	help
	  Enable ngx_http_flv_module

config BR2_PACKAGE_NGINX_HTTP_MP4_MODULE
	bool "ngx_http_mp4_module"
	help
	  Enable ngx_http_mp4_module

config BR2_PACKAGE_NGINX_HTTP_GUNZIP_MODULE
	bool "ngx_http_gunzip_module"
	select BR2_PACKAGE_ZLIB
	help
	  Enable ngx_http_gunzip_module

config BR2_PACKAGE_NGINX_HTTP_GZIP_STATIC_MODULE
	bool "ngx_http_gzip_static_module"
	select BR2_PACKAGE_ZLIB
	help
	  Enable ngx_http_gzip_static_module

config BR2_PACKAGE_NGINX_HTTP_AUTH_REQUEST_MODULE
	bool "ngx_http_auth_request_module"
	help
	  Enable ngx_http_auth_request_module

config BR2_PACKAGE_NGINX_HTTP_RANDOM_INDEX_MODULE
	bool "ngx_http_random_index_module"
	help
	  Enable ngx_http_random_index_module

config BR2_PACKAGE_NGINX_HTTP_SECURE_LINK_MODULE
	bool "ngx_http_secure_link_module"
	select BR2_PACKAGE_OPENSSL
	help
	  Enable ngx_http_secure_link_module

config BR2_PACKAGE_NGINX_HTTP_DEGRADATION_MODULE
	bool "ngx_http_degradation_module"
	help
	  Enable ngx_http_degradation_module

config BR2_PACKAGE_NGINX_HTTP_STUB_STATUS_MODULE
	bool "ngx_http_stub_status_module"
	help
	  Enable ngx_http_stub_status_module

config BR2_PACKAGE_NGINX_HTTP_CHARSET_MODULE
	bool "ngx_http_charset_module"
	default y
	help
	  Enable ngx_http_charset_module

config BR2_PACKAGE_NGINX_HTTP_GZIP_MODULE
	bool "ngx_http_gzip_module"
	select BR2_PACKAGE_ZLIB
	default y
	help
	  Enable ngx_http_gzip_module

config BR2_PACKAGE_NGINX_HTTP_SSI_MODULE
	bool "ngx_http_ssi_module"
	default y
	help
	  Enable ngx_http_ssi_module

config BR2_PACKAGE_NGINX_HTTP_USERID_MODULE
	bool "ngx_http_userid_module"
	default y
	help
	  Enable ngx_http_userid_module

config BR2_PACKAGE_NGINX_HTTP_ACCESS_MODULE
	bool "ngx_http_access_module"
	default y
	help
	  Enable ngx_http_access_module

config BR2_PACKAGE_NGINX_HTTP_AUTH_BASIC_MODULE
	bool "ngx_http_auth_basic_module"
	default y
	help
	  Enable ngx_http_auth_basic_module

config BR2_PACKAGE_NGINX_HTTP_AUTOINDEX_MODULE
	bool "ngx_http_autoindex_module"
	default y
	help
	  Enable ngx_http_autoindex_module

config BR2_PACKAGE_NGINX_HTTP_GEO_MODULE
	bool "ngx_http_geo_module"
	default y
	help
	  Enable ngx_http_geo_module

config BR2_PACKAGE_NGINX_HTTP_MAP_MODULE
	bool "ngx_http_map_module"
	default y
	help
	  Enable ngx_http_map_module

config BR2_PACKAGE_NGINX_HTTP_SPLIT_CLIENTS_MODULE
	bool "ngx_http_split_clients_module"
	default y
	help
	  Enable ngx_http_split_clients_module

config BR2_PACKAGE_NGINX_HTTP_REFERER_MODULE
	bool "ngx_http_referer_module"
	default y
	help
	  Enable ngx_http_referer_module

config BR2_PACKAGE_NGINX_HTTP_REWRITE_MODULE
	bool "ngx_http_rewrite_module"
	select BR2_PACKAGE_PCRE
	default y
	help
	  Enable ngx_http_rewrite_module

config BR2_PACKAGE_NGINX_HTTP_PROXY_MODULE
	bool "ngx_http_proxy_module"
	default y
	help
	  Enable ngx_http_proxy_module

config BR2_PACKAGE_NGINX_HTTP_FASTCGI_MODULE
	bool "ngx_http_fastcgi_module"
	default y
	help
	  Enable ngx_http_fastcgi_module

config BR2_PACKAGE_NGINX_HTTP_UWSGI_MODULE
	bool "ngx_http_uwsgi_module"
	default y
	help
	  Enable ngx_http_uwsgi_module

config BR2_PACKAGE_NGINX_HTTP_SCGI_MODULE
	bool "ngx_http_scgi_module"
	default y
	help
	  Enable ngx_http_scgi_module

config BR2_PACKAGE_NGINX_HTTP_MEMCACHED_MODULE
	bool "ngx_http_memcached_module"
	default y
	help
	  Enable ngx_http_memcached_module

config BR2_PACKAGE_NGINX_HTTP_LIMIT_CONN_MODULE
	bool "ngx_http_limit_conn_module"
	default y
	help
	  Enable ngx_http_limit_conn_module

config BR2_PACKAGE_NGINX_HTTP_LIMIT_REQ_MODULE
	bool "ngx_http_limit_req_module"
	default y
	help
	  Enable ngx_http_limit_req_module

config BR2_PACKAGE_NGINX_HTTP_EMPTY_GIF_MODULE
	bool "ngx_http_empty_gif_module"
	default y
	help
	  Enable ngx_http_empty_gif_module

config BR2_PACKAGE_NGINX_HTTP_BROWSER_MODULE
	bool "ngx_http_browser_module"
	default y
	help
	  Enable ngx_http_browser_module

config BR2_PACKAGE_NGINX_HTTP_UPSTREAM_IP_HASH_MODULE
	bool "ngx_http_upstream_ip_hash_module"
	default y
	help
	  Enable ngx_http_upstream_ip_hash_module

config BR2_PACKAGE_NGINX_HTTP_UPSTREAM_LEAST_CONN_MODULE
	bool "ngx_http_upstream_least_conn_module"
	default y
	help
	  Enable ngx_http_upstream_least_conn_module

config BR2_PACKAGE_NGINX_HTTP_UPSTREAM_KEEPALIVE_MODULE
	bool "ngx_http_upstream_keepalive_module"
	default y
	help
	  Enable ngx_http_upstream_keepalive_module

endif #BR2_PACKAGE_NGINX_HTTP

config BR2_PACKAGE_NGINX_MAIL
	bool "mail proxy modules"

if BR2_PACKAGE_NGINX_MAIL

config BR2_PACKAGE_NGINX_MAIL_SSL_MODULE
	bool "ngx_mail_ssl_module"
	select BR2_PACKAGE_OPENSSL
	help
	  Enable ngx_mail_ssl_module

config BR2_PACKAGE_NGINX_MAIL_POP3_MODULE
	bool "ngx_mail_pop3_module"
	default y
	help
	  Enable ngx_mail_pop3_module

config BR2_PACKAGE_NGINX_MAIL_IMAP_MODULE
	bool "ngx_mail_imap_module"
	default y
	help
	  Enable ngx_mail_imap_module

config BR2_PACKAGE_NGINX_MAIL_SMTP_MODULE
	bool "ngx_mail_smtp_module"
	default y
	help
	  Enable ngx_mail_smtp_module

endif #BR2_PACKAGE_NGINX_MAIL

comment "misc. modules"

config BR2_PACKAGE_NGINX_SELECT_MODULE
	bool "ngx_select_module"
	help
	  Enable ngx_select_module

config BR2_PACKAGE_NGINX_POLL_MODULE
	bool "ngx_poll_module"
	help
	  Enable ngx_poll_module

config BR2_PACKAGE_NGINX_ADD_MODULES
	string "additional modules"
	help
	  Space separated list of urls of the additional modules

endif
```

## package/ngircd/Config.in
```kconfig
config BR2_PACKAGE_NGIRCD
	bool "ngircd"
	depends on BR2_USE_MMU # fork()
	help
	  Next Generation IRC server deamon.

	  http://ngircd.barton.de
```

## package/ngrep/Config.in
```kconfig
config BR2_PACKAGE_NGREP
	bool "ngrep"
	select BR2_PACKAGE_LIBPCAP
	select BR2_PACKAGE_PCRE
	help
	  Network grep.

	  http://ngrep.sourceforge.net/
```

## package/nilfs-utils/Config.in
```kconfig
config BR2_PACKAGE_NILFS_UTILS
	bool "nilfs-utils"
	depends on BR2_USE_MMU # util-linux libmount, libblkid
	depends on BR2_TOOLCHAIN_HAS_THREADS # sem_open()
	select BR2_PACKAGE_UTIL_LINUX_LIBUUID
	select BR2_PACKAGE_UTIL_LINUX_LIBBLKID
	select BR2_PACKAGE_UTIL_LINUX_LIBMOUNT
	select BR2_PACKAGE_UTIL_LINUX
	help
	  Tools for creating and managing NILFS2 filesystems.

	  https://nilfs.sourceforge.io

comment "nilfs-utils needs a toolchain w/ threads"
	depends on BR2_USE_MMU
	depends on !BR2_TOOLCHAIN_HAS_THREADS
```

## package/nload/Config.in
```kconfig
comment "nload needs a toolchain w/ C++"
	depends on !BR2_INSTALL_LIBSTDCPP

config BR2_PACKAGE_NLOAD
	bool "nload"
	depends on BR2_INSTALL_LIBSTDCPP
	select BR2_PACKAGE_NCURSES
	help
	  nload is a console application which monitors network traffic
	  and bandwidth usage in real time. It visualizes the in- and
	  outgoing traffic using two graphs and provides additional info
	  like total amount of transfered data and min/max network
	  usage.

	  http://www.roland-riegel.de/nload/
```

## package/nmap/Config.in
```kconfig
config BR2_PACKAGE_NMAP
	bool "nmap"
	depends on BR2_INSTALL_LIBSTDCPP
	depends on BR2_USE_MMU # fork()
	depends on BR2_TOOLCHAIN_HAS_THREADS
	select BR2_PACKAGE_LIBLINEAR
	select BR2_PACKAGE_LIBPCAP
	select BR2_PACKAGE_NMAP_NMAP \
	       if !BR2_PACKAGE_NMAP_NCAT && !BR2_PACKAGE_NMAP_NPING && !BR2_PACKAGE_NMAP_NDIFF
	help
	  Nmap ("Network Mapper") is a free and open source (license)
	  utility for network discovery and security auditing.

	  http://nmap.org

if  BR2_PACKAGE_NMAP

config BR2_PACKAGE_NMAP_NCAT
	bool "install ncat"
	depends on BR2_PACKAGE_BUSYBOX_SHOW_OTHERS
	help
	  Ncat is a feature-packed networking utility which reads and
	  writes data across networks from the command line. Ncat was
	  written for the Nmap Project as a much-improved
	  reimplementation of the venerable Netcat.

	  If symlink to "nc" is installed if neither netcat or
	  netcat-openbsd is selected.

comment "a symlink from ncat to 'nc' will be installed"
	depends on BR2_PACKAGE_NMAP_NCAT
	depends on !BR2_PACKAGE_NETCAT
	depends on !BR2_PACKAGE_NETCAT_OPENBSD

config BR2_PACKAGE_NMAP_NDIFF
	bool "install ndiff"
	# ndiff only works with python2.x
	depends on BR2_PACKAGE_PYTHON
	help
	  This option installs the 'ndiff' tool.

comment "ndiff needs Python 2.x"
	depends on !BR2_PACKAGE_PYTHON

config BR2_PACKAGE_NMAP_NMAP
	bool "install nmap"
	select BR2_PACKAGE_PCRE
	help
	  This option installs 'nmap' itself.

config BR2_PACKAGE_NMAP_NPING
	bool "install nping"
	help
	  This option installs the 'nping' tool.

endif

comment "nmap-nmap needs a toolchain w/ C++, threads"
	depends on BR2_USE_MMU
	depends on !(BR2_INSTALL_LIBSTDCPP && BR2_TOOLCHAIN_HAS_THREADS)
```

## package/nmon/Config.in
```kconfig
config BR2_PACKAGE_NMON
	bool "nmon"
	depends on BR2_TOOLCHAIN_USES_GLIBC # fstab.h
	select BR2_PACKAGE_NCURSES
	help
	  Nmon is short for Nigel's performance Monitor for Linux

	  http://nmon.sourceforge.net/pmwiki.php

comment "nmon needs a glibc toolchain"
	depends on !BR2_TOOLCHAIN_USES_GLIBC
```
