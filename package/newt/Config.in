## package/nodejs/Config.in
```kconfig
config BR2_PACKAGE_NODEJS_ARCH_SUPPORTS
	bool
	# On ARM, at least ARMv6+ with VFPv2+ is needed
	default y if BR2_arm && !BR2_ARM_CPU_ARMV4 && !BR2_ARM_CPU_ARMV5 && BR2_ARM_CPU_HAS_VFPV2
	default y if BR2_mipsel && !BR2_MIPS_SOFT_FLOAT
	default y if BR2_aarch64 || BR2_i386 || BR2_x86_64

comment "nodejs needs a toolchain w/ C++, dynamic library, threads, gcc >= 4.8, wchar"
	depends on BR2_USE_MMU
	depends on BR2_PACKAGE_NODEJS_ARCH_SUPPORTS
	depends on !BR2_INSTALL_LIBSTDCPP || BR2_STATIC_LIBS || !BR2_TOOLCHAIN_HAS_THREADS || \
		!BR2_HOST_GCC_AT_LEAST_4_8 || !BR2_TOOLCHAIN_GCC_AT_LEAST_4_8 || !BR2_USE_WCHAR

config BR2_PACKAGE_NODEJS
	bool "nodejs"
	depends on BR2_TOOLCHAIN_HAS_THREADS
	depends on BR2_INSTALL_LIBSTDCPP
	depends on BR2_PACKAGE_NODEJS_ARCH_SUPPORTS
	depends on BR2_HOST_GCC_AT_LEAST_4_8
	depends on BR2_TOOLCHAIN_GCC_AT_LEAST_4_8
	depends on BR2_USE_WCHAR
	# uses fork()
	depends on BR2_USE_MMU
	# uses dlopen(). On ARMv5, we could technically support static
	# linking, but that's too much of a corner case to support it.
	depends on !BR2_STATIC_LIBS
	select BR2_PACKAGE_C_ARES
	select BR2_PACKAGE_LIBHTTPPARSER
	select BR2_PACKAGE_ZLIB
	help
	  Event-driven I/O server-side JavaScript environment based on V8.

	  http://nodejs.org/

if BR2_PACKAGE_NODEJS

config BR2_PACKAGE_NODEJS_NPM
	bool "NPM for the target"
	select BR2_PACKAGE_OPENSSL
	help
	  NPM is the package manager for the Node JavaScript platform.
	  Note that enabling NPM on the target also selects OpenSSL for the
	  target.

	  http://www.npmjs.org

	  Note that NPM is always built for the buildroot host.

config BR2_PACKAGE_NODEJS_MODULES_ADDITIONAL
	string "Additional modules"
	help
	  List of space-separated nodejs modules to install via npm.
	  See https://npmjs.org/ to find modules and 'npm help install'
	  for available installation methods. For repeatable builds,
	  download and save tgz files or clone git repos for the
	  components you care about.

	  Example: serialport uglify-js@1.3.4 /my/module/mymodule.tgz git://github.com/someuser/somemodule.git#v1.2

	  This would install the serialport module (at the newest version),
	  the uglify-js module at 1.3.4, a module from a filesystem path,
	  and a module from a git repository.

config BR2_PACKAGE_NODEJS_MODULES_ADDITIONAL_DEPS
	string "Additional module dependencies"
	help
	  List of space-separated buildroot recipes which must be built before
	  your npms can be installed. For example, if in 'Additional modules'
	  you specified 'node-curl' (see:
	  https://github.com/jiangmiao/node-curl), you could then specify
	  'libcurl' here, to ensure that buildroot builds the libcurl package,
	  and does so before building your node modules.

endif
```

## package/nodm/Config.in
```kconfig
config BR2_PACKAGE_NODM
	bool "nodm"
	depends on BR2_PACKAGE_XORG7
	depends on (BR2_ENABLE_LOCALE && BR2_USE_WCHAR) # linux-pam
	depends on !BR2_STATIC_LIBS # linux-pam
	depends on !BR2_TOOLCHAIN_USES_MUSL # linux-pam
	depends on BR2_USE_MMU # linux-pam
	select BR2_PACKAGE_XLIB_LIBX11
	select BR2_PACKAGE_LINUX_PAM
	help
	  nodm is a minimal display manager that simply logs in
	  as a given user and starts an X session, without asking
	  for username or password.

	  For those cases where automatic login is needed (and
	  does not imply a security issue), nodm is simple to setup,
	  lightweight, and it should do exactly the right thing.

	  https://github.com/spanezz/nodm/

comment "nodm needs a glibc or uClibc toolchain w/ wchar, locale, dynamic library"
	depends on BR2_PACKAGE_XORG7
	depends on !(BR2_ENABLE_LOCALE && BR2_USE_WCHAR) \
		|| BR2_STATIC_LIBS || BR2_TOOLCHAIN_USES_MUSL
```

## package/noip/Config.in
```kconfig
config BR2_PACKAGE_NOIP
	bool "noip"
	help
	  Dynamic DNS update client for no-ip.com

	  http://www.no-ip.com/downloads.php
```

## package/nss-mdns/Config.in
```kconfig
config BR2_PACKAGE_NSS_MDNS
	bool "nss-mdns"
	# libdaemon->avahi uses fork()
	depends on BR2_USE_MMU
	depends on BR2_TOOLCHAIN_USES_GLIBC
	depends on BR2_PACKAGE_AVAHI_DAEMON
	help
	  nss-mdns is a plugin for the GNU Name Service Switch (NSS)
	  functionality of the GNU C Library (glibc) providing host
	  name resolution via Multicast DNS (aka Zeroconf, aka Apple
	  Rendezvous, aka Apple Bonjour), effectively allowing name
	  resolution by common Unix/Linux programs in the ad-hoc
	  mDNS domain .local.

	  http://0pointer.de/lennart/projects/nss-mdns/

comment "nss-mdns needs an (e)glibc toolchain"
	depends on BR2_USE_MMU && BR2_PACKAGE_AVAHI_DAEMON
	depends on !BR2_TOOLCHAIN_USES_GLIBC
```

## package/nss-myhostname/Config.in
```kconfig
config BR2_PACKAGE_NSS_MYHOSTNAME
	bool "nss-myhostname"
	depends on BR2_TOOLCHAIN_USES_GLIBC
	depends on !BR2_PACKAGE_SYSTEMD_MYHOSTNAME
	help
	  Name Service Switch module for resolving the local hostname

	  http://0pointer.de/lennart/projects/nss-myhostname

comment "nss-myhostname needs a glibc toolchain"
	depends on !BR2_TOOLCHAIN_USES_GLIBC
	depends on !BR2_PACKAGE_SYSTEMD_MYHOSTNAME
```

## package/nss-pam-ldapd/Config.in
```kconfig
config BR2_PACKAGE_NSS_PAM_LDAPD
	bool "nss-pam-ldapd"
	depends on BR2_TOOLCHAIN_USES_GLIBC
	select BR2_PACKAGE_OPENLDAP
	help
	  Name Service Switch (NSS) module that allows your LDAP
	  server to provide user account, group, host name, alias,
	  netgroup, and basically any other information that you would
	  normally get from /etc flat files or NIS. It also provides a
	  Pluggable Authentication Module (PAM) to do authentication
	  to an LDAP server.

	  http://arthurdejong.org/nss-pam-ldapd/

if BR2_PACKAGE_NSS_PAM_LDAPD

config BR2_PACKAGE_NSS_PAM_LDAPD_UTILITIES
	bool "nss-pam-ldapd utilities"
	help
	  Build/Install command-line utilities.

endif

comment "nss-pam-ldapd needs an (e)glibc toolchain"
	depends on !BR2_TOOLCHAIN_USES_GLIBC
```

## package/ntfs-3g/Config.in
```kconfig
config BR2_PACKAGE_NTFS_3G
	bool "ntfs-3g"
	depends on BR2_USE_WCHAR
	depends on BR2_TOOLCHAIN_HAS_THREADS
	depends on BR2_USE_MMU
	depends on !BR2_STATIC_LIBS
	help
	  The NTFS-3G driver is an open source, freely available
	  read/write NTFS driver for Linux, FreeBSD, Mac OS X, NetBSD,
	  and Haiku. It provides safe and fast handling of the Windows
	  XP, Windows Server 2003, Windows 2000 and Windows Vista file
	  systems. Most POSIX file system operations are supported, with
	  the exception of full file ownership and access right support.

	  http://www.ntfs-3g.org/

if BR2_PACKAGE_NTFS_3G

config BR2_PACKAGE_NTFS_3G_ENCRYPTED
	bool "encrypted volumes"
	depends on BR2_PACKAGE_LIBGPG_ERROR_ARCH_SUPPORTS # libgcrypt
	select BR2_PACKAGE_GNUTLS
	select BR2_PACKAGE_LIBGCRYPT
	help
	  Enable support for NTFS encrypted volumes.

config BR2_PACKAGE_NTFS_3G_NTFSPROGS
	bool "ntfsprogs"
	help
	  Install NTFS utilities.

endif

comment "ntfs-3g needs a toolchain w/ wchar, threads, dynamic library"
	depends on BR2_USE_MMU
	depends on !BR2_USE_WCHAR || !BR2_TOOLCHAIN_HAS_THREADS || BR2_STATIC_LIBS
```

## package/ntfsprogs/Config.in
```kconfig
config BR2_PACKAGE_NTFSPROGS
	bool "ntfsprogs"
	depends on BR2_USE_WCHAR
	depends on BR2_LARGEFILE
	depends on BR2_DEPRECATED
	help
	  wide collection of NTFS utilities

	  http://www.linux-ntfs.org/

comment "ntfsprogs requires a toolchain with WCHAR and LARGEFILE support"
	depends on !BR2_USE_WCHAR || !BR2_LARGEFILE
```

## package/ntp/Config.in
```kconfig
config BR2_PACKAGE_NTP
	bool "ntp"
	select BR2_PACKAGE_LIBEVENT
	help
	  Network Time Protocol suite/programs.
	  Provides things like ntpd, ntpdate, ntpq, etc...

	  http://www.ntp.org/

if BR2_PACKAGE_NTP

config BR2_PACKAGE_NTP_SNTP
	bool "sntp"
	help
	  Simple network time protocol program

config BR2_PACKAGE_NTP_NTP_KEYGEN
	bool "ntp-keygen"
	help
	  Create a NTP host key

config BR2_PACKAGE_NTP_NTP_SHM_CLK
	bool "SHM clock support"
	help
	  Compile ntp with support for a SHM clock attached through
	  shared memory.

config BR2_PACKAGE_NTP_NTP_WAIT
	bool "ntp-wait"
	depends on BR2_PACKAGE_PERL
	help
	  ntp-wait waits until the locally running ntpd is in state 4
	  (synchronized). This could be useful at boot time, to delay the
	  boot sequence until after "ntpd -g" has set the time.

config BR2_PACKAGE_NTP_NTPD
	bool "ntpd"
	default y
	help
	  ntpd is the time synchronization daemon keeping your local
	  system date and time in sync and optionally serving time and date
	  information on the network via the NTP protocol.

config BR2_PACKAGE_NTP_NTPD_ATOM_PPS
	bool "PPS support"
	depends on BR2_PACKAGE_NTP_NTPD
	select BR2_PACKAGE_PPS_TOOLS
	help
	  Compile ntpd with the ability to use an ATOM PPS source.

config BR2_PACKAGE_NTP_NTPDATE
	bool "ntpdate"
	help
	  The ntpdate utility program is used to set the local date and time
	  from an NTP server given as an argument.

config BR2_PACKAGE_NTP_NTPDC
	bool "ntpdc"
	help
	  The ntpdc utility program is used to query an NTP daemon about
	  its current state and to request changes in that state.

config BR2_PACKAGE_NTP_NTPQ
	bool "ntpq"
	help
	  The ntpq utility program is used to query NTP servers requesting
	  information about current state and/or changes in that state.

config BR2_PACKAGE_NTP_NTPSNMPD
	bool "ntpsnmpd"
	depends on BR2_USE_MMU # netsnmp fork()
	select BR2_PACKAGE_NETSNMP
	help
	  Install ntpsnmpd NTP SNMP MIB agent.

config BR2_PACKAGE_NTP_NTPTIME
	bool "ntptime"
	help
	  The ntptime utility program is used to read and set kernel time
	  variables.

config BR2_PACKAGE_NTP_NTPTRACE
	bool "ntptrace"
	depends on BR2_PACKAGE_PERL
	help
	  ntptrace is a perl script that uses the ntpq utility program to
	  follow the chain of NTP servers from a given host back to the
	  primary time source

config BR2_PACKAGE_NTP_TICKADJ
	bool "tickadj"
	help
	  set time-related kernel variables

endif
```
