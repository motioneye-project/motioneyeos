## package/omniorb/Config.in
```kconfig
comment "omniORB needs a toolchain w/ C++, threads"
	depends on !BR2_INSTALL_LIBSTDCPP || !BR2_TOOLCHAIN_HAS_THREADS

config BR2_PACKAGE_OMNIORB
	bool "omniorb"
	depends on BR2_INSTALL_LIBSTDCPP
	depends on BR2_TOOLCHAIN_HAS_THREADS
	help
	  omniORB is a robust high performance CORBA ORB for C++ and Python.
	  omniORB is largely CORBA 2.6 compliant. omniORB is one of only
	  three ORBs to have been awarded the Open Group's Open Brand for
	  CORBA. This means that omniORB has been tested and certified
	  CORBA compliant, to version 2.1 of the CORBA specification.

	  http://omniorb.sourceforge.net/

if BR2_PACKAGE_OMNIORB

config BR2_PACKAGE_OMNIORB_WITH_APPS
	bool "Enable Apps and Services"
	help
	  omniORB applications and services disabled by default
	  embedded system build configuration.

endif
```

## package/omxplayer/Config.in
```kconfig
config BR2_PACKAGE_OMXPLAYER
	bool "omxplayer"
	depends on BR2_arm
	depends on BR2_USE_MMU # dbus
	depends on BR2_PACKAGE_FFMPEG_ARCH_SUPPORTS # ffmpeg
	depends on BR2_INSTALL_LIBSTDCPP # boost
	depends on BR2_TOOLCHAIN_HAS_THREADS # boost, libusb
	depends on BR2_USE_WCHAR # boost
	depends on BR2_PACKAGE_RPI_USERLAND
	select BR2_PACKAGE_BOOST
	select BR2_PACKAGE_DBUS
	select BR2_PACKAGE_FFMPEG
	select BR2_PACKAGE_FFMPEG_AVRESAMPLE
	select BR2_PACKAGE_FFMPEG_SWSCALE
	select BR2_PACKAGE_FREETYPE
	select BR2_PACKAGE_LIBIDN
	select BR2_PACKAGE_LIBUSB
	select BR2_PACKAGE_PCRE
	select BR2_PACKAGE_ZLIB
	help
	  OMXPlayer is a commandline OMX player for the Raspberry Pi. It was
	  developed as a testbed for the XBMC Raspberry PI implementation
	  and is quite handy to use standalone.

	  https://github.com/popcornmix/omxplayer

comment "omxplayer needs rpi-userland and a toolchain w/ C++, threads, wchar, dynamic library"
	depends on BR2_arm
	depends on BR2_USE_MMU
	depends on BR2_PACKAGE_FFMPEG_ARCH_SUPPORTS
	depends on !BR2_PACKAGE_RPI_USERLAND
	depends on !BR2_INSTALL_LIBSTDCPP || !BR2_TOOLCHAIN_HAS_THREADS \
		|| !BR2_USE_WCHAR || BR2_STATIC_LIBS
```

## package/on2-8170-libs/Config.in
```kconfig
config BR2_PACKAGE_ON2_8170_LIBS
	#This is a binary only package which has been compiled for glibc
	depends on BR2_arm926t
	depends on BR2_TOOLCHAIN_USES_GLIBC
	depends on BR2_LINUX_KERNEL # on2-8170-modules
	select BR2_PACKAGE_ON2_8170_MODULES # runtime
	bool "on2-8170-libs"
	help
	  Libraries for Hantro X170 video decoder

	  http://www.at91.com/linux4sam/bin/view/Linux4SAM/SAM9M10Gstreamer

comment "on2-8170-libs needs a glibc toolchain and a Linux kernel to be built"
	depends on BR2_arm926t
	depends on !BR2_LINUX_KERNEL || !BR2_TOOLCHAIN_USES_GLIBC
```

## package/on2-8170-modules/Config.in
```kconfig
config BR2_PACKAGE_ON2_8170_MODULES
	bool "on2-8170-modules"
	depends on BR2_LINUX_KERNEL
	depends on BR2_arm926t
	help
	  Kernel modules for Hantro x170 hardware video decompression
	  support.

	  http://www.at91.com/linux4sam/bin/view/Linux4SAM/SAM9M10Gstreamer

comment "on2-8170-modules needs a Linux kernel to be built"
	depends on BR2_arm926t
	depends on !BR2_LINUX_KERNEL
```

## package/oniguruma/Config.in
```kconfig
config BR2_PACKAGE_ONIGURUMA
	bool "oniguruma"
	help
	  Oniguruma is a modern and flexible regular expressions
	  library. It encompasses features from different regular
	  expression implementations that traditionally exist in
	  different languages.

	  https://github.com/kkos/oniguruma
```

## package/open-lldp/Config.in
```kconfig
config BR2_PACKAGE_OPEN_LLDP
	bool "open-lldp"
	depends on !BR2_STATIC_LIBS # dlfcn.h
	depends on BR2_TOOLCHAIN_HAS_THREADS # libnl
	select BR2_PACKAGE_LIBCONFIG
	select BR2_PACKAGE_LIBNL
	select BR2_PACKAGE_READLINE
	help
	  This package contains the Linux user space daemon and
	  configuration tool for Intel LLDP Agent with Enhanced Ethernet
	  support for the Data Center.

	  http://open-lldp.org/

comment "open-lldp needs a toolchain w/ dynamic library, threads"
	depends on BR2_STATIC_LIBS || !BR2_TOOLCHAIN_HAS_THREADS
```
