## package/numactl/Config.in
```kconfig
config BR2_PACKAGE_NUMACTL
	bool "numactl"
	# numactl uses some system calls that are not available on all
	# architectures.
	depends on BR2_LARGEFILE
	depends on BR2_i386 || BR2_mips || BR2_mipsel || \
		   BR2_mips64 || BR2_mips64el || BR2_powerpc || BR2_x86_64
	help
	  numactl allows you to run your application on specific cpus
	  and memory nodes. It does this by supplying a NUMA memory
	  policy to the operating system before running your program.

	  http://oss.sgi.com/projects/libnuma/

comment "numactl requires a toolchain with LARGEFILE support"
	depends on !BR2_LARGEFILE
```

## package/nut/Config.in
```kconfig
comment "nut needs a toolchain w/ C++"
	depends on BR2_USE_MMU
	depends on !BR2_INSTALL_LIBSTDCPP

config BR2_PACKAGE_NUT
	bool "nut"
	depends on BR2_USE_MMU # fork()
	depends on BR2_INSTALL_LIBSTDCPP
	help
	  Network UPS tools

	  The primary goal of the Network UPS Tools (NUT) project is
	  to provide support for Power Devices, such as
	  Uninterruptible Power Supplies, Power Distribution Units and
	  Solar Controllers.

	  http://www.networkupstools.org/

if BR2_PACKAGE_NUT

config BR2_PACKAGE_NUT_DRIVERS
	string "drivers"
	help
	  Select the individual drivers to enable, in a
	  comma-separated list. Leave empty for all.

endif # BR2_PACKAGE_NUT
```

## package/nuttcp/Config.in
```kconfig
config BR2_PACKAGE_NUTTCP
	bool "nuttcp"
	depends on BR2_USE_MMU # fork()
	help
	  nuttcp is a TCP/UDP network testing tool, much like iperf

	  http://nuttcp.net
```

## package/nvidia-driver/Config.in
```kconfig
comment "nvidia-driver needs a glibc toolchain"
	depends on BR2_i386 || BR2_x86_64
	depends on !BR2_TOOLCHAIN_USES_GLIBC

config BR2_PACKAGE_NVIDIA_DRIVER
	bool "nvidia-driver"
	depends on BR2_i386 || BR2_x86_64
	depends on BR2_TOOLCHAIN_USES_GLIBC
	help
	  The binary-only driver blob for NVidia cards.
	  This is the userland part only.

	  http://www.nvidia.com/

if BR2_PACKAGE_NVIDIA_DRIVER

comment "nvidia-driver X.org drivers needs a modular Xorg server"
	depends on !BR2_PACKAGE_XSERVER_XORG_SERVER_MODULAR

config BR2_PACKAGE_NVIDIA_DRIVER_XORG
	bool "X.org drivers"
	default y
	depends on BR2_PACKAGE_XSERVER_XORG_SERVER_MODULAR
	select BR2_PACKAGE_MESA3D_HEADERS
	select BR2_PACKAGE_XLIB_LIBX11
	select BR2_PACKAGE_XLIB_LIBXEXT
	select BR2_PACKAGE_HAS_LIBGL
	select BR2_PACKAGE_HAS_LIBEGL
	select BR2_PACKAGE_HAS_LIBEGL_WAYLAND
	select BR2_PACKAGE_HAS_LIBGLES

if BR2_PACKAGE_NVIDIA_DRIVER_XORG

config BR2_PACKAGE_PROVIDES_LIBGL
	default "nvidia-driver"

config BR2_PACKAGE_PROVIDES_LIBEGL
	default "nvidia-driver"

config BR2_PACKAGE_PROVIDES_LIBGLES
	default "nvidia-driver"

config BR2_PACKAGE_NVIDIA_DRIVER_PRIVATE_LIBS
	bool "Install private libraries"
	help
	  Two libraries require special agreement with NVidia to
	  develop code linking to those libraries: libnvidia-ifr.so
	  and libnvidia-fbc.so (to grab and encode an OpenGL buffer or
	  an X framebuffer.)

	  Say 'y' here if you plan on running a program that uses
	  those private libraries.

endif # BR2_PACKAGE_NVIDIA_DRIVER_XORG

config BR2_PACKAGE_NVIDIA_DRIVER_CUDA
	bool "CUDA support"

if BR2_PACKAGE_NVIDIA_DRIVER_CUDA

config BR2_PACKAGE_NVIDIA_DRIVER_OPENCL
	bool "OpenCL support"
	select BR2_PACKAGE_MESA3D_HEADERS
	select BR2_PACKAGE_HAS_LIBOPENCL

config BR2_PACKAGE_PROVIDES_LIBOPENCL
	default "nvidia-driver" if BR2_PACKAGE_NVIDIA_DRIVER_OPENCL

config BR2_PACKAGE_NVIDIA_DRIVER_CUDA_PROGS
	bool "CUDA MPS server and control"
	help
	  Say 'y' here if you need to run more than one program
	  doing CUDA at the same time. The MPS server will be
	  launched automatically when needed.

endif # BR2_PACKAGE_NVIDIA_DRIVER_CUDA

comment "nvidia kernel module needs a kernel to be built"
	depends on !BR2_LINUX_KERNEL

config BR2_PACKAGE_NVIDIA_DRIVER_MODULE
	bool "nvidia kernel module"
	depends on BR2_LINUX_KERNEL
	select BR2_LINUX_NEEDS_MODULES # not using kernel-module infra
	help
	  Build the nvidia.ko kernel module.

	  If CUDA support (above) is set, and the target is x86_64, then
	  this will also build the nvidia-uvm.ko kernel module, which
	  provides Unified Memory access to the GPU and CPU memories for
	  CUDA programs.

endif # BR2_PACKAGE_NVIDIA_DRIVER
```

## package/nvidia-tegra23/Config.in
```kconfig
menuconfig BR2_PACKAGE_NVIDIA_TEGRA23
	bool "nvidia-tegra23"
	depends on BR2_cortex_a9
	depends on BR2_ARM_EABIHF && BR2_TOOLCHAIN_USES_GLIBC
	depends on BR2_PACKAGE_XORG7
	depends on BR2_PACKAGE_XSERVER_XORG_SERVER_VIDEODRV_ABI_14
	help
	  Install NVidia proprietary blobs to drive Tegra2 or Tegra3
	  GPUs found in some mobile-targeted ARM SoCs.

if BR2_PACKAGE_NVIDIA_TEGRA23

choice
	prompt "Tegra platform"
	help
	  Select the SOC platform.

config BR2_PACKAGE_NVIDIA_TEGRA23_TEGRA2
	bool "Tegra 2"
	help
	  NVIDIA Tegra 2 is a dual-core Cortex-A9 without NEON.

config BR2_PACKAGE_NVIDIA_TEGRA23_TEGRA3
	bool "Tegra 3"
	depends on BR2_ARM_CPU_HAS_NEON
	help
	  NVIDIA Tegra 3 is a quad-core Cortex-A9 with NEON.

endchoice

source "package/nvidia-tegra23/nvidia-tegra23-binaries/Config.in"
source "package/nvidia-tegra23/nvidia-tegra23-codecs/Config.in"
endif

comment "nvidia-tegra23 needs Xorg <= 1.14 and a glibc toolchain w/ EABIhf"
	depends on BR2_cortex_a9
	depends on !BR2_ARM_EABIHF || !BR2_TOOLCHAIN_USES_GLIBC \
		|| !BR2_PACKAGE_XORG7 || !BR2_PACKAGE_XSERVER_XORG_SERVER_VIDEODRV_ABI_14
```

## package/nvidia-tegra23/nvidia-tegra23-binaries/Config.in
```kconfig
config BR2_PACKAGE_NVIDIA_TEGRA23_BINARIES
	bool "nvidia-tegra23 binaries"
	select BR2_PACKAGE_MESA3D_HEADERS
	select BR2_PACKAGE_XLIB_LIBX11
	select BR2_PACKAGE_XLIB_LIBXEXT
	select BR2_PACKAGE_HAS_LIBEGL
	select BR2_PACKAGE_HAS_LIBGLES
	select BR2_PACKAGE_HAS_LIBOPENMAX
	help
	  Those packages provide libraries, drivers and firmware that
	  comes from NVIDIA Linux For Tegra.

	  https://developer.nvidia.com/linux-tegra

if BR2_PACKAGE_NVIDIA_TEGRA23_BINARIES

config BR2_PACKAGE_PROVIDES_LIBEGL
	default "nvidia-tegra23-binaries"

config BR2_PACKAGE_PROVIDES_LIBGLES
	default "nvidia-tegra23-binaries"

config BR2_PACKAGE_PROVIDES_LIBOPENMAX
	default "nvidia-tegra23-binaries"

endif
```

## package/nvidia-tegra23/nvidia-tegra23-codecs/Config.in
```kconfig
config BR2_PACKAGE_NVIDIA_TEGRA23_CODECS
	bool "nvidia-tegra23 codecs"
	depends on BR2_PACKAGE_NVIDIA_TEGRA23_BINARIES
	help
	  NVIDIA Tegra restricted codecs from Linux For Tegra 16.5.

	  https://developer.nvidia.com/linux-tegra-rel-16
```

## package/nvme/Config.in
```kconfig
config BR2_PACKAGE_NVME
	bool "nvme"
	help
	  NVME utility, a utility for interacting with standard NVM
	  Express (optimized PCI Express SSD interface) devices.

	  https://github.com/linux-nvme/nvme-cli
```

## package/ocf-linux/Config.in
```kconfig
config BR2_PACKAGE_OCF_LINUX
	bool "ocf-linux"
	help
	  OCF-Linux is a Linux port of the OpenBSD/FreeBSD Cryptographic
	  Framework (OCF). This port aims to bring full asynchronous HW/SW
	  crypto acceleration to the Linux kernel and applications
	  running under Linux.

	  You need to enable the OCF linux kernel extension or provide
	  a prepatched kernel to make this option useful.

	  http://ocf-linux.sourceforge.net/
```

## package/ocrad/Config.in
```kconfig
config BR2_PACKAGE_OCRAD
	bool "ocrad"
	depends on BR2_INSTALL_LIBSTDCPP
	help
	  GNU Ocrad is an OCR (Optical Character Recognition) program
	  based on a feature extraction method.
	  It reads images in pbm (bitmap), pgm (greyscale) or
	  ppm (color) formats and produces text in byte (8-bit) or
	  UTF-8 formats.

	  http://www.gnu.org/software/ocrad/

comment "ocrad needs a toolchain with C++ support"
	depends on !BR2_INSTALL_LIBSTDCPP
```

## package/odhcp6c/Config.in
```kconfig
config BR2_PACKAGE_ODHCP6C
	bool "odhcp6c"
	depends on BR2_USE_MMU # fork()
	help
	  odhcp6c is a minimal DHCPv6 and RA-client for use in
	  embedded Linux systems, especially routers.

	  https://git.openwrt.org/project/odhcp6c.git
```

## package/odhcploc/Config.in
```kconfig
config BR2_PACKAGE_ODHCPLOC
	bool "odhcploc"
	help
	  Open DHCP Locate (ODHCPLoc) is program to locate and
	  display active DHCP servers on a subnet.
	  Can be used to scan for rogue DHCP servers.

	  http://odhcploc.sourceforge.net/
```

## package/odroid-mali/Config.in
```kconfig
config BR2_PACKAGE_ODROID_MALI
	bool "odroid-mali"
	depends on BR2_TOOLCHAIN_USES_GLIBC
	depends on BR2_aarch64 || BR2_ARM_EABIHF
	select BR2_PACKAGE_HAS_LIBEGL
	select BR2_PACKAGE_HAS_LIBGLES
	select BR2_PACKAGE_ODROID_SCRIPTS # runtime
	help
	  Install the ARM Mali drivers for odroidc2 based systems.

	  https://github.com/mdrjr/c2_mali

if BR2_PACKAGE_ODROID_MALI

config BR2_PACKAGE_PROVIDES_LIBEGL
	default "odroid-mali"

config BR2_PACKAGE_PROVIDES_LIBGLES
	default "odroid-mali"

endif

config BR2_PACKAGE_ODROID_MALI_X11
	bool
	depends on BR2_aarch64 # No 32 bit version available
	select BR2_PACKAGE_LIBDRM
	select BR2_PACKAGE_XLIB_LIBX11
	select BR2_PACKAGE_XLIB_LIBXDAMAGE
	select BR2_PACKAGE_XLIB_LIBXEXT
	select BR2_PACKAGE_XLIB_LIBXFIXES

comment "odroid-mali needs a glibc toolchain"
	depends on BR2_aarch64 || BR2_ARM_EABIHF
	depends on !BR2_TOOLCHAIN_USES_GLIBC
```

## package/odroid-scripts/Config.in
```kconfig
config BR2_PACKAGE_ODROID_SCRIPTS
	bool "odroid-scripts"
	depends on BR2_aarch64 || BR2_arm
	help
	  Install the scripts for the odroidc2 based systems.

	  https://github.com/mdrjr/c2_bootini
```

## package/ofono/Config.in
```kconfig
config BR2_PACKAGE_OFONO
	bool "ofono"
	depends on BR2_USE_WCHAR # gettext, libglib2
	depends on BR2_TOOLCHAIN_HAS_THREADS # dbus, libglib2
	depends on BR2_USE_MMU # dbus, libglib2
	depends on !BR2_TOOLCHAIN_EXTERNAL_CODESOURCERY_NIOSII # libcap-ng
	depends on !BR2_STATIC_LIBS # dlopen()
	depends on BR2_TOOLCHAIN_HAS_SYNC_4
	select BR2_PACKAGE_LIBCAP_NG
	select BR2_PACKAGE_DBUS
	select BR2_PACKAGE_LIBGLIB2
	select BR2_PACKAGE_MOBILE_BROADBAND_PROVIDER_INFO
	help
	  oFono is a free, open source project for mobile telephony
	  (GSM/UMTS) applications. It uses high-level D-Bus API for
	  use by telephony applications. It uses 3GPP standard.

	  http://ofono.org/

comment "ofono needs a toolchain w/ dynamic library, wchar, threads"
	depends on BR2_USE_MMU
	depends on BR2_TOOLCHAIN_HAS_SYNC_4
	depends on BR2_STATIC_LIBS || !BR2_USE_WCHAR || !BR2_TOOLCHAIN_HAS_THREADS
	depends on !BR2_TOOLCHAIN_EXTERNAL_CODESOURCERY_NIOSII
```

## package/ogre/Config.in
```kconfig
config BR2_PACKAGE_OGRE
	bool "ogre"
	depends on BR2_PACKAGE_HAS_LIBGL # libglu
	depends on BR2_PACKAGE_XORG7
	depends on BR2_INSTALL_LIBSTDCPP
	depends on BR2_TOOLCHAIN_HAS_THREADS
	depends on BR2_TOOLCHAIN_GCC_AT_LEAST_4_8 # C++11
	depends on !BR2_STATIC_LIBS
	depends on BR2_USE_MMU
	depends on BR2_USE_WCHAR # use wchar_t
	select BR2_PACKAGE_FREETYPE
	select BR2_PACKAGE_LIBFREEIMAGE
	select BR2_PACKAGE_LIBGLU # GL/glu.h
	select BR2_PACKAGE_SDL2
	select BR2_PACKAGE_SDL2_OPENGL
	select BR2_PACKAGE_SDL2_X11 # use wmInfo.info.x11
	select BR2_PACKAGE_XLIB_LIBX11
	select BR2_PACKAGE_XLIB_LIBXAW
	select BR2_PACKAGE_XLIB_LIBXEXT
	select BR2_PACKAGE_XLIB_LIBXRANDR
	select BR2_PACKAGE_ZZIPLIB
	help
	  OGRE is a scene-oriented, flexible 3D engine written in C++
	  designed to make it easier and more intuitive for developers
	  to produce games and demos utilising 3D hardware. The class
	  library abstracts all the details of using the underlying
	  system libraries like Direct3D and OpenGL and provides an
	  interface based on world objects and other intuitive classes.

	  https://ogrecave.github.io/ogre

comment "ogre needs X11 and an OpenGL provider"
	depends on !BR2_PACKAGE_HAS_LIBGL || !BR2_PACKAGE_XORG7
	depends on BR2_TOOLCHAIN_HAS_THREADS && BR2_TOOLCHAIN_GCC_AT_LEAST_4_8 \
		&& BR2_INSTALL_LIBSTDCPP && !BR2_STATIC_LIBS && BR2_USE_WCHAR
	depends on BR2_USE_MMU

comment "ogre needs a toolchain w/ C++, dynamic library, gcc >= 4.8, threads, wchar"
	depends on !BR2_INSTALL_LIBSTDCPP || !BR2_TOOLCHAIN_GCC_AT_LEAST_4_8 \
		|| BR2_STATIC_LIBS || !BR2_TOOLCHAIN_HAS_THREADS \
		|| !BR2_USE_WCHAR
	depends on BR2_USE_MMU
```

## package/ola/Config.in
```kconfig
comment "ola needs a toolchain w/ C++, threads, largefile, wchar"
	depends on !BR2_INSTALL_LIBSTDCPP || !BR2_LARGEFILE || !BR2_USE_WCHAR || !BR2_TOOLCHAIN_HAS_THREADS

config BR2_PACKAGE_OLA
	bool "ola (open lighting architecture)"
	select BR2_PACKAGE_PROTOBUF
	select BR2_PACKAGE_UTIL_LINUX_LIBUUID
	select BR2_PACKAGE_UTIL_LINUX
	depends on BR2_INSTALL_LIBSTDCPP # protobuf
	depends on BR2_LARGEFILE # util-linux
	depends on BR2_USE_WCHAR # util-linux
	depends on BR2_TOOLCHAIN_HAS_THREADS
	help
	  Open Lighting Architecture provides applications
	  with a mechanism to send and receive DMX512 & RDM
	  commands using hardware devices and DMX over IP protocols.

	  http://www.opendmx.net/index.php/OLA

if BR2_PACKAGE_OLA

menu "bindings and interface"

config BR2_PACKAGE_OLA_WEB
	bool "http interface"
	select BR2_PACKAGE_LIBMICROHTTPD
	help
	  Build OLA with browser interface.

config BR2_PACKAGE_OLA_PYTHON_BINDINGS
	bool "python bindings"
	select BR2_PACKAGE_PYTHON
	select BR2_PACKAGE_PYTHON_PROTOBUF
	depends on BR2_USE_MMU
	help
	  Build OLA with support for the Python language.

config BR2_PACKAGE_OLA_SLP
	bool "slp tools"
	help
	  Build OLA with slp tools.

endmenu

menu "tests and examples"

config BR2_PACKAGE_OLA_EXAMPLES
	bool "examples"
	select BR2_PACKAGE_NCURSES
	help
	  Build OLA examples.

config BR2_PACKAGE_OLA_RDM_TESTS
	bool "rdm tests"
	select BR2_PACKAGE_OLA_PYTHON_BINDINGS
	depends on BR2_USE_MMU
	help
	  Build OLA RDM tests.

endmenu

menu "plugin selections"

config BR2_PACKAGE_OLA_PLUGIN_E131
	bool "acn E131"
	help
	  Build ACN E131 plugin for OLA.

config BR2_PACKAGE_OLA_PLUGIN_ARTNET
	bool "artnet"
	help
	  Build Artnet plugin for OLA.

config BR2_PACKAGE_OLA_PLUGIN_OPENDMX
	bool "DMX4Linux"
	help
	  Build DMX4Linux plugin for OLA.

config BR2_PACKAGE_OLA_PLUGIN_DUMMY
	bool "dummy"
	help
	  Build Dummy plugin for OLA.

config BR2_PACKAGE_OLA_PLUGIN_ESPNET
	bool "espnet"
	help
	  Build EspNet plugin for OLA.

config BR2_PACKAGE_OLA_PLUGIN_KINET
	bool "kinet"
	help
	  Build KiNet plugin for OLA.

config BR2_PACKAGE_OLA_PLUGIN_MILINT
	bool "Milford Instruments"
	help
	  Build Milford Instruments 1-463 plugin for OLA.

config BR2_PACKAGE_OLA_PLUGIN_OSC
	bool "osc"
	select BR2_PACKAGE_LIBLO
	help
	  Build Open Sound Control plugin for OLA.

config BR2_PACKAGE_OLA_PLUGIN_PATHPORT
	bool "pathport"
	help
	  Build Pathport plugin for OLA.

config BR2_PACKAGE_OLA_PLUGIN_SANDNET
	bool "sandnet"
	help
	  Build SandNet plugin for OLA.

config BR2_PACKAGE_OLA_PLUGIN_SHOWNET
	bool "shownet"
	help
	  Build ShowNet plugin for OLA.

config BR2_PACKAGE_OLA_PLUGIN_STAGEPROFI
	bool "stageprofi"
	select BR2_PACKAGE_LIBUSB
	help
	  Build StageProfi plugin for OLA.

config BR2_PACKAGE_OLA_PLUGIN_USBPRO
	bool "usbpro"
	select BR2_PACKAGE_LIBUSB
	help
	  Build UsbPro plugin for OLA.

endmenu

endif
```

## package/olsr/Config.in
```kconfig
config BR2_PACKAGE_OLSR
	bool "olsrd"
	depends on BR2_USE_MMU # fork()
	depends on BR2_TOOLCHAIN_HAS_THREADS
	help
	  The Optimized Link State Routing protocol (OLSR) is a
	  routing protocol that is optimised for mobile ad-hoc
	  networks, sometimes called wireless mesh networks. It is a
	  proactive link-state routing protocol that floods a full
	  topology table to all nodes in the network which then
	  compute optimal forwarding paths locally.

	  http://www.olsr.org/

comment "olsr needs a toolchain w/ threads"
	depends on BR2_USE_MMU
	depends on !BR2_TOOLCHAIN_HAS_THREADS
```

## package/omap-u-boot-utils/Config.in.host
```kconfig
config BR2_PACKAGE_HOST_OMAP_U_BOOT_UTILS
	bool "host omap-u-boot-utils"
	depends on BR2_arm || BR2_armeb
	help
	  U-Boot Utilities for Texas Instrument's OMAP platforms.
	  This is a set of tools to control U-Boot from scripts,
	  generate OMAP-specific signed image files and more.

	  https://github.com/nmenon/omap-u-boot-utils
```
