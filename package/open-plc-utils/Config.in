## package/open-plc-utils/Config.in
```kconfig
config BR2_PACKAGE_OPEN_PLC_UTILS
	bool "open-plc-utils"
	depends on BR2_USE_MMU # fork()
	help
	  Open version of the Qualcomm Atheros Powerline Toolkit

	  https://github.com/qca/open-plc-utils
```

## package/open2300/Config.in
```kconfig
config BR2_PACKAGE_OPEN2300
	bool "open2300"
	help
	  open2300 reads (and writes) data from a Lacrosse
	  WS2300/WS2305/WS2310/WS2315 Weather Station

	  http://www.lavrsen.dk/foswiki/bin/view/Open2300/WebHome
```

## package/openal/Config.in
```kconfig
# openal can:
# - use __atomic_*() intrinsics when available
# - otherwise use __sync_*() intrinsics when available. It needs the
#   4-byte ones on 32 bits architectures, and the 4-byte and 8-byte
#   one on 64 bits architecture
# - it also provides its one implementation of atomic operations on
#   x86 and x86_64, but we dont take those into account since in most
#   situations __atomic_*() or __sync_*() will be available, and not
#   all x86 CPUs provide the necessary assembly instructions.
config BR2_PACKAGE_OPENAL_ARCH_SUPPORTS
	bool
	default y if BR2_TOOLCHAIN_HAS_ATOMIC
	default y if BR2_TOOLCHAIN_HAS_SYNC_4 && !BR2_ARCH_IS_64
	default y if BR2_TOOLCHAIN_HAS_SYNC_4 && BR2_TOOLCHAIN_HAS_SYNC_8 && BR2_ARCH_IS_64

config BR2_PACKAGE_OPENAL
	bool "openal"
	depends on BR2_INSTALL_LIBSTDCPP
	depends on BR2_TOOLCHAIN_HAS_THREADS_NPTL
	depends on BR2_PACKAGE_OPENAL_ARCH_SUPPORTS
	help
	  OpenAL provides capabilities for playing audio in a virtual
	  3D environment. Distance attenuation, doppler shift, and
	  directional sound emitters are among the features handled by
	  the API.

	  http://kcat.strangesoft.net/openal.html

comment "openal needs a toolchain w/ NPTL, C++"
	depends on BR2_PACKAGE_OPENAL_ARCH_SUPPORTS
	depends on !BR2_TOOLCHAIN_HAS_THREADS_NPTL \
		|| !BR2_INSTALL_LIBSTDCPP
```

## package/openblas/Config.in
```kconfig
config BR2_PACKAGE_OPENBLAS_DEFAULT_TARGET
	string
	default "P2"           if BR2_x86_pentium2
	default "KATMAI"       if BR2_x86_pentium3
	default "NORTHWOOD"    if BR2_x86_pentium4
	default "PRESCOTT"     if BR2_x86_prescott
	default "BANIAS"       if BR2_x86_pentium_m
	default "CORE2"        if BR2_x86_core2
	default "NEHALEM"      if BR2_x86_corei7
	default "SANDYBRIDGE"  if BR2_x86_corei7_avx
	default "HASWELL"      if BR2_x86_core_avx2
	default "ATOM"         if BR2_x86_atom
	default "ATHLON"       if BR2_x86_athlon || BR2_x86_athlon_4
	default "OPTERON"      if BR2_x86_opteron
	default "OPTERON_SSE3" if BR2_x86_opteron_sse3
	default "BARCELONA"    if BR2_x86_barcelona
	default "STEAMROLLER"  if BR2_x86_steamroller
	default "VIAC3"        if BR2_x86_c3 || BR2_x86_c32
	default "SSE_GENERIC"  if BR2_X86_CPU_HAS_SSE
	default "POWER4"       if BR2_powerpc_power4
	default "POWER5"       if BR2_powerpc_power5
	default "POWER6"       if BR2_powerpc_power6
	default "POWER7"       if BR2_powerpc_power7
	default "POWER8"       if BR2_powerpc_power8
	default "PPCG4"        if BR2_powerpc_7400 || BR2_powerpc_7450
	default "PPC970"       if BR2_powerpc_970
	default "PPC440"       if BR2_powerpc_440
	default "PPC440FP2"    if BR2_powerpc_440fp
	# P5600 is built with MSA support which is only available in Codescape toolchains
	default "P5600"        if BR2_mips_p5600 && BR2_TOOLCHAIN_EXTERNAL_CODESCAPE_MTI_MIPS
	default "SICORTEX"     if BR2_MIPS_CPU_MIPS64
	# I6400 is built with MSA support which is only available in Codescape toolchains
	default "I6400"        if BR2_mips_i6400 && BR2_TOOLCHAIN_EXTERNAL_CODESCAPE_IMG_MIPS
	default "SPARC"        if BR2_sparc
	# Cortex-A15 always have a VFPv4
	default "CORTEXA15"    if (BR2_cortex_a15 && BR2_ARM_EABIHF)
	# Cortex-A9 have an optional VFPv3, so we need to make sure it
	# is available
	default "CORTEXA9"     if (BR2_cortex_a9 && BR2_ARM_EABIHF && \
				   BR2_ARM_CPU_HAS_VFPV3)
	default "ARMV5"        if BR2_ARM_CPU_ARMV5
	# On ARMv6, OpenBLAS assumes that a VFP is available, and
	# EABIhf is used
	default "ARMV6"        if (BR2_ARM_CPU_ARMV6 && BR2_ARM_EABIHF && \
				   BR2_ARM_CPU_HAS_VFPV2)
	# On ARMv7, OpenBLAS assumes that a full VFPv3+ is available
	# (and not the more limited D16 variant), and that EABIhf is
	# used.
	default "ARMV7"        if (BR2_ARM_CPU_ARMV7A && BR2_ARM_EABIHF && \
				   BR2_ARM_CPU_HAS_VFPV3)
	default "ARMV8"        if BR2_aarch64 || BR2_aarch64_be
	help
	  OpenBLAS target CPU. See TargetList.txt in the source tree for
	  the possible target strings. A possible value is set
	  automatically based on your Target Architecture Variant.

config BR2_PACKAGE_OPENBLAS_ARCH_SUPPORTS
	bool
	default y if BR2_PACKAGE_OPENBLAS_DEFAULT_TARGET != ""

config BR2_PACKAGE_OPENBLAS
	bool "openblas"
	depends on BR2_PACKAGE_OPENBLAS_ARCH_SUPPORTS
	help
	  An optimized BLAS library based on GotoBLAS2 1.13 BSD version.

	  https://www.openblas.net/

if BR2_PACKAGE_OPENBLAS

config BR2_PACKAGE_OPENBLAS_TARGET
	string "OpenBLAS target CPU"
	default BR2_PACKAGE_OPENBLAS_DEFAULT_TARGET

endif
```

## package/openbox/Config.in
```kconfig
config BR2_PACKAGE_OPENBOX
	bool "openbox"
	depends on BR2_PACKAGE_XORG7
	depends on BR2_TOOLCHAIN_HAS_THREADS # glib2
	depends on BR2_USE_MMU # glib2
	depends on BR2_USE_WCHAR # glib2
	depends on BR2_TOOLCHAIN_HAS_SYNC_4 # pango -> harfbuzz
	depends on BR2_INSTALL_LIBSTDCPP # pango -> freetype
	select BR2_PACKAGE_LIBGLIB2
	select BR2_PACKAGE_LIBXML2
	select BR2_PACKAGE_PANGO
	select BR2_PACKAGE_XLIB_LIBX11
	# libxft and libxrender are needed to get xft support in pango
	select BR2_PACKAGE_XLIB_LIBXFT
	select BR2_PACKAGE_XLIB_LIBXRENDER
	help
	  Openbox is a highly configurable, next generation window
	  manager with extensive standards support.

	  http://openbox.org

comment "openbox needs a toolchain w/ C++, threads, wchar"
	depends on BR2_USE_MMU
	depends on BR2_TOOLCHAIN_HAS_SYNC_4
	depends on !BR2_TOOLCHAIN_HAS_THREADS || !BR2_USE_WCHAR || \
		!BR2_INSTALL_LIBSTDCPP
	depends on BR2_PACKAGE_XORG7
```

## package/opencore-amr/Config.in
```kconfig
config BR2_PACKAGE_OPENCORE_AMR
	bool "opencore-amr"
	depends on BR2_INSTALL_LIBSTDCPP
	help
	  Library of OpenCORE Framework implementation of Adaptive Multi Rate
	  Narrowband and Wideband (AMR-NB and AMR-WB) speech codec.

	  http://opencore-amr.sourceforge.net/

comment "opencore-amr needs a toolchain w/ C++"
        depends on !BR2_INSTALL_LIBSTDCPP
```

## package/opencv/Config.in
```kconfig
menuconfig BR2_PACKAGE_OPENCV
	bool "opencv"
	select BR2_PACKAGE_ZLIB
	depends on BR2_TOOLCHAIN_HAS_THREADS_NPTL
	depends on BR2_INSTALL_LIBSTDCPP
	depends on BR2_USE_WCHAR
	depends on !BR2_STATIC_LIBS # include dlfcn.h
	help
	  OpenCV (Open Source Computer Vision) is a library of programming
	  functions for real time computer vision.

	  Note that the opencv_core module and the opencv_hal library
	  are always built and installed, not matter which other
	  modules are enabled below.

	  http://opencv.org/

if BR2_PACKAGE_OPENCV

comment "OpenCV modules"

config BR2_PACKAGE_OPENCV_LIB_CALIB3D
	bool "calib3d"
	select BR2_PACKAGE_OPENCV_LIB_FEATURES2D
	select BR2_PACKAGE_OPENCV_LIB_IMGPROC
	help
	  Include opencv_calib3d (camera calibration and 3d reconstruction) module
	  into the OpenCV build.

config BR2_PACKAGE_OPENCV_LIB_FEATURES2D
	bool "features2d"
	select BR2_PACKAGE_OPENCV_LIB_FLANN
	select BR2_PACKAGE_OPENCV_LIB_IMGPROC
	select BR2_PACKAGE_OPENCV_LIB_ML
	help
	  Include opencv_features2d (2d features framework) module into the OpenCV
	  build.

config BR2_PACKAGE_OPENCV_LIB_FLANN
	bool "flann"
	# opencv_core dependency is already enabled
	help
	  Include opencv_flann (clustering and search in multi-dimensional spaces)
	  module into the OpenCV build.

config BR2_PACKAGE_OPENCV_LIB_HIGHGUI
	bool "highgui"
	select BR2_PACKAGE_OPENCV_LIB_IMGCODECS
	select BR2_PACKAGE_OPENCV_LIB_IMGPROC
	select BR2_PACKAGE_OPENCV_LIB_VIDEOIO
	help
	  Include opencv_highgui (high-level gui and media i/o) module into the
	  OpenCV build.

choice
	prompt "gui toolkit"
	depends on BR2_PACKAGE_OPENCV_LIB_HIGHGUI
	help
	  GUI toolkit to be used by the opencv_highgui module.

config BR2_PACKAGE_OPENCV_GUI_NONE
	bool "none"

config BR2_PACKAGE_OPENCV_WITH_GTK
	bool "gtk2"
	depends on BR2_ARCH_HAS_ATOMICS # libgtk2 -> cairo
	depends on BR2_USE_MMU # libgtk2 -> libglib2
	depends on BR2_USE_WCHAR # libgtk2 -> libglib2
	depends on BR2_TOOLCHAIN_HAS_THREADS # libgtk2 -> libglib2
	depends on BR2_INSTALL_LIBSTDCPP
	depends on BR2_PACKAGE_XORG7
	select BR2_PACKAGE_LIBGTK2

comment "gtk2 needs X.org and a toolchain w/ wchar, threads, C++"
	depends on BR2_USE_MMU # libgtk2 -> glib2
	depends on BR2_ARCH_HAS_ATOMICS # libgtk2 -> cairo
	depends on !BR2_PACKAGE_XORG7 || \
		!BR2_USE_WCHAR || \
		!BR2_TOOLCHAIN_HAS_THREADS || \
		!BR2_INSTALL_LIBSTDCPP

config BR2_PACKAGE_OPENCV_WITH_QT
	bool "qt4"
	depends on BR2_INSTALL_LIBSTDCPP
	depends on BR2_USE_MMU # qt
	select BR2_PACKAGE_QT
	select BR2_PACKAGE_QT_STL
	select BR2_PACKAGE_QT_GUI_MODULE
	select BR2_PACKAGE_QT_TEST
	help
	  Use Qt with QtTest module and STL support

comment "qt4 needs a toolchain w/ C++"
	depends on BR2_USE_MMU # qt
	depends on !BR2_INSTALL_LIBSTDCPP

endchoice

config BR2_PACKAGE_OPENCV_LIB_IMGCODECS
	bool "imgcodecs"
	select BR2_PACKAGE_OPENCV_LIB_IMGPROC
	help
	  Include opencv_imgcodecs (image codecs) module into the OpenCV build.

config BR2_PACKAGE_OPENCV_LIB_IMGPROC
	bool "imgproc"
	# opencv_core dependency is already enabled
	help
	  Include opencv_imgproc (image processing) module into the OpenCV build.

config BR2_PACKAGE_OPENCV_LIB_ML
	bool "ml"
	# opencv_core dependency is already enabled
	help
	  Include opencv_ml (machine learning) module into the OpenCV build.

config BR2_PACKAGE_OPENCV_LIB_OBJDETECT
	bool "objdetect"
	# opencv_core dependency is already enabled
	select BR2_PACKAGE_OPENCV_LIB_IMGPROC
	select BR2_PACKAGE_OPENCV_LIB_ML
	help
	  Include opencv_objdetect (object detection) module into the OpenCV build.

config BR2_PACKAGE_OPENCV_LIB_PHOTO
	bool "photo"
	select BR2_PACKAGE_OPENCV_LIB_IMGPROC
	help
	  Include opencv_photo (computational photography) module into the OpenCV
	  build.

config BR2_PACKAGE_OPENCV_LIB_PYTHON
	bool "python"
	depends on BR2_PACKAGE_PYTHON || BR2_PACKAGE_PYTHON3
	depends on BR2_aarch64 || BR2_arm || BR2_armeb || BR2_i386 \
		|| BR2_mips || BR2_mipsel || BR2_powerpc || BR2_powerpc64 \
		|| BR2_sh || BR2_x86_64 # python-numpy
	depends on !BR2_TOOLCHAIN_USES_UCLIBC || BR2_i386 || BR2_x86_64 # python-numpy
	select BR2_PACKAGE_PYTHON_NUMPY
	help
	  Include opencv_python module into the OpenCV build.
	  No python example is installed.

config BR2_PACKAGE_OPENCV_LIB_SHAPE
	bool "shape"
	# opencv_core dependency is already enabled
	select BR2_PACKAGE_OPENCV_LIB_IMGPROC
	select BR2_PACKAGE_OPENCV_LIB_VIDEO
	help
	  Include opencv_shape (shape descriptors and matchers) module into the
	  OpenCV build.

config BR2_PACKAGE_OPENCV_LIB_STITCHING
	bool "stitching"
	select BR2_PACKAGE_OPENCV_LIB_CALIB3D
	select BR2_PACKAGE_OPENCV_LIB_FEATURES2D
	select BR2_PACKAGE_OPENCV_LIB_IMGPROC
	select BR2_PACKAGE_OPENCV_LIB_OBJDETECT
	help
	  Include opencv_stitching (images stitching) module into the OpenCV build.

config BR2_PACKAGE_OPENCV_LIB_SUPERRES
	bool "superres"
	select BR2_PACKAGE_OPENCV_LIB_IMGPROC
	select BR2_PACKAGE_OPENCV_LIB_VIDEO
	help
	  Include opencv_superres (super resolution) module into the OpenCV build.

config BR2_PACKAGE_OPENCV_LIB_TS
	bool "ts"
	# opencv_core dependency is already enabled
	select BR2_PACKAGE_OPENCV_LIB_HIGHGUI
	select BR2_PACKAGE_OPENCV_LIB_IMGCODECS
	select BR2_PACKAGE_OPENCV_LIB_IMGPROC
	select BR2_PACKAGE_OPENCV_LIB_VIDEOIO
	help
	  Include opencv_ts (test) module into the OpenCV build.

config BR2_PACKAGE_OPENCV_LIB_VIDEOIO
	bool "videoio"
	select BR2_PACKAGE_OPENCV_LIB_IMGCODECS
	select BR2_PACKAGE_OPENCV_LIB_IMGPROC
	help
	  Include opencv_videoio (media i/o) module into the OpenCV build.

config BR2_PACKAGE_OPENCV_LIB_VIDEO
	bool "video"
	select BR2_PACKAGE_OPENCV_LIB_IMGPROC
	help
	  Include opencv_video (video analysis) module into the OpenCV build.

config BR2_PACKAGE_OPENCV_LIB_VIDEOSTAB
	bool "videostab"
	select BR2_PACKAGE_OPENCV_LIB_CALIB3D
	select BR2_PACKAGE_OPENCV_LIB_FEATURES2D
	select BR2_PACKAGE_OPENCV_LIB_IMGPROC
	select BR2_PACKAGE_OPENCV_LIB_PHOTO
	select BR2_PACKAGE_OPENCV_LIB_VIDEO
	help
	  Include opencv_videostab (video stabilization) module into the OpenCV
	  build.

comment "Test sets"
config BR2_PACKAGE_OPENCV_BUILD_TESTS
	bool "build tests"

config BR2_PACKAGE_OPENCV_BUILD_PERF_TESTS
	bool "build performance tests"

comment "3rd party support"

config BR2_PACKAGE_OPENCV_WITH_FFMPEG
	bool "ffmpeg support"
	select BR2_PACKAGE_BZIP2
	select BR2_PACKAGE_FFMPEG
	select BR2_PACKAGE_FFMPEG_SWSCALE
	help
	  Use ffmpeg from the target system.

choice
	prompt "gstreamer support"
	help
	  OpenCV prefers gstreamer-1 over gstreamer-0.10.

config BR2_PACKAGE_OPENCV_WITHOUT_GSTREAMER
	bool "none"

config BR2_PACKAGE_OPENCV_WITH_GSTREAMER
	bool "gstreamer-0.10"
	depends on BR2_USE_MMU # gstreamer -> libglib2
	depends on BR2_USE_WCHAR # gstreamer -> libglib2
	depends on BR2_TOOLCHAIN_HAS_THREADS # gstreamer -> libglib2
	select BR2_PACKAGE_GSTREAMER
	select BR2_PACKAGE_GST_PLUGINS_BASE
	select BR2_PACKAGE_GST_PLUGINS_BASE_PLUGIN_APP

comment "gstreamer-0.10 support needs a toolchain w/ wchar, threads"
	depends on BR2_USE_MMU
	depends on !BR2_USE_WCHAR || !BR2_TOOLCHAIN_HAS_THREADS

config BR2_PACKAGE_OPENCV_WITH_GSTREAMER1
	bool "gstreamer-1.x"
	depends on BR2_USE_MMU # gstreamer1 -> libglib2
	depends on BR2_USE_WCHAR # gstreamer1 -> libglib2
	depends on BR2_TOOLCHAIN_HAS_THREADS # gstreamer1 -> libglib2
	select BR2_PACKAGE_GSTREAMER1
	select BR2_PACKAGE_GST1_PLUGINS_BASE
	select BR2_PACKAGE_GST1_PLUGINS_BASE_PLUGIN_APP

comment "gstreamer-1.x support needs a toolchain w/ wchar, threads"
	depends on BR2_USE_MMU
	depends on !BR2_USE_WCHAR || !BR2_TOOLCHAIN_HAS_THREADS

endchoice

config BR2_PACKAGE_OPENCV_WITH_JASPER
	bool "jpeg2000 support"
	select BR2_PACKAGE_JASPER
	help
	  Enable jpeg2000 support.

	  Note: this does not use the libjasper bundled with opencv,
	  but uses the libjasper package installed system-wide by
	  Buildroot.

config BR2_PACKAGE_OPENCV_WITH_JPEG
	bool "jpeg support"
	select BR2_PACKAGE_JPEG
	help
	  Use shared libjpeg from the target system.

config BR2_PACKAGE_OPENCV_WITH_PNG
	bool "png support"
	select BR2_PACKAGE_LIBPNG
	help
	  Use shared libpng from the target system.

config BR2_PACKAGE_OPENCV_WITH_TIFF
	bool "tiff support"
	select BR2_PACKAGE_TIFF
	help
	  Use shared libtiff from the target system.

config BR2_PACKAGE_OPENCV_WITH_V4L
	bool "v4l support"
	help
	  Enable Video 4 Linux support.

	  If the package libv4l is enabled, its support is automatically enabled.

comment "Install options"

config BR2_PACKAGE_OPENCV_INSTALL_DATA
	bool "install extra data"
	help
	  Install various data that is used by cv libraries and/or demo
	  applications, specifically for haarcascades and lbpcascades
	  features.

	  For further information: see OpenCV documentation.

endif # BR2_PACKAGE_OPENCV

comment "opencv needs a toolchain w/ C++, NPTL, wchar, dynamic library"
	depends on !BR2_INSTALL_LIBSTDCPP || \
		!BR2_USE_WCHAR || \
		!BR2_TOOLCHAIN_HAS_THREADS_NPTL || \
		BR2_STATIC_LIBS
```
