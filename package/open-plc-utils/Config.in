## package/openjdk/Config.in
```kconfig
config BR2_PACKAGE_HOST_OPENJDK_BIN_ARCH_SUPPORTS
	bool
	default y if BR2_HOSTARCH = "x86_64"

# Taken from make/autoconf/platform.m4
config BR2_PACKAGE_OPENJDK_ARCH_SUPPORTS
	bool
	default y if BR2_aarch64
	default y if BR2_arm
	default y if BR2_i386 || BR2_x86_64
	default y if BR2_m68k
	default y if BR2_powerpc || BR2_powerpc64 || BR2_powerpc64le
	default y if BR2_sh

config BR2_PACKAGE_OPENJDK
	bool "openjdk"
	depends on BR2_PACKAGE_HOST_OPENJDK_BIN_ARCH_SUPPORTS
	depends on BR2_PACKAGE_OPENJDK_ARCH_SUPPORTS
	depends on !BR2_SOFT_FLOAT
	depends on !BR2_STATIC_LIBS # glibc
	depends on BR2_INSTALL_LIBSTDCPP # cups
	depends on BR2_TOOLCHAIN_HAS_THREADS # alsa-lib, cups, libusb
	depends on BR2_TOOLCHAIN_USES_GLIBC
	depends on BR2_USE_MMU # cups
	depends on BR2_PACKAGE_XORG7
	select BR2_PACKAGE_ALSA_LIB
	select BR2_PACKAGE_ALSA_LIB_MIXER
	select BR2_PACKAGE_ALSA_LIB_PCM
	select BR2_PACKAGE_ALSA_LIB_RAWMIDI
	select BR2_PACKAGE_ALSA_LIB_SEQ
	select BR2_PACKAGE_CUPS
	select BR2_PACKAGE_FONTCONFIG
	select BR2_PACKAGE_GIFLIB
	select BR2_PACKAGE_JPEG
	select BR2_PACKAGE_LCMS2
	select BR2_PACKAGE_LIBPNG
	select BR2_PACKAGE_LIBUSB
	select BR2_PACKAGE_XLIB_LIBXRANDR
	select BR2_PACKAGE_XLIB_LIBXRENDER
	select BR2_PACKAGE_XLIB_LIBXT
	select BR2_PACKAGE_XLIB_LIBXTST
	select BR2_PACKAGE_ZLIB
	help
	  OpenJDK is a free and open-source implementation of the
	  Java Platform.

	  http://openjdk.java.net/

if BR2_PACKAGE_OPENJDK

choice
	prompt "openjdk version"
	default BR2_OPENJDK_VERSION_LATEST
	help
	  Select the version of OpenJDK you wish to use.

config BR2_OPENJDK_VERSION_LTS
	bool "LTS (OpenJDK 11)"

config BR2_OPENJDK_VERSION_LATEST
	bool "latest (OpenJDK 14)"

endchoice

config BR2_PACKAGE_OPENJDK_FULL_JDK
	bool "Build the full JDK"
	help
	  Install the full JDK instead of just the run time.
	  The full JDK includes several packages used for debugging and
	  development. Some useful tools included with the JDK are:
	    - javaws
	      Command line tool for launching Java Web Start and setting
	      various options.

	    - jcmd:
	      JVM Diagnostic Commands tool: Sends diagnostic command
	      requests to a running Java Virtual Machine.

	    - jinfo
	      Configuration Info for Java: Prints configuration
	      information for a given process or core file or a remote
	      debug server.

	    - jmap
	      Memory Map for Java: Prints shared object memory maps or
	      heap memory details of a given process or core file or a
	      remote debug server.

	    - jsadebugd
	      Serviceability Agent Debug Daemon for Java: Attaches to a
	      process or core file and acts as a debug server.

	    - jstack
	      Stack Trace for Java - Prints a stack trace of threads for
	      a given process or core file or remote debug server.

	    - jstat
	      JVM Statistics Monitoring Tool: Attaches to an
	      instrumented HotSpot Java virtual machine and collects and
	      logs performance statistics as specified by the command
	      line options.

	    - jstatd
	      JVM jstat Daemon - Launches an RMI server application that
	      monitors for the creation and termination of instrumented
	      HotSpot Java virtual machines and provides an interface to
	      allow remote monitoring tools to attach to Java virtual
	      machines running on the local system.

	  Note:
	  While the JDK also comes with several tools which can be used
	  for developing java applications on a target, Buildroot does
	  not support development on a target. Building the full JDK is
	  supported for debugging purposes only.

	  Selecting this option increases the file system by
	  approximately 110M.

choice
	prompt "openjdk variant"
	default BR2_PACKAGE_OPENJDK_JVM_VARIANT_SERVER if !BR2_powerpc
	default BR2_PACKAGE_OPENJDK_JVM_VARIANT_ZERO if BR2_powerpc

config BR2_PACKAGE_OPENJDK_JVM_VARIANT_CLIENT
	bool "client"
	depends on !BR2_powerpc
	help
	  Quick loading, but slower run-time performance.

config BR2_PACKAGE_OPENJDK_JVM_VARIANT_SERVER
	bool "server"
	depends on !BR2_powerpc
	help
	  Slower loading, but faster run-time performance.

config BR2_PACKAGE_OPENJDK_JVM_VARIANT_ZERO
	bool "zero"
	select BR2_PACKAGE_LIBFFI
	help
	  A non-assembler variant with wide arch support, however
	  performance is less then client/server.

	  http://openjdk.java.net/projects/zero

endchoice
endif

comment "openjdk needs X.Org"
	depends on BR2_PACKAGE_OPENJDK_ARCH_SUPPORTS
	depends on BR2_PACKAGE_HOST_OPENJDK_BIN_ARCH_SUPPORTS
	depends on BR2_USE_MMU
	depends on !BR2_PACKAGE_XORG7

comment "openjdk needs glibc, and a toolchain w/ wchar, dynamic library, threads, C++"
	depends on BR2_USE_MMU
	depends on BR2_PACKAGE_OPENJDK_ARCH_SUPPORTS
	depends on BR2_PACKAGE_HOST_OPENJDK_BIN_ARCH_SUPPORTS
	depends on BR2_STATIC_LIBS || !BR2_INSTALL_LIBSTDCPP || \
		!BR2_TOOLCHAIN_HAS_THREADS || !BR2_TOOLCHAIN_USES_GLIBC

comment "openjdk does not support soft float configurations"
	depends on BR2_PACKAGE_OPENJDK_ARCH_SUPPORTS
	depends on BR2_PACKAGE_HOST_OPENJDK_BIN_ARCH_SUPPORTS
	depends on BR2_USE_MMU
	depends on BR2_SOFT_FLOAT
```

## package/openjpeg/Config.in
```kconfig
config BR2_PACKAGE_OPENJPEG
	bool "openjpeg"
	help
	  The OpenJPEG library is an open-source JPEG 2000 codec
	  written in C.

          http://www.openjpeg.org
```

## package/openlayers/Config.in
```kconfig
config BR2_PACKAGE_OPENLAYERS
	bool "openlayers"
	help
	  OpenLayers makes it easy to put a dynamic map in any web
	  page. It can display map tiles, vector data and markers
	  loaded from any source. OpenLayers has been developed to
	  further the use of geographic information of all kinds. It
	  is completely free, Open Source JavaScript, released under
	  the 2-clause BSD License (also known as the FreeBSD).

	  https://openlayers.org
```

## package/openldap/Config.in
```kconfig
config BR2_PACKAGE_OPENLDAP
	bool "openldap"
	depends on BR2_USE_WCHAR
	depends on BR2_USE_MMU # needs fork()
	help
	  OpenLDAP Software is an open source implementation of
	  the Lightweight Directory Access Protocol.

	  This only installs client-side support.

	  http://www.openldap.org/

if BR2_PACKAGE_OPENLDAP

config BR2_PACKAGE_OPENLDAP_CLIENTS
	bool "openldap client binaries"
	default y
	help
	  Install the OpenLDAP client tools (ldapadd, ldapcompare, ldapdelete,
	  ldapexop, ldapmodify, ldapmodrdn, ldappasswd, ldapsearch, ldapurl,
	  ldapwhoami)

endif

comment "openldap needs a toolchain w/ wchar"
	depends on BR2_USE_MMU # needs fork()
	depends on !BR2_USE_WCHAR
```

## package/openmotif/Config.in
```kconfig
config BR2_PACKAGE_OPENMOTIF
	bool "openmotif"
	help
	  OpenMotif is the publicly licensed version of Motif, the industry standard user interface toolkit for UNIX systems.

	  ftp://ftp.ics.com/openmotif/2.3/2.3.0
```

## package/openmpi/Config.in
```kconfig
comment "openmpi needs a toolchain w/ dynamic library, NPTL, wchar, C++"
	depends on BR2_USE_MMU
	depends on !BR2_sparc
	depends on BR2_STATIC_LIBS || !BR2_TOOLCHAIN_HAS_THREADS_NPTL \
		|| !BR2_USE_WCHAR || !BR2_INSTALL_LIBSTDCPP

config BR2_PACKAGE_OPENMPI
	bool "openmpi"
	depends on BR2_USE_MMU # fork()
	depends on BR2_USE_WCHAR
	depends on BR2_TOOLCHAIN_HAS_THREADS_NPTL
	depends on BR2_INSTALL_LIBSTDCPP
	depends on !BR2_STATIC_LIBS # dlfcn.h
	# from the configure script: "Sparc v8 target is not supported
	# in this release of Open MPI"
	depends on !BR2_sparc
	help
	  A High Performance Message Passing Library.

	  https://www.open-mpi.org/
```

## package/openntpd/Config.in
```kconfig
config BR2_PACKAGE_OPENNTPD
	bool "openntpd"
	depends on BR2_INET_IPV6
	depends on BR2_TOOLCHAIN_HAS_THREADS_NPTL
	depends on BR2_USE_MMU # fork ()
	depends on !BR2_PACKAGE_NTP # conflicting binaries
	help
	  OpenNTPD is an easy to use implementation of the Network Time
	  Protocol. It provides the ability to sync the local clock
	  to remote NTP servers and can act as NTP server itself,
	  redistributing the local clock. It just works.

	  http://www.openntpd.org/

comment "openntpd needs a toolchain w/ NPTL, IPv6"
	depends on BR2_USE_MMU
	depends on !BR2_INET_IPV6 || !BR2_TOOLCHAIN_HAS_THREADS_NPTL
```

## package/openobex/Config.in
```kconfig
config BR2_PACKAGE_OPENOBEX
	bool "openobex"
	help
	  Free open source implementation of the Object Exchange (OBEX)
	  protocol.

	  http://sourceforge.net/projects/openobex
```
