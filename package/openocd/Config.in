## package/openvmtools/Config.in
```kconfig
config BR2_PACKAGE_OPENVMTOOLS
	bool "openvmtools"
	depends on BR2_i386 || BR2_x86_64
	depends on BR2_USE_MMU # libglib2
	depends on BR2_USE_WCHAR # libglib2
	depends on BR2_TOOLCHAIN_HAS_THREADS # libglib2
	depends on BR2_TOOLCHAIN_HAS_NATIVE_RPC
	depends on BR2_ENABLE_LOCALE
	select BR2_PACKAGE_LIBGLIB2
	select BR2_PACKAGE_LIBDNET
	help
	  Open Virtual Machine Tools for VMware guest OS

	  http://open-vm-tools.sourceforge.net/

	  ICU locales, Xerces, and X11 tools are currently not supported.

	  NOTE: Support for vmblock-fuse will be enabled in openvmtools if the
		libfuse package is selected.

if BR2_PACKAGE_OPENVMTOOLS

config BR2_PACKAGE_OPENVMTOOLS_PROCPS
	bool "procps support"
	depends on BR2_PACKAGE_BUSYBOX_SHOW_OTHERS
	select BR2_PACKAGE_PROCPS_NG
	help
	  Enable support for procps / meminfo

comment "procps support needs BR2_PACKAGE_BUSYBOX_SHOW_OTHERS"
	depends on !BR2_PACKAGE_BUSYBOX_SHOW_OTHERS

config BR2_PACKAGE_OPENVMTOOLS_PAM
	bool "PAM support"
	select BR2_PACKAGE_LINUX_PAM
	# linux-pam needs locale and wchar, but we already have this
	# dependency on the main symbol, above.
	depends on !BR2_STATIC_LIBS
	help
	  Support for PAM in openvmtools

comment "PAM support needs a toolchain w/ dynamic library"
	depends on BR2_STATIC_LIBS

endif

comment "openvmtools needs a toolchain w/ wchar, threads, RPC, locale"
	depends on BR2_i386 || BR2_x86_64
	depends on BR2_USE_MMU
	depends on !BR2_USE_WCHAR || !BR2_TOOLCHAIN_HAS_THREADS || \
		!BR2_TOOLCHAIN_HAS_NATIVE_RPC || !BR2_ENABLE_LOCALE
```

## package/openvpn/Config.in
```kconfig
comment "openvpn needs a toolchain w/ IPv6"
	depends on BR2_USE_MMU
	depends on !BR2_INET_IPV6

config BR2_PACKAGE_OPENVPN
	bool "openvpn"
	depends on BR2_INET_IPV6
	depends on BR2_USE_MMU # fork()
	help
	  OpenVPN is a full-featured SSL VPN solution which can
	  accomodate a wide range of configurations, including road
	  warrior access, home/office/campus telecommuting, WiFi
	  security, secure branch office linking, and enterprise-scale
	  remote access solutions with load balancing, failover, and
	  fine-grained access-controls.

	  http://openvpn.net/

if BR2_PACKAGE_OPENVPN

config BR2_PACKAGE_OPENVPN_LZO
	bool "LZO compression"
	default y
	select BR2_PACKAGE_LZO
	help
	  Enable LZO compression.

config BR2_PACKAGE_OPENVPN_SMALL
	bool "Optimize for small size"
	help
	  Make OpenVPN as small as possible.
	  You loose eurephia, debugging info, help messages and more.
	  It saves around 100 KiB in binary file size.

choice
	prompt "Crypto backend"
	default BR2_PACKAGE_OPENVPN_CRYPTO_OPENSSL
	help
	  Select the cryptographic library to use.

	config BR2_PACKAGE_OPENVPN_CRYPTO_OPENSSL
	bool "OpenSSL"
	select BR2_PACKAGE_OPENSSL
	help
	  Enable TLS-based key exchange and OpenSSL crypto support.

	config BR2_PACKAGE_OPENVPN_CRYPTO_POLARSSL
	bool "PolarSSL"
	select BR2_PACKAGE_POLARSSL
	help
	  Enable TLS-based key exchange and PolarSSL crypto support.

endchoice

endif
```

## package/openzwave/Config.in
```kconfig
config BR2_PACKAGE_OPENZWAVE
	bool "openzwave"
	depends on BR2_TOOLCHAIN_HAS_THREADS_NPTL
	depends on BR2_INSTALL_LIBSTDCPP
	depends on !BR2_STATIC_LIBS
	depends on BR2_USE_WCHAR
	select BR2_PACKAGE_TINYXML
	help
	  Free software library that interfaces with selected Z-Wave
	  PC controllers, allowing anyone to create applications that
	  manipulate and respond to devices on a Z-Wave network,
	  without requiring in-depth knowledge of the Z-Wave protocol

	  http://www.openzwave.net

comment "openzwave needs a toolchain w/ C++, dynamic library, NPTL, wchar"
	depends on !BR2_INSTALL_LIBSTDCPP || BR2_STATIC_LIBS || \
		!BR2_TOOLCHAIN_HAS_THREADS_NPTL || !BR2_USE_WCHAR
```

## package/opkg/Config.in
```kconfig
comment "opkg needs a toolchain w/ wchar"
	depends on BR2_USE_MMU
	depends on !BR2_USE_WCHAR

config BR2_PACKAGE_OPKG
	bool "opkg"
	depends on BR2_USE_MMU # fork()
	depends on BR2_USE_WCHAR # libarchive
	select BR2_PACKAGE_LIBARCHIVE
	help
	  Opkg is a lightweight package management system, based on
	  ipkg. It is written in C and resembles apt/dpkg in
	  operation. It is intended for use on embedded Linux devices.
	  Opkg is maintained, stable, robust and conservative in its
	  memory usage, despite its buggy ipkg ancestry. As best it
	  can, opkg maintains backwards compatibility with ipkg and
	  conforms to a subset of debian's policy manual regarding
	  control files.

	  http://code.google.com/p/opkg/

if BR2_PACKAGE_OPKG

config BR2_PACKAGE_OPKG_GPG_SIGN
	bool "gnupg support"
	depends on BR2_PACKAGE_LIBGPG_ERROR_ARCH_SUPPORTS # libgpg-error
	select BR2_PACKAGE_LIBGPGME
	select BR2_PACKAGE_LIBGPG_ERROR
	help
	  Enable opkg package signature checking support using
	  gnupg/libgpgme.

endif
```

## package/oprofile/Config.in
```kconfig
# memory barrier function implemented only for some architectures
config BR2_PACKAGE_OPROFILE_ARCH_SUPPORTS
	bool
	default y
	depends on BR2_arceb || BR2_arcle || BR2_arm || BR2_armeb || \
		BR2_aarch64 || BR2_aarch64_be || BR2_i386 || BR2_mips || \
		BR2_mipsel || BR2_mips64 || BR2_mips64el || BR2_powerpc || \
		BR2_powerpc64 || BR2_powerpc64le || BR2_sh || \
		BR2_sparc || BR2_sparc64 || BR2_x86_64

config BR2_PACKAGE_OPROFILE_NEEDS_LIBPFM4
	bool
	default y if BR2_powerpc || BR2_powerpc64 || BR2_powerpc64le

config BR2_PACKAGE_OPROFILE
	bool "oprofile"
	depends on BR2_USE_MMU # fork()
	depends on BR2_INSTALL_LIBSTDCPP
	depends on BR2_USE_WCHAR # binutils
	depends on BR2_PACKAGE_OPROFILE_ARCH_SUPPORTS
	# libpfm4 is needed on PowerPC, and requires thread support
	depends on BR2_TOOLCHAIN_HAS_THREADS_NPTL || !BR2_PACKAGE_OPROFILE_NEEDS_LIBPFM4
	select BR2_PACKAGE_POPT
	select BR2_PACKAGE_BINUTILS
	select BR2_PACKAGE_LIBPFM4 if BR2_PACKAGE_OPROFILE_NEEDS_LIBPFM4
	help
	  OProfile is a system-wide profiler for Linux systems,
	  capable of profiling all running code at low overhead.
	  OProfile is released under the GNU GPL.

	  It consists of a kernel driver and a daemon for collecting
	  sample data, and several post-profiling tools for turning
	  data into information.

	  OProfile leverages the hardware performance counters of the
	  CPU to enable profiling of a wide variety of interesting
	  statistics, which can also be used for basic time-spent
	  profiling. All code is profiled: hardware and software
	  interrupt handlers, kernel modules, the kernel, shared
	  libraries, and applications.

	  https://sourceforge.net/projects/oprofile/

comment "oprofile needs a toolchain w/ C++, wchar"
	depends on BR2_USE_MMU
	depends on BR2_PACKAGE_OPROFILE_ARCH_SUPPORTS
	depends on !BR2_INSTALL_LIBSTDCPP || !BR2_USE_WCHAR

comment "oprofile needs a toolchain w/ NPTL on PowerPC(64)"
	depends on BR2_USE_MMU && BR2_PACKAGE_OPROFILE_NEEDS_LIBPFM4
	depends on !BR2_TOOLCHAIN_HAS_THREADS_NPTL
```

## package/optee-benchmark/Config.in
```kconfig
config BR2_PACKAGE_OPTEE_BENCHMARK
	bool "optee-benchmark"
	depends on BR2_USE_MMU # fork()
	depends on BR2_TOOLCHAIN_HAS_THREADS # optee-client
	select BR2_PACKAGE_OPTEE_CLIENT
	select BR2_PACKAGE_LIBYAML
	help
	  Enable the OP-TEE benchmark package that brings facilities
	  for profiling traversal and execution timings when
	  invoking OP-TEE. OP-TEE benchmark is a component delivered
	  by the OP-TEE project.

	  http://github.com/linaro-swg/optee_benchmark

comment "optee-benchmark needs a toolchain w/ threads"
	depends on BR2_USE_MMU
	depends on !BR2_TOOLCHAIN_HAS_THREADS
```

## package/optee-client/Config.in
```kconfig
config BR2_PACKAGE_OPTEE_CLIENT
	bool "optee-client"
	depends on BR2_TOOLCHAIN_HAS_THREADS
	help
	  Enable the OP-TEE client package that brings non-secure
	  client application resources for OP-TEE support. OP-TEE
	  client is a component delivered by the OP-TEE project.

	  The client API library allows application to invoke trusted
	  applications hosted in the OP-TEE OS secure world.  The
	  supplicant provides services hosted by the non-secure world
	  and invoked by the secure world.

	  https://github.com/OP-TEE/optee_client

if BR2_PACKAGE_OPTEE_CLIENT

config BR2_PACKAGE_OPTEE_CLIENT_TEE_FS_PATH
	string "Path for normal world OS secure storage"
	default "/data/tee"
	help
	  Path to storage area for secure storage based on the
	  normal world OS providing the actual storage via
	  tee-supplicant.

endif

comment "optee-client needs a toolchain w/ threads"
	depends on !BR2_TOOLCHAIN_HAS_THREADS
```

## package/optee-examples/Config.in
```kconfig
config BR2_PACKAGE_OPTEE_EXAMPLES
	bool "optee-examples"
	depends on BR2_TARGET_OPTEE_OS
	depends on BR2_TOOLCHAIN_HAS_THREADS # optee-client
	select BR2_PACKAGE_OPTEE_CLIENT
	select BR2_TARGET_OPTEE_OS_SDK
	help
	  Enable the OP-TEE examples package that brings examples of
	  implementation of OP-TEE non-secure client applications and
	  secure trusted applications. OP-TEE examples is a
	  component delivered by the OP-TEE project.

	  Trusted application binary files are installed in the target
	  directory /lib/optee_armtz as other trusted applications.
	  At runtime OP-TEE OS can load trusted applications from this
	  non-secure filesystem/directory into the secure world for
	  execution.

	  https://github.com/linaro-swg/optee_examples

comment "optee-examples needs a toolchain w/ threads"
	depends on BR2_TARGET_OPTEE_OS
	depends on !BR2_TOOLCHAIN_HAS_THREADS
```

## package/optee-test/Config.in
```kconfig
config BR2_PACKAGE_OPTEE_TEST
	bool "optee-test"
	depends on BR2_TARGET_OPTEE_OS
	depends on BR2_TOOLCHAIN_HAS_THREADS # optee-client
	select BR2_PACKAGE_OPTEE_CLIENT
	select BR2_TARGET_OPTEE_OS_SDK
	help
	  This build option enables OP-TEE test package from the
	  OP-TEE project. It helps platforms to verify the OP-TEE
	  installation against a set of regression and performance
	  tests.

	  The package generates userspace test applications and
	  data files for the Linux userland. It also generates
	  OP-TEE trusted applications.

	  Trusted application binary files are installed in the target
	  directory /lib/optee_armtz as other trusted applications.
	  At runtime OP-TEE OS can load trusted applications from this
	  non-secure filesystem/directory into the secure world for
	  execution.

	  http://github.com/OP-TEE/optee_test

comment "optee-test needs a toolchain w/ threads"
	depends on BR2_TARGET_OPTEE_OS
	depends on !BR2_TOOLCHAIN_HAS_THREADS
```

## package/opus-tools/Config.in
```kconfig
config BR2_PACKAGE_OPUS_TOOLS
	bool "opus-tools"
	select BR2_PACKAGE_LIBOGG
	select BR2_PACKAGE_LIBOPUSENC
	select BR2_PACKAGE_OPUS
	select BR2_PACKAGE_OPUSFILE
	help
	  Opus codec command line tools. This package provides the
	  reference implementations of encoder and decoder utilities
	  for libopus.

	  http://opus-codec.org
```

## package/opus/Config.in
```kconfig
config BR2_PACKAGE_OPUS
	bool "opus"
	help
	  The Opus codec is designed for interactive speech and audio
	  transmission over the Internet. It is designed by the IETF
	  Codec Working Group and incorporates technology from Skype's
	  SILK codec and Xiph.Org's CELT codec.

	  It is intended to suit a wide range of interactive audio
	  applications, including Voice over IP, videoconferencing,
	  in-game chat, and even remote live music performances. It
	  can scale from low bit-rate narrowband speech to very high
	  quality stereo music.

	  http://opus-codec.org

if BR2_PACKAGE_OPUS

config BR2_PACKAGE_OPUS_FIXED_POINT
	bool "use fixed-point" if !BR2_SOFT_FLOAT
	default y if BR2_SOFT_FLOAT
	help
	  Compile without floating point operations (for machines
	  without a fast enough FPU).

endif
```

## package/opusfile/Config.in
```kconfig
config BR2_PACKAGE_OPUSFILE
	bool "opusfile"
	select BR2_PACKAGE_LIBOGG
	select BR2_PACKAGE_OPUS
	help
	  A convenient high-level API for decoding and basic
	  manipulation of all Ogg Opus audio streams.

	  http://opus-codec.org
```

## package/orbit/Config.in
```kconfig
config BR2_PACKAGE_ORBIT
	bool "orbit"
	depends on BR2_PACKAGE_LUA_5_1 || BR2_PACKAGE_LUAJIT
	select BR2_PACKAGE_LPEG # runtime
	select BR2_PACKAGE_LUAFILESYSTEM # runtime
	select BR2_PACKAGE_WSAPI_XAVANTE # runtime
	help
	  An MVC web framework for Lua. The design is inspired by
	  lightweight Ruby frameworks such as Camping

	  http://keplerproject.github.com/orbit

comment "orbit needs a Lua 5.1 interpreter"
	depends on !BR2_PACKAGE_LUA_5_1
	depends on !BR2_PACKAGE_LUAJIT
```

## package/orc/Config.in
```kconfig
config BR2_PACKAGE_ORC
	bool "orc"
	depends on BR2_TOOLCHAIN_HAS_THREADS
	help
	  Orc is a library and set of tools for compiling and executing
	  very simple programs that operate on arrays of data.

	  http://code.entropywave.com/projects/orc/

comment "orc requires a toolchain with thread support"
	depends on !BR2_TOOLCHAIN_HAS_THREADS
```
