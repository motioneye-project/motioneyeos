## package/ortp/Config.in
```kconfig
config BR2_PACKAGE_ORTP
	bool "oRTP"
	depends on BR2_INSTALL_LIBSTDCPP
	depends on BR2_TOOLCHAIN_HAS_THREADS
	depends on !BR2_TOOLCHAIN_HAS_GCC_BUG_64735 # bctoolbox
	select BR2_PACKAGE_BCTOOLBOX
	help
	  oRTP, a Real-time Transport Protocol (RTP,RFC3550) library

	  https://www.linphone.org/technical-corner/ortp

comment "ortp needs a toolchain w/ C++, threads"
	depends on !BR2_INSTALL_LIBSTDCPP || !BR2_TOOLCHAIN_HAS_THREADS

comment "ortp needs a toolchain not affected by GCC bug 64735"
	depends on BR2_TOOLCHAIN_HAS_GCC_BUG_64735
```

## package/owfs/Config.in
```kconfig
config BR2_PACKAGE_OWFS
	bool "owfs"
	depends on BR2_TOOLCHAIN_HAS_THREADS
	help
	  OWFS is an easy way to use the powerful 1-wire system of
	  Dallas/Maxim.

	  OWFS is a simple and flexible program to monitor and control
	  the physical environment. You can write scripts to read
	  temperature, flash lights, write to an LCD, log and graph,
	  etc.

	  http://owfs.org/

comment "owfs needs a toolchain w/ threads"
	depends on !BR2_TOOLCHAIN_HAS_THREADS
```

## package/owl-linux/Config.in
```kconfig
config BR2_PACKAGE_OWL_LINUX
	bool "owl-linux"
	depends on BR2_LINUX_KERNEL
	depends on (BR2_arm920t || BR2_arm922t || BR2_arm926t)
	help
	  Linux kernel driver for the H&D Wireless SPB104 SD-card WiFi SIP.

	  owl-linux requires the hidden kernel option WIRELESS_EXT enabled.

	  http://linux.hd-wireless.se/bin/view/Linux/GettingStarted

comment "owl-linux requires a Linux kernel"
	depends on !BR2_LINUX_KERNEL
	depends on BR2_arm || BR2_armeb

comment "owl-linux is only supported on ARM9 architecture"
	depends on !(BR2_arm920t || BR2_arm922t || BR2_arm926t)
	depends on BR2_arm || BR2_armeb
```

## package/p11-kit/Config.in
```kconfig
config BR2_PACKAGE_P11_KIT
	bool "p11-kit"
	depends on !BR2_PREFER_STATIC_LIB
	depends on BR2_USE_MMU
	depends on BR2_TOOLCHAIN_HAS_THREADS
	select BR2_PACKAGE_LIBTASN1
	help
	  Provides a way to load and enumerate PKCS#11 modules.
	  Provides a standard configuration setup for installing PKCS#11
	  modules in such a way that they're discoverable.

	  http://p11-glue.freedesktop.org/p11-kit.html

comment "p11-kit needs a toolchain w/ threads"
	depends on !BR2_TOOLCHAIN_HAS_THREADS
```

## package/paho-mqtt-cpp/Config.in
```kconfig
config BR2_PACKAGE_PAHO_MQTT_CPP
	bool "paho-mqtt-cpp"
	depends on !BR2_STATIC_LIBS  # dlopen()
	depends on BR2_TOOLCHAIN_HAS_THREADS
	depends on !BR2_TOOLCHAIN_HAS_GCC_BUG_64735 # std::future
	depends on BR2_INSTALL_LIBSTDCPP
	select BR2_PACKAGE_PAHO_MQTT_C
	help
	  MQTT client C++ library

	  https://eclipse.org/paho/clients/cpp/

comment "paho-mqtt-cpp needs a toolchain w/ threads, C++, dynamic library support"
	depends on BR2_STATIC_LIBS || !BR2_TOOLCHAIN_HAS_THREADS || \
		!BR2_INSTALL_LIBSTDCPP
	depends on !BR2_TOOLCHAIN_HAS_GCC_BUG_64735

comment "paho-mqtt-cpp needs a toolchain not affected by GCC bug 64735"
	depends on BR2_TOOLCHAIN_HAS_GCC_BUG_64735
```

## package/pamtester/Config.in
```kconfig
config BR2_PACKAGE_PAMTESTER
	bool "pamtester"
	depends on BR2_PACKAGE_LINUX_PAM
	help
	  A tiny utility for testing pluggable authentication modules
	  (PAM) facility. While specifically designed to help PAM module
	  authors to test their modules, that might also be handy for
	  system administrators interested in building a centralised
	  authentication system using common standards such as NIS, SASL
	  and LDAP.

	  http://pamtester.sourceforge.net/

comment "pamtester depends on linux-pam"
	depends on !BR2_PACKAGE_LINUX_PAM
```

## package/pango/Config.in
```kconfig
config BR2_PACKAGE_PANGO
	bool "pango"
	depends on BR2_USE_WCHAR # glib2
	depends on BR2_TOOLCHAIN_HAS_THREADS # glib2
	depends on BR2_INSTALL_LIBSTDCPP # freetype support
	select BR2_PACKAGE_LIBGLIB2
	select BR2_PACKAGE_EXPAT
	select BR2_PACKAGE_CAIRO
	select BR2_PACKAGE_FONTCONFIG
	select BR2_PACKAGE_FREETYPE
	select BR2_PACKAGE_GETTEXT if BR2_NEEDS_GETTEXT_IF_LOCALE
	select BR2_PACKAGE_XLIB_LIBX11 if BR2_PACKAGE_XORG7
	help
	  Pango is a library for laying out and rendering of text, with an
	  emphasis on internationalization. Pango can be used anywhere that
	  text layout is needed, though most of the work on Pango so far has
	  been done in the context of the GTK+ widget toolkit. Pango forms the
	  core of text and font handling for GTK+-2.x.

	  http://www.pango.org/

comment "pango needs a toolchain w/ wchar, threads, C++"
	depends on !BR2_USE_WCHAR || !BR2_TOOLCHAIN_HAS_THREADS || \
		!BR2_INSTALL_LIBSTDCPP
```

## package/pangomm/Config.in
```kconfig
config BR2_PACKAGE_PANGOMM
	bool "pangomm"
	depends on BR2_TOOLCHAIN_HAS_SYNC_4 # pango -> harfbuzz
	depends on BR2_INSTALL_LIBSTDCPP # glibmm/pango
	depends on BR2_TOOLCHAIN_GCC_AT_LEAST_4_9 # C++11
	depends on BR2_TOOLCHAIN_HAS_THREADS # *mm/pango -> libglib2
	depends on BR2_USE_MMU # *mm/pango -> libglib2
	depends on BR2_USE_WCHAR # *mm/pango -> libglib2
	select BR2_PACKAGE_CAIROMM
	select BR2_PACKAGE_GLIBMM
	select BR2_PACKAGE_PANGO
	select BR2_PACKAGE_LIBSIGC
	help
	  The pangomm package is a set of C++ bindings for Pango.

	  http://www.gtkmm.org/

comment "pangomm needs a toolchain w/ C++, wchar, threads, gcc >= 4.9"
	depends on BR2_USE_MMU
	depends on BR2_TOOLCHAIN_HAS_SYNC_4
	depends on !BR2_TOOLCHAIN_GCC_AT_LEAST_4_9 || !BR2_USE_WCHAR \
		|| !BR2_INSTALL_LIBSTDCPP || !BR2_TOOLCHAIN_HAS_THREADS
```

## package/parted/Config.in
```kconfig
config BR2_PACKAGE_PARTED
	bool "parted"
	depends on BR2_ENABLE_LOCALE
	depends on BR2_USE_WCHAR
	select BR2_PACKAGE_UTIL_LINUX
	select BR2_PACKAGE_UTIL_LINUX_LIBUUID
	help
	  parted, the GNU partition resizing program

	  http://www.gnu.org/software/parted/

comment "parted needs a toolchain w/ locale, wchar"
	depends on !BR2_ENABLE_LOCALE || !BR2_USE_WCHAR
```

## package/patch/Config.in
```kconfig
config BR2_PACKAGE_PATCH
	bool "patch"
	depends on BR2_USE_MMU # fork()
	depends on BR2_USE_WCHAR
	depends on BR2_PACKAGE_BUSYBOX_SHOW_OTHERS
	help
	  Take patch files (containing difference listings) and apply
	  them to original files, producing patched versions.

	  http://www.gnu.org/software/patch/

comment "patch needs a toolchain w/ wchar"
	depends on !BR2_USE_WCHAR
	depends on BR2_USE_MMU
	depends on BR2_PACKAGE_BUSYBOX_SHOW_OTHERS
```

## package/patchelf/Config.in.host
```kconfig
config BR2_PACKAGE_HOST_PATCHELF
	bool
	default y
	help
	  PatchELF is a small utility to modify the dynamic linker
	  and RPATH of ELF executables.

	  http://nixos.org/patchelf.html
```

## package/pax-utils/Config.in
```kconfig
config BR2_PACKAGE_PAX_UTILS
	bool "pax-utils"
	depends on BR2_TOOLCHAIN_HEADERS_AT_LEAST_3_5 # needs PR_SET_NO_NEW_PRIVS
	help
	  ELF related utils for ELF 32/64 binaries that can check files
	  for security relevant properties.

	  http://www.gentoo.org/proj/en/hardened/pax-utils.xml

comment "pax-utils needs a toolchain w/ headers >= 3.5"
	depends on !BR2_TOOLCHAIN_HEADERS_AT_LEAST_3_5
```

## package/paxtest/Config.in
```kconfig
config BR2_PACKAGE_PAXTEST
	bool "paxtest"
	# No UCLIBC or MUSL because __NO_A_OUT_SUPPORT
	depends on BR2_TOOLCHAIN_USES_GLIBC
	help
	  PaX regression test suite

	  http://pax.grsecurity.net/docs

comment "paxtest needs a glibc toolchain"
	depends on !BR2_TOOLCHAIN_USES_GLIBC
```

## package/pciutils/Config.in
```kconfig
config BR2_PACKAGE_PCIUTILS
	bool "pciutils"
	# PCI not supported on Blackfin
	depends on !BR2_bfin
	help
	  Various utilities dealing with the PCI bus.
	  Provides things like setpci and lspci.

	  http://atrey.karlin.mff.cuni.cz/~mj/pciutils.html
```

## package/pcm-tools/Config.in
```kconfig
comment "pcm-tools needs a toolchain w/ C++"
	depends on BR2_i386 || BR2_x86_64
	depends on !BR2_INSTALL_LIBSTDCPP

config BR2_PACKAGE_PCM_TOOLS
	bool "pcm-tools"
	depends on BR2_i386 || BR2_x86_64
	depends on BR2_INSTALL_LIBSTDCPP
	select BR2_PACKAGE_HWDATA
	select BR2_PACKAGE_HWDATA_PCI_IDS
	help
	  Processor Counter Monitor (PCM) is an application programming
	  interface (API) and a set of tools based on the API to monitor
	  performance and energy metrics of Intel(R) Core(TM), Xeon(R),
	  Atom(TM) and Xeon Phi(TM) processors.

	  https://github.com/opcm/pcm

if BR2_PACKAGE_PCM_TOOLS

# The pmu-query script is not compatible with Python 3
config BR2_PACKAGE_PCM_TOOLS_PMU_QUERY
	bool "install the pmu-query script"
	default y
	depends on BR2_PACKAGE_PYTHON
	select BR2_PACKAGE_CA_CERTIFICATES # https
	select BR2_PACKAGE_PYTHON_HASHLIB # urllib2
	select BR2_PACKAGE_PYTHON_SSL # urllib2

comment "pmu-query needs Python 2.x"
	depends on !BR2_PACKAGE_PYTHON

endif
```

## package/pcmanfm/Config.in
```kconfig
config BR2_PACKAGE_PCMANFM
	bool "pcmanfm"
	depends on BR2_PACKAGE_XORG7
	depends on BR2_USE_WCHAR # libglib2
	depends on BR2_TOOLCHAIN_HAS_THREADS # libglib2
	depends on BR2_USE_MMU # libglib2
	depends on BR2_INSTALL_LIBSTDCPP # libgtk2
	depends on BR2_TOOLCHAIN_HAS_SYNC_4 # libgtk2 -> pango -> harfbuzz
	select BR2_PACKAGE_LIBFM
	select BR2_PACKAGE_MENU_CACHE
	select BR2_PACKAGE_LIBGLIB2
	select BR2_PACKAGE_LIBGTK2 if !BR2_PACKAGE_LIBGTK3_X11
	help
	  PCMan File Manager (PCManFM) is a file manager application developed
	  by Hong Jen Yee from Taiwan which is meant to be a replacement for
	  Nautilus, Konqueror and Thunar.

	  http://wiki.lxde.org/en/PCManFM

comment "pcmanfm needs a toolchain w/ wchar, threads, C++"
	depends on BR2_USE_MMU
	depends on BR2_PACKAGE_XORG7
	depends on BR2_TOOLCHAIN_HAS_SYNC_4
	depends on !BR2_USE_WCHAR || !BR2_INSTALL_LIBSTDCPP || \
		!BR2_TOOLCHAIN_HAS_THREADS
```

## package/pcmcia/Config.in
```kconfig
config BR2_PACKAGE_PCMCIA
	bool "pcmcia"
	depends on BR2_PACKAGE_LINUX
	# The website says it's deprecated after 2.4.x kernels
	depends on BR2_DEPRECATED
	help
	  PCMCIA tools for Linux.

	  http://pcmcia-cs.sourceforge.net/
```

## package/pcre/Config.in
```kconfig
config BR2_PACKAGE_PCRE
	bool "pcre"
	help
	  Perl Compatible Regular Expressions. By default, only the
	  8-bits libpcre is built. To get the 16-bits and/or 32-bits
	  variants libpcre16/libpcre32, use the package sub-options.

	  http://www.pcre.org/

if BR2_PACKAGE_PCRE

config BR2_PACKAGE_PCRE_16
	bool "16-bit pcre"
	help
	  This option builds the 16-bits pcre library, i.e 'libpcre16'

config BR2_PACKAGE_PCRE_32
	bool "32-bit pcre"
	help
	  This option builds the 32-bits pcre library, i.e 'libpcre32'

config BR2_PACKAGE_PCRE_UTF
	bool "UTF-8/16/32 support in pcre"
	help
	  This option builds the pcre library with UTF-8/16/32 support

config BR2_PACKAGE_PCRE_UCP
	bool "Unicode properties support in pcre"
	select BR2_PACKAGE_PCRE_UTF
	help
	  This option builds the pcre library with Unicode properties
	  support (implies UTF-8/16/32 support)'

endif
```

## package/pcre2/Config.in
```kconfig
config BR2_PACKAGE_PCRE2
	bool "pcre2"
	help
	  Perl Compatible Regular Expressions. By default, only the
	  8-bits libpcre2 is built. To get the 16-bits and/or 32-bits
	  variants libpcre2-16/libpcre2-32, use the package
	  sub-options.

	  http://www.pcre.org/

if BR2_PACKAGE_PCRE2

config BR2_PACKAGE_PCRE2_16
	bool "16-bit pcre2"
	help
	  This option builds the 16-bits pcre2 library, i.e
	  'libpcre2-16'

config BR2_PACKAGE_PCRE2_32
	bool "32-bit pcre2"
	help
	  This option builds the 32-bits pcre2 library, i.e
	  'libpcre2-32'

config BR2_PACKAGE_PCRE2_JIT_ARCH_SUPPORTS
	bool
	default y if BR2_aarch64
	default y if BR2_arm || BR2_armeb
	default y if BR2_i386 || BR2_x86_64
	default y if BR2_mips || BR2_mipsel || BR2_mips64 || BR2_mips64el
	default y if BR2_powerpc
	default y if BR2_sparc

config BR2_PACKAGE_PCRE2_JIT
	bool "enable JIT support"
	depends on BR2_PACKAGE_PCRE2_JIT_ARCH_SUPPORTS
	depends on BR2_TOOLCHAIN_HAS_THREADS
	help
	  This option enables JIT support

comment "JIT support needs a toolchain w/ threads"
	depends on BR2_PACKAGE_PCRE2_JIT_ARCH_SUPPORTS
	depends on !BR2_TOOLCHAIN_HAS_THREADS

endif
```

## package/pcsc-lite/Config.in
```kconfig
config BR2_PACKAGE_PCSC_LITE
	bool "pcsc-lite"
	depends on BR2_TOOLCHAIN_HAS_THREADS
	depends on BR2_USE_MMU # fork()
	depends on !BR2_STATIC_LIBS
	help
	  Middleware to access smart card using SCard API (PC/SC).

	  https://muscle.apdu.fr/

if BR2_PACKAGE_PCSC_LITE

config BR2_PACKAGE_PCSC_LITE_FORCE_LIBUSB
	bool "use libusb"
	depends on !BR2_PACKAGE_HAS_UDEV
	select BR2_PACKAGE_LIBUSB
	help
	  Select Y if you want to support usb smart card readers.

config BR2_PACKAGE_PCSC_LITE_DEBUGATR
	bool "enable ATR debug messages"
	help
	  Enable ATR debug messages from pcscd.

config BR2_PACKAGE_PCSC_LITE_EMBEDDED
	bool "enable embedded mode"
	help
	  Limit RAM and CPU resources by disabling logs.

endif

comment "pcsc-lite needs a toolchain w/ threads, dynamic library"
	depends on BR2_USE_MMU
	depends on !BR2_TOOLCHAIN_HAS_THREADS || BR2_STATIC_LIBS
```

## package/pdbg/Config.in
```kconfig
config BR2_PACKAGE_PDBG
	bool "pdbg"
	help
	  PowerPC FSI Debugger, for low level debugging of a IBM
	  Power8 and Power9 CPU over FSI.

	  pdbg runs on a BMC, which is generally an ARM-powered system
	  monitoring/controlling a host CPU. It can also run on the host.

	  https://github.com/open-power/pdbg
```

## package/pdmenu/Config.in
```kconfig
config BR2_PACKAGE_PDMENU
	bool "pdmenu"
	depends on BR2_USE_MMU # slang
	select BR2_PACKAGE_SLANG
	help
	  Pdmenu is a full screen menuing system for Unix. It is
	  designed to be easy to use, and is suitable as a login shell
	  for inexperienced users, or it can just be ran at the
	  command line as a handy menu.

	  Pdmenu features color support and GPM mouse support at the
	  Linux console. It was developed on Linux, and has now been
	  compiled on many other unixes without problems.

	  https://joeyh.name/code/pdmenu/
```

## package/perf/Config.in
```kconfig
config BR2_PACKAGE_PERF
	bool "perf"
	depends on BR2_LINUX_KERNEL
	depends on BR2_LARGEFILE
	help
	  perf (sometimes "Perf Events" or perf tools, originally
	  "Performance Counters for Linux") - is a performance
	  analyzing tool in Linux, available from kernel version
	  2.6.31. User-space controlling utility, called 'perf' has
	  git-like interface with subcommands. It is capable of
	  statistical profiling of entire system (both kernel and user
	  code), single CPU or severals threads.

	  This package builds and install the userspace 'perf'
	  command. It is up to the user to ensure that the kernel
	  configuration has all suitable options enable to allow a
	  proper operation of 'perf'.

	  https://perf.wiki.kernel.org/

comment "perf only available if Linux kernel is enabled, and requires largefile support"
	depends on !BR2_LINUX_KERNEL || !BR2_LARGEFILE
```

## package/perl-apache-logformat-compiler/Config.in
```kconfig
config BR2_PACKAGE_PERL_APACHE_LOGFORMAT_COMPILER
	bool "perl-apache-logformat-compiler"
	select BR2_PACKAGE_PERL_POSIX_STRFTIME_COMPILER # runtime
	help
	  Compile a log format string to perl-code.

	  https://github.com/kazeburo/Apache-LogFormat-Compiler
```

## package/perl-appconfig/Config.in
```kconfig
config BR2_PACKAGE_PERL_APPCONFIG
	bool "perl-appconfig"
	help
	  AppConfig is a bundle of Perl5 modules for reading
	  configuration files and parsing command line
	  arguments.

	  https://metacpan.org/release/AppConfig
```
