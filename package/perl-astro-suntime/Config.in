## package/perl-astro-suntime/Config.in
```kconfig
config BR2_PACKAGE_PERL_ASTRO_SUNTIME
	bool "perl-astro-suntime"
	help
	  A functional module for calculating sunrise/sunset times.

	  https://metacpan.org/release/Astro-SunTime
```

## package/perl-class-inspector/Config.in
```kconfig
config BR2_PACKAGE_PERL_CLASS_INSPECTOR
	bool "perl-class-inspector"
	help
	  Get information about a class and its structure.

	  https://metacpan.org/pod/Class::Inspector
```

## package/perl-class-load/Config.in
```kconfig
config BR2_PACKAGE_PERL_CLASS_LOAD
	bool "perl-class-load"
	depends on !BR2_STATIC_LIBS
	select BR2_PACKAGE_PERL_DATA_OPTLIST # runtime
	select BR2_PACKAGE_PERL_MODULE_IMPLEMENTATION # runtime
	select BR2_PACKAGE_PERL_MODULE_RUNTIME # runtime
	select BR2_PACKAGE_PERL_PACKAGE_STASH # runtime
	select BR2_PACKAGE_PERL_TRY_TINY # runtime
	help
	  A working (require "Class::Name") and more.

	  https://github.com/moose/Class-Load

comment "perl-class-load needs a toolchain w/ dynamic library"
	depends on BR2_STATIC_LIBS
```

## package/perl-class-method-modifiers/Config.in
```kconfig
config BR2_PACKAGE_PERL_CLASS_METHOD_MODIFIERS
	bool "perl-class-method-modifiers"
	help
	  Provides Moose-like method modifiers.

	  https://github.com/moose/Class-Method-Modifiers
```

## package/perl-class-std-fast/Config.in
```kconfig
config BR2_PACKAGE_PERL_CLASS_STD_FAST
	bool "perl-class-std-fast"
	select BR2_PACKAGE_PERL_CLASS_STD # runtime
	help
	  faster but less secure than Class::Std.

	  https://metacpan.org/release/Class-Std-Fast
```

## package/perl-class-std/Config.in
```kconfig
config BR2_PACKAGE_PERL_CLASS_STD
	bool "perl-class-std"
	help
	  Support for creating standard "inside-out" classes.

	  https://metacpan.org/release/Class-Std
```

## package/perl-convert-asn1/Config.in
```kconfig
config BR2_PACKAGE_PERL_CONVERT_ASN1
	bool "perl-convert-asn1"
	help
	  Convert between perl data structures and ASN.1 encoded
	  packets.

	  https://metacpan.org/release/Convert-ASN1
```

## package/perl-cookie-baker/Config.in
```kconfig
config BR2_PACKAGE_PERL_COOKIE_BAKER
	bool "perl-cookie-baker"
	select BR2_PACKAGE_PERL_URI # runtime
	help
	  Cookie string generator / parser.

	  https://github.com/kazeburo/Cookie-Baker
```

## package/perl-crypt-blowfish/Config.in
```kconfig
config BR2_PACKAGE_PERL_CRYPT_BLOWFISH
	bool "perl-crypt-blowfish"
	depends on !BR2_STATIC_LIBS
	help
	  Perl Blowfish encryption module.

	  https://metacpan.org/release/Crypt-Blowfish

comment "perl-crypt-blowfish needs a toolchain w/ dynamic library"
	depends on BR2_STATIC_LIBS
```

## package/perl-crypt-cbc/Config.in
```kconfig
config BR2_PACKAGE_PERL_CRYPT_CBC
	bool "perl-crypt-cbc"
	help
	  Encrypt Data with Cipher Block Chaining Mode.

	  https://metacpan.org/release/Crypt-CBC
```

## package/perl-crypt-openssl-aes/Config.in
```kconfig
config BR2_PACKAGE_PERL_CRYPT_OPENSSL_AES
	bool "perl-crypt-openssl-aes"
	depends on !BR2_STATIC_LIBS
	select BR2_PACKAGE_OPENSSL
	help
	  A Perl wrapper around OpenSSL's AES library.

	  https://metacpan.org/release/Crypt-OpenSSL-AES

comment "perl-crypt-openssl-aes needs a toolchain w/ dynamic library"
	depends on BR2_STATIC_LIBS
```

## package/perl-crypt-openssl-random/Config.in
```kconfig
config BR2_PACKAGE_PERL_CRYPT_OPENSSL_RANDOM
	bool "perl-crypt-openssl-random"
	depends on !BR2_STATIC_LIBS
	select BR2_PACKAGE_OPENSSL
	help
	  OpenSSL/LibreSSL pseudo-random number generator access.

	  https://metacpan.org/release/Crypt-OpenSSL-Random

comment "perl-crypt-openssl-random needs a toolchain w/ dynamic library"
	depends on BR2_STATIC_LIBS
```

## package/perl-crypt-openssl-rsa/Config.in
```kconfig
config BR2_PACKAGE_PERL_CRYPT_OPENSSL_RSA
	bool "perl-crypt-openssl-rsa"
	depends on !BR2_STATIC_LIBS
	select BR2_PACKAGE_PERL_CRYPT_OPENSSL_RANDOM # runtime
	help
	  RSA encoding and decoding, using the openSSL libraries.

	  http://github.com/toddr/Crypt-OpenSSL-RSA

comment "perl-crypt-openssl-rsa needs a toolchain w/ dynamic library"
	depends on BR2_STATIC_LIBS
```

## package/perl-crypt-ssleay/Config.in
```kconfig
config BR2_PACKAGE_PERL_CRYPT_SSLEAY
	bool "perl-crypt-ssleay"
	depends on !BR2_STATIC_LIBS
	select BR2_PACKAGE_OPENSSL
	select BR2_PACKAGE_PERL_LWP_PROTOCOL_HTTPS # runtime
	help
	  OpenSSL support for LWP.

	  https://metacpan.org/release/Crypt-SSLeay

comment "perl-crypt-ssleay needs a toolchain w/ dynamic library"
	depends on BR2_STATIC_LIBS
```

## package/perl-data-dump/Config.in
```kconfig
config BR2_PACKAGE_PERL_DATA_DUMP
	bool "perl-data-dump"
	help
	  Pretty printing of data structures.

	  https://metacpan.org/release/Data-Dump
```

## package/perl-data-optlist/Config.in
```kconfig
config BR2_PACKAGE_PERL_DATA_OPTLIST
	bool "perl-data-optlist"
	depends on !BR2_STATIC_LIBS
	select BR2_PACKAGE_PERL_PARAMS_UTIL # runtime
	select BR2_PACKAGE_PERL_SUB_INSTALL # runtime
	help
	  parse and validate simple name/value option pairs.

	  https://github.com/rjbs/Data-OptList

comment "perl-data-optlist needs a toolchain w/ dynamic library"
	depends on BR2_STATIC_LIBS
```

## package/perl-data-uuid/Config.in
```kconfig
config BR2_PACKAGE_PERL_DATA_UUID
	bool "perl-data-uuid"
	depends on !BR2_STATIC_LIBS
	help
	  Globally/Universally Unique Identifiers (GUIDs/UUIDs).

	  https://metacpan.org/release/Data-UUID

comment "perl-data-uuid needs a toolchain w/ dynamic library"
	depends on BR2_STATIC_LIBS
```

## package/perl-date-manip/Config.in
```kconfig
config BR2_PACKAGE_PERL_DATE_MANIP
	bool "perl-date-manip"
	help
	  Date manipulation routines.

	  https://metacpan.org/release/Date-Manip
```

## package/perl-datetime-tiny/Config.in
```kconfig
config BR2_PACKAGE_PERL_DATETIME_TINY
	bool "perl-datetime-tiny"
	help
	  A date object, with as little code as possible.

	  https://github.com/dagolden/DateTime-Tiny
```

## package/perl-db-file/Config.in
```kconfig
config BR2_PACKAGE_PERL_DB_FILE
	bool "perl-db-file"
	depends on !BR2_STATIC_LIBS
	select BR2_PACKAGE_BERKELEYDB
	help
	  Perl5 access to Berkeley DB version 1.x or 2.x.

	  https://metacpan.org/release/DB_File

comment "perl-db-file needs a toolchain w/ dynamic library"
	depends on BR2_STATIC_LIBS
```

## package/perl-dbd-mysql/Config.in
```kconfig
config BR2_PACKAGE_PERL_DBD_MYSQL
	bool "perl-dbd-mysql"
	depends on !BR2_STATIC_LIBS
	depends on BR2_INSTALL_LIBSTDCPP # mysql
	depends on BR2_USE_MMU # mysql
	depends on BR2_TOOLCHAIN_HAS_THREADS # mysql
	select BR2_PACKAGE_MYSQL
	select BR2_PACKAGE_PERL_DBI # runtime
	help
	  A MySQL driver for the Perl5 Database Interface (DBI).

	  http://dbi.perl.org/

comment "perl-dbd-mysql needs a toolchain w/ dynamic library, C++, threads"
	depends on BR2_USE_MMU
	depends on BR2_STATIC_LIBS || !BR2_INSTALL_LIBSTDCPP || \
		!BR2_TOOLCHAIN_HAS_THREADS
```

## package/perl-dbi/Config.in
```kconfig
config BR2_PACKAGE_PERL_DBI
	bool "perl-dbi"
	depends on !BR2_STATIC_LIBS
	help
	  Database independent interface for Perl.

	  http://dbi.perl.org/

comment "perl-dbi needs a toolchain w/ dynamic library"
	depends on BR2_STATIC_LIBS
```

## package/perl-devel-globaldestruction/Config.in
```kconfig
config BR2_PACKAGE_PERL_DEVEL_GLOBALDESTRUCTION
	bool "perl-devel-globaldestruction"
	select BR2_PACKAGE_PERL_SUB_EXPORTER_PROGRESSIVE # runtime
	help
	  Provides function returning the equivalent of
	  ${^GLOBAL_PHASE} eq 'DESTRUCT' for older perls.

	  https://metacpan.org/release/Devel-GlobalDestruction
```

## package/perl-devel-stacktrace-ashtml/Config.in
```kconfig
config BR2_PACKAGE_PERL_DEVEL_STACKTRACE_ASHTML
	bool "perl-devel-stacktrace-ashtml"
	select BR2_PACKAGE_PERL_DEVEL_STACKTRACE # runtime
	help
	  Displays stack trace in HTML.

	  https://github.com/miyagawa/Devel-StackTrace-AsHTML
```

## package/perl-devel-stacktrace/Config.in
```kconfig
config BR2_PACKAGE_PERL_DEVEL_STACKTRACE
	bool "perl-devel-stacktrace"
	help
	  An object representing a stack trace.

	  http://metacpan.org/release/Devel-StackTrace
```
