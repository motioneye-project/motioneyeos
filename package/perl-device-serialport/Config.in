## package/perl-device-serialport/Config.in
```kconfig
config BR2_PACKAGE_PERL_DEVICE_SERIALPORT
	bool "perl-device-serialport"
	depends on !BR2_STATIC_LIBS
	help
	  Linux/POSIX emulation of Win32::SerialPort functions.

	  https://metacpan.org/release/Device-SerialPort

comment "perl-device-serialport needs a toolchain w/ dynamic library"
	depends on BR2_STATIC_LIBS
```

## package/perl-digest-hmac/Config.in
```kconfig
config BR2_PACKAGE_PERL_DIGEST_HMAC
	bool "perl-digest-hmac"
	help
	  Keyed-Hashing for Message Authentication.

	  https://metacpan.org/release/Digest-HMAC
```

## package/perl-digest-md5/Config.in
```kconfig
config BR2_PACKAGE_PERL_DIGEST_MD5
	bool "perl-digest-md5"
	depends on !BR2_STATIC_LIBS
	help
	  Perl interface to the MD-5 algorithm.

	  https://metacpan.org/release/Digest-MD5

comment "perl-digest-md5 needs a toolchain w/ dynamic library"
	depends on BR2_STATIC_LIBS
```

## package/perl-digest-sha1/Config.in
```kconfig
config BR2_PACKAGE_PERL_DIGEST_SHA1
	bool "perl-digest-sha1"
	depends on !BR2_STATIC_LIBS
	help
	  Perl interface to the SHA-1 algorithm

	  https://metacpan.org/release/Digest-SHA1

comment "perl-digest-sha1 needs a toolchain w/ dynamic library"
	depends on BR2_STATIC_LIBS
```

## package/perl-dist-checkconflicts/Config.in
```kconfig
config BR2_PACKAGE_PERL_DIST_CHECKCONFLICTS
	bool "perl-dist-checkconflicts"
	select BR2_PACKAGE_PERL_MODULE_RUNTIME # runtime
	help
	  declare version conflicts for your dist.

	  http://metacpan.org/release/Dist-CheckConflicts
```

## package/perl-encode-detect/Config.in
```kconfig
config BR2_PACKAGE_PERL_ENCODE_DETECT
	bool "perl-encode-detect"
	depends on BR2_INSTALL_LIBSTDCPP
	depends on !BR2_STATIC_LIBS
	help
	  An Encode::Encoding subclass that detects the encoding of
	  data.

	  https://metacpan.org/release/Encode-Detect

comment "perl-encode-detect needs a toolchain w/ C++, dynamic library"
	depends on BR2_STATIC_LIBS || !BR2_INSTALL_LIBSTDCPP
```

## package/perl-encode-locale/Config.in
```kconfig
config BR2_PACKAGE_PERL_ENCODE_LOCALE
	bool "perl-encode-locale"
	help
	  Determine the locale encoding.

	  https://metacpan.org/release/Encode-Locale
```

## package/perl-exporter-tiny/Config.in
```kconfig
config BR2_PACKAGE_PERL_EXPORTER_TINY
	bool "perl-exporter-tiny"
	help
	  an exporter with the features of Sub::Exporter but only core
	  dependencies.

	  https://metacpan.org/release/Exporter-Tiny
```

## package/perl-file-listing/Config.in
```kconfig
config BR2_PACKAGE_PERL_FILE_LISTING
	bool "perl-file-listing"
	select BR2_PACKAGE_PERL_HTTP_DATE # runtime
	help
	  parse directory listing.

	  https://metacpan.org/release/File-Listing
```

## package/perl-file-sharedir/Config.in
```kconfig
config BR2_PACKAGE_PERL_FILE_SHAREDIR
	bool "perl-file-sharedir"
	select BR2_PACKAGE_PERL_CLASS_INSPECTOR # runtime
	help
	  Locate per-dist and per-module shared files.

	  https://metacpan.org/release/File-ShareDir
```

## package/perl-file-slurp/Config.in
```kconfig
config BR2_PACKAGE_PERL_FILE_SLURP
	bool "perl-file-slurp"
	help
	  Simple and Efficient Reading/Writing/Modifying of Complete
	  Files.

	  https://metacpan.org/release/File-Slurp
```

## package/perl-file-util/Config.in
```kconfig
config BR2_PACKAGE_PERL_FILE_UTIL
	bool "perl-file-util"
	help
	  Easy, versatile, portable file handling.

	  https://github.com/tommybutler/file-util/wiki
```

## package/perl-filesys-notify-simple/Config.in
```kconfig
config BR2_PACKAGE_PERL_FILESYS_NOTIFY_SIMPLE
	bool "perl-filesys-notify-simple"
	help
	  Simple and dumb file system watcher.

	  https://github.com/miyagawa/Filesys-Notify-Simple
```

## package/perl-gd/Config.in
```kconfig
config BR2_PACKAGE_PERL_GD
	bool "perl-gd"
	depends on !BR2_STATIC_LIBS
	select BR2_PACKAGE_ZLIB
	select BR2_PACKAGE_LIBPNG
	select BR2_PACKAGE_FREETYPE
	select BR2_PACKAGE_GD
	help
	  Perl interface to the gd2 graphics library

	  https://metacpan.org/release/GD

comment "perl-gd needs a toolchain w/ dynamic library"
	depends on BR2_STATIC_LIBS
```

## package/perl-gdgraph/Config.in
```kconfig
config BR2_PACKAGE_PERL_GDGRAPH
	bool "perl-gdgraph"
	depends on !BR2_STATIC_LIBS
	select BR2_PACKAGE_PERL_GD # runtime
	select BR2_PACKAGE_PERL_GDTEXTUTIL # runtime
	help
	  Produces charts with GD.

	  https://metacpan.org/release/GDGraph

comment "perl-gdgraph needs a toolchain w/ dynamic library"
	depends on BR2_STATIC_LIBS
```

## package/perl-gdtextutil/Config.in
```kconfig
config BR2_PACKAGE_PERL_GDTEXTUTIL
	bool "perl-gdtextutil"
	help
	  Text utilities for use with GD

	  https://metacpan.org/release/GDTextUtil
```

## package/perl-hash-multivalue/Config.in
```kconfig
config BR2_PACKAGE_PERL_HASH_MULTIVALUE
	bool "perl-hash-multivalue"
	help
	  Store multiple values per key.

	  https://github.com/miyagawa/Hash-MultiValue
```

## package/perl-html-parser/Config.in
```kconfig
config BR2_PACKAGE_PERL_HTML_PARSER
	bool "perl-html-parser"
	depends on !BR2_STATIC_LIBS
	select BR2_PACKAGE_PERL_HTML_TAGSET
	help
	  The HTML-Parser distribution is is a collection of modules that parse
	  and extract information from HTML documents

	  http://github.com/gisle/html-parser

comment "perl-html-parser needs a toolchain w/ dynamic library"
	depends on BR2_STATIC_LIBS
```

## package/perl-html-tagset/Config.in
```kconfig
config BR2_PACKAGE_PERL_HTML_TAGSET
	bool "perl-html-tagset"
	help
	  data tables useful in parsing HTML.

	  https://metacpan.org/release/HTML-Tagset
```

## package/perl-http-cookies/Config.in
```kconfig
config BR2_PACKAGE_PERL_HTTP_COOKIES
	bool "perl-http-cookies"
	select BR2_PACKAGE_PERL_HTTP_DATE # runtime
	select BR2_PACKAGE_PERL_HTTP_MESSAGE # runtime
	help
	  HTTP cookie jars.

	  https://github.com/libwww-perl/http-cookies
```

## package/perl-http-daemon/Config.in
```kconfig
config BR2_PACKAGE_PERL_HTTP_DAEMON
	bool "perl-http-daemon"
	select BR2_PACKAGE_PERL_HTTP_DATE # runtime
	select BR2_PACKAGE_PERL_HTTP_MESSAGE # runtime
	select BR2_PACKAGE_PERL_LWP_MEDIATYPES # runtime
	help
	  A simple http server class.

	  https://github.com/libwww-perl/HTTP-Daemon
```

## package/perl-http-date/Config.in
```kconfig
config BR2_PACKAGE_PERL_HTTP_DATE
	bool "perl-http-date"
	select BR2_PACKAGE_PERL_TIMEDATE # runtime
	help
	  HTTP::Date - date conversion routines.

	  https://github.com/libwww-perl/HTTP-Date
```

## package/perl-http-entity-parser/Config.in
```kconfig
config BR2_PACKAGE_PERL_HTTP_ENTITY_PARSER
	bool "perl-http-entity-parser"
	select BR2_PACKAGE_PERL_HTTP_MULTIPARTPARSER # runtime
	select BR2_PACKAGE_PERL_HASH_MULTIVALUE # runtime
	select BR2_PACKAGE_PERL_JSON_MAYBEXS # runtime
	select BR2_PACKAGE_PERL_STREAM_BUFFERED # runtime
	select BR2_PACKAGE_PERL_WWW_FORM_URLENCODED # runtime
	help
	  PSGI compliant HTTP Entity Parser.

	  https://github.com/kazeburo/HTTP-Entity-Parser
```

## package/perl-http-headers-fast/Config.in
```kconfig
config BR2_PACKAGE_PERL_HTTP_HEADERS_FAST
	bool "perl-http-headers-fast"
	select BR2_PACKAGE_PERL_HTTP_DATE # runtime
	help
	  faster implementation of HTTP::Headers.

	  https://github.com/tokuhirom/HTTP-Headers-Fast
```

## package/perl-http-message/Config.in
```kconfig
config BR2_PACKAGE_PERL_HTTP_MESSAGE
	bool "perl-http-message"
	select BR2_PACKAGE_PERL_ENCODE_LOCALE # runtime
	select BR2_PACKAGE_PERL_HTTP_DATE # runtime
	select BR2_PACKAGE_PERL_IO_HTML # runtime
	select BR2_PACKAGE_PERL_LWP_MEDIATYPES # runtime
	select BR2_PACKAGE_PERL_URI # runtime
	help
	  HTTP style message (base class).

	  https://github.com/libwww-perl/HTTP-Message
```
