## package/perl-http-multipartparser/Config.in
```kconfig
config BR2_PACKAGE_PERL_HTTP_MULTIPARTPARSER
	bool "perl-http-multipartparser"
	help
	  HTTP MultiPart Parser.

	  https://metacpan.org/release/HTTP-MultiPartParser
```

## package/perl-http-negotiate/Config.in
```kconfig
config BR2_PACKAGE_PERL_HTTP_NEGOTIATE
	bool "perl-http-negotiate"
	select BR2_PACKAGE_PERL_HTTP_MESSAGE # runtime
	help
	  choose a variant to serve.

	  https://metacpan.org/release/HTTP-Negotiate
```

## package/perl-i18n/Config.in
```kconfig
config BR2_PACKAGE_PERL_I18N
	bool "perl-i18n"
	select BR2_PACKAGE_PERL_LOCALE_MAKETEXT_LEXICON # runtime
	help
	  Perl Internationalization Pragma.

	  https://metacpan.org/release/i18n
```

## package/perl-io-html/Config.in
```kconfig
config BR2_PACKAGE_PERL_IO_HTML
	bool "perl-io-html"
	help
	  Perl module that opens a file and performs automatic charset
	  detection

	  https://github.com/madsen/io-html
```

## package/perl-io-interface/Config.in
```kconfig
config BR2_PACKAGE_PERL_IO_INTERFACE
	bool "perl-io-interface"
	depends on !BR2_STATIC_LIBS
	help
	  Access and modify network interface card configuration.

	  https://metacpan.org/release/IO-Interface

comment "perl-io-interface needs a toolchain w/ dynamic library"
	depends on BR2_STATIC_LIBS
```

## package/perl-io-socket-multicast/Config.in
```kconfig
config BR2_PACKAGE_PERL_IO_SOCKET_MULTICAST
	bool "perl-io-socket-multicast"
	depends on !BR2_STATIC_LIBS
	select BR2_PACKAGE_PERL_IO_INTERFACE # runtime
	help
	  Send and receive multicast messages.

	  https://metacpan.org/release/IO-Socket-Multicast

comment "perl-io-socket-multicast needs a toolchain w/ dynamic library"
	depends on BR2_STATIC_LIBS
```

## package/perl-io-socket-ssl/Config.in
```kconfig
config BR2_PACKAGE_PERL_IO_SOCKET_SSL
	bool "perl-io-socket-ssl"
	depends on !BR2_STATIC_LIBS
	select BR2_PACKAGE_PERL_NET_SSLEAY
	help
	  Nearly transparent SSL encapsulation for IO::Socket::INET.

	  https://github.com/noxxi/p5-io-socket-ssl

comment "perl-io-socket-ssl needs a toolchain w/ dynamic library"
	depends on BR2_STATIC_LIBS
```

## package/perl-json-maybexs/Config.in
```kconfig
config BR2_PACKAGE_PERL_JSON_MAYBEXS
	bool "perl-json-maybexs"
	help
	  Use Cpanel::JSON::XS with a fallback to JSON::XS and
	  JSON::PP.

	  https://metacpan.org/release/JSON-MaybeXS
```

## package/perl-json-tiny/Config.in
```kconfig
config BR2_PACKAGE_PERL_JSON_TINY
	bool "perl-json-tiny"
	help
	  Minimalistic JSON. No dependencies.

	  https://metacpan.org/release/JSON-Tiny
```

## package/perl-libwww-perl/Config.in
```kconfig
config BR2_PACKAGE_PERL_LIBWWW_PERL
	bool "perl-libwww-perl"
	depends on !BR2_STATIC_LIBS
	select BR2_PACKAGE_PERL_ENCODE_LOCALE # runtime
	select BR2_PACKAGE_PERL_FILE_LISTING # runtime
	select BR2_PACKAGE_PERL_HTML_PARSER # runtime
	select BR2_PACKAGE_PERL_HTTP_COOKIES # runtime
	select BR2_PACKAGE_PERL_HTTP_DAEMON # runtime
	select BR2_PACKAGE_PERL_HTTP_DATE # runtime
	select BR2_PACKAGE_PERL_HTTP_MESSAGE # runtime
	select BR2_PACKAGE_PERL_HTTP_NEGOTIATE # runtime
	select BR2_PACKAGE_PERL_LWP_MEDIATYPES # runtime
	select BR2_PACKAGE_PERL_NET_HTTP # runtime
	select BR2_PACKAGE_PERL_TRY_TINY # runtime
	select BR2_PACKAGE_PERL_URI # runtime
	select BR2_PACKAGE_PERL_WWW_ROBOTRULES # runtime
	help
	  The World-Wide Web library for Perl.

	  https://github.com/libwww-perl/libwww-perl

comment "perl-libwww-perl needs a toolchain w/ dynamic library"
	depends on BR2_STATIC_LIBS
```

## package/perl-libwww/Config.in
```kconfig
config BR2_PACKAGE_PERL_LIBWWW
	bool "perl-libwww"
	select BR2_PACKAGE_PERL_ENCODE_LOCALE
	select BR2_PACKAGE_PERL_FILE_LISTING
	select BR2_PACKAGE_PERL_HTML_PARSER
	select BR2_PACKAGE_PERL_HTTP_COOKIES
	select BR2_PACKAGE_PERL_HTTP_DAEMON
	select BR2_PACKAGE_PERL_HTTP_NEGOTIATE
	select BR2_PACKAGE_PERL_LWP_MEDIATYPES
	select BR2_PACKAGE_PERL_NET_HTTP
	select BR2_PACKAGE_PERL_URI
	select BR2_PACKAGE_PERL_WWW_ROBOTRULES
	help
	  The World-Wide Web library for Perl

	  https://github.com/libwww-perl/libwww-perl
```

## package/perl-locale-maketext-lexicon/Config.in
```kconfig
config BR2_PACKAGE_PERL_LOCALE_MAKETEXT_LEXICON
	bool "perl-locale-maketext-lexicon"
	help
	  Use other catalog formats in Maketext.

	  http://search.cpan.org/dist/Locale-Maketext-Lexicon
```

## package/perl-lwp-mediatypes/Config.in
```kconfig
config BR2_PACKAGE_PERL_LWP_MEDIATYPES
	bool "perl-lwp-mediatypes"
	help
	  guess media type for a file or a URL.

	  https://metacpan.org/release/LWP-MediaTypes
```

## package/perl-lwp-protocol-https/Config.in
```kconfig
config BR2_PACKAGE_PERL_LWP_PROTOCOL_HTTPS
	bool "perl-lwp-protocol-https"
	depends on !BR2_STATIC_LIBS
	select BR2_PACKAGE_PERL_IO_SOCKET_SSL # runtime
	select BR2_PACKAGE_PERL_MOZILLA_CA # runtime
	select BR2_PACKAGE_PERL_NET_HTTP # runtime
	select BR2_PACKAGE_PERL_LIBWWW_PERL # runtime
	help
	  Provide https support for LWP::UserAgent.

	  https://metacpan.org/release/LWP-Protocol-https

comment "perl-lwp-protocol-https needs a toolchain w/ dynamic library"
	depends on BR2_STATIC_LIBS
```

## package/perl-mail-dkim/Config.in
```kconfig
config BR2_PACKAGE_PERL_MAIL_DKIM
	bool "perl-mail-dkim"
	depends on !BR2_STATIC_LIBS
	select BR2_PACKAGE_PERL_CRYPT_OPENSSL_RSA # runtime
	select BR2_PACKAGE_PERL_MAILTOOLS # runtime
	select BR2_PACKAGE_PERL_NET_DNS # runtime
	help
	  Signs/verifies Internet mail with DKIM/DomainKey signatures.

	  https://metacpan.org/release/Mail-DKIM

comment "perl-mail-dkim needs a toolchain w/ dynamic library"
	depends on BR2_STATIC_LIBS
```

## package/perl-mailtools/Config.in
```kconfig
config BR2_PACKAGE_PERL_MAILTOOLS
	bool "perl-mailtools"
	select BR2_PACKAGE_PERL_TIMEDATE # runtime
	help
	  Various ancient e-mail related modules.

	  https://metacpan.org/release/MailTools
```

## package/perl-math-bigint/Config.in
```kconfig
config BR2_PACKAGE_PERL_MATH_BIGINT
	bool "perl-math-bigint"
	help
	  Pure Perl module to test Math::BigInt with scalars.

	  https://metacpan.org/release/Math-BigInt
```

## package/perl-math-prime-util/Config.in
```kconfig
config BR2_PACKAGE_PERL_MATH_PRIME_UTIL
	bool "perl-math-prime-util"
	depends on !BR2_STATIC_LIBS
	help
	  Utilities related to prime numbers, including fast sieves and
	  factoring.

	  https://github.com/danaj/Math-Prime-Util

comment "perl-math-prime-util needs a toolchain w/ dynamic library"
	depends on BR2_STATIC_LIBS
```

## package/perl-mime-base64-urlsafe/Config.in
```kconfig
config BR2_PACKAGE_PERL_MIME_BASE64_URLSAFE
	bool "perl-mime-base64-urlsafe"
	help
	  Perl version of Python's URL-safe base64 codec.

	  https://metacpan.org/release/MIME-Base64-URLSafe
```

## package/perl-mime-base64/Config.in
```kconfig
config BR2_PACKAGE_PERL_MIME_BASE64
	bool "perl-mime-base64"
	depends on !BR2_STATIC_LIBS
	help
	  The RFC 2045 encodings; base64 and quoted-printable.

	  https://metacpan.org/release/MIME-Base64

comment "perl-mime-base64 needs a toolchain w/ dynamic library"
	depends on BR2_STATIC_LIBS
```

## package/perl-mime-tools/Config.in
```kconfig
config BR2_PACKAGE_PERL_MIME_TOOLS
	bool "perl-mime-tools"
	select BR2_PACKAGE_PERL_MAILTOOLS # runtime
	help
	  Tools to manipulate MIME messages.

	  https://metacpan.org/release/MIME-tools
```

## package/perl-module-implementation/Config.in
```kconfig
config BR2_PACKAGE_PERL_MODULE_IMPLEMENTATION
	bool "perl-module-implementation"
	select BR2_PACKAGE_PERL_MODULE_RUNTIME # runtime
	select BR2_PACKAGE_PERL_TRY_TINY # runtime
	help
	  Loads one of several alternate underlying implementations for
	  a module.

	  http://metacpan.org/release/Module-Implementation
```

## package/perl-module-runtime/Config.in
```kconfig
config BR2_PACKAGE_PERL_MODULE_RUNTIME
	bool "perl-module-runtime"
	help
	  runtime module handling.

	  https://metacpan.org/release/Module-Runtime
```

## package/perl-mojolicious-plugin-authentication/Config.in
```kconfig
config BR2_PACKAGE_PERL_MOJOLICIOUS_PLUGIN_AUTHENTICATION
	bool "perl-mojolicious-plugin-authentication"
	select BR2_PACKAGE_PERL_MOJOLICIOUS # runtime
	help
	  A plugin to make authentication a bit easier.

	  https://metacpan.org/release/Mojolicious-Plugin-Authentication
```

## package/perl-mojolicious-plugin-authorization/Config.in
```kconfig
config BR2_PACKAGE_PERL_MOJOLICIOUS_PLUGIN_AUTHORIZATION
	bool "perl-mojolicious-plugin-authorization"
	select BR2_PACKAGE_PERL_MOJOLICIOUS # runtime
	help
	  A plugin to make authorization a bit easier.

	  https://metacpan.org/module/Mojolicious::Plugin::Authorization
```
