## package/perl-mojolicious-plugin-cspheader/Config.in
```kconfig
config BR2_PACKAGE_PERL_MOJOLICIOUS_PLUGIN_CSPHEADER
	bool "perl-mojolicious-plugin-cspheader"
	select BR2_PACKAGE_PERL_MOJOLICIOUS # runtime
	help
	  Mojolicious Plugin to add Content-Security-Policy header to
	  every HTTP response.

	  https://metacpan.org/release/Mojolicious-Plugin-CSPHeader
```

## package/perl-mojolicious-plugin-i18n/Config.in
```kconfig
config BR2_PACKAGE_PERL_MOJOLICIOUS_PLUGIN_I18N
	bool "perl-mojolicious-plugin-i18n"
	select BR2_PACKAGE_PERL_MOJOLICIOUS # runtime
	help
	  Internationalization Plugin for Mojolicious.

	  https://metacpan.org/release/Mojolicious-Plugin-I18N
```

## package/perl-mojolicious-plugin-securityheader/Config.in
```kconfig
config BR2_PACKAGE_PERL_MOJOLICIOUS_PLUGIN_SECURITYHEADER
	bool "perl-mojolicious-plugin-securityheader"
	select BR2_PACKAGE_PERL_MOJOLICIOUS # runtime
	help
	  Mojolicious Plugin.

	  http://github.com/reneeb/Mojolicious-Plugin-SecurityHeader
```

## package/perl-mojolicious/Config.in
```kconfig
config BR2_PACKAGE_PERL_MOJOLICIOUS
	bool "perl-mojolicious"
	help
	  Real-time web framework.

	  https://mojolicious.org
```

## package/perl-moo/Config.in
```kconfig
config BR2_PACKAGE_PERL_MOO
	bool "perl-moo"
	select BR2_PACKAGE_PERL_CLASS_METHOD_MODIFIERS # runtime
	select BR2_PACKAGE_PERL_MODULE_RUNTIME # runtime
	select BR2_PACKAGE_PERL_ROLE_TINY # runtime
	select BR2_PACKAGE_PERL_SUB_QUOTE # runtime
	help
	  Minimalist Object Orientation (with Moose compatibility).

	  https://metacpan.org/release/Moo
```

## package/perl-mozilla-ca/Config.in
```kconfig
config BR2_PACKAGE_PERL_MOZILLA_CA
	bool "perl-mozilla-ca"
	help
	  Mozilla's CA cert bundle in PEM format.

	  https://metacpan.org/release/Mozilla-CA
```

## package/perl-net-dns/Config.in
```kconfig
config BR2_PACKAGE_PERL_NET_DNS
	bool "perl-net-dns"
	select BR2_PACKAGE_PERL_DIGEST_HMAC
	help
	  Perl Interface to the Domain Name System

	  https://metacpan.org/release/Net-DNS
```

## package/perl-net-http/Config.in
```kconfig
config BR2_PACKAGE_PERL_NET_HTTP
	bool "perl-net-http"
	select BR2_PACKAGE_PERL_URI # runtime
	help
	  Low-level HTTP connection (client).

	  https://github.com/libwww-perl/Net-HTTP
```

## package/perl-net-ping/Config.in
```kconfig
config BR2_PACKAGE_PERL_NET_PING
	bool "perl-net-ping"
	help
	  check a remote host for reachability.

	  https://metacpan.org/release/Net-Ping
```

## package/perl-net-snmp/Config.in
```kconfig
config BR2_PACKAGE_PERL_NET_SNMP
	bool "perl-net-snmp"
	help
	  Object oriented interface to SNMP.

	  https://metacpan.org/release/Net-SNMP
```

## package/perl-net-ssh2/Config.in
```kconfig
config BR2_PACKAGE_PERL_NET_SSH2
	bool "perl-net-ssh2"
	depends on !BR2_STATIC_LIBS
	depends on BR2_PACKAGE_LIBSSH2_OPENSSL || BR2_PACKAGE_LIBSSH2_LIBGCRYPT
	select BR2_PACKAGE_ZLIB
	help
	  Support for the SSH 2 protocol via libssh2.

	  Note: only the OpenSSL and Libgcrypt backends of libssh2 are
	  supported.

	  https://metacpan.org/release/Net-SSH2

comment "perl-net-ssh2 needs a toolchain w/ dynamic library"
	depends on BR2_STATIC_LIBS

comment "perl-net-ssh2 needs libssh2 with OpenSSL or Libgcrypt backend"
	depends on !(BR2_PACKAGE_LIBSSH2_OPENSSL || BR2_PACKAGE_LIBSSH2_LIBGCRYPT)
```

## package/perl-net-ssleay/Config.in
```kconfig
config BR2_PACKAGE_PERL_NET_SSLEAY
	bool "perl-net-ssleay"
	depends on !BR2_STATIC_LIBS
	select BR2_PACKAGE_OPENSSL
	help
	  Perl extension for using OpenSSL.

	  https://metacpan.org/release/Net-SSLeay

comment "perl-net-ssleay needs a toolchain w/ dynamic library"
	depends on BR2_STATIC_LIBS
```

## package/perl-net-telnet/Config.in
```kconfig
config BR2_PACKAGE_PERL_NET_TELNET
	bool "perl-net-telnet"
	help
	  Interact with TELNET port or other TCP ports.

	  https://metacpan.org/release/Net-Telnet
```

## package/perl-netaddr-ip/Config.in
```kconfig
config BR2_PACKAGE_PERL_NETADDR_IP
	bool "perl-netaddr-ip"
	help
	  Manages IPv4 and IPv6 addresses and subnets.

	  https://metacpan.org/release/NetAddr-IP
```

## package/perl-number-bytes-human/Config.in
```kconfig
config BR2_PACKAGE_PERL_NUMBER_BYTES_HUMAN
	bool "perl-number-bytes-human"
	help
	  Convert byte count to human readable format.

	  https://metacpan.org/release/Number-Bytes-Human
```

## package/perl-package-stash/Config.in
```kconfig
config BR2_PACKAGE_PERL_PACKAGE_STASH
	bool "perl-package-stash"
	select BR2_PACKAGE_PERL_DIST_CHECKCONFLICTS # runtime
	select BR2_PACKAGE_PERL_MODULE_IMPLEMENTATION # runtime
	help
	  routines for manipulating stashes.

	  http://metacpan.org/release/Package-Stash
```

## package/perl-params-util/Config.in
```kconfig
config BR2_PACKAGE_PERL_PARAMS_UTIL
	bool "perl-params-util"
	depends on !BR2_STATIC_LIBS
	help
	  Simple, compact and correct param-checking functions.

	  https://metacpan.org/release/Params-Util

comment "perl-params-util needs a toolchain w/ dynamic library"
	depends on BR2_STATIC_LIBS
```

## package/perl-path-tiny/Config.in
```kconfig
config BR2_PACKAGE_PERL_PATH_TINY
	bool "perl-path-tiny"
	help
	  File path utility

	  https://github.com/dagolden/Path-Tiny
```

## package/perl-plack/Config.in
```kconfig
config BR2_PACKAGE_PERL_PLACK
	bool "perl-plack"
	select BR2_PACKAGE_PERL_APACHE_LOGFORMAT_COMPILER # runtime
	select BR2_PACKAGE_PERL_COOKIE_BAKER # runtime
	select BR2_PACKAGE_PERL_DEVEL_STACKTRACE # runtime
	select BR2_PACKAGE_PERL_DEVEL_STACKTRACE_ASHTML # runtime
	select BR2_PACKAGE_PERL_FILE_SHAREDIR # runtime
	select BR2_PACKAGE_PERL_FILESYS_NOTIFY_SIMPLE # runtime
	select BR2_PACKAGE_PERL_HTTP_ENTITY_PARSER # runtime
	select BR2_PACKAGE_PERL_HTTP_HEADERS_FAST # runtime
	select BR2_PACKAGE_PERL_HTTP_MESSAGE # runtime
	select BR2_PACKAGE_PERL_HASH_MULTIVALUE # runtime
	select BR2_PACKAGE_PERL_STREAM_BUFFERED # runtime
	select BR2_PACKAGE_PERL_TRY_TINY # runtime
	select BR2_PACKAGE_PERL_URI # runtime
	select BR2_PACKAGE_PERL_WWW_FORM_URLENCODED # runtime
	help
	  Perl Superglue for Web frameworks and Web Servers (PSGI
	  toolkit).

	  https://github.com/plack/Plack
```

## package/perl-posix-strftime-compiler/Config.in
```kconfig
config BR2_PACKAGE_PERL_POSIX_STRFTIME_COMPILER
	bool "perl-posix-strftime-compiler"
	help
	  GNU C library compatible strftime for loggers and servers.

	  https://github.com/kazeburo/POSIX-strftime-Compiler
```

## package/perl-role-tiny/Config.in
```kconfig
config BR2_PACKAGE_PERL_ROLE_TINY
	bool "perl-role-tiny"
	help
	  Roles. Like a nouvelle cuisine portion size slice of Moose.

	  https://metacpan.org/release/Role-Tiny
```

## package/perl-stream-buffered/Config.in
```kconfig
config BR2_PACKAGE_PERL_STREAM_BUFFERED
	bool "perl-stream-buffered"
	help
	  temporary buffer to save bytes.

	  https://github.com/plack/Stream-Buffered
```

## package/perl-sub-exporter-progressive/Config.in
```kconfig
config BR2_PACKAGE_PERL_SUB_EXPORTER_PROGRESSIVE
	bool "perl-sub-exporter-progressive"
	help
	  Only use Sub::Exporter if you need it.

	  https://github.com/frioux/Sub-Exporter-Progressive
```

## package/perl-sub-install/Config.in
```kconfig
config BR2_PACKAGE_PERL_SUB_INSTALL
	bool "perl-sub-install"
	help
	  install subroutines into packages easily.

	  https://github.com/rjbs/Sub-Install
```

## package/perl-sub-quote/Config.in
```kconfig
config BR2_PACKAGE_PERL_SUB_QUOTE
	bool "perl-sub-quote"
	help
	  Efficient generation of subroutines via string eval.

	  https://metacpan.org/release/Sub-Quote
```
