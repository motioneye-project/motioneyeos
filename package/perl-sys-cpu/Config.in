## package/perl-sys-cpu/Config.in
```kconfig
config BR2_PACKAGE_PERL_SYS_CPU
	bool "perl-sys-cpu"
	depends on !BR2_STATIC_LIBS
	help
	  Perl module for getting information about the system CPU
	  (Sys::CPU).

comment "perl-sys-cpu needs a toolchain w/ dynamic library"
	depends on BR2_STATIC_LIBS
```

## package/perl-sys-meminfo/Config.in
```kconfig
config BR2_PACKAGE_PERL_SYS_MEMINFO
	bool "perl-sys-meminfo"
	depends on !BR2_STATIC_LIBS
	help
	  query the total free and used physical memory.

	  https://metacpan.org/release/Sys-MemInfo

comment "perl-sys-meminfo needs a toolchain w/ dynamic library"
	depends on BR2_STATIC_LIBS
```

## package/perl-sys-mmap/Config.in
```kconfig
config BR2_PACKAGE_PERL_SYS_MMAP
	bool "perl-sys-mmap"
	depends on !BR2_STATIC_LIBS
	help
	  uses mmap to map in a file as a Perl variable.

	  https://metacpan.org/release/Sys-Mmap

comment "perl-sys-mmap needs a toolchain w/ dynamic library"
	depends on BR2_STATIC_LIBS
```

## package/perl-time-hires/Config.in
```kconfig
config BR2_PACKAGE_PERL_TIME_HIRES
	bool "perl-time-hires"
	depends on !BR2_STATIC_LIBS
	help
	  High resolution alarm, sleep, gettimeofday, interval timers.

	  https://metacpan.org/release/Time-HiRes

comment "perl-time-hires needs a toolchain w/ dynamic library"
	depends on BR2_STATIC_LIBS
```

## package/perl-time-parsedate/Config.in
```kconfig
config BR2_PACKAGE_PERL_TIME_PARSEDATE
	bool "perl-time-parsedate"
	help
	  Parse and format time values.

	  https://metacpan.org/release/Time-ParseDate
```

## package/perl-timedate/Config.in
```kconfig
config BR2_PACKAGE_PERL_TIMEDATE
	bool "perl-timedate"
	help
	  miscellaneous timezone manipulations routines.

	  https://metacpan.org/release/TimeDate
```

## package/perl-try-tiny/Config.in
```kconfig
config BR2_PACKAGE_PERL_TRY_TINY
	bool "perl-try-tiny"
	help
	  Minimal try/catch with proper preservation of $@

	  https://github.com/p5sagit/Try-Tiny
```

## package/perl-type-tiny/Config.in
```kconfig
config BR2_PACKAGE_PERL_TYPE_TINY
	bool "perl-type-tiny"
	select BR2_PACKAGE_PERL_EXPORTER_TINY # runtime
	help
	  tiny, yet Moo(se)-compatible type constraint.

	  http://typetiny.toby.ink/
```

## package/perl-uri/Config.in
```kconfig
config BR2_PACKAGE_PERL_URI
	bool "perl-uri"
	help
	  Uniform Resource Identifiers (absolute and relative)

	  https://github.com/libwww-perl/URI
```

## package/perl-www-form-urlencoded/Config.in
```kconfig
config BR2_PACKAGE_PERL_WWW_FORM_URLENCODED
	bool "perl-www-form-urlencoded"
	help
	  parser and builder for application/x-www-form-urlencoded.

	  https://github.com/kazeburo/WWW-Form-UrlEncoded
```

## package/perl-www-robotrules/Config.in
```kconfig
config BR2_PACKAGE_PERL_WWW_ROBOTRULES
	bool "perl-www-robotrules"
	select BR2_PACKAGE_PERL_URI # runtime
	help
	  database of robots.txt-derived permissions.

	  https://metacpan.org/release/WWW-RobotRules
```

## package/perl-x10/Config.in
```kconfig
config BR2_PACKAGE_PERL_X10
	bool "perl-x10"
	depends on !BR2_STATIC_LIBS
	select BR2_PACKAGE_PERL_ASTRO_SUNTIME # runtime
	select BR2_PACKAGE_PERL_DEVICE_SERIALPORT # runtime
	select BR2_PACKAGE_PERL_TIME_PARSEDATE # runtime
	help
	  creates a server used to receive events from an x10 client.

	  https://metacpan.org/release/X10

comment "perl-x10 needs a toolchain w/ dynamic library"
	depends on BR2_STATIC_LIBS
```

## package/perl-xml-libxml/Config.in
```kconfig
config BR2_PACKAGE_PERL_XML_LIBXML
	bool "perl-xml-libxml"
	depends on !BR2_STATIC_LIBS
	select BR2_PACKAGE_LIBXML2
	select BR2_PACKAGE_ZLIB
	select BR2_PACKAGE_PERL_XML_NAMESPACESUPPORT # runtime
	select BR2_PACKAGE_PERL_XML_SAX # runtime
	select BR2_PACKAGE_PERL_XML_SAX_BASE # runtime
	help
	  Interface to Gnome libxml2 xml parsing and DOM library.

	  https://github.com/shlomif/perl-XML-LibXML

comment "perl-xml-libxml needs a toolchain w/ dynamic library"
	depends on BR2_STATIC_LIBS
```

## package/perl-xml-namespacesupport/Config.in
```kconfig
config BR2_PACKAGE_PERL_XML_NAMESPACESUPPORT
	bool "perl-xml-namespacesupport"
	help
	  A simple generic namespace processor

	  https://github.com/perigrin/xml-namespacesupport
```

## package/perl-xml-sax-base/Config.in
```kconfig
config BR2_PACKAGE_PERL_XML_SAX_BASE
	bool "perl-xml-sax-base"
	help
	  Base class for SAX Drivers and Filters

	  https://metacpan.org/release/XML-SAX-Base
```

## package/perl-xml-sax/Config.in
```kconfig
config BR2_PACKAGE_PERL_XML_SAX
	bool "perl-xml-sax"
	select BR2_PACKAGE_PERL_XML_NAMESPACESUPPORT # runtime
	select BR2_PACKAGE_PERL_XML_SAX_BASE # runtime
	help
	  Simple API for XML.

	  https://metacpan.org/release/XML-SAX
```

## package/perl/Config.in
```kconfig
config BR2_PACKAGE_PERL
	bool "perl"
	depends on BR2_USE_MMU # fork()
	help
	  Larry Wall's Practical Extraction and Report Language
	  An interpreted scripting language, known among some as
	  "Unix's Swiss Army Chainsaw".

	  http://www.perl.org/

if BR2_PACKAGE_PERL

config BR2_PACKAGE_PERL_MODULES
	string "custom module selection"
	help
	  List of space-separated perl modules (without .pm) to copy
	  to the rootfs.

	  Examples: constant Getopt/Std Time/Local

	  Module dependencies on external libraries are not automatic so
	  check your needs.

	  Leave empty for all modules (as far as the external libraries
	  are available).

endif
```

## package/phidgetwebservice/Config.in
```kconfig
config BR2_PACKAGE_PHIDGETWEBSERVICE
	bool "phidgetwebservice"
	depends on BR2_TOOLCHAIN_HAS_THREADS # libusb, libphidget
	depends on !BR2_STATIC_LIBS # libphidget
	select BR2_PACKAGE_LIBPHIDGET
	help
	  phidgetwebservice (the Phidget WebService) provides an HTTP
	  front-end to the libphidget device control API. This
	  provides an alternative to the libphidget C linkage
	  interface for controlling locally attached Phidgets USB
	  devices and it also allows you to control Phidget USB
	  devices remotely when the host running the phidgetwebservice
	  has an exposed network interface.

	  The phidgetwebservice client program uses the libphidget
	  HTTP functions to send commands to the phidgetwebservice.

	  http://phidgets.com/

comment "phidgetwebservice needs a toolchain w/ threads, dynamic library"
	depends on !BR2_TOOLCHAIN_HAS_THREADS
	depends on BR2_STATIC_LIBS
```

## package/php-amqp/Config.in
```kconfig
config BR2_PACKAGE_PHP_AMQP
	bool "php-amqp"
	depends on BR2_PACKAGE_PHP
	depends on BR2_TOOLCHAIN_HAS_THREADS # rabbitmq-c
	select BR2_PACKAGE_RABBITMQ_C
	help
	  Communicate with any AMQP compliant server.

	  http://pecl.php.net/package/amqp

comment "php-amqp needs a toolchain w/ threads"
	depends on !BR2_TOOLCHAIN_HAS_THREADS
```

## package/php-geoip/Config.in
```kconfig
config BR2_PACKAGE_PHP_GEOIP
	bool "php-geoip"
	select BR2_PACKAGE_GEOIP
	help
	  PHP GeoIP-based IP address mapper to geographical places.

	  http://pecl.php.net/package/geoip
```

## package/php-gnupg/Config.in
```kconfig
config BR2_PACKAGE_PHP_GNUPG
	bool "php-gnupg"
	depends on BR2_PACKAGE_PHP
	depends on BR2_USE_MMU # libassuan
	select BR2_PACKAGE_LIBGPGME
	help
	  PHP wrapper around the gpgme library.

	  http://pecl.php.net/package/gnupg
```

## package/php-imagick/Config.in
```kconfig
config BR2_PACKAGE_PHP_IMAGICK
	bool "php-imagick"
	depends on BR2_PACKAGE_PHP
	depends on BR2_USE_MMU # imagemagick
	depends on BR2_TOOLCHAIN_HAS_THREADS # imagemagick
	select BR2_PACKAGE_IMAGEMAGICK
	help
	  PHP wrapper to the ImageMagick library.

	  http://pecl.php.net/package/imagick

comment "php-imagemagick needs a toolchain w/ threads"
	depends on BR2_USE_MMU
	depends on BR2_PACKAGE_PHP
	depends on !BR2_TOOLCHAIN_HAS_THREADS
```

## package/php-memcached/Config.in
```kconfig
config BR2_PACKAGE_PHP_MEMCACHED
	bool "php-memcached"
	depends on BR2_INSTALL_LIBSTDCPP # libmemcached
	depends on BR2_TOOLCHAIN_HAS_THREADS # libmemcached
	select BR2_PACKAGE_PHP_EXT_SESSION
	select BR2_PACKAGE_LIBMEMCACHED
	select BR2_PACKAGE_ZLIB
	help
	  PHP extension for interfacing with memcached via
	  libmemcached library.

	  http://pecl.php.net/package/memcached

comment "php-memcached needs a toolchain w/ C++, threads"
	depends on !BR2_INSTALL_LIBSTDCPP || !BR2_TOOLCHAIN_HAS_THREADS
```

## package/php-ssh2/Config.in
```kconfig
config BR2_PACKAGE_PHP_SSH2
	bool "php-ssh2"
	depends on BR2_PACKAGE_PHP
	depends on BR2_PACKAGE_LIBGPG_ERROR_ARCH_SUPPORTS \
		&& !BR2_PACKAGE_OPENSSL # libssh2, libgcrypt
	select BR2_PACKAGE_LIBSSH2
	help
	  PHP bindings for the libssh2 library.

	  http://pecl.php.net/package/ssh2
```

## package/php-yaml/Config.in
```kconfig
config BR2_PACKAGE_PHP_YAML
	bool "php-yaml"
	select BR2_PACKAGE_LIBYAML
	help
	  PHP YAML-1.1 parser and emitter.

	  http://pecl.php.net/package/yaml
```
