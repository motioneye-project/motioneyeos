## package/php-zmq/Config.in
```kconfig
comment "php-zmq needs a toolchain w/ C++, NPTL"
	depends on !(BR2_INSTALL_LIBSTDCPP && BR2_TOOLCHAIN_HAS_THREADS_NPTL)

config BR2_PACKAGE_PHP_ZMQ
	bool "php-zmq"
	depends on BR2_PACKAGE_PHP
	depends on BR2_INSTALL_LIBSTDCPP
	depends on BR2_TOOLCHAIN_HAS_THREADS_NPTL # zeromq
	select BR2_PACKAGE_ZEROMQ
	help
	  ZeroMQ messaging bindings for PHP

	  http://pecl.php.net/package/zmq
```

## package/php/Config.in
```kconfig
config BR2_PACKAGE_PHP
	bool "php"
	select BR2_PACKAGE_PHP_SAPI_CGI if \
	       !BR2_PACKAGE_PHP_SAPI_CLI && \
	       !BR2_PACKAGE_PHP_SAPI_FPM &&  \
	       BR2_USE_MMU
	select BR2_PACKAGE_PHP_SAPI_CLI if !BR2_USE_MMU
	help
	  PHP  is a widely-used general-purpose scripting
	  language that is especially suited for Web development
	  and can be embedded into HTML.

	  http://www.php.net

if BR2_PACKAGE_PHP

config BR2_PACKAGE_PHP_SAPI_CGI
	bool "CGI interface"
	# CGI uses fork()
	depends on BR2_USE_MMU
	help
	  Common Gateway Interface

config BR2_PACKAGE_PHP_SAPI_CLI
	bool "CLI interface"
	help
	  Command Line Interface

config BR2_PACKAGE_PHP_SAPI_FPM
	bool "FPM interface"
	depends on BR2_USE_MMU
	help
	  PHP-FPM (FastCGI Process Manager)

source "package/php/Config.ext"

endif
```

## package/physfs/Config.in
```kconfig
config BR2_PACKAGE_PHYSFS
	bool "physfs"
	depends on BR2_INSTALL_LIBSTDCPP
	depends on BR2_TOOLCHAIN_HAS_THREADS
	help
	  PhysicsFS; a portable, flexible file i/o abstraction.

	  http://icculus.org/physfs

comment "physfs needs a toolchain w/ C++, threads"
	depends on !BR2_INSTALL_LIBSTDCPP || !BR2_TOOLCHAIN_HAS_THREADS
```

## package/phytool/Config.in
```kconfig
config BR2_PACKAGE_PHYTOOL
	bool "phytool"
	depends on BR2_TOOLCHAIN_HEADERS_AT_LEAST_3_7 # linux/mdio.h
	help
	  Linux MDIO register access utility.

	  https://github.com/wkz/phytool

comment "phytool needs a toolchain w/ headers >= 3.7"
	depends on !BR2_TOOLCHAIN_HEADERS_AT_LEAST_3_7
```

## package/picocom/Config.in
```kconfig
config BR2_PACKAGE_PICOCOM
	bool "picocom"
	help
	  picocom is a minimal dumb-terminal emulation program. It
	  is, in principle, very much like minicom, only it's pico
	  instead of mini!

	  http://code.google.com/p/picocom/
```

## package/pifmrds/Config.in
```kconfig
config BR2_PACKAGE_PIFMRDS
	bool "pifmrds"
	depends on BR2_arm
	select BR2_PACKAGE_LIBSNDFILE
	help
	  pifmrds, FM-RDS transmitter using the Raspberry Pi's PWM

	  https://github.com/ChristopheJacquet/PiFmRds
```

## package/piglit/Config.in
```kconfig
config BR2_PACKAGE_PIGLIT
	bool "piglit"
	depends on BR2_PACKAGE_PYTHON3 # python3 only script
	depends on BR2_PACKAGE_PYTHON_NUMPY_ARCH_SUPPORTS
	depends on BR2_PACKAGE_WAFFLE_SUPPORTS_GLX || \
		BR2_PACKAGE_WAFFLE_SUPPORTS_WAYLAND || \
		BR2_PACKAGE_WAFFLE_SUPPORTS_X11_EGL || \
		BR2_PACKAGE_WAFFLE_SUPPORTS_GBM
	depends on BR2_TOOLCHAIN_USES_GLIBC || BR2_TOOLCHAIN_USES_MUSL # python-numpy
	select BR2_PACKAGE_LIBDRM if BR2_PACKAGE_HAS_LIBGL
	select BR2_PACKAGE_LIBPNG
	select BR2_PACKAGE_LIBXKBCOMMON if BR2_PACKAGE_WAYLAND
	select BR2_PACKAGE_MESA3D_DEMOS # glxinfo
	select BR2_PACKAGE_PYTHON_MAKO
	select BR2_PACKAGE_PYTHON_NUMPY
	select BR2_PACKAGE_PYTHON_SIX
	select BR2_PACKAGE_PYTHON3_BZIP2
	select BR2_PACKAGE_PYTHON3_PYEXPAT
	select BR2_PACKAGE_PYTHON3_XZ
	select BR2_PACKAGE_PYTHON3_ZLIB
	select BR2_PACKAGE_UTIL_LINUX # runtime
	select BR2_PACKAGE_UTIL_LINUX_BINARIES # requires real dmesg tool
	select BR2_PACKAGE_WAFFLE # wflinfo, libwaffle-1
	select BR2_PACKAGE_XLIB_LIBX11 if BR2_PACKAGE_XORG7
	select BR2_PACKAGE_XLIB_LIBXEXT if BR2_PACKAGE_XORG7
	select BR2_PACKAGE_XORGPROTO if BR2_PACKAGE_XORG7
	select BR2_PACKAGE_ZLIB
	help
	  Piglit is an open-source test suite for OpenGL
	  implementations.

	  https://piglit.freedesktop.org

comment "piglit needs glibc or musl"
	depends on !(BR2_TOOLCHAIN_USES_GLIBC || BR2_TOOLCHAIN_USES_MUSL)
```

## package/pigpio/Config.in
```kconfig
config BR2_PACKAGE_PIGPIO
	bool "pigpio"
	depends on BR2_aarch64 || BR2_arm
	depends on BR2_TOOLCHAIN_HAS_THREADS
	depends on !BR2_STATIC_LIBS
	help
	  Pigpio is a library for the Raspberry Pi which allows
	  control of the General Purpose Input Outputs (GPIO).

	  http://abyz.me.uk/rpi/pigpio/

comment "pigpio needs a toolchain w/ threads, dynamic library"
	depends on BR2_aarch64 || BR2_arm
	depends on !BR2_TOOLCHAIN_HAS_THREADS || BR2_STATIC_LIBS
```

## package/pigz/Config.in
```kconfig
config BR2_PACKAGE_PIGZ
	bool "pigz"
	depends on BR2_TOOLCHAIN_HAS_THREADS
	select BR2_PACKAGE_ZLIB
	help
	  pigz, which stands for parallel implementation of gzip, is a
	  fully functional replacement for gzip that exploits multiple
	  processors and multiple cores to the hilt when compressing
	  data.

	  http://www.zlib.net/pigz/

comment "pigz needs a toolchain w/ threads"
	depends on !BR2_TOOLCHAIN_HAS_THREADS
```

## package/pigz/Config.in.host
```kconfig
config BR2_PACKAGE_HOST_PIGZ
	bool "host pigz"
	help
	  pigz, which stands for parallel implementation of gzip, is a
	  fully functional replacement for gzip that exploits multiple
	  processors and multiple cores to the hilt when compressing
	  data.

	  http://www.zlib.net/pigz/
```

## package/pimd/Config.in
```kconfig
config BR2_PACKAGE_PIMD
	bool "pimd"
	depends on BR2_USE_MMU # fork()
	help
	  pimd is a lightweight stand-alone PIM-SM v2 multicast routing
	  daemon.

	  http://troglobit.com/projects/pimd/
```

## package/pinentry/Config.in
```kconfig
menuconfig BR2_PACKAGE_PINENTRY
	bool "pinentry"
	depends on BR2_PACKAGE_LIBGPG_ERROR_ARCH_SUPPORTS # libgpg-error
	depends on BR2_USE_MMU # libassuan
	select BR2_PACKAGE_LIBASSUAN
	select BR2_PACKAGE_LIBGPG_ERROR
	# At least one backend is needed to avoid build breakage
	select BR2_PACKAGE_PINENTRY_NCURSES if \
		!BR2_PACKAGE_PINENTRY_GTK2 && \
		!BR2_PACKAGE_PINENTRY_QT5
	help
	  A collection of simple PIN or pass-phrase entry dialogs

	  https://www.gnupg.org/related_software/pinentry/

if BR2_PACKAGE_PINENTRY

config BR2_PACKAGE_PINENTRY_FLTK
	bool "pinentry-fltk"
	depends on BR2_USE_MMU # fltk
	depends on BR2_INSTALL_LIBSTDCPP # fltk
	depends on BR2_PACKAGE_XORG7 # fltk
	select BR2_PACKAGE_FLTK
	help
	  The pinentry-fltk tool

comment "pinentry-fltk needs X and a toolchain w/ C++"
	depends on BR2_USE_MMU
	depends on !BR2_PACKAGE_XORG7 || !BR2_INSTALL_LIBSTDCPP

config BR2_PACKAGE_PINENTRY_NCURSES
	bool "pinentry-ncurses"
	select BR2_PACKAGE_NCURSES
	select BR2_PACKAGE_LIBICONV if !BR2_ENABLE_LOCALE
	help
	  The pinentry-ncurses tool

config BR2_PACKAGE_PINENTRY_GTK2
	bool "pinentry-gtk2"
	depends on BR2_PACKAGE_XORG7
	depends on BR2_USE_WCHAR
	depends on BR2_TOOLCHAIN_HAS_THREADS
	depends on BR2_USE_MMU
	depends on BR2_INSTALL_LIBSTDCPP
	depends on BR2_TOOLCHAIN_HAS_SYNC_4 # libgtk2 -> pango -> harfbuzz
	depends on BR2_TOOLCHAIN_GCC_AT_LEAST_4_8 # libgtk2 -> pango -> harfbuzz
	select BR2_PACKAGE_LIBGTK2
	select BR2_PACKAGE_LIBICONV if !BR2_ENABLE_LOCALE
	help
	  The pinentry-gtk2 tool

comment "pinentry-gtk2 needs X and a toolchain w/ wchar, threads, C++, gcc >= 4.8"
	depends on BR2_USE_MMU
	depends on BR2_TOOLCHAIN_HAS_SYNC_4
	depends on !BR2_PACKAGE_XORG7 || !BR2_USE_WCHAR || \
		!BR2_TOOLCHAIN_GCC_AT_LEAST_4_8 || \
		!BR2_INSTALL_LIBSTDCPP || !BR2_TOOLCHAIN_HAS_THREADS

config BR2_PACKAGE_PINENTRY_QT5
	bool "pinentry-qt5"
	depends on BR2_INSTALL_LIBSTDCPP
	depends on BR2_USE_WCHAR
	depends on BR2_TOOLCHAIN_HAS_THREADS_NPTL
	depends on BR2_TOOLCHAIN_GCC_AT_LEAST_5
	depends on !BR2_arc
	depends on !BR2_STATIC_LIBS
	select BR2_PACKAGE_QT5
	select BR2_PACKAGE_QT5BASE_GUI
	select BR2_PACKAGE_QT5BASE_WIDGETS
	help
	  The pinentry-qt5 tool

comment "pinentry-qt5 needs a toolchain w/ wchar, NPTL, gcc >= 5.0, C++, dynamic library"
	depends on !BR2_arc
	depends on !BR2_INSTALL_LIBSTDCPP || !BR2_USE_WCHAR || \
		!BR2_TOOLCHAIN_HAS_THREADS_NPTL || !BR2_TOOLCHAIN_GCC_AT_LEAST_5 || \
		BR2_STATIC_LIBS

endif
```

## package/pipewire/Config.in
```kconfig
config BR2_PACKAGE_PIPEWIRE
	bool "pipewire"
	depends on BR2_PACKAGE_HAS_UDEV # libudev
	depends on BR2_TOOLCHAIN_HAS_THREADS # dbus, alsa-lib
	depends on BR2_USE_MMU # dbus
	select BR2_PACKAGE_ALSA_LIB
	select BR2_PACKAGE_DBUS
	help
	  PipeWire is a server and user space API to deal with
	  multimedia pipelines.

	  https://pipewire.org/

if BR2_PACKAGE_PIPEWIRE

config BR2_PACKAGE_PIPEWIRE_GSTREAMER
	bool "pipewire gstreamer plugins"
	depends on BR2_USE_WCHAR # libglib2
	depends on BR2_TOOLCHAIN_HAS_THREADS # libglib2
	depends on BR2_USE_MMU # libglib2
	select BR2_PACKAGE_LIBGLIB2
	select BR2_PACKAGE_GSTREAMER1
	select BR2_PACKAGE_GST1_PLUGINS_BASE
	help
	  Build GStreamer plugins

comment "pipewire gstreamer support needs a toolchain w/ wchar, threads"
	depends on BR2_USE_MMU
	depends on !BR2_USE_WCHAR || !BR2_TOOLCHAIN_HAS_THREADS

endif

comment "pipewire needs udev and a toolchain w/ threads"
	depends on BR2_USE_MMU
	depends on !BR2_PACKAGE_HAS_UDEV || !BR2_TOOLCHAIN_HAS_THREADS
```

## package/pistache/Config.in
```kconfig
config BR2_PACKAGE_PISTACHE
	bool "pistache"
	depends on BR2_TOOLCHAIN_GCC_AT_LEAST_4_9 # C++14
	depends on BR2_USE_WCHAR
	depends on BR2_TOOLCHAIN_HAS_THREADS
	depends on BR2_INSTALL_LIBSTDCPP
	depends on !BR2_TOOLCHAIN_USES_UCLIBC
	help
	  Pistache is a modern and elegant HTTP and REST framework
	  for C++. It is entirely written in pure C++14 and provides
	  a clear and pleasant API.

	  https://github.com/oktal/pistache

comment "pistache needs a glibc toolchain w/ C++, gcc >= 4.9, threads, wchar"
	depends on !BR2_INSTALL_LIBSTDCPP || \
	BR2_TOOLCHAIN_USES_UCLIBC || \
	!BR2_TOOLCHAIN_GCC_AT_LEAST_4_9 || \
	!BR2_TOOLCHAIN_HAS_THREADS || \
	!BR2_USE_WCHAR
```

## package/pixiewps/Config.in
```kconfig
config BR2_PACKAGE_PIXIEWPS
	bool "pixiewps"
	depends on BR2_TOOLCHAIN_HAS_THREADS
	help
	  Pixie WPS is a C based tool to audit networks against the so
	  called "Pixie Dust" attack.

	  https://github.com/wiire-a/pixiewps/wiki

comment "pixiewps needs a toolchain w/ threads"
	depends on !BR2_TOOLCHAIN_HAS_THREADS
```

## package/pixman/Config.in
```kconfig
config BR2_PACKAGE_PIXMAN
	bool "pixman"
	help
	  Cairo pixel manager

	  http://cairographics.org/releases/
```

## package/pixz/Config.in
```kconfig
config BR2_PACKAGE_PIXZ
	bool "pixz"
	depends on BR2_TOOLCHAIN_HAS_THREADS
	depends on BR2_USE_WCHAR # libarchive
	select BR2_PACKAGE_LIBARCHIVE
	select BR2_PACKAGE_XZ
	help
	  Pixz (pronounced pixie) is a parallel, indexing version of xz.

	  https://github.com/vasi/pixz

comment "pixz needs a toolchain w/ threads, wchar"
	depends on !BR2_TOOLCHAIN_HAS_THREADS || !BR2_USE_WCHAR
```

## package/pkcs11-helper/Config.in
```kconfig
config BR2_PACKAGE_PKCS11_HELPER
	bool "pkcs11-helper"
	depends on !BR2_STATIC_LIBS # dlfcn.h
	help
	  pkcs11-helper is a library that simplifies the interaction
	  with PKCS#11 providers for end-user applications.

	  pkcs11-helper allows using multiple PKCS#11 providers at the
	  same time, enumerating available token certificates, or
	  selecting a certificate directly by serialized id, handling
	  card removal and card insert events, handling card re-insert
	  to a different slot, supporting session expiration and much
	  more all using a simple API.

	  pkcs11-helper is not designed to manage card content, since
	  object attributes are usually vendor specific, and 99% of
	  application need to access existing objects in order to
	  perform signature and decryption.

	  https://github.com/OpenSC/pkcs11-helper

comment "pkcs11-helper needs a toolchain w/ dynamic library"
	depends on BR2_STATIC_LIBS
```

## package/pkg-config/Config.in
```kconfig
config BR2_PACKAGE_PKG_CONFIG
	bool "pkg-config"
	depends on BR2_USE_WCHAR # glib2
	depends on BR2_TOOLCHAIN_HAS_THREADS # glib2
	depends on BR2_USE_MMU # glib2
	depends on BR2_DEPRECATED
	select BR2_PACKAGE_LIBGLIB2
	help
	  pkg-config is a system for managing library compile/link
	  flags that works with automake and autoconf. It replaces
	  the ubiquitous *-config scripts you may have seen with a
	  single tool.

	  http://www.freedesktop.org/software/pkgconfig/

comment "pkg-config needs a toolchain w/ wchar, threads"
	depends on BR2_DEPRECATED
	depends on BR2_USE_MMU
	depends on !BR2_USE_WCHAR || !BR2_TOOLCHAIN_HAS_THREADS
```

## package/pkgconf/Config.in
```kconfig
config BR2_PACKAGE_PKGCONF
	bool "pkgconf"
	help
	  pkgconf is a program which helps to configure compiler and
	  linker flags for development frameworks. It is similar to
	  pkg-config, but was written from scratch in the summer of
	  2011 to replace pkg-config, which now needs itself to build
	  itself

	  http://pkgconf.org/
```

## package/pkgconf/Config.in.host
```kconfig
config BR2_PACKAGE_HOST_PKGCONF
	bool "host pkgconf"
	help
	  pkgconf is a program which helps to configure compiler and linker
	  flags for development frameworks. It is similar to pkg-config,
	  but was written from scratch in the summer of 2011 to replace
	  pkg-config, which now needs itself to build itself

	  https://github.com/pkgconf/pkgconf
```

## package/pkgconfig/Config.in
```kconfig
config BR2_PACKAGE_PKG_CONFIG
	bool "pkg-config"
	select BR2_PACKAGE_LIBGLIB2
	help
	  pkg-config is a system for managing library compile/link
	  flags that works with automake and autoconf. It replaces
	  the ubiquitous *-config scripts you may have seen with a
	  single tool.

	  http://www.freedesktop.org/software/pkgconfig/
```

## package/pngquant/Config.in
```kconfig
config BR2_PACKAGE_PNGQUANT
	bool "pngquant"
	select BR2_PACKAGE_LIBPNG
	select BR2_PACKAGE_ZLIB
	help
	  Lossy PNG compressor — pngquant command and libimagequant
	  library

	  https://pngquant.org
```

## package/poco/Config.in
```kconfig
config BR2_PACKAGE_POCO_ARCH_SUPPORTS
	bool
	default y
	depends on !BR2_arc
	depends on !BR2_microblaze
	depends on !BR2_mipsel
	depends on !BR2_or1k
	depends on !BR2_riscv
	depends on !BR2_xtensa

config BR2_PACKAGE_POCO
	bool "poco"
	depends on BR2_INSTALL_LIBSTDCPP
	depends on BR2_USE_WCHAR
	# pthread_condattr_setclock
	depends on BR2_TOOLCHAIN_HAS_THREADS_NPTL
	depends on !BR2_STATIC_LIBS # dlopen()
	depends on BR2_PACKAGE_POCO_ARCH_SUPPORTS
	select BR2_PACKAGE_ZLIB
	select BR2_PACKAGE_PCRE
	help
	  The C++ Portable Components Libraries

	  http://pocoproject.org

if BR2_PACKAGE_POCO

comment "poco components"

config BR2_PACKAGE_POCO_JSON
	bool "json"

config BR2_PACKAGE_POCO_XML
	bool "xml"
	select BR2_PACKAGE_EXPAT

config BR2_PACKAGE_POCO_UTIL
	bool "util"
	select BR2_PACKAGE_POCO_XML

config BR2_PACKAGE_POCO_NET
	bool "net"

config BR2_PACKAGE_POCO_CRYPTO
	bool "crypto"
	select BR2_PACKAGE_OPENSSL

config BR2_PACKAGE_POCO_NETSSL_OPENSSL
	bool "netssl_openssl"
	select BR2_PACKAGE_POCO_NET
	select BR2_PACKAGE_POCO_CRYPTO
	select BR2_PACKAGE_POCO_UTIL
	select BR2_PACKAGE_OPENSSL

config BR2_PACKAGE_POCO_ZIP
	bool "zip"
	select BR2_PACKAGE_POCO_XML
	select BR2_PACKAGE_POCO_NET
	select BR2_PACKAGE_POCO_UTIL

config BR2_PACKAGE_POCO_CPP_PARSER
	bool "cpp_parser"

config BR2_PACKAGE_POCO_PDF
	bool "pdf"
	select BR2_PACKAGE_POCO_JSON
	select BR2_PACKAGE_POCO_UTIL
	select BR2_PACKAGE_POCO_XML

config BR2_PACKAGE_POCO_REDIS
	bool "redis"
	select BR2_PACKAGE_POCO_NET

config BR2_PACKAGE_POCO_MONGODB
	bool "mongodb"
	select BR2_PACKAGE_POCO_NET

config BR2_PACKAGE_POCO_DATA
	bool

config BR2_PACKAGE_POCO_DATA_SQLITE
	bool "sqlite"
	select BR2_PACKAGE_POCO_DATA
	select BR2_PACKAGE_SQLITE

config BR2_PACKAGE_POCO_DATA_MYSQL
	bool "mysql"
	depends on BR2_USE_MMU # mysql
	select BR2_PACKAGE_POCO_DATA
	select BR2_PACKAGE_MYSQL

endif # BR2_PACKAGE_POCO

comment "poco needs a toolchain w/ wchar, NPTL, C++, dynamic library"
	depends on !BR2_USE_WCHAR || !BR2_INSTALL_LIBSTDCPP \
		|| !BR2_TOOLCHAIN_HAS_THREADS_NPTL || BR2_STATIC_LIBS
	depends on BR2_PACKAGE_POCO_ARCH_SUPPORTS
```
