## package/policycoreutils/Config.in
```kconfig
comment "policycoreutils needs a toolchain w/ threads, dynamic library"
	depends on BR2_PACKAGE_AUDIT_ARCH_SUPPORTS
	depends on !BR2_TOOLCHAIN_HAS_THREADS || BR2_STATIC_LIBS

config BR2_PACKAGE_POLICYCOREUTILS
	bool "policycoreutils"
	depends on BR2_PACKAGE_AUDIT_ARCH_SUPPORTS # libsemanage
	depends on BR2_TOOLCHAIN_HAS_THREADS # libsemanage
	depends on !BR2_STATIC_LIBS #libsemanage
	select BR2_PACKAGE_LIBSEMANAGE
	select BR2_PACKAGE_LIBCAP_NG
	help
	  Policycoreutils is a collection of policy utilities
	  (originally the "core" set of utilities needed to use
	  SELinux, although it has grown a bit over time), which have
	  different dependencies.  sestatus, secon, run_init, and
	  newrole only use libselinux.  load_policy and setfiles only
	  use libselinux and libsepol.  semodule and semanage use
	  libsemanage (and thus bring in dependencies on libsepol and
	  libselinux as well). setsebool uses libselinux to make
	  non-persistent boolean changes (via the kernel interface)
	  and uses libsemanage to make persistent boolean changes.

	  The base package will install the following utilities:
	      load_policy
	      newrole
	      run_init
	      secon
	      semodule
	      sestatus
	      setfiles
	      setsebool

	  http://selinuxproject.org/page/Main_Page
```

## package/polkit/Config.in
```kconfig
config BR2_PACKAGE_POLKIT
	bool "polkit"
	depends on BR2_HOST_GCC_AT_LEAST_4_9 # spidermonkey
	depends on BR2_INSTALL_LIBSTDCPP # spidermonkey
	depends on BR2_PACKAGE_SPIDERMONKEY_ARCH_SUPPORTS # spidermonkey
	depends on BR2_TOOLCHAIN_GCC_AT_LEAST_4_9 # spidermonkey
	depends on BR2_TOOLCHAIN_HAS_THREADS_NPTL # spidermonkey
	depends on BR2_USE_MMU # libglib2, dbus
	depends on BR2_USE_WCHAR # libglib2
	depends on !BR2_STATIC_LIBS # spidermonkey
	depends on !BR2_TOOLCHAIN_USES_UCLIBC # spidermonkey
	select BR2_PACKAGE_DBUS # runtime
	select BR2_PACKAGE_EXPAT
	select BR2_PACKAGE_LIBGLIB2
	select BR2_PACKAGE_SPIDERMONKEY
	help
	  PolicyKit is a toolkit for defining and handling
	  authorizations. It is used for allowing unprivileged
	  processes to speak to privileged processes.

	  http://www.freedesktop.org/wiki/Software/polkit

comment "polkit needs a glibc or musl toolchain with C++, wchar, dynamic library, NPTL, gcc >= 4.9"
	depends on BR2_USE_MMU
	depends on BR2_PACKAGE_SPIDERMONKEY_ARCH_SUPPORTS
	depends on BR2_TOOLCHAIN_USES_UCLIBC || \
		!BR2_INSTALL_LIBSTDCPP || \
		BR2_STATIC_LIBS || \
		!BR2_TOOLCHAIN_HAS_THREADS_NPTL || \
		!BR2_HOST_GCC_AT_LEAST_4_9 || \
		!BR2_TOOLCHAIN_GCC_AT_LEAST_4_9 || \
		!BR2_USE_WCHAR
```

## package/poppler/Config.in
```kconfig
config BR2_PACKAGE_POPPLER
	bool "poppler"
	depends on BR2_USE_WCHAR
	depends on BR2_INSTALL_LIBSTDCPP
	depends on BR2_TOOLCHAIN_HAS_THREADS
	depends on !BR2_STATIC_LIBS
	depends on BR2_TOOLCHAIN_GCC_AT_LEAST_5 # C++14, constexpr
	select BR2_PACKAGE_FONTCONFIG
	help
	  Poppler is a PDF rendering library based on the xpdf-3.0
	  code base.

	  http://poppler.freedesktop.org/

if BR2_PACKAGE_POPPLER

config BR2_PACKAGE_POPPLER_QT5
	bool "Qt5 support"
	depends on BR2_PACKAGE_QT5
	select BR2_PACKAGE_QT5BASE_GUI
	select BR2_PACKAGE_QT5BASE_WIDGETS
	select BR2_PACKAGE_QT5BASE_XML
	help
	  Build Qt support into the Poppler library

config BR2_PACKAGE_POPPLER_UTILS
	bool "command line utils"
	help
	  Compile poppler command line utils.

endif

comment "poppler needs a toolchain w/ wchar, C++, threads, dynamic library, gcc >= 5"
	depends on !BR2_USE_WCHAR || !BR2_INSTALL_LIBSTDCPP || \
		!BR2_TOOLCHAIN_HAS_THREADS || BR2_STATIC_LIBS || \
		!BR2_TOOLCHAIN_GCC_AT_LEAST_5
```

## package/popt/Config.in
```kconfig
config BR2_PACKAGE_POPT
	bool "popt"
	default n
	help
	  Popt is a C library for parsing command line parameters.

	  http://rpm5.org
```

## package/portage/Config.in
```kconfig
config BR2_PACKAGE_PORTAGE
	bool "portage"
	select BR2_PACKAGE_PYTHON
	depends on BR2_USE_WCHAR
	help
	  Portage, the Gentoo package management tool.

	  http://www.gentoo.org/

comment "portage requires a toolchain with WCHAR support"
	depends on !BR2_USE_WCHAR
```

## package/portaudio/Config.in
```kconfig
comment "portaudio needs a toolchain threads support"
	depends on !BR2_TOOLCHAIN_HAS_THREADS

config BR2_PACKAGE_PORTAUDIO
	bool "portaudio"
	depends on BR2_TOOLCHAIN_HAS_THREADS
	help
	  PortAudio is a free, cross-platform, open-source,
	  audio I/O library.

	  http://www.portaudio.com/

if BR2_PACKAGE_PORTAUDIO

config BR2_PACKAGE_PORTAUDIO_ALSA
	bool "alsa support"
	select BR2_PACKAGE_ALSA_LIB
	depends on BR2_TOOLCHAIN_HAS_THREADS # alsa-lib
	default y
	help
	  Compile with ALSA support.

config BR2_PACKAGE_PORTAUDIO_OSS
	bool "oss support"
	help
	  Compile with OSS support.

config BR2_PACKAGE_PORTAUDIO_CXX
	bool "C++ bindings"
	depends on BR2_INSTALL_LIBSTDCPP
	help
	  Enables C++ bindings.

endif # BR2_PACKAGE_PORTAUDIO
```

## package/portmap/Config.in
```kconfig
config BR2_PACKAGE_PORTMAP
	bool "portmap"
	depends on BR2_TOOLCHAIN_HAS_NATIVE_RPC
	help
	  The standard portmapper for RPC services.

	  Note that portmap is being deprecated in favour of rpcbind.

	  http://neil.brown.name/portmap/

comment "portmap needs a toolchain w/ RPC"
	depends on !BR2_TOOLCHAIN_HAS_NATIVE_RPC
```

## package/postgresql/Config.in
```kconfig
config BR2_PACKAGE_POSTGRESQL
	bool "postgresql"
	depends on BR2_USE_MMU # fork()
	depends on BR2_USE_WCHAR
	# fails to build in a pure static linking scenario, and
	# postgresql is unlikely to be used in a pure statically
	# linked environment.
	depends on !BR2_STATIC_LIBS
	help
	  PostgreSQL is a powerful, open source object-relational
	  database system.

	  Enable the readline package to gain readline support in
	  psql (the command line interpreter), which offers
	  command history and edit functions.

	  Enable the zlib package to gain builtin compression for
	  archives with pg_dump and pg_restore.

	  http://www.postgresql.org

comment "postgresql needs a toolchain w/ dynamic library, wchar"
	depends on BR2_USE_MMU
	depends on BR2_STATIC_LIBS || !BR2_USE_WCHAR
```

## package/powerpc-utils/Config.in
```kconfig
config BR2_PACKAGE_POWERPC_UTILS
	bool "powerpc-utils"
	depends on BR2_powerpc || BR2_powerpc64 || BR2_powerpc64le
	select BR2_PACKAGE_ZLIB
	help
	  System utilities for PowerPC machines.

	  http://sourceforge.net/projects/powerpc-utils/
```

## package/powertop/Config.in
```kconfig
config BR2_PACKAGE_POWERTOP
	bool "powertop"
	depends on BR2_INSTALL_LIBSTDCPP
	depends on BR2_TOOLCHAIN_HAS_THREADS # libnl
	depends on BR2_USE_WCHAR
	select BR2_PACKAGE_NCURSES
	select BR2_PACKAGE_PCIUTILS
	select BR2_PACKAGE_LIBNL
	help
	  A tool to diagnose issues with power consumption and power
	  management

	  https://01.org/powertop/

comment "powertop needs a toolchain w/ C++, threads, wchar"
	depends on !BR2_INSTALL_LIBSTDCPP || !BR2_TOOLCHAIN_HAS_THREADS || \
		!BR2_USE_WCHAR
```

## package/powervr/Config.in
```kconfig
config BR2_PACKAGE_HAS_POWERVR
	bool

config BR2_PACKAGE_PROVIDES_POWERVR
	string
	depends on BR2_PACKAGE_HAS_POWERVR
```

## package/pppd/Config.in
```kconfig
config BR2_PACKAGE_PPPD
	bool "pppd"
	depends on !BR2_STATIC_LIBS
	depends on !BR2_TOOLCHAIN_USES_MUSL # Use __P() macro all over the tree
	depends on BR2_USE_MMU
	select BR2_PACKAGE_OPENSSL if BR2_TOOLCHAIN_USES_GLIBC
	help
	  An implementation of the Point-to-point protocol.

	  http://www.samba.org/ppp/

if BR2_PACKAGE_PPPD

config BR2_PACKAGE_PPPD_FILTER
	bool "filtering"
	select BR2_PACKAGE_LIBPCAP
	help
	  Packet filtering abilities for pppd. If enabled,
	  the pppd active-filter and pass-filter options
	  are available.

config BR2_PACKAGE_PPPD_RADIUS
	bool "radius"
	help
	  Install RADIUS support for pppd

config BR2_PACKAGE_PPPD_OVERWRITE_RESOLV_CONF
	bool "overwrite /etc/resolv.conf"
	default y
	help
	  Overwrite /etc/resolv.conf instead of maintaining the
	  separate list of nameservers in /etc/ppp/resolv.conf

	  Note that the pppd default of writing to /etc/ppp/resolv.conf
	  does not work on a read-only rootfs unless you make it
	  writable in your rootfs customizations (e.g. by linking it to
	  a file in tmpfs or by mounting a writable filesystem on it).

endif

comment "pppd needs a uClibc or glibc toolchain w/ dynamic library"
	depends on BR2_STATIC_LIBS || BR2_TOOLCHAIN_USES_MUSL
	depends on BR2_USE_MMU
```

## package/pptp-linux/Config.in
```kconfig
config BR2_PACKAGE_PPTP_LINUX
	bool "pptp-linux"
	depends on BR2_USE_MMU # fork()
	help
	  An implementation of the Point-to-point protocol client.

	  http://pptpclient.sourceforge.net/
```

## package/prboom/Config.in
```kconfig
config BR2_PACKAGE_PRBOOM
	bool "prboom"
	# These result in internal compiler error
	depends on !BR2_TOOLCHAIN_EXTERNAL_CODESOURCERY_SH
	select BR2_PACKAGE_SDL
	select BR2_PACKAGE_SDL_MIXER
	select BR2_PACKAGE_SDL_NET
	help
	  PrBoom is a Doom client which allows you to play the good old game on
	  newer hardware. It even supports higher resolution and better
	  rendering, while still keeping the old style alive.

	  http://prboom.sourceforge.net/
```

## package/privoxy/Config.in
```kconfig
config BR2_PACKAGE_PRIVOXY
	bool "privoxy"
	depends on BR2_USE_MMU # fork()
	select BR2_PACKAGE_PCRE
	select BR2_PACKAGE_ZLIB
	help
	  A non-caching web proxy with advanced filtering capabilities
	  for enhancing privacy, modifying web page data and HTTP
	  headers, controlling access, and removing ads and other
	  obnoxious Internet junk.

	  http://www.privoxy.org/
```

## package/procps-ng/Config.in
```kconfig
config BR2_PACKAGE_PROCPS_NG
	bool "procps-ng"
	depends on BR2_USE_MMU # fork()
	depends on BR2_PACKAGE_BUSYBOX_SHOW_OTHERS
	depends on !BR2_TOOLCHAIN_USES_MUSL # fopencookie()
	select BR2_PACKAGE_NCURSES
	help
	  Standard informational utilities and process-handling tools.
	  Provides things like kill, ps, uptime, free, top, etc...

	  http://sourceforge.net/projects/procps-ng/

comment "procps-ng needs a glibc or uclibc toolchain"
	depends on BR2_USE_MMU
	depends on BR2_TOOLCHAIN_USES_MUSL
```

## package/procps/Config.in
```kconfig
config BR2_PACKAGE_PROCPS
	bool "procps"
	select BR2_PACKAGE_NCURSES
	depends on BR2_USE_WCHAR
	help
	  Standard informational utilities and process-handling tools.
	  Provides things like kill, ps, uptime, free, top, etc...

	  http://procps.sourceforge.net/
```

## package/procrank_linux/Config.in
```kconfig
config BR2_PACKAGE_PROCRANK_LINUX
	bool "procrank_linux"
	help
	  procrank is a tool commonly used by Android platform
	  developers to find out how much memory is really being used.

	  https://github.com/csimmonds/procrank_linux
```

## package/proftpd/Config.in
```kconfig
config BR2_PACKAGE_PROFTPD
	bool "proftpd"
	depends on BR2_USE_MMU # fork()
	help
	  ProFTPD, a highly configurable FTP server.

	  http://www.proftpd.org/

if BR2_PACKAGE_PROFTPD

config BR2_PACKAGE_PROFTPD_MOD_CAP
	bool "mod_cap support"
	select BR2_PACKAGE_LIBCAP
	help
	  Compile ProFTPD with mod_cap support

config BR2_PACKAGE_PROFTPD_MOD_REWRITE
	bool "mod_rewrite support"
	help
	  Compile ProFTPD with mod_rewrite support

config BR2_PACKAGE_PROFTPD_MOD_REDIS
	bool "mod_redis support"
	select BR2_PACKAGE_HIREDIS
	help
	  The mod_redis module enables ProFTPD support for caching
	  data in Redis servers, using the hiredis client library.

config BR2_PACKAGE_PROFTPD_MOD_SFTP
	bool "mod_sftp support"
	select BR2_PACKAGE_OPENSSL
	help
	  Compile ProFTPD with mod_sftp support

config BR2_PACKAGE_PROFTPD_MOD_SQL
	bool "mod_sql support"
	help
	  Compile ProFTPD with mod_sql support.

if BR2_PACKAGE_PROFTPD_MOD_SQL

config BR2_PACKAGE_PROFTPD_MOD_SQL_SQLITE
	bool "mod_sql_sqlite support"
	select BR2_PACKAGE_SQLITE
	help
	  Compile ProFTPD with mod_sql_sqlite support.

endif

config BR2_PACKAGE_PROFTPD_MOD_QUOTATAB
	bool "mod_quotatab support"
	help
	  Compile ProFTPD with mod_quotatab support. This module
	  is required in order to support quota tables:
	        1. mod_quotatab_file
	        2. mod_quotatab_ldap
	        3. mod_quotatab_radius
	        4. mod_quotatab_sql

if BR2_PACKAGE_PROFTPD_MOD_QUOTATAB

config BR2_PACKAGE_PROFTPD_MOD_QUOTATAB_FILE
	bool "mod_quotatab_file table support"
	help
	  Compile mod_quotatab with mod_quotatab_file table.

config BR2_PACKAGE_PROFTPD_MOD_QUOTATAB_LDAP
	bool "mod_quotatab_ldap table support"
	help
	  Compile mod_quotatab with mod_quotatab_ldap table.

config BR2_PACKAGE_PROFTPD_MOD_QUOTATAB_RADIUS
	bool "mod_quotatab_radius table support"
	help
	  Compile mod_quotatab with mod_quotatab_radius table.

config BR2_PACKAGE_PROFTPD_MOD_QUOTATAB_SQL
	bool "mod_quotatab_sql table support"
	select BR2_PACKAGE_PROFTPD_MOD_SQL
	help
	  Compile mod_quotatab with mod_quotatab_sql table.

endif

config BR2_PACKAGE_PROFTPD_BUFFER_SIZE
	int "buffer size in bytes (0 for default)"
	default "0"
	help
	  By increasing the buffer size above the default of 1K,
	  proftpd reads and writes data in larger chunks, and makes
	  fewer expensive system calls. Use of this option to set buffer
	  sizes of 8K or more has been reported to drastically increase
	  transfer speeds (depending on network configurations).

	  0 uses the default size of 1024.

endif
```

## package/proj/Config.in
```kconfig
config BR2_PACKAGE_PROJ
	bool "proj"
	depends on BR2_INSTALL_LIBSTDCPP
	depends on BR2_TOOLCHAIN_GCC_AT_LEAST_4_7 # C++11
	depends on BR2_TOOLCHAIN_HAS_THREADS
	depends on BR2_USE_WCHAR
	select BR2_PACKAGE_SQLITE
	help
	  proj.4 is a standard UNIX filter function which converts
	  geographic longitude and latitude coordinates into cartesian
	  coordinates (and vice versa), and it is a C API for software
	  developers to include coordinate transformation in their own
	  software.

	  http://proj4.org/

comment "proj needs a toolchain w/ C++, gcc >= 4.7, threads, wchar"
	depends on !BR2_INSTALL_LIBSTDCPP || \
		!BR2_TOOLCHAIN_GCC_AT_LEAST_4_7 || \
		!BR2_TOOLCHAIN_HAS_THREADS || !BR2_USE_WCHAR
```

## package/prosody/Config.in
```kconfig
config BR2_PACKAGE_PROSODY
	bool "prosody"
	depends on BR2_USE_MMU # fork
	depends on BR2_PACKAGE_HAS_LUAINTERPRETER
	depends on !BR2_PACKAGE_LUA_5_3
	depends on !BR2_STATIC_LIBS # luaexpat, luasec, luasocket, luafilesystem
	select BR2_PACKAGE_LUABITOP if !BR2_PACKAGE_LUAJIT # runtime
	select BR2_PACKAGE_LUAEXPAT # runtime
	select BR2_PACKAGE_LUASEC # runtime
	select BR2_PACKAGE_LUASOCKET # runtime
	select BR2_PACKAGE_OPENSSL
	select BR2_PACKAGE_LIBIDN
	select BR2_PACKAGE_LUAFILESYSTEM # runtime
	help
	  Prosody is a modern XMPP communication server. It aims to be
	  easy to set up and configure, and efficient with system
	  resources.

	  https://prosody.im

comment "prosody needs the lua interpreter, dynamic library"
	depends on !BR2_PACKAGE_HAS_LUAINTERPRETER || BR2_STATIC_LIBS
	depends on BR2_USE_MMU

comment "prosody needs a Lua 5.1/5.2 interpreter"
	depends on BR2_PACKAGE_LUA_5_3
```

## package/protobuf-c/Config.in
```kconfig
config BR2_PACKAGE_PROTOBUF_C
	bool "protobuf-c"
	depends on BR2_INSTALL_LIBSTDCPP
	depends on BR2_TOOLCHAIN_HAS_THREADS
	# host-protobuf only builds on certain architectures
	depends on BR2_HOSTARCH = "x86_64" || BR2_HOSTARCH = "x86"
	depends on BR2_HOST_GCC_AT_LEAST_4_8 # host-protobuf
	help
	  Code generator and runtime libraries to use Protocol Buffers
	  from pure C (not C++).

	  https://github.com/protobuf-c/protobuf-c

comment "protobuf-c needs a toolchain w/ C++, threads, host gcc >= 4.8"
	depends on !BR2_INSTALL_LIBSTDCPP || !BR2_TOOLCHAIN_HAS_THREADS \
		|| !BR2_HOST_GCC_AT_LEAST_4_8
	depends on BR2_HOSTARCH = "x86_64" || BR2_HOSTARCH = "x86"
```
