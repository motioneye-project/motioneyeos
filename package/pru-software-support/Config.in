## package/pru-software-support/Config.in
```kconfig
config BR2_PACKAGE_PRU_SOFTWARE_SUPPORT
	bool "pru-software-support"
	depends on BR2_PACKAGE_HOST_TI_CGT_PRU_ARCH_SUPPORTS
	select BR2_PACKAGE_HOST_PRU_SOFTWARE_SUPPORT
	help
	  PRU firmware examples extracted from TI's PRU software
	  support package. See readme.txt for installation details.

	  https://git.ti.com/pru-software-support-package/pru-software-support-package
```

## package/pru-software-support/Config.in.host
```kconfig
config BR2_PACKAGE_HOST_PRU_SOFTWARE_SUPPORT
	bool "host pru-software-support"
	depends on BR2_PACKAGE_HOST_TI_CGT_PRU_ARCH_SUPPORTS
	select BR2_PACKAGE_HOST_TI_CGT_PRU
	help
	  This package provides useful headers and libraries for the
	  PRU unit found on some TI processors e.g. AM3358. Note that
	  the included labs and examples aren't built, they can be
	  built using the corresponding target package.

	  https://git.ti.com/pru-software-support-package/pru-software-support-package
```

## package/psmisc/Config.in
```kconfig
config BR2_PACKAGE_PSMISC
	bool "psmisc"
	depends on BR2_PACKAGE_BUSYBOX_SHOW_OTHERS
	select BR2_PACKAGE_NCURSES
	help
	  Helpful /proc related utilities such as pstree, fuser, and killall

	  https://gitlab.com/psmisc/psmisc
```

## package/psplash/Config.in
```kconfig
config BR2_PACKAGE_PSPLASH
	bool "psplash"
	depends on BR2_USE_WCHAR
	help
	  PSplash is a userspace graphical boot splash screen for mainly
	  embedded Linux devices supporting a 16bpp or 32bpp framebuffer.
	  It has few dependencies (just libc), supports basic images and
	  text and handles rotation. Its visual look is configurable by
	  basic source changes.

	  Also included is a 'client' command utility for sending
	  information to psplash such as boot progress information.

	  Start the drawing process with 'psplash -n&' as early as possible.
	  Note: psplash creates a FIFO in /tmp for communication with
	  psplash-write.

	  Usage:
	  * Set progress bar to 50 percent:
	    psplash-write "PROGRESS 50"

	  * Display message "foobar" above progress bar:
	    psplash-write "MSG foobar"

	  * Terminate psplash:
	    psplash-write "QUIT"

	  http://git.yoctoproject.org/cgit/cgit.cgi/psplash/

comment "psplash needs a toolchain w/ wchar"
	depends on !BR2_USE_WCHAR
```

## package/ptm2human/Config.in
```kconfig
config BR2_PACKAGE_PTM2HUMAN_ARCH_SUPPORTS
	bool
	default y if BR2_arm
	default y if BR2_armeb
	default y if BR2_aarch64
	default y if BR2_aarch64_be

config BR2_PACKAGE_PTM2HUMAN
	bool "ptm2human"
	depends on BR2_PACKAGE_PTM2HUMAN_ARCH_SUPPORTS
	help
	  ptm2human is a decoder for trace data outputted by Program
	  Trace Macrocell (PTM) and Embedded Trace Macrocell
	  (ETMv4). It deconstructs ID packets and data packets
	  from the formatter of ARM Coresight ETB, and then
	  translates the trace data to a human-readable format.

	  https://github.com/hwangcc23/ptm2human
```

## package/ptpd/Config.in
```kconfig
config BR2_PACKAGE_PTPD
	bool "ptpd"
	help
	  The PTP daemon (PTPd) implements the Precision Time protocol
	  (PTP) as defined by the IEEE-1588-2002.

	  http://ptpd.sourceforge.net/
```

## package/ptpd2/Config.in
```kconfig
config BR2_PACKAGE_PTPD2
	bool "ptpd2"
	select BR2_PACKAGE_LIBPCAP
	help
	  The PTP daemon (PTPd) implements the Precision Time protocol
	  (PTP) as defined by the IEEE-1588-2008.

	  http://ptpd.sourceforge.net/
```

## package/pugixml/Config.in
```kconfig
config BR2_PACKAGE_PUGIXML
	bool "pugixml"
	depends on BR2_INSTALL_LIBSTDCPP
	help
	  Light-weight, simple and fast XML parser for C++ with XPath
	  support

	  Features:
	  * DOM-like interface with rich traversal/modification
	    capabilities
	  * Extremely fast non-validating XML parser which constructs
	    the DOM tree from an XML file/buffer
	  * XPath 1.0 implementation for complex data-driven tree
	    queries
	  * Full Unicode support with Unicode interface variants and
	    automatic encoding conversions

	  http://pugixml.org/
	  https://github.com/zeux/pugixml

if BR2_PACKAGE_PUGIXML

config BR2_PACKAGE_PUGIXML_XPATH_SUPPORT
	bool "Enable XPath support"
	default y
	help
	  When disabled, both XPath interfaces and XPath implementation
	  are excluded from compilation. This option is provided in case
	  you do not need XPath functionality and need to save code
	  space.

config BR2_PACKAGE_PUGIXML_COMPACT
	bool "Enable compact mode"
	help
	  Activates a different internal representation of document
	  storage that is much more memory efficient for documents with
	  a lot of markup (i.e.  nodes and attributes), but is slightly
	  slower to parse and access.

	  http://pugixml.org/docs/manual.html#dom.memory.compact

config BR2_PACKAGE_PUGIXML_HEADER_ONLY
	bool "Enable header-only version"
	help
	  All source code for pugixml will be included in every
	  translation unit that includes pugixml.hpp. This is how most
	  of Boost and STL libraries work.

	  http://pugixml.org/docs/manual.html#install.building.header

endif

comment "pugixml needs a toolchain w/ C++"
	depends on !BR2_INSTALL_LIBSTDCPP
```

## package/pulseaudio/Config.in
```kconfig
config BR2_PACKAGE_PULSEAUDIO
	bool "pulseaudio"
	depends on BR2_USE_WCHAR
	depends on BR2_TOOLCHAIN_HAS_THREADS
	select BR2_PACKAGE_LIBTOOL
	select BR2_PACKAGE_JSON_C
	select BR2_PACKAGE_LIBSNDFILE
	select BR2_PACKAGE_SPEEX
	depends on BR2_LARGEFILE
	depends on BR2_USE_MMU # fork()
	help
	  PulseAudio is a sound system for POSIX OSes, meaning that it
	  is a proxy for your sound applications. It allows you to do
	  advanced operations on your sound data as it passes between
	  your application and your hardware. Things like transferring
	  the audio to a different machine, changing the sample format
	  or channel count and mixing several sounds into one are
	  easily achieved using a sound server.

	  http://pulseaudio.org

if BR2_PACKAGE_PULSEAUDIO

config BR2_PACKAGE_PULSEAUDIO_DAEMON
	bool "start as a system daemon"
	help
	  PulseAudio can be started as a system daemon. This is not the
	  recommended way of using PulseAudio unless you are building a
	  headless system.

endif

comment "pulseaudio needs a toolchain w/ wchar, largefile, threads"
	depends on BR2_USE_MMU
	depends on !BR2_USE_WCHAR || !BR2_LARGEFILE || !BR2_TOOLCHAIN_HAS_THREADS
```

## package/pulseview/Config.in
```kconfig
config BR2_PACKAGE_PULSEVIEW
	bool "pulseview"
	depends on BR2_PACKAGE_QT5
	# libsigrok->libglib2:
	depends on BR2_USE_WCHAR
	depends on BR2_TOOLCHAIN_HAS_THREADS
	depends on BR2_USE_MMU
	depends on BR2_INSTALL_LIBSTDCPP
	# libsigrok->libzip
	depends on !BR2_STATIC_LIBS
	# libsigrok
	depends on BR2_TOOLCHAIN_GCC_AT_LEAST_4_9
	depends on BR2_HOST_GCC_AT_LEAST_4_9
	depends on BR2_ENABLE_LOCALE
	select BR2_PACKAGE_LIBSIGROK
	select BR2_PACKAGE_LIBSIGROKCXX
	select BR2_PACKAGE_QT5BASE_WIDGETS
	select BR2_PACKAGE_QT5BASE_PNG
	select BR2_PACKAGE_QT5SVG
	select BR2_PACKAGE_BOOST
	select BR2_PACKAGE_BOOST_FILESYSTEM
	select BR2_PACKAGE_BOOST_SYSTEM
	select BR2_PACKAGE_BOOST_SERIALIZATION
	help
	  PulseView is a Qt based logic analyzer, oscilloscope
	  and MSO GUI for sigrok.

	  http://sigrok.org/wiki/PulseView

comment "pulseview needs a toolchain w/ locale, wchar, threads, dynamic library, C++, gcc >= 4.9, host gcc >= 4.9"
	depends on BR2_USE_MMU
	depends on BR2_PACKAGE_QT5
	depends on !BR2_TOOLCHAIN_GCC_AT_LEAST_4_9 || !BR2_USE_WCHAR \
		|| !BR2_TOOLCHAIN_HAS_THREADS || !BR2_INSTALL_LIBSTDCPP \
		|| BR2_STATIC_LIBS || !BR2_ENABLE_LOCALE || \
		!BR2_HOST_GCC_AT_LEAST_4_9
```

## package/pure-ftpd/Config.in
```kconfig
config BR2_PACKAGE_PURE_FTPD
	bool "pure-ftpd"
	select BR2_PACKAGE_LIBICONV if !BR2_ENABLE_LOCALE
	depends on BR2_USE_MMU # fork()
	help
	  Pure-FTPd is a free (BSD), secure, production-quality and standard-
	  conformant FTP server. It doesn't provide useless bells and whistles,
	  but focuses on efficiency and ease of use. It provides simple answers
	  to common needs, plus unique useful features for personal users as
	  well as hosting providers.

	  http://www.pureftpd.org

if BR2_PACKAGE_PURE_FTPD

config BR2_PACKAGE_PURE_FTPD_FTPWHO
	bool "ftpwho"
	help
	  Enable the pure-ftpd command.  Pure-ftpwho shows current Pure-ftpd
	  client sessions.  Only the system administrator may run this.  Output
	  can be text (default), HTML, XML data and parser-optimized.

config BR2_PACKAGE_PURE_FTPD_QUOTAS
	bool "quotas"
	help
	  Enable virtual quotas. With virtual quotas, restrictions can
	  be placed on the maximum number of files a user can store in
	  his account. In addition, restrictions can also be placed
	  on the total size.

endif
```

## package/putty/Config.in
```kconfig
config BR2_PACKAGE_PUTTY
	bool "putty"
	depends on BR2_USE_MMU # fork()
	depends on BR2_USE_WCHAR
	help
	  PuTTY is a free SSH and Telnet client. Without GTK2
	  activated, only the commandline tools plink, pscp, psftp,
	  and puttygen are built; enable GTK2 for the graphical
	  client.

	  http://www.chiark.greenend.org.uk/~sgtatham/putty/

comment "putty needs a toolchain w/ wchar"
	depends on BR2_USE_MMU
	depends on !BR2_USE_WCHAR
```

## package/pv/Config.in
```kconfig
config BR2_PACKAGE_PV
	bool "pv"
	help
	  Pipe Viewer - is a terminal-based tool for
	  monitoring the progress of data through a
	  pipeline.

	  http://www.ivarch.com/programs/pv.shtml
```

## package/pwgen/Config.in
```kconfig
config BR2_PACKAGE_PWGEN
	bool "pwgen"
	help
	  Pwgen is a small, GPL'ed password generator which creates passwords
	  which can be easily memorized by a human.

	  http://sourceforge.net/projects/pwgen/
```

## package/pwgen/Config.in.host
```kconfig
config BR2_PACKAGE_HOST_PWGEN
	bool "host pwgen"
	help
	  Pwgen is a small, GPL'ed password generator which creates
	  passwords which can be easily memorized by a human.

	  http://sourceforge.net/projects/pwgen/
```

## package/python-aenum/Config.in
```kconfig
config BR2_PACKAGE_PYTHON_AENUM
	bool "python-aenum"
	help
	  Advanced Enumerations (compatible with Python's stdlib Enum),
	  NamedTuples, and NamedConstants.

	  https://pypi.org/project/aenum
```

## package/python-aioblescan/Config.in
```kconfig
config BR2_PACKAGE_PYTHON_AIOBLESCAN
	bool "python-aioblescan"
	depends on BR2_PACKAGE_PYTHON3
	help
	  Scanning Bluetooth for advertised info with asyncio.

	  https://github.com/frawau/aioblescan
```

## package/python-aiocoap/Config.in
```kconfig
config BR2_PACKAGE_PYTHON_AIOCOAP
	bool "python-aiocoap"
	depends on BR2_PACKAGE_PYTHON3
	help
	  Python CoAP library.

	  https://github.com/chrysn/aiocoap
```

## package/python-aioconsole/Config.in
```kconfig
config BR2_PACKAGE_PYTHON_AIOCONSOLE
	bool "python-aioconsole"
	depends on BR2_PACKAGE_PYTHON3
	help
	  Asynchronous console and interfaces for asyncio.

	  https://github.com/vxgmichel/aioconsole
```

## package/python-aiodns/Config.in
```kconfig
config BR2_PACKAGE_PYTHON_AIODNS
	bool "python-aiodns"
	depends on BR2_PACKAGE_PYTHON3
	select BR2_PACKAGE_PYTHON_PYCARES # runtime
	help
	  Simple DNS resolver for asyncio.

	  http://github.com/saghul/aiodns
```

## package/python-aiohttp-apispec/Config.in
```kconfig
config BR2_PACKAGE_PYTHON_AIOHTTP_APISPEC
	bool "python-aiohttp-apispec"
	depends on BR2_PACKAGE_PYTHON3
	select BR2_PACKAGE_PYTHON_AIOHTTP
	select BR2_PACKAGE_PYTHON_APISPEC
	help
	  Build and document REST APIs with aiohttp and apispec.

	  https://github.com/maximdanilchenko/aiohttp-apispec
```

## package/python-aiohttp-cors/Config.in
```kconfig
config BR2_PACKAGE_PYTHON_AIOHTTP_CORS
	bool "python-aiohttp-cors"
	depends on BR2_PACKAGE_PYTHON3
	select BR2_PACKAGE_PYTHON_AIOHTTP # runtime
	help
	  CORS support for aiohttp.

	  https://github.com/aio-libs/aiohttp-cors
```

## package/python-aiohttp-debugtoolbar/Config.in
```kconfig
config BR2_PACKAGE_PYTHON_AIOHTTP_DEBUGTOOLBAR
	bool "python-aiohttp-debugtoolbar"
	depends on BR2_PACKAGE_PYTHON3
	select BR2_PACKAGE_PYTHON_AIOHTTP # runtime
	select BR2_PACKAGE_PYTHON_AIOHTTP_JINJA2 # runtime
	help
	  debugtoolbar for aiohttp.

	  https://github.com/aio-libs/aiohttp_debugtoolbar
```

## package/python-aiohttp-jinja2/Config.in
```kconfig
config BR2_PACKAGE_PYTHON_AIOHTTP_JINJA2
	bool "python-aiohttp-jinja2"
	depends on BR2_PACKAGE_PYTHON3
	select BR2_PACKAGE_PYTHON_AIOHTTP # runtime
	select BR2_PACKAGE_PYTHON_JINJA2 # runtime
	help
	  Jinja2 template renderer for aiohttp.web (http server for
	  asyncio).

	  https://github.com/aio-libs/aiohttp_jinja2/
```

## package/python-aiohttp-mako/Config.in
```kconfig
config BR2_PACKAGE_PYTHON_AIOHTTP_MAKO
	bool "python-aiohttp-mako"
	depends on BR2_PACKAGE_PYTHON3
	select BR2_PACKAGE_PYTHON_AIOHTTP # runtime
	select BR2_PACKAGE_PYTHON_MAKO # runtime
	help
	  mako template renderer for aiohttp.web (http server for
	  asyncio).

	  https://github.com/aio-libs/aiohttp-mako/
```
