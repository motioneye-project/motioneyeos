## package/python-aiohttp-remotes/Config.in
```kconfig
config BR2_PACKAGE_PYTHON_AIOHTTP_REMOTES
	bool "python-aiohttp-remotes"
	depends on BR2_PACKAGE_PYTHON3
	select BR2_PACKAGE_PYTHON_AIOHTTP # runtime
	help
	  Control remote side information.

	  https://github.com/aio-libs/aiohttp-remotes
```

## package/python-aiohttp-security/Config.in
```kconfig
config BR2_PACKAGE_PYTHON_AIOHTTP_SECURITY
	bool "python-aiohttp-security"
	depends on BR2_PACKAGE_PYTHON3
	select BR2_PACKAGE_PYTHON_AIOHTTP # runtime
	help
	  Security for aiohttp.web.

	  https://github.com/aio-libs/aiohttp_security/
```

## package/python-aiohttp-session/Config.in
```kconfig
config BR2_PACKAGE_PYTHON_AIOHTTP_SESSION
	bool "python-aiohttp-session"
	depends on BR2_PACKAGE_PYTHON3
	select BR2_PACKAGE_PYTHON_AIOHTTP # runtime
	help
	  Sessions for aiohttp.web.

	  https://github.com/aio-libs/aiohttp_session/
```

## package/python-aiohttp-sse/Config.in
```kconfig
config BR2_PACKAGE_PYTHON_AIOHTTP_SSE
	bool "python-aiohttp-sse"
	depends on BR2_PACKAGE_PYTHON3
	select BR2_PACKAGE_PYTHON_AIOHTTP # runtime
	help
	  Server-sent events support for aiohttp.

	  https://github.com/aio-libs/aiohttp_sse/
```

## package/python-aiohttp-swagger/Config.in
```kconfig
config BR2_PACKAGE_PYTHON_AIOHTTP_SWAGGER
	bool "python-aiohttp-swagger"
	depends on BR2_PACKAGE_PYTHON3
	help
	  Swagger API Documentation builder for aiohttp server

	  https://github.com/eLvErDe/aiohttp-swagger
```

## package/python-aiohttp/Config.in
```kconfig
config BR2_PACKAGE_PYTHON_AIOHTTP
	bool "python-aiohttp"
	depends on BR2_PACKAGE_PYTHON3
	select BR2_PACKAGE_PYTHON_ATTRS # runtime
	select BR2_PACKAGE_PYTHON_CCHARDET if BR2_INSTALL_LIBSTDCPP # runtime
	select BR2_PACKAGE_PYTHON_CHARDET if !BR2_INSTALL_LIBSTDCPP # runtime
	select BR2_PACKAGE_PYTHON_MULTIDICT # runtime
	select BR2_PACKAGE_PYTHON_ASYNC_TIMEOUT # runtime
	select BR2_PACKAGE_PYTHON_YARL # runtime
	select BR2_PACKAGE_PYTHON_AIODNS # runtime
	select BR2_PACKAGE_PYTHON3_ZLIB # runtime
	help
	  Async http client/server framework (asyncio).

	  https://github.com/aio-libs/aiohttp
```

## package/python-aiojobs/Config.in
```kconfig
config BR2_PACKAGE_PYTHON_AIOJOBS
	bool "python-aiojobs"
	depends on BR2_PACKAGE_PYTHON3
	help
	  Jobs scheduler for managing background task (asyncio).

	  https://github.com/aio-libs/aiojobs
```

## package/python-aiologstash/Config.in
```kconfig
config BR2_PACKAGE_PYTHON_AIOLOGSTASH
	bool "python-aiologstash"
	depends on BR2_PACKAGE_PYTHON3
	select BR2_PACKAGE_PYTHON_ASYNC_TIMEOUT # runtime
	select BR2_PACKAGE_PYTHON_LOGSTASH # runtime
	help
	  asyncio-compatible logstash logging handler.

	  https://github.com/aio-libs/aiologstash
```

## package/python-aiomonitor/Config.in
```kconfig
config BR2_PACKAGE_PYTHON_AIOMONITOR
	bool "python-aiomonitor"
	depends on BR2_PACKAGE_PYTHON3
	select BR2_PACKAGE_PYTHON_TERMINALTABLES # runtime
	select BR2_PACKAGE_PYTHON_AIOCONSOLE # runtime
	help
	  aiomonitor adds monitor and python REPL capabilities for
	  asyncio application.

	  https://github.com/aio-libs/aiomonitor
```

## package/python-aioredis/Config.in
```kconfig
config BR2_PACKAGE_PYTHON_AIOREDIS
	bool "python-aioredis"
	depends on BR2_PACKAGE_PYTHON3
	select BR2_PACKAGE_PYTHON_ASYNC_TIMEOUT # runtime
	select BR2_PACKAGE_PYTHON_HIREDIS # runtime
	help
	  Provides simple and clear interface to Redis based on asyncio.

	  https://github.com/aio-libs/aioredis
```

## package/python-aiorwlock/Config.in
```kconfig
config BR2_PACKAGE_PYTHON_AIORWLOCK
	bool "python-aiorwlock"
	depends on BR2_PACKAGE_PYTHON3
	help
	  Read write lock for asyncio.

	  https://github.com/aio-libs/aiorwlock
```

## package/python-aiosignal/Config.in
```kconfig
config BR2_PACKAGE_PYTHON_AIOSIGNAL
	bool "python-aiosignal"
	depends on BR2_PACKAGE_PYTHON3
	select BR2_PACKAGE_PYTHON_FROZENLIST # runtime
	help
	  aiosignal: a list of registered asynchronous callbacks.

	  https://github.com/aio-libs/aiosignal
```

## package/python-aiozipkin/Config.in
```kconfig
config BR2_PACKAGE_PYTHON_AIOZIPKIN
	bool "python-aiozipkin"
	depends on BR2_PACKAGE_PYTHON3
	select BR2_PACKAGE_PYTHON_AIOHTTP # runtime
	help
	  Distributed tracing instrumentation for asyncio application
	  with zipkin.

	  https://github.com/aio-libs/aiozipkin
```

## package/python-alsaaudio/Config.in
```kconfig
comment "python-alsaaudio needs a toolchain w/ threads"
	depends on !BR2_TOOLCHAIN_HAS_THREADS

config BR2_PACKAGE_PYTHON_ALSAAUDIO
	bool "python-alsaaudio"
	depends on BR2_TOOLCHAIN_HAS_THREADS # alsa-lib
	select BR2_PACKAGE_ALSA_LIB
	select BR2_PACKAGE_ALSA_LIB_PCM
	select BR2_PACKAGE_ALSA_LIB_MIXER
	help
	  The PyAlsaAudio package contains bindings for the ALSA sound
	  API.

	  http://pyalsaaudio.sourceforge.net/
```

## package/python-apispec/Config.in
```kconfig
config BR2_PACKAGE_PYTHON_APISPEC
	bool "python-apispec"
	depends on BR2_PACKAGE_PYTHON3
	help
	  A pluggable API specification generator. Currently supports the OpenAPI Specification (f.k.a. the Swagger specification).

	  https://github.com/marshmallow-code/apispec
```

## package/python-argh/Config.in
```kconfig
config BR2_PACKAGE_PYTHON_ARGH
	bool "python-argh"
	help
	  An unobtrusive argparse wrapper with natural syntax.

	  http://github.com/neithere/argh/
```

## package/python-argon2-cffi/Config.in
```kconfig
config BR2_PACKAGE_PYTHON_ARGON2_CFFI
	bool "python-argon2-cffi"
	select BR2_PACKAGE_PYTHON_CFFI # runtime
	select BR2_PACKAGE_PYTHON_ENUM34 if BR2_PACKAGE_PYTHON # runtime
	select BR2_PACKAGE_PYTHON_SIX # runtime
	help
	  The secure Argon2 password hashing algorithm.

	  https://argon2-cffi.readthedocs.io/
```

## package/python-arrow/Config.in
```kconfig
config BR2_PACKAGE_PYTHON_ARROW
	bool "python-arrow"
	select BR2_PACKAGE_PYTHON_DATEUTIL # runtime
	select BR2_PACKAGE_PYTHON_BACKPORTS_FUNCTOOLS_LRU_CACHE \
	       if BR2_PACKAGE_PYTHON # runtime
	help
	  Better dates and times for Python.

	  https://github.com/crsmithdev/arrow/
```

## package/python-asgiref/Config.in
```kconfig
config BR2_PACKAGE_PYTHON_ASGIREF
	bool "python-asgiref"
	depends on BR2_PACKAGE_PYTHON3
	help
	  ASGI is a standard for Python asynchronous web apps and
	  servers to communicate with each other, and positioned as
	  an asynchronous successor to WSGI.

	  This package includes ASGI base libraries, such as:
	    - Sync-to-async and async-to-sync function wrappers,
	      asgiref.sync
	    - Server base classes, asgiref.server
	    - A WSGI-to-ASGI adapter, in asgiref.wsgi

	  http://github.com/django/asgiref/
```

## package/python-asn1crypto/Config.in
```kconfig
config BR2_PACKAGE_PYTHON_ASN1CRYPTO
	bool "python-asn1crypto"
	help
	  Fast ASN.1 parser and serializer with definitions for
	  private keys, public keys, certificates, CRL, OCSP, CMS,
	  PKCS#3, PKCS#7, PKCS#8, PKCS#12, PKCS#5, X.509 and TSP.

	  https://github.com/wbond/asn1crypto
```

## package/python-async-lru/Config.in
```kconfig
config BR2_PACKAGE_PYTHON_ASYNC_LRU
	bool "python-async-lru"
	depends on BR2_PACKAGE_PYTHON3
	help
	  Simple lru_cache for asyncio.

	  https://github.com/aio-libs/async_lru
```

## package/python-async-timeout/Config.in
```kconfig
config BR2_PACKAGE_PYTHON_ASYNC_TIMEOUT
	bool "python-async-timeout"
	depends on BR2_PACKAGE_PYTHON3
	help
	  asyncio-compatible timeout context manager.

	  https://github.com/aio-libs/async-timeout
```

## package/python-autobahn/Config.in
```kconfig
config BR2_PACKAGE_PYTHON_AUTOBAHN
	bool "python-autobahn"
	depends on BR2_INSTALL_LIBSTDCPP # python-cryptography -> python-pyasn
	depends on BR2_PACKAGE_PYTHON3
	select BR2_PACKAGE_PYTHON_CRYPTOGRAPHY # runtime
	select BR2_PACKAGE_PYTHON_TXAIO # runtime
	help
	  WebSocket client and server library, WAMP real-time
	  framework.

	  https://pypi.python.org/pypi/autobahn

comment "python-autobahn needs a toolchain w/ C++"
	depends on !BR2_INSTALL_LIBSTDCPP
	depends on BR2_PACKAGE_PYTHON3
```

## package/python-automat/Config.in
```kconfig
config BR2_PACKAGE_PYTHON_AUTOMAT
	bool "python-automat"
	select BR2_PACKAGE_PYTHON_ATTRS # runtime
	select BR2_PACKAGE_PYTHON_SIX # runtime
	help
	  Self-service finite-state machines for the programmer on the
	  go.

	  https://github.com/glyph/Automat
```

## package/python-avro/Config.in
```kconfig
config BR2_PACKAGE_PYTHON_AVRO
	bool "python-avro"
	depends on BR2_PACKAGE_PYTHON3
	help
	  Select this option to install the Avro Python3 language
	  bindings, and the `avro` command line tool

	  Apache Avro is a data serialization system.
	  Avro provides:
	  - Rich data structures.
	  - A compact, fast, binary data format.
	  - A container file, to store persistent data.
	  - Remote procedure call (RPC).
	  - Simple integration with dynamic languages.
	  - Code generation is not required to read or write data
	    files nor to use or implement RPC protocols.
	  - Code generation as an optional optimization,
	    only worth implementing for statically typed languages.

	  http://avro.apache.org/
```
