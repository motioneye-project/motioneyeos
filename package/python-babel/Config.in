## package/python-babel/Config.in
```kconfig
config BR2_PACKAGE_PYTHON_BABEL
	bool "python-babel"
	select BR2_PACKAGE_PYTHON_PYTZ # runtime
	help
	  A collection of tools for internationalizing Python
	  applications.

	  http://babel.pocoo.org/en/latest/
```

## package/python-backcall/Config.in
```kconfig
config BR2_PACKAGE_PYTHON_BACKCALL
	bool "python-backcall"
	help
	  Specifications for callback functions passed in to an API.

	  https://github.com/takluyver/backcall
```

## package/python-backports-abc/Config.in
```kconfig
config BR2_PACKAGE_PYTHON_BACKPORTS_ABC
	bool "python-backports-abc"
	help
	  A backport of recent additions to the 'collections.abc'
	  module.

	  https://pypi.python.org/pypi/backports_abc
```

## package/python-backports-functools-lru-cache/Config.in
```kconfig
config BR2_PACKAGE_PYTHON_BACKPORTS_FUNCTOOLS_LRU_CACHE
	bool "python-backports-functools-lru-cache"
	depends on BR2_PACKAGE_PYTHON
	help
	  Backport of functools.lru_cache from Python 3.3

	  https://github.com/jaraco/backports.functools_lru_cache
```

## package/python-backports-shutil-get-terminal-size/Config.in
```kconfig
config BR2_PACKAGE_PYTHON_BACKPORTS_SHUTIL_GET_TERMINAL_SIZE
	bool "python-backports-shutil-get-terminal-size"
	depends on BR2_PACKAGE_PYTHON
	help
	  A backport of the get_terminal_size function from Python
	  3.3's shutil.

	  https://pypi.python.org/pypi/backports.shutil_get_terminal_size
```

## package/python-backports-ssl-match-hostname/Config.in
```kconfig
config BR2_PACKAGE_PYTHON_BACKPORTS_SSL_MATCH_HOSTNAME
	bool "python-backports-ssl-match-hostname"
	depends on BR2_PACKAGE_PYTHON
	help
	  The ssl.match_hostname() function from Python 3.5.

	  http://bitbucket.org/brandon/backports.ssl_match_hostname
```

## package/python-bcrypt/Config.in
```kconfig
config BR2_PACKAGE_PYTHON_BCRYPT
	bool "python-bcrypt"
	select BR2_PACKAGE_PYTHON_CFFI # runtime
	select BR2_PACKAGE_PYTHON_SIX # runtime
	help
	  Modern password hashing for your software and your servers.

	  https://github.com/pyca/bcrypt/
```

## package/python-beautifulsoup4/Config.in
```kconfig
config BR2_PACKAGE_PYTHON_BEAUTIFULSOUP4
	bool "python-beautifulsoup4"
	help
	  Beautiful Soup is a Python library for pulling data out of
	  HTML and XML files. It works with your favorite parser to
	  provide idiomatic ways of navigating, searching, and
	  modifying the parse tree. It commonly saves programmers
	  hours or days of work.

	  http://www.crummy.com/software/BeautifulSoup/bs4/
```

## package/python-bluepy/Config.in
```kconfig
config BR2_PACKAGE_PYTHON_BLUEPY
	bool "python-bluepy"
	depends on BR2_PACKAGE_PYTHON3
	select BR2_PACKAGE_BLUEZ5_UTILS
	help
	  Python interface to Bluetooth LE on Linux

	  https://github.com/IanHarvey/bluepy
```

## package/python-bluezero/Config.in
```kconfig
config BR2_PACKAGE_PYTHON_BLUEZERO
	bool "python-bluezero"
	help
	  Python library for Bluetooth Low Energy (BLE) on Linux.

	  For central.py, peripheral.py and broadcaster.py you need
	  to enable the dbus-python and the bluez5-utils package.
	  For observer.py, you need to enable the python-aioblescan
	  package.

	  https://github.com/ukBaz/python-bluezero
```

## package/python-bottle/Config.in
```kconfig
config BR2_PACKAGE_PYTHON_BOTTLE
	bool "python-bottle"
	help
	  Bottle is a fast, simple and lightweight WSGI micro
	  web-framework for Python. It is distributed as a single file
	  module and has no dependencies other than the Python
	  Standard Library.

	  http://bottlepy.org
```

## package/python-brotli/Config.in
```kconfig
config BR2_PACKAGE_PYTHON_BROTLI
	bool "python-brotli"
	depends on BR2_INSTALL_LIBSTDCPP
	help
	  Python bindings for the Brotli compression library.

	  https://github.com/google/brotli
```

## package/python-bunch/Config.in
```kconfig
config BR2_PACKAGE_PYTHON_BUNCH
	bool "python-bunch"
	help
	  A dot-accessible dictionary (a la JavaScript objects).

	  http://github.com/dsc/bunch
```

## package/python-cached-property/Config.in
```kconfig
config BR2_PACKAGE_PYTHON_CACHED_PROPERTY
	bool "python-cached-property"
	help
	  A decorator for caching properties in classes.

	  https://github.com/pydanny/cached-property
```

## package/python-can/Config.in
```kconfig
config BR2_PACKAGE_PYTHON_CAN
	bool "python-can"
	select BR2_PACKAGE_PYTHON_SETUPTOOLS # runtime
	select BR2_PACKAGE_PYTHON_SQLITE if BR2_PACKAGE_PYTHON # runtime
	select BR2_PACKAGE_PYTHON3_SQLITE if BR2_PACKAGE_PYTHON3 # runtime
	select BR2_PACKAGE_PYTHON_TYPING if BR2_PACKAGE_PYTHON # runtime
	select BR2_PACKAGE_PYTHON_AENUM # runtime
	select BR2_PACKAGE_PYTHON_WRAPT # runtime
	select BR2_PACKAGE_PYTHON_ZLIB if BR2_PACKAGE_PYTHON
	select BR2_PACKAGE_PYTHON3_ZLIB if BR2_PACKAGE_PYTHON3
	help
	  This module provides controller area network support for
	  Python.

	  https://github.com/hardbyte/python-can
```

## package/python-canopen/Config.in
```kconfig
config BR2_PACKAGE_PYTHON_CANOPEN
	bool "python-canopen"
	select BR2_PACKAGE_PYTHON_CAN # runtime
	help
	  A Python implementation of the CANopen standard. The aim
	  of the project is to support the most common parts of the
	  CiA 301 standard in a Pythonic interface.

	  https://github.com/christiansandberg/canopen
```

## package/python-cbor2/Config.in
```kconfig
config BR2_PACKAGE_PYTHON_CBOR2
	bool "python-cbor2"
	help
	  Pure Python CBOR (de)serializer with extensive tag support.

	  https://cbor2.readthedocs.io/
```

## package/python-cchardet/Config.in
```kconfig
config BR2_PACKAGE_PYTHON_CCHARDET
	bool "python-cchardet"
	depends on BR2_INSTALL_LIBSTDCPP
	help
	  cChardet is high speed universal character encoding
	  detector.

	  https://github.com/PyYoshi/cChardet

comment "python-cchardet needs a toolchain w/ C++"
	depends on !BR2_INSTALL_LIBSTDCPP
```

## package/python-certifi/Config.in
```kconfig
config BR2_PACKAGE_PYTHON_CERTIFI
	bool "python-certifi"
	help
	  Python package for providing Mozilla's CA Bundle.

	  http://certifi.io/
```

## package/python-cffi/Config.in
```kconfig
config BR2_PACKAGE_PYTHON_CFFI
	bool "python-cffi"
	select BR2_PACKAGE_LIBFFI
	select BR2_PACKAGE_PYTHON_PYCPARSER # runtime
	help
	  This is the Foreign Function Interface for Python calling C
	  code. The aim of this project is to provide a convenient
	  and reliable way of calling C code from Python.

	  https://pypi.python.org/pypi/cffi
```

## package/python-channels-redis/Config.in
```kconfig
config BR2_PACKAGE_PYTHON_CHANNELS_REDIS
	bool "python-channels-redis"
	depends on BR2_INSTALL_LIBSTDCPP # python-channels -> python-daphne
	depends on BR2_PACKAGE_PYTHON3 # python-channels
	select BR2_PACKAGE_PYTHON_AIOREDIS # runtime
	select BR2_PACKAGE_PYTHON_ASGIREF # runtime
	select BR2_PACKAGE_PYTHON_CHANNELS # runtime
	select BR2_PACKAGE_PYTHON_MSGPACK # runtime
	help
	  A Django Channels channel layer that uses Redis as its
	  backing store, and supports both a single-server and
	  sharded configurations, as well as group support.

	  http://github.com/django/channels_redis/

comment "python-channels-redis needs a toolchain w/ C++"
	depends on !BR2_INSTALL_LIBSTDCPP
	depends on BR2_PACKAGE_PYTHON3
```

## package/python-channels/Config.in
```kconfig
config BR2_PACKAGE_PYTHON_CHANNELS
	bool "python-channels"
	depends on BR2_INSTALL_LIBSTDCPP # python-daphne -> python-autobahn -> python-cryptography
	depends on BR2_PACKAGE_PYTHON3 # python-daphne
	select BR2_PACKAGE_PYTHON_ASGIREF # runtime
	select BR2_PACKAGE_PYTHON_DAPHNE # runtime
	select BR2_PACKAGE_PYTHON_DJANGO # runtime
	help
	  Channels augments Django to bring WebSocket, long-poll
	  HTTP, task offloading and other async support to your
	  code, using familiar Django design patterns and a
	  flexible underlying framework that lets you not only
	  customize behaviours but also write support for your
	  own protocols and needs.

	  http://github.com/django/channels

comment "python-channels needs a toolchain w/ C++"
	depends on !BR2_INSTALL_LIBSTDCPP
	depends on BR2_PACKAGE_PYTHON3
```

## package/python-characteristic/Config.in
```kconfig
config BR2_PACKAGE_PYTHON_CHARACTERISTIC
	bool "python-characteristic"
	help
	  Python attributes without boilerplate.

	  https://pypi.python.org/pypi/characteristic
```

## package/python-chardet/Config.in
```kconfig
config BR2_PACKAGE_PYTHON_CHARDET
	bool "python-chardet"
	select BR2_PACKAGE_PYTHON_SETUPTOOLS # runtime
	help
	  Universal encoding detector for Python 2 and 3.

	  https://github.com/chardet/chardet
```

## package/python-cheetah/Config.in
```kconfig
config BR2_PACKAGE_PYTHON_CHEETAH
	bool "python-cheetah"
	depends on BR2_PACKAGE_PYTHON
	help
	  Cheetah is an open source template engine and code generation tool.

	  It can be used standalone or combined with other tools and frameworks.
	  Web development is its principle use, but Cheetah is very flexible
	  and is also being used to generate C++ game code, Java, sql, form
	  emails and even Python code.

	  https://pypi.python.org/pypi/Cheetah/
```
