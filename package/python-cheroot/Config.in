## package/python-cheroot/Config.in
```kconfig
config BR2_PACKAGE_PYTHON_CHEROOT
	bool "python-cheroot"
	depends on BR2_PACKAGE_PYTHON3 # python-more-itertools, python-jaraco-functools
	select BR2_PACKAGE_PYTHON_SIX # runtime
	select BR2_PACKAGE_PYTHON_MORE_ITERTOOLS # runtime
	select BR2_PACKAGE_PYTHON_JARACO_FUNCTOOLS # runtime
	help
	  Cheroot is the high-performance, pure-Python
	  HTTP server used by CherryPy.

	  https://github.com/cherrypy/cheroot
```

## package/python-cherrypy/Config.in
```kconfig
config BR2_PACKAGE_PYTHON_CHERRYPY
	bool "python-cherrypy"
	depends on BR2_PACKAGE_PYTHON3 # python-cheroot, python-portend
	select BR2_PACKAGE_PYTHON_CHEROOT # runtime
	select BR2_PACKAGE_PYTHON_JARACO_CLASSES # runtime
	select BR2_PACKAGE_PYTHON_PORTEND # runtime
	select BR2_PACKAGE_PYTHON3_PYEXPAT # runtime
	select BR2_PACKAGE_PYTHON_SIX # runtime
	select BR2_PACKAGE_PYTHON3_ZLIB # runtime
	help
	  A minimalist web framework

	  http://www.cherrypy.org
```

## package/python-click/Config.in
```kconfig
config BR2_PACKAGE_PYTHON_CLICK
	bool "python-click"
	help
	  A simple wrapper around optparse for powerful command line
	  utilities.

	  https://pypi.python.org/pypi/click
```

## package/python-coherence/Config.in
```kconfig
config BR2_PACKAGE_PYTHON_COHERENCE
	bool "python-coherence"
	depends on BR2_PACKAGE_PYTHON
	select BR2_PACKAGE_PYTHON_TWISTED
	select BR2_PACKAGE_PYTHON_ZOPE_INTERFACE
	select BR2_PACKAGE_PYTHON_PYASN1
	help
	  A DLNA/UPnP Media Server and Framework for the Digital Living.

	  https://github.com/coherence-project/Coherence
```

## package/python-colibris/Config.in
```kconfig
config BR2_PACKAGE_PYTHON_COLIBRIS
	bool "python-colibris"
	depends on BR2_PACKAGE_PYTHON3
	help
	  A collection of libraries glued together to make writing RESTful microservices easier.

	  https://gitlab.com/safefleet/colibris
```

## package/python-colorama/Config.in
```kconfig
config BR2_PACKAGE_PYTHON_COLORAMA
	bool "python-colorama"
	help
	  Cross-platform colored terminal text.

	  https://github.com/tartley/colorama
```

## package/python-colorlog/Config.in
```kconfig
config BR2_PACKAGE_PYTHON_COLORLOG
	bool "python-colorlog"
	help
	  Log formatting with colors.

	  https://github.com/borntyping/python-colorlog
```

## package/python-configshell-fb/Config.in
```kconfig
config BR2_PACKAGE_PYTHON_CONFIGSHELL_FB
	bool "python-configshell-fb"
	select BR2_PACKAGE_PYTHON_PYPARSING
	select BR2_PACKAGE_PYTHON3_READLINE if BR2_PACKAGE_PYTHON3
	select BR2_PACKAGE_PYTHON_READLINE if BR2_PACKAGE_PYTHON
	select BR2_PACKAGE_PYTHON_SIX
	select BR2_PACKAGE_PYTHON_URWID
	help
	  configshell-fb is a Python library that provides a framework
	  for building simple but nice CLI-based applications.

	  https://github.com/agrover/configshell-fb
```

## package/python-couchdb/Config.in
```kconfig
config BR2_PACKAGE_PYTHON_COUCHDB
	bool "python-couchdb"
	select BR2_PACKAGE_PYTHON_SSL if BR2_PACKAGE_PYTHON # runtime
	select BR2_PACKAGE_PYTHON3_SSL if BR2_PACKAGE_PYTHON3 # runtime
	help
	  Python client library for working with CouchDB.

	  https://github.com/djc/couchdb-python/
```

## package/python-crc16/Config.in
```kconfig
config BR2_PACKAGE_PYTHON_CRC16
	bool "python-crc16"
	depends on BR2_PACKAGE_PYTHON
	help
	  This library calculates only CRC16 (16-bit codes) and the
	  only supported variant at the moment is CRC-CCITT (XModem).
	  CRC is a way of detecting accidental changes in data storage
	  or transmission. There are many variants of CRC and CRC16,
	  in particular.

	  https://code.google.com/archive/p/pycrc16/
```

## package/python-crontab/Config.in
```kconfig
config BR2_PACKAGE_PYTHON_CRONTAB
	bool "python-crontab"
	select BR2_PACKAGE_PYTHON_DATEUTIL # runtime
	help
	  Crontab module for reading and writing crontab files and
	  accessing the system cron automatically and simply using
	  a direct API.

	  https://gitlab.com/doctormo/python-crontab/
```

## package/python-crossbar/Config.in
```kconfig
config BR2_PACKAGE_PYTHON_CROSSBAR
	bool "python-crossbar"
	depends on BR2_INSTALL_LIBSTDCPP # python-cryptography
	depends on BR2_PACKAGE_PYTHON3
	# All the following dependencies are runtime dependencies
	select BR2_PACKAGE_PYTHON_ATTRS
	select BR2_PACKAGE_PYTHON_AUTOBAHN
	select BR2_PACKAGE_PYTHON_BITSTRING
	select BR2_PACKAGE_PYTHON_CBOR
	select BR2_PACKAGE_PYTHON_CBOR2
	select BR2_PACKAGE_PYTHON_CLICK
	select BR2_PACKAGE_PYTHON_CONSTANTLY
	select BR2_PACKAGE_PYTHON_CRYPTOGRAPHY
	select BR2_PACKAGE_PYTHON_H2
	select BR2_PACKAGE_PYTHON_IDNA
	select BR2_PACKAGE_PYTHON_INCREMENTAL
	select BR2_PACKAGE_PYTHON_JINJA2
	select BR2_PACKAGE_PYTHON_LMDB
	select BR2_PACKAGE_PYTHON_MISTUNE
	select BR2_PACKAGE_PYTHON_NETADDR
	select BR2_PACKAGE_PYTHON_PASSLIB
	select BR2_PACKAGE_PYTHON_PRIORITY
	select BR2_PACKAGE_PYTHON_PSUTIL
	select BR2_PACKAGE_PYTHON_PYASN1
	select BR2_PACKAGE_PYTHON_PYASN1_MODULES
	select BR2_PACKAGE_PYTHON_PYGMENTS
	select BR2_PACKAGE_PYTHON_PYNACL
	select BR2_PACKAGE_PYTHON_PYOPENSSL
	select BR2_PACKAGE_PYTHON_PYQRCODE
	select BR2_PACKAGE_PYTHON_PYTRIE
	select BR2_PACKAGE_PYTHON_PYYAML
	select BR2_PACKAGE_PYTHON_SDNOTIFY
	select BR2_PACKAGE_PYTHON_SERVICE_IDENTITY
	select BR2_PACKAGE_PYTHON_SETPROCTITLE
	select BR2_PACKAGE_PYTHON_SETUPTOOLS
	select BR2_PACKAGE_PYTHON_TREQ
	select BR2_PACKAGE_PYTHON_TWISTED
	select BR2_PACKAGE_PYTHON_TXAIO
	select BR2_PACKAGE_PYTHON_TXTORCON
	select BR2_PACKAGE_PYTHON_U_MSGPACK
	select BR2_PACKAGE_PYTHON_UBJSON
	select BR2_PACKAGE_PYTHON_WATCHDOG
	select BR2_PACKAGE_PYTHON_WERKZEUG
	select BR2_PACKAGE_PYTHON_ZOPE_INTERFACE
	help
	  Crossbar.io is an open-source WAMP application router that
	  allows to build advanced applications from loosely-coupled
	  components that can talk in real-time with each other.

	  https://pypi.python.org/pypi/crossbar

comment "python-crossbar needs a toolchain w/ C++"
	depends on !BR2_INSTALL_LIBSTDCPP
	depends on BR2_PACKAGE_PYTHON3
```

## package/python-cryptography/Config.in
```kconfig
config BR2_PACKAGE_PYTHON_CRYPTOGRAPHY
	bool "python-cryptography"
	depends on BR2_INSTALL_LIBSTDCPP # python-pyasn
	select BR2_PACKAGE_OPENSSL
	select BR2_PACKAGE_PYTHON_CFFI # runtime
	select BR2_PACKAGE_PYTHON_ENUM34 if BR2_PACKAGE_PYTHON # runtime
	select BR2_PACKAGE_PYTHON_HASHLIB if BR2_PACKAGE_PYTHON # runtime
	select BR2_PACKAGE_PYTHON_IDNA # runtime
	select BR2_PACKAGE_PYTHON_IPADDRESS if BR2_PACKAGE_PYTHON # runtime
	select BR2_PACKAGE_PYTHON_ASN1CRYPTO # runtime
	select BR2_PACKAGE_PYTHON_PYEXPAT if BR2_PACKAGE_PYTHON # runtime
	select BR2_PACKAGE_PYTHON3_PYEXPAT if BR2_PACKAGE_PYTHON3 # runtime
	select BR2_PACKAGE_PYTHON_SETUPTOOLS # runtime
	select BR2_PACKAGE_PYTHON_SIX # runtime
	select BR2_PACKAGE_PYTHON_SSL if BR2_PACKAGE_PYTHON # runtime
	select BR2_PACKAGE_PYTHON3_SSL if BR2_PACKAGE_PYTHON3 # runtime
	help
	  cryptography is a package designed to expose cryptographic
	  primitives and recipes to Python developers.

	  https://cryptography.io

comment "python-cryptography needs a toolchain w/ C++"
	depends on !BR2_INSTALL_LIBSTDCPP
```

## package/python-cssselect/Config.in
```kconfig
config BR2_PACKAGE_PYTHON_CSSSELECT
	bool "python-cssselect"
	help
	  cssselect parses CSS3 Selectors and translates them to XPath 1.0

	  http://packages.python.org/cssselect/
```

## package/python-cycler/Config.in
```kconfig
config BR2_PACKAGE_PYTHON_CYCLER
	bool "python-cycler"
	depends on BR2_PACKAGE_PYTHON || BR2_PACKAGE_PYTHON3
	help
	  Creates a Cycler objects much like cycler, but
	  includes input validation.

	  https://matplotlib.org/cycler/
```

## package/python-cython/Config.in.host
```kconfig
config BR2_PACKAGE_HOST_PYTHON_CYTHON
	bool "host python-cython"
	help
	  The Cython compiler for writing C extensions for the Python
	  language.

	  http://cython.org/
```

## package/python-daemon/Config.in
```kconfig
config BR2_PACKAGE_PYTHON_DAEMON
	bool "python-daemon"
	select BR2_PACKAGE_PYTHON_DOCUTILS # runtime
	help
	  Library to implement a well-behaved Unix daemon process.

	  https://pypi.python.org/pypi/python-daemon/
```

## package/python-daemonize/Config.in
```kconfig
config BR2_PACKAGE_PYTHON_DAEMONIZE
	bool "python-daemonize"
	select BR2_PACKAGE_PYTHON_SETUPTOOLS # runtime
	help
	  Library to enable your code run as a daemon process on
	  Unix-like systems.

	  https://pypi.python.org/pypi/daemonize
```

## package/python-daphne/Config.in
```kconfig
config BR2_PACKAGE_PYTHON_DAPHNE
	bool "python-daphne"
	depends on BR2_INSTALL_LIBSTDCPP # python-autobahn -> python-cryptography
	depends on BR2_PACKAGE_PYTHON3
	select BR2_PACKAGE_PYTHON_ASGIREF # runtime
	select BR2_PACKAGE_PYTHON_AUTOBAHN # runtime
	select BR2_PACKAGE_PYTHON_TWISTED # runtime
	select BR2_PACKAGE_PYTHON_TWISTED_TLS # runtime
	help
	  Daphne is a HTTP, HTTP2 and WebSocket protocol server for
	  ASGI and ASGI-HTTP, developed to power Django Channels.
	  It supports automatic negotiation of protocols; there's no
	  need for URL prefixing to determine WebSocket endpoints
	  versus HTTP endpoints.

	  https://github.com/django/daphne

comment "python-daphne needs a toolchain w/ C++"
	depends on !BR2_INSTALL_LIBSTDCPP
	depends on BR2_PACKAGE_PYTHON3
```

## package/python-dataproperty/Config.in
```kconfig
config BR2_PACKAGE_PYTHON_DATAPROPERTY
	bool "python-dataproperty"
	depends on BR2_PACKAGE_PYTHON3 # python-mbstrdecoder
	select BR2_PACKAGE_PYTHON_MBSTRDECODER # runtime
	select BR2_PACKAGE_PYTHON_SIX # runtime
	select BR2_PACKAGE_PYTHON_TYPEPY # runtime
	help
	  Python library for extract property from data.

	  https://github.com/thombashi/DataProperty
```

## package/python-decorator/Config.in
```kconfig
config BR2_PACKAGE_PYTHON_DECORATOR
	bool "python-decorator"
	help
	  Better living through Python with decorators

	  https://github.com/micheles/decorator
```

## package/python-dialog/Config.in
```kconfig
config BR2_PACKAGE_PYTHON_DIALOG
	bool "python-dialog"
	depends on BR2_PACKAGE_PYTHON
	depends on BR2_USE_MMU # dialog
	select BR2_PACKAGE_DIALOG
	help
	  A Python interface to the UNIX dialog utility and
	  mostly-compatible programs.

	  http://pythondialog.sourceforge.net/
```

## package/python-dialog3/Config.in
```kconfig
config BR2_PACKAGE_PYTHON_DIALOG3
	bool "python-dialog3"
	depends on BR2_PACKAGE_PYTHON3
	depends on BR2_USE_MMU # dialog
	select BR2_PACKAGE_DIALOG
	help
	  A Python 3 only interface to the UNIX dialog utility and
	  mostly-compatible programs.

	  http://pythondialog.sourceforge.net/
```

## package/python-django-enumfields/Config.in
```kconfig
config BR2_PACKAGE_PYTHON_DJANGO_ENUMFIELDS
	bool "python-django-enumfields"
	select BR2_PACKAGE_PYTHON_ENUM34 if BR2_PACKAGE_PYTHON # runtime
	help
	  Real Python Enums for Django.

	  https://github.com/hzdg/django-enumfields
```

## package/python-django/Config.in
```kconfig
config BR2_PACKAGE_PYTHON_DJANGO
	bool "python-django"
	depends on BR2_PACKAGE_PYTHON3
	select BR2_PACKAGE_PYTHON3_UNICODEDATA
	select BR2_PACKAGE_PYTHON3_PYEXPAT
	select BR2_PACKAGE_PYTHON_ASGIREF # runtime
	select BR2_PACKAGE_PYTHON_PYTZ # runtime
	select BR2_PACKAGE_PYTHON_SETUPTOOLS # runtime
	select BR2_PACKAGE_PYTHON_SQLPARSE # runtime

	help
	  Django is a high-level Python Web framework that encourages
	  rapid development and clean, pragmatic design. It takes your
	  Web applications from concept to launch in a matter of
	  hours.  Django takes care of user authentication, content
	  administration, site maps, RSS feeds, user comments and many
	  more tasks.  Django takes security seriously and helps
	  developers avoid many common security mistakes

	  https://www.djangoproject.com/
```
