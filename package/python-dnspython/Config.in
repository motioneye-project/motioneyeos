## package/python-dnspython/Config.in
```kconfig
config BR2_PACKAGE_PYTHON_DNSPYTHON
	bool "python-dnspython"
	help
	  A powerful DNS toolkit for python.

	  http://www.dnspython.org
```

## package/python-docker-pycreds/Config.in
```kconfig
config BR2_PACKAGE_PYTHON_DOCKER_PYCREDS
	bool "python-docker-pycreds"
	select BR2_PACKAGE_PYTHON_SIX # runtime
	help
	  Python bindings for the docker credentials store API.

	  https://github.com/shin-/dockerpy-creds
```

## package/python-docker/Config.in
```kconfig
config BR2_PACKAGE_PYTHON_DOCKER
	bool "python-docker"
	# docker-engine may be running on another host, so no dependency
	select BR2_PACKAGE_PYTHON_SSL if BR2_PACKAGE_PYTHON # runtime
	select BR2_PACKAGE_PYTHON3_SSL if BR2_PACKAGE_PYTHON3 # runtime
	select BR2_PACKAGE_PYTHON_BACKPORTS_SSL_MATCH_HOSTNAME \
	       if BR2_PACKAGE_PYTHON # runtime
	select BR2_PACKAGE_PYTHON_REQUESTS # runtime
	select BR2_PACKAGE_PYTHON_SIX # runtime
	select BR2_PACKAGE_PYTHON_WEBSOCKET_CLIENT # runtime
	select BR2_PACKAGE_PYTHON_DOCKER_PYCREDS # runtime
	help
	  A Python library for the Docker Engine API.

	  https://github.com/docker/docker-py
```

## package/python-dockerpty/Config.in
```kconfig
config BR2_PACKAGE_PYTHON_DOCKERPTY
	bool "python-dockerpty"
	select BR2_PACKAGE_PYTHON_SIX # runtime
	help
	  Python library to use the pseudo-tty of a docker container.

	  https://github.com/d11wtq/dockerpty
```

## package/python-docopt/Config.in
```kconfig
config BR2_PACKAGE_PYTHON_DOCOPT
	bool "python-docopt"
	help
	  docopt helps you create most beautiful command-line
	  interfaces easily. The option parser is generated based on
	  the beautiful help message that you write yourself. This way
	  you don't need to write this stupid repeatable parser-code,
	  and instead can write only the help message-- the way you
	  want it.

	  https://github.com/docopt/docopt
```

## package/python-dominate/Config.in
```kconfig
config BR2_PACKAGE_PYTHON_DOMINATE
	bool "python-dominate"
	help
	  Dominate is a Python library for creating and manipulating
	  HTML documents using an elegant DOM API.

	  http://github.com/Knio/dominate/
```

## package/python-dotenv/Config.in
```kconfig
config BR2_PACKAGE_PYTHON_DOTENV
	bool "python-dotenv"
	depends on BR2_PACKAGE_PYTHON || BR2_PACKAGE_PYTHON3
	help
	  Add .env support to your django/flask apps in development and deployments.

	  https://github.com/theskumar/python-dotenv
```

## package/python-dpkt/Config.in
```kconfig
config BR2_PACKAGE_PYTHON_DPKT
	bool "python-dpkt"
	select BR2_PACKAGE_PYTHON_ZLIB if BR2_PACKAGE_PYTHON # runtime
	select BR2_PACKAGE_PYTHON3_ZLIB if BR2_PACKAGE_PYTHON3 # runtime
	help
	  Fast, simple packet creation / parsing, with definitions
	  for the basic TCP/IP protocols.

	  https://github.com/kbandla/dpkt
```

## package/python-ecdsa/Config.in
```kconfig
config BR2_PACKAGE_PYTHON_ECDSA
	bool "python-ecdsa"
	select BR2_PACKAGE_PYTHON_SIX # runtime
	help
	  ECDSA cryptographic signature library (pure python).

	  http://github.com/warner/python-ecdsa
```

## package/python-engineio/Config.in
```kconfig
config BR2_PACKAGE_PYTHON_ENGINEIO
	bool "python-engineio"
	select BR2_PACKAGE_PYTHON_SIX # runtime
	select BR2_PACKAGE_PYTHON_ZLIB if BR2_PACKAGE_PYTHON
	select BR2_PACKAGE_PYTHON3_ZLIB if BR2_PACKAGE_PYTHON3
	help
	  Engine.IO server.

	  http://github.com/miguelgrinberg/python-engineio/
```

## package/python-entrypoints/Config.in
```kconfig
config BR2_PACKAGE_PYTHON_ENTRYPOINTS
	bool "python-entrypoints"
	help
	  Discover and load entry points from installed packages.

	  https://github.com/takluyver/entrypoints
```

## package/python-enum/Config.in
```kconfig
config BR2_PACKAGE_PYTHON_ENUM
	bool "python-enum"
	depends on BR2_PACKAGE_PYTHON
	help
	  Robust enumerated type support in Python

	  An enumeration object is an immutable sequence object built
	  from a sequence of strings. Each value is also available as
	  an attribute. Such values are constant. Comparisons and
	  enumeration are supported.

	  https://pypi.python.org/pypi/enum
```

## package/python-esptool/Config.in
```kconfig
config BR2_PACKAGE_PYTHON_ESPTOOL
	bool "python-esptool"
	select BR2_PACKAGE_PYTHON_ECDSA # runtime
	select BR2_PACKAGE_PYTHON_PYAES # runtime
	select BR2_PACKAGE_PYTHON_SERIAL # runtime
	help
	  A serial utility to communicate & flash code to Espressif
	  ESP8266 & ESP32 chips.

	  https://github.com/espressif/esptool
```

## package/python-falcon/Config.in
```kconfig
config BR2_PACKAGE_PYTHON_FALCON
	bool "python-falcon"
	help
	  An unladen web framework for building APIs and app
	  backends.

	  https://falconframework.org
```

## package/python-fastentrypoints/Config.in.host
```kconfig
config BR2_PACKAGE_HOST_PYTHON_FASTENTRYPOINTS
	bool "host python-fastentrypoints"
	help
	  Makes entry_points specified in setup.py load more quickly.

	  https://github.com/ninjaaron/fast-entry_points
```

## package/python-filelock/Config.in
```kconfig
config BR2_PACKAGE_PYTHON_FILELOCK
	bool "python-filelock"
	help
	  A platform independent file lock.

	  https://github.com/benediktschmitt/py-filelock
```

## package/python-fire/Config.in
```kconfig
config BR2_PACKAGE_PYTHON_FIRE
	bool "python-fire"
	select BR2_PACKAGE_PYTHON_SIX # runtime
	select BR2_PACKAGE_PYTHON_TERMCOLOR # runtime
	select BR2_PACKAGE_PYTHON_ENUM34 if BR2_PACKAGE_PYTHON # runtime
	help
	  A library for automatically generating command line
	  interfaces.

	  https://github.com/google/python-fire
```

## package/python-flask-cors/Config.in
```kconfig
config BR2_PACKAGE_PYTHON_FLASK_CORS
	bool "python-flask-cors"
	select BR2_PACKAGE_PYTHON_FLASK # runtime
	select BR2_PACKAGE_PYTHON_SIX # runtime
	help
	  A Flask extension adding a decorator for CORS support.

	  https://github.com/corydolphin/flask-cors
```

## package/python-flask-sqlalchemy/Config.in
```kconfig
config BR2_PACKAGE_PYTHON_FLASK_SQLALCHEMY
	bool "python-flask-sqlalchemy"
	select BR2_PACKAGE_PYTHON_FLASK # runtime
	select BR2_PACKAGE_PYTHON_SQLALCHEMY # runtime
	help
	  Flask-SQLAlchemy is a Flask microframework extension which
	  adds support for the SQLAlchemy SQL toolkit/ORM.

	  http://github.com/mitsuhiko/flask-sqlalchemy
```

## package/python-flask/Config.in
```kconfig
config BR2_PACKAGE_PYTHON_FLASK
	bool "python-flask"
	select BR2_PACKAGE_PYTHON_CLICK # runtime
	select BR2_PACKAGE_PYTHON_JINJA2 # runtime
	select BR2_PACKAGE_PYTHON_WERKZEUG # runtime
	select BR2_PACKAGE_PYTHON_ITSDANGEROUS # runtime
	select BR2_PACKAGE_PYTHON_ZLIB if BR2_PACKAGE_PYTHON
	select BR2_PACKAGE_PYTHON3_ZLIB if BR2_PACKAGE_PYTHON3
	help
	  Flask is a microframework for Python based on Werkzeug,
	  Jinja 2 and good intentions.

	  http://flask.pocoo.org/
```

## package/python-flatbuffers/Config.in
```kconfig
config BR2_PACKAGE_PYTHON_FLATBUFFERS
	bool "python-flatbuffers"
	help
	  The FlatBuffers serialization format for Python.

	  https://github.com/google/flatbuffers
```

## package/python-flup/Config.in
```kconfig
config BR2_PACKAGE_PYTHON_FLUP
	bool "python-flup"
	depends on BR2_PACKAGE_PYTHON
	help
	  flup provides of a collection of WSGI modules for Python.
	  It allows a webserver to use scgi-mod and fastcgi-mod
	  with python.

	  https://pypi.python.org/pypi/flup
```

## package/python-frozenlist/Config.in
```kconfig
config BR2_PACKAGE_PYTHON_FROZENLIST
	bool "python-frozenlist"
	depends on BR2_PACKAGE_PYTHON3
	help
	  A list-like structure which implements
	  collections.abc.MutableSequence.

	  https://github.com/aio-libs/frozenlist
```

## package/python-functools32/Config.in
```kconfig
config BR2_PACKAGE_PYTHON_FUNCTOOLS32
	bool "python-functools32"
	depends on BR2_PACKAGE_PYTHON
	help
	  Backport of the functools module from Python 3.2.3 for use on 2.7
	  and PyPy.

	  https://github.com/MiCHiLU/python-functools32
```

## package/python-future/Config.in
```kconfig
config BR2_PACKAGE_PYTHON_FUTURE
	bool "python-future"
	help
	  Easy, clean, reliable Python 2/3 compatibility.

	  http://python-future.org
```
