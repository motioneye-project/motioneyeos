## package/python-gitdb2/Config.in
```kconfig
config BR2_PACKAGE_PYTHON_GITDB2
	bool "python-gitdb2"
	select BR2_PACKAGE_PYTHON_SMMAP2 # runtime
	select BR2_PACKAGE_PYTHON_ZLIB if BR2_PACKAGE_PYTHON  # runtime
	select BR2_PACKAGE_PYTHON3_ZLIB if BR2_PACKAGE_PYTHON3  # runtime
	help
	  GitDB allows you to access bare git repositories for reading
	  and writing. It aims at allowing full access to loose objects
	  as well as packs with performance and scalability in mind. It
	  operates exclusively on streams, allowing to handle large
	  objects with a small memory footprint.

	  https://github.com/gitpython-developers/gitdb
```

## package/python-gobject/Config.in
```kconfig
config BR2_PACKAGE_PYTHON_GOBJECT
	bool "python-gobject"
	depends on BR2_USE_MMU # libglib2, gobject-introspection
	depends on BR2_PACKAGE_HOST_QEMU_ARCH_SUPPORTS # gobject-introspection
	depends on BR2_TOOLCHAIN_GCC_AT_LEAST_4_9 # gobject-introspection
	depends on BR2_TOOLCHAIN_USES_GLIBC # gobject-introspection
	depends on BR2_PACKAGE_PYTHON3 # gobject-introspection
	select BR2_PACKAGE_GOBJECT_INTROSPECTION
	select BR2_PACKAGE_LIBGLIB2
	help
	  Python bindings for the GLib/GObject library

	  https://wiki.gnome.org/action/show/Projects/PyGObject

comment "python-gobject needs a glibc toolchain, gcc >= 4.9"
	depends on BR2_USE_MMU
	depends on BR2_PACKAGE_HOST_QEMU_ARCH_SUPPORTS
	depends on !BR2_TOOLCHAIN_USES_GLIBC || \
		!BR2_TOOLCHAIN_GCC_AT_LEAST_4_9
```

## package/python-greenlet/Config.in
```kconfig
config BR2_PACKAGE_PYTHON_GREENLET_ARCH_SUPPORTS
	bool
	default y if BR2_arm || BR2_armeb
	default y if BR2_aarch64
	default y if BR2_csky
	default y if BR2_m68k
	default y if BR2_mips || BR2_mipsel || BR2_mips64 || BR2_mips64el
	default y if BR2_powerpc || BR2_powerpc64 || BR2_powerpc64le
	default y if BR2_riscv
	default y if BR2_sparc || BR2_sparc64
	default y if BR2_i386 || BR2_x86_64

config BR2_PACKAGE_PYTHON_GREENLET
	bool "python-greenlet"
	depends on BR2_PACKAGE_PYTHON_GREENLET_ARCH_SUPPORTS
	help
	  Lightweight in-process concurrent programming.

	  https://github.com/python-greenlet/greenlet
```

## package/python-gunicorn/Config.in
```kconfig
config BR2_PACKAGE_PYTHON_GUNICORN
	bool "python-gunicorn"
	select BR2_PACKAGE_PYTHON_SSL if BR2_PACKAGE_PYTHON # runtime
	select BR2_PACKAGE_PYTHON3_SSL if BR2_PACKAGE_PYTHON3 # runtime
	help
	  Gunicorn ‘Green Unicorn’ is a Python WSGI HTTP Server for
	  UNIX. It’s a pre-fork worker model ported from Ruby’s
	  Unicorn project. The Gunicorn server is broadly compatible
	  with various web frameworks, simply implemented, light on
	  server resource usage, and fairly speedy.

	  http://gunicorn.org/
```

## package/python-h2/Config.in
```kconfig
config BR2_PACKAGE_PYTHON_H2
	bool "python-h2"
	select BR2_PACKAGE_PYTHON_HYPERFRAME # runtime
	select BR2_PACKAGE_PYTHON_HPACK # runtime
	help
	  HTTP/2 State-Machine based protocol implementation.

	  http://hyper.rtfd.org
```

## package/python-hiredis/Config.in
```kconfig
config BR2_PACKAGE_PYTHON_HIREDIS
	bool "python-hiredis"
	help
	  Python wrapper for hiredis.

	  https://github.com/redis/hiredis-py
```

## package/python-hpack/Config.in
```kconfig
config BR2_PACKAGE_PYTHON_HPACK
	bool "python-hpack"
	help
	  Pure-Python HPACK header compression.

	  http://hyper.rtfd.org
```

## package/python-html5lib/Config.in
```kconfig
config BR2_PACKAGE_PYTHON_HTML5LIB
	bool "python-html5lib"
	select BR2_PACKAGE_PYTHON_SIX # runtime
	select BR2_PACKAGE_PYTHON_WEBENCODINGS # runtime
	help
	  HTML parser based on the WHATWG HTML specification.

	  https://github.com/html5lib/html5lib-python
```

## package/python-huepy/Config.in
```kconfig
config BR2_PACKAGE_PYTHON_HUEPY
	bool "python-huepy"
	help
	  Hue will help you to print awesomely in terminals.

	  https://github.com/s0md3v/hue
```

## package/python-humanize/Config.in
```kconfig
config BR2_PACKAGE_PYTHON_HUMANIZE
	bool "python-humanize"
	help
	  Python humanize package contains various common humanization
	  utilities, like turning a number into a fuzzy human readable
	  duration ('3 minutes ago') or into a human readable size or
	  throughput.

	  http://github.com/jmoiron/humanize
```

## package/python-hyperframe/Config.in
```kconfig
config BR2_PACKAGE_PYTHON_HYPERFRAME
	bool "python-hyperframe"
	help
	  HTTP/2 framing layer for Python.

	  http://hyper.rtfd.org
```

## package/python-hyperlink/Config.in
```kconfig
config BR2_PACKAGE_PYTHON_HYPERLINK
	bool "python-hyperlink"
	select BR2_PACKAGE_PYTHON_IDNA # runtime
	help
	  A featureful, correct URL for Python.

	  https://github.com/python-hyper/hyperlink
```

## package/python-ibmiotf/Config.in
```kconfig
config BR2_PACKAGE_PYTHON_IBMIOTF
	bool "python-ibmiotf"
	select BR2_PACKAGE_PYTHON_ISO8601 # runtime
	select BR2_PACKAGE_PYTHON_PAHO_MQTT # runtime
	select BR2_PACKAGE_PYTHON_PYTZ # runtime
	select BR2_PACKAGE_PYTHON_REQUESTS # runtime
	select BR2_PACKAGE_PYTHON_REQUESTS_TOOLBELT # runtime
	select BR2_PACKAGE_PYTHON_SSL if BR2_PACKAGE_PYTHON # runtime
	select BR2_PACKAGE_PYTHON3_SSL if BR2_PACKAGE_PYTHON3 # runtime
	help
	  Python Client for IBM Watson IoT Platform.

	  https://github.com/ibm-watson-iot/iot-python
```

## package/python-idna-ssl/Config.in
```kconfig
config BR2_PACKAGE_PYTHON_IDNA_SSL
	bool "python-idna-ssl"
	help
	  Patch ssl.match_hostname for Unicode(idna) domains support.

	  https://github.com/aio-libs/idna-ssl
```

## package/python-idna/Config.in
```kconfig
config BR2_PACKAGE_PYTHON_IDNA
	bool "python-idna"
	help
	  A library to support the Internationalised Domain Names in
	  Applications (IDNA) protocol as specified in RFC 5891. This
	  version of the protocol is often referred to as “IDNA2008”
	  and can produce different results from the earlier standard
	  from 2003.

	  https://github.com/kjd/idna
```

## package/python-ifaddr/Config.in
```kconfig
config BR2_PACKAGE_PYTHON_IFADDR
	bool "python-ifaddr"
	help
	  Enumerates all IP addresses on all network adapters of the
	  system.

	  https://github.com/pydron/ifaddr
```

## package/python-inflection/Config.in
```kconfig
config BR2_PACKAGE_PYTHON_INFLECTION
	bool "python-inflection"
	select BR2_PACKAGE_PYTHON_UNICODEDATA if BR2_PACKAGE_PYTHON
	select BR2_PACKAGE_PYTHON3_UNICODEDATA if BR2_PACKAGE_PYTHON3
	help
	  A string transformation library that singularizes and
	  pluralizes English words, and transforms strings from
	  CamelCase to underscored string.

	  Inflection is a port of Ruby on Rails' inflector to Python

	  https://github.com/jpvanhal/inflection
```

## package/python-influxdb/Config.in
```kconfig
config BR2_PACKAGE_PYTHON_INFLUXDB
	bool "python-influxdb"
	select BR2_PACKAGE_PYTHON_DATEUTIL # runtime
	select BR2_PACKAGE_PYTHON_PYTZ # runtime
	select BR2_PACKAGE_PYTHON_REQUESTS # runtime
	select BR2_PACKAGE_PYTHON_SIX # runtime
	help
	  InfluxDB client.

	  https://github.com/influxdb/influxdb-python
```

## package/python-iniparse/Config.in
```kconfig
config BR2_PACKAGE_PYTHON_INIPARSE
	bool "python-iniparse"
	select BR2_PACKAGE_PYTHON_SIX # runtime
	help
	  iniparse is an INI parser for Python which is API compatible
	  with the standard library's ConfigParser, preserves
	  structure of INI files (order of sections & options,
	  indentation, comments, and blank lines are preserved when
	  data is updated), and is more convenient to use.

	  https://pypi.python.org/pypi/iniparse
```

## package/python-iowait/Config.in
```kconfig
config BR2_PACKAGE_PYTHON_IOWAIT
	bool "python-iowait"
	help
	  Platform-independent module for I/O completion events.

	  https://launchpad.net/python-iowait
```

## package/python-ipaddr/Config.in
```kconfig
config BR2_PACKAGE_PYTHON_IPADDR
	depends on BR2_PACKAGE_PYTHON # included since python3.3
	bool "python-ipaddr"
	help
	  An IPv4/IPv6 manipulation library in Python. This library is
	  used to create/poke/manipulate IPv4 and IPv6 addresses and
	  prefixes.

	  https://github.com/google/ipaddr-py
```

## package/python-ipaddress/Config.in
```kconfig
config BR2_PACKAGE_PYTHON_IPADDRESS
	bool "python-ipaddress"
	depends on BR2_PACKAGE_PYTHON
	help
	  Python 3.3's ipaddress for older Python versions.

	  https://github.com/phihag/ipaddress
```

## package/python-iptables/Config.in
```kconfig
config BR2_PACKAGE_PYTHON_IPTABLES
	bool "python-iptables"
	depends on !BR2_STATIC_LIBS
	select BR2_PACKAGE_IPTABLES # runtime dependency
	help
	  Python bindings for iptables.

	  https://github.com/ldx/python-iptables

comment "python-iptables needs a toolchain w/ dynamic library"
	depends on BR2_STATIC_LIBS
```

## package/python-ipy/Config.in
```kconfig
config BR2_PACKAGE_PYTHON_IPY
	bool "python-ipy"
	depends on BR2_PACKAGE_PYTHON
	help
	  IPy - class and tools for handling of IPv4 and
	  IPv6 addresses and networks.

	  https://github.com/haypo/python-ipy/
```

## package/python-ipython-genutils/Config.in
```kconfig
config BR2_PACKAGE_PYTHON_IPYTHON_GENUTILS
	bool "python-ipython-genutils"
	help
	  IPython vestigial utilities

	  https://pypi.python.org/pypi/ipython_genutils
```
