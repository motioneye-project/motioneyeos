## package/python-ipython/Config.in
```kconfig
config BR2_PACKAGE_PYTHON_IPYTHON
	bool "python-ipython"
	depends on BR2_PACKAGE_PYTHON3
	select BR2_PACKAGE_PYTHON_BACKCALL # runtime
	select BR2_PACKAGE_PYTHON_DECORATOR # runtime
	select BR2_PACKAGE_PYTHON_JEDI # runtime
	select BR2_PACKAGE_PYTHON_PICKLESHARE # runtime
	select BR2_PACKAGE_PYTHON_PROMPT_TOOLKIT # runtime
	select BR2_PACKAGE_PYTHON_PYGMENTS  # runtime
	select BR2_PACKAGE_PYTHON_PEXPECT # runtime
	select BR2_PACKAGE_PYTHON_TRAITLETS  # runtime
	help
	  IPython is a command shell for interactive computing in
	  multiple programming languages, originally developed for the
	  Python programming language, that offers enhanced
	  introspection, rich media, additional shell syntax, tab
	  completion, and rich history.

	  http://ipython.org/
```

## package/python-iso8601/Config.in
```kconfig
config BR2_PACKAGE_PYTHON_ISO8601
	bool "python-iso8601"
	help
	  Simple module to parse ISO 8601 dates.

	  https://bitbucket.org/micktwomey/pyiso8601
```

## package/python-itsdangerous/Config.in
```kconfig
config BR2_PACKAGE_PYTHON_ITSDANGEROUS
	bool "python-itsdangerous"
	select BR2_PACKAGE_PYTHON_ZLIB if BR2_PACKAGE_PYTHON # runtime
	select BR2_PACKAGE_PYTHON3_ZLIB if BR2_PACKAGE_PYTHON3 # runtime
	help
	  Itsdangerous contains various helpers to pass data to
	  untrusted environments and to get it back safe and sound.

	  http://pythonhosted.org/itsdangerous/
```

## package/python-janus/Config.in
```kconfig
config BR2_PACKAGE_PYTHON_JANUS
	bool "python-janus"
	depends on BR2_PACKAGE_PYTHON3
	help
	  Mixed sync-async queue to interoperate between asyncio
	  tasks and classic threads.

	  https://github.com/aio-libs/janus/
```

## package/python-jaraco-classes/Config.in
```kconfig
config BR2_PACKAGE_PYTHON_JARACO_CLASSES
	bool "python-jaraco-classes"
	select BR2_PACKAGE_PYTHON_SIX # runtime
	help
	  Utility functions for Python class constructs.

	  https://github.com/jaraco/jaraco.classes
```

## package/python-jaraco-functools/Config.in
```kconfig
config BR2_PACKAGE_PYTHON_JARACO_FUNCTOOLS
	bool "python-jaraco-functools"
	depends on BR2_PACKAGE_PYTHON3 # python-more-itertools
	select BR2_PACKAGE_PYTHON_MORE_ITERTOOLS # runtime
	help
	  Additional functools in the spirit of stdlib’s
	  functools.

	  https://github.com/jaraco/jaraco.functools
```

## package/python-jedi/Config.in
```kconfig
config BR2_PACKAGE_PYTHON_JEDI
	bool "python-jedi"
	select BR2_PACKAGE_PYTHON_PARSO # runtime
	help
	  An autocompletion tool for Python that can be used for text
	  editors.

	  https://github.com/davidhalter/jedi
```

## package/python-jinja2/Config.in
```kconfig
config BR2_PACKAGE_PYTHON_JINJA2
	bool "python-jinja2"
	select BR2_PACKAGE_PYTHON_MARKUPSAFE # runtime
	select BR2_PACKAGE_PYTHON_UNICODEDATA if BR2_PACKAGE_PYTHON
	select BR2_PACKAGE_PYTHON3_UNICODEDATA if BR2_PACKAGE_PYTHON3
	help
	  Jinja2 is a template engine written in pure Python. It
	  provides a Django inspired non-XML syntax but supports
	  inline expressions and an optional sandboxed environment.

	  http://jinja.pocoo.org/
```

## package/python-json-schema-validator/Config.in
```kconfig
config BR2_PACKAGE_PYTHON_JSON_SCHEMA_VALIDATOR
	bool "python-json-schema-validator"
	help
	  JSON Schema Validator

	  https://pypi.python.org/pypi/json-schema-validator
```

## package/python-jsonmodels/Config.in
```kconfig
config BR2_PACKAGE_PYTHON_JSONMODELS
	bool "python-jsonmodels"
	select BR2_PACKAGE_PYTHON_DATEUTIL # runtime
	select BR2_PACKAGE_PYTHON_SIX # runtime
	help
	  Models to make easier to deal with structures that are
	  converted to, or read from JSON.

	  https://github.com/beregond/jsonmodels
```

## package/python-jsonpointer/Config.in
```kconfig
config BR2_PACKAGE_PYTHON_JSONPOINTER
	bool "python-jsonpointer"
	depends on BR2_PACKAGE_PYTHON3
	help
	  Resolve JSON Pointers in Python.

	  https://github.com/stefankoegl/python-json-pointer
```

## package/python-jsonschema/Config.in
```kconfig
config BR2_PACKAGE_PYTHON_JSONSCHEMA
	bool "python-jsonschema"
	select BR2_PACKAGE_PYTHON_FUNCTOOLS32 if BR2_PACKAGE_PYTHON # runtime
	help
	  An implementation of JSON Schema validation for Python.

	  http://github.com/Julian/jsonschema
```

## package/python-keyring/Config.in
```kconfig
config BR2_PACKAGE_PYTHON_KEYRING
	bool "python-keyring"
	depends on BR2_PACKAGE_PYTHON3
	depends on BR2_INSTALL_LIBSTDCPP # python-secretstorage
	select BR2_PACKAGE_PYTHON_ENTRYPOINTS # runtime
	select BR2_PACKAGE_PYTHON_SECRETSTORAGE # runtime
	help
	  The Python keyring lib provides a easy way to access the
	  system keyring service from Python.

	  https://pypi.python.org/pypi/keyring

comment "python-keyring needs a toolchain w/ C++"
	depends on !BR2_INSTALL_LIBSTDCPP
```

## package/python-kiwisolver/Config.in
```kconfig
config BR2_PACKAGE_PYTHON_KIWISOLVER
	bool "python-kiwisolver"
	depends on BR2_INSTALL_LIBSTDCPP
	help
	  Kiwi is an efficient C++ implementation of the Cassowary
	  constraint solving algorithm. Kiwi is an implementation of
	  the algorithm based on the seminal Cassowary paper. It is
	  not a refactoring of the original C++ solver. Kiwi has been
	  designed from the ground up to be lightweight and fast. Kiwi
	  ranges from 10x to 500x faster than the original Cassowary
	  solver with typical use cases gaining a 40x
	  improvement. Memory savings are consistently > 5x.

	  https://github.com/nucleic/kiwi

comment "python-kiwisolver needs a toolchain w/ C++"
	depends on !BR2_INSTALL_LIBSTDCPP
```

## package/python-libconfig/Config.in
```kconfig
comment "python-libconfig needs a toolchain w/ C++, largefile, threads"
	depends on !BR2_INSTALL_LIBSTDCPP || !BR2_LARGEFILE || !BR2_TOOLCHAIN_HAS_THREADS

config BR2_PACKAGE_PYTHON_LIBCONFIG
	bool "python-libconfig"
	select BR2_PACKAGE_BOOST
	select BR2_PACKAGE_BOOST_PYTHON
	select BR2_PACKAGE_LIBCONFIG
	depends on BR2_INSTALL_LIBSTDCPP
	depends on BR2_LARGEFILE
	depends on BR2_TOOLCHAIN_HAS_THREADS
	help
	  Python bindings to the C++ library libconfig

	  Libconfig is a simple library for manipulating structured
	  configuration files. The file format is more compact and more
	  readable than XML. And unlike XML, it is type-aware, so it is
	  not necessary to do string parsing in application code.
	  http://www.hyperrealm.com/libconfig/

	  https://github.com/cnangel/python-libconfig
```

## package/python-libusb1/Config.in
```kconfig
config BR2_PACKAGE_PYTHON_LIBUSB1
	bool "python-libusb1"
	depends on BR2_TOOLCHAIN_HAS_THREADS # libusb
	select BR2_PACKAGE_LIBUSB
	help
	  Pure-python wrapper for libusb-1.0.

	  http://github.com/vpelletier/python-libusb1

comment "python-libusb1 needs a toolchain w/ threads"
	depends on !BR2_TOOLCHAIN_HAS_THREADS
```

## package/python-lmdb/Config.in
```kconfig
config BR2_PACKAGE_PYTHON_LMDB
	bool "python-lmdb"
	select BR2_PACKAGE_PYTHON_CFFI # runtime
	help
	  Universal Python binding for the LMDB 'Lightning' Database.

	  https://pypi.python.org/pypi/lmdb
```

## package/python-lockfile/Config.in
```kconfig
config BR2_PACKAGE_PYTHON_LOCKFILE
	bool "python-lockfile"
	help
	  The lockfile package exports a LockFile class which provides a
	  simple API for locking files. Unlike the Windows
	  msvcrt.locking function, the fcntl.lockf and flock functions,
	  and the deprecated posixfile module, the API is identical
	  across both Unix (including Linux and Mac) and Windows
	  platforms.

	  The lock mechanism relies on the atomic nature of the link
	  (on Unix) and mkdir (on Windows) system calls. An
	  implementation based on SQLite is also provided, more as a
	  demonstration of the possibilities it provides than as
	  production-quality code.

	  https://pypi.org/project/lockfile/
```

## package/python-logbook/Config.in
```kconfig
config BR2_PACKAGE_PYTHON_LOGBOOK
	bool "python-logbook"
	select BR2_PACKAGE_PYTHON_ZLIB if BR2_PACKAGE_PYTHON
	select BR2_PACKAGE_PYTHON3_ZLIB if BR2_PACKAGE_PYTHON3
	help
	  A logging replacement for Python.

	  http://logbook.pocoo.org/
```

## package/python-logstash/Config.in
```kconfig
config BR2_PACKAGE_PYTHON_LOGSTASH
	bool "python-logstash"
	help
	  Python logging handler for Logstash.

	  https://github.com/vklochan/python-logstash
```

## package/python-lxml/Config.in
```kconfig
config BR2_PACKAGE_PYTHON_LXML
	bool "python-lxml"
	select BR2_PACKAGE_LIBXML2
	select BR2_PACKAGE_LIBXSLT
	select BR2_PACKAGE_PYTHON_ZLIB if BR2_PACKAGE_PYTHON
	select BR2_PACKAGE_PYTHON3_ZLIB if BR2_PACKAGE_PYTHON3
	help
	  The lxml XML toolkit is a Pythonic binding for the C libraries
	  libxml2 and libxslt.

	  http://lxml.de/
```

## package/python-lxml/Config.in.host
```kconfig
config BR2_PACKAGE_HOST_PYTHON_LXML
	bool "host python-lxml"
	help
	  The lxml XML toolkit is a Pythonic binding for the C libraries
	  libxml2 and libxslt.

	  http://lxml.de/
```

## package/python-m2r/Config.in
```kconfig
config BR2_PACKAGE_PYTHON_M2R
	bool "python-m2r"
	select BR2_PACKAGE_PYTHON_MISTUNE # runtime
	select BR2_PACKAGE_PYTHON_DOCUTILS # runtime
	help
	  Markdown to reStructuredText converter.

	  https://github.com/miyakogi/m2r
```

## package/python-mad/Config.in
```kconfig
config BR2_PACKAGE_PYTHON_MAD
	bool "python-mad"
	depends on BR2_PACKAGE_PYTHON
	select BR2_PACKAGE_LIBMAD
	help
	  python-mad is a Python binding for the MAD library, a
	  high-quality integer-only MPEG decoder.

	  http://spacepants.org/src/pymad/
```

## package/python-mako/Config.in
```kconfig
config BR2_PACKAGE_PYTHON_MAKO
	bool "python-mako"
	help
	  Mako is a template library written in Python. It provides a
	  familiar, non-XML syntax which compiles into Python modules
	  for maximum performance.

	  https://pypi.python.org/pypi/Mako
```
