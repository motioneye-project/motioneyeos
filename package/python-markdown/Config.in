## package/python-markdown/Config.in
```kconfig
config BR2_PACKAGE_PYTHON_MARKDOWN
	bool "python-markdown"
	depends on BR2_PACKAGE_PYTHON3
	# runtime dependency on Python's xml module
	select BR2_PACKAGE_PYTHON3_PYEXPAT
	help
	  This is a Python implementation of John Gruber's Markdown

	  https://pypi.python.org/pypi/Markdown
```

## package/python-markupsafe/Config.in
```kconfig
config BR2_PACKAGE_PYTHON_MARKUPSAFE
	bool "python-markupsafe"
	help
	  MarkupSafe implements a XML/HTML/XHTML Markup safe string
	  for Python.

	  https://github.com/mitsuhiko/markupsafe
```

## package/python-marshmallow-peewee/Config.in
```kconfig
config BR2_PACKAGE_PYTHON_MARSHMALLOW_PEEWEE
	bool "python-peewee"
	depends on BR2_PACKAGE_PYTHON3
	help
	  Peewee integration with the marshmallow (de)serialization library.

	  https://github.com/klen/marshmallow-peewee
```

## package/python-marshmallow/Config.in
```kconfig
config BR2_PACKAGE_PYTHON_MARSHMALLOW
	bool "python-marshmallow"
	depends on BR2_PACKAGE_PYTHON3
	help
	  A lightweight library for converting complex objects to and from simple Python datatypes.

	  https://github.com/marshmallow-code/marshmallow
```

## package/python-matplotlib/Config.in
```kconfig
config BR2_PACKAGE_PYTHON_MATPLOTLIB
	bool "python-matplotlib"
	depends on BR2_INSTALL_LIBSTDCPP
	depends on BR2_PACKAGE_PYTHON3
	depends on BR2_PACKAGE_PYTHON_NUMPY_ARCH_SUPPORTS
	depends on BR2_TOOLCHAIN_USES_GLIBC || BR2_TOOLCHAIN_USES_MUSL # python-numpy
	select BR2_PACKAGE_FREETYPE # runtime
	select BR2_PACKAGE_LIBPNG # runtime
	select BR2_PACKAGE_PYTHON_CYCLER
	select BR2_PACKAGE_PYTHON_SETUPTOOLS # runtime
	select BR2_PACKAGE_PYTHON_DATEUTIL # runtime
	select BR2_PACKAGE_PYTHON_KIWISOLVER # runtime
	select BR2_PACKAGE_PYTHON_NUMPY # runtime
	select BR2_PACKAGE_PYTHON_PYPARSING # runtime
	select BR2_PACKAGE_PYTHON3_ZLIB # runtime
	select BR2_PACKAGE_ZLIB # runtime
	help
	  Matplotlib strives to produce publication quality 2D
	  graphics for interactive graphing, scientific publishing,
	  user interface development and web application servers
	  targeting multiple user interfaces and hardcopy output
	  formats.

	  https://matplotlib.org/

comment "python-matplotlib needs a toolchain w/ C++"
	depends on !BR2_INSTALL_LIBSTDCPP

comment "python-matplotlib needs glibc or musl"
	depends on !(BR2_TOOLCHAIN_USES_GLIBC || BR2_TOOLCHAIN_USES_MUSL)
```

## package/python-mbstrdecoder/Config.in
```kconfig
config BR2_PACKAGE_PYTHON_MBSTRDECODER
	bool "python-mbstrdecoder"
	depends on BR2_PACKAGE_PYTHON3
	help
	  multi-byte character string decoder.

	  https://github.com/thombashi/mbstrdecoder
```

## package/python-meld3/Config.in
```kconfig
config BR2_PACKAGE_PYTHON_MELD3
	bool "python-meld3"
	depends on BR2_PACKAGE_PYTHON
	select BR2_PACKAGE_PYTHON_PYEXPAT
	help
	  A HTML/XML templating system.

	  https://github.com/supervisor/meld3
```

## package/python-mimeparse/Config.in
```kconfig
config BR2_PACKAGE_PYTHON_MIMEPARSE
	bool "python-mimeparse"
	help
	  A module provides basic functions for parsing mime-type
	  names and matching them against a list of media-ranges.

	  https://github.com/dbtsai/python-mimeparse
```

## package/python-mistune/Config.in
```kconfig
config BR2_PACKAGE_PYTHON_MISTUNE
	bool "python-mistune"
	help
	  The fastest markdown parser in pure Python with renderer
	  features, inspired by marked.

	  https://pypi.python.org/pypi/mistune
```

## package/python-mock/Config.in
```kconfig
config BR2_PACKAGE_PYTHON_MOCK
	bool "python-mock"
	depends on BR2_PACKAGE_PYTHON || BR2_PACKAGE_PYTHON3
	depends on BR2_PACKAGE_PYTHON_PBR
	help
	  mock is a library for testing in Python. It allows you to replace parts of your system under test with mock objects and make assertions about how they have been used.

	  https://github.com/testing-cabal/mock
```

## package/python-modbus-tk/Config.in
```kconfig
config BR2_PACKAGE_PYTHON_MODBUS_TK
	bool "python-modbus-tk"
	select BR2_PACKAGE_PYTHON_SERIAL # runtime
	help
	  Implementation of modbus protocol in python.

	  https://github.com/ljean/modbus-tk/
```

## package/python-more-itertools/Config.in
```kconfig
config BR2_PACKAGE_PYTHON_MORE_ITERTOOLS
	bool "python-more-itertools"
	depends on BR2_PACKAGE_PYTHON3
	help
	  More routines for operating on iterables, beyond itertools.

	  https://github.com/erikrose/more-itertools
```

## package/python-msgfy/Config.in
```kconfig
config BR2_PACKAGE_PYTHON_MSGFY
	bool "python-msgfy"
	depends on BR2_PACKAGE_PYTHON3
	help
	  msgfy is a Python library for convert Exception instance to
	  a human-readable error message.

	  https://github.com/thombashi/msgfy
```

## package/python-msgpack/Config.in
```kconfig
config BR2_PACKAGE_PYTHON_MSGPACK
	bool "python-msgpack"
	help
	  MessagePack (http://msgpack.org/) is a fast, compact binary
	  serialization format, suitable for similar data to JSON.
	  This package provides a pure python library for reading
	  and writing MessagePack data.

	  https://pypi.python.org/pypi/msgpack-python/
```

## package/python-multidict/Config.in
```kconfig
config BR2_PACKAGE_PYTHON_MULTIDICT
	bool "python-multidict"
	depends on BR2_PACKAGE_PYTHON3
	help
	  Multidict is dict-like collection of key-value pairs where a
	  key may occur more than once in the container.

	  https://github.com/aio-libs/multidict
```

## package/python-mutagen/Config.in
```kconfig
config BR2_PACKAGE_PYTHON_MUTAGEN
	bool "python-mutagen"
	select BR2_PACKAGE_PYTHON_PYEXPAT if BR2_PACKAGE_PYTHON # runtime
	select BR2_PACKAGE_PYTHON3_PYEXPAT if BR2_PACKAGE_PYTHON3 # runtime
	select BR2_PACKAGE_PYTHON_ZLIB if BR2_PACKAGE_PYTHON # runtime
	select BR2_PACKAGE_PYTHON3_ZLIB if BR2_PACKAGE_PYTHON3 # runtime
	help
	  Mutagen is a Python module to handle audio metadata.  It
	  supports ASF, FLAC, MP4, Monkey's Audio, MP3, Musepack, Ogg
	  Opus, Ogg FLAC, Ogg Speex, Ogg Theora, Ogg Vorbis, True
	  Audio, WavPack, OptimFROG, and AIFF audio files. All
	  versions of ID3v2 are supported, and all standard ID3v2.4
	  frames are parsed.

	  It can read Xing headers to accurately calculate the bitrate
	  and length of MP3s. ID3 and APEv2 tags can be edited
	  regardless of audio format.  It can also manipulate Ogg
	  streams on an individual packet/page level.

	  https://mutagen.readthedocs.io/en/latest/
```

## package/python-mwclient/Config.in
```kconfig
config BR2_PACKAGE_PYTHON_MWCLIENT
	bool "python-mwclient"
	select BR2_PACKAGE_PYTHON_REQUESTS_OAUTHLIB # runtime
	select BR2_PACKAGE_PYTHON_SIX # runtime
	help
	  MediaWiki API client.

	  https://github.com/btongminh/mwclient
```

## package/python-mwscrape2slob/Config.in
```kconfig
config BR2_PACKAGE_PYTHON_MWSCRAPE2SLOB
	bool "python-mwscrape2slob"
	depends on !BR2_BINFMT_FLAT # python-slob -> python-pyicu -> icu
	depends on BR2_INSTALL_LIBSTDCPP # python-slob -> python-pyicu -> icu
	depends on BR2_TOOLCHAIN_GCC_AT_LEAST_4_8 # python-slob -> python-pyicu -> icu
	depends on BR2_PACKAGE_PYTHON3
	select BR2_PACKAGE_PYTHON_COUCHDB # runtime
	select BR2_PACKAGE_PYTHON_CSSSELECT # runtime
	select BR2_PACKAGE_PYTHON_CSSUTILS # runtime
	select BR2_PACKAGE_PYTHON_LXML # runtime
	select BR2_PACKAGE_PYTHON_SLOB # runtime
	help
	  A tool to create slob with content from a MediaWiki CouchDB
	  created by mwscrape.

	  https://github.com/itkach/mwscrape2slob

comment "python-mwscrape2slob needs a toolchain w/ C++, gcc >= 4.8"
	depends on BR2_PACKAGE_PYTHON3 && !BR2_BINFMT_FLAT
	depends on !BR2_INSTALL_LIBSTDCPP || \
		!BR2_TOOLCHAIN_GCC_AT_LEAST_4_8
```

## package/python-nested-dict/Config.in
```kconfig
config BR2_PACKAGE_PYTHON_NESTED_DICT
	bool "python-nested-dict"
	help
	  Python dictionary with automatic and arbitrary levels of
	  nestedness.

	  http://pypi.python.org/pypi/nested_dict
```

## package/python-netaddr/Config.in
```kconfig
config BR2_PACKAGE_PYTHON_NETADDR
	bool "python-netaddr"
	help
	  A network address manipulation library for Python.

	  https://pypi.python.org/pypi/netaddr
```

## package/python-netifaces/Config.in
```kconfig
config BR2_PACKAGE_PYTHON_NETIFACES
	bool "python-netifaces"
	help
	  Portable access to network interfaces from Python.

	  http://alastairs-place.net/projects/netifaces
```

## package/python-networkmanager/Config.in
```kconfig
config BR2_PACKAGE_PYTHON_NETWORKMANAGER
	bool "python-networkmanager"
	depends on BR2_PACKAGE_NETWORK_MANAGER # runtime
	depends on BR2_USE_WCHAR # dbus-python
	depends on BR2_TOOLCHAIN_HAS_THREADS # dbus-python
	depends on BR2_PACKAGE_DBUS # dbus-python
	select BR2_PACKAGE_DBUS_PYTHON # runtime
	select BR2_PACKAGE_PYTHON_SIX # runtime
	help
	  python-networkmanager wraps NetworkManagers D-Bus interface
	  so you can be less verbose when talking to NetworkManager
	  from python. All interfaces have been wrapped in classes,
	  properties are exposed as python properties and function
	  calls are forwarded to the correct interface.

	  https://pypi.python.org/pypi/python-networkmanager/
```

## package/python-networkx/Config.in
```kconfig
config BR2_PACKAGE_PYTHON_NETWORKX
	bool "python-networkx"
	select BR2_PACKAGE_PYTHON_DECORATOR # runtime
	help
	  A Python package for the creation, manipulation,
	  and study of the structure, dynamics, and
	  functions of complex networks.

	  https://pypi.python.org/pypi/networkx
```

## package/python-nfc/Config.in
```kconfig
config BR2_PACKAGE_PYTHON_NFC
	bool "python-nfc"
	depends on BR2_PACKAGE_PYTHON
	depends on BR2_TOOLCHAIN_HAS_THREADS # libusb
	select BR2_PACKAGE_LIBUSB
	select BR2_PACKAGE_LIBUSB_COMPAT
	help
	  Python module for near field communication.

	  https://launchpad.net/nfcpy

comment "python-nfc requires a toolchain with threads support"
	depends on !BR2_TOOLCHAIN_HAS_THREADS
```

## package/python-numpy/Config.in
```kconfig
config BR2_PACKAGE_PYTHON_NUMPY_ARCH_SUPPORTS
	bool
	# Numpy has some CPU specific code
	default y if BR2_arc
	default y if BR2_aarch64
	default y if BR2_arm
	default y if BR2_armeb
	default y if BR2_i386
	default y if BR2_mips
	default y if BR2_mipsel
	default y if BR2_powerpc
	default y if BR2_powerpc64
	default y if BR2_sh
	default y if BR2_x86_64

config BR2_PACKAGE_PYTHON_NUMPY
	bool "python-numpy"
	depends on BR2_PACKAGE_PYTHON_NUMPY_ARCH_SUPPORTS
	# python-numpy needs fenv.h which is not provided by uclibc
	depends on BR2_TOOLCHAIN_USES_GLIBC || BR2_TOOLCHAIN_USES_MUSL
	help
	  NumPy is the fundamental package for scientific computing
	  with Python.

	  Note that NumPy needs fenv.h fully supported by the
	  C library.

	  http://www.numpy.org/

comment "python-numpy needs glibc or musl"
	depends on !(BR2_TOOLCHAIN_USES_GLIBC || BR2_TOOLCHAIN_USES_MUSL)
```
