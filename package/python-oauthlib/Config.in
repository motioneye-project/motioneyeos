## package/python-oauthlib/Config.in
```kconfig
config BR2_PACKAGE_PYTHON_OAUTHLIB
	bool "python-oauthlib"
	help
	  A generic, spec-compliant, thorough implementation of the
	  OAuth request-signing logic.

	  https://github.com/idan/oauthlib
```

## package/python-paho-mqtt/Config.in
```kconfig
config BR2_PACKAGE_PYTHON_PAHO_MQTT
	bool "python-paho-mqtt"
	help
	  The Paho Python Client provides a client class with support
	  for both MQTT v3.1 and v3.1.1 on Python 2.7 or 3.x. It also
	  provides some helper functions to make publishing messages
	  to an MQTT server very straightforward.

	  https://pypi.python.org/pypi/paho-mqtt
```

## package/python-pam/Config.in
```kconfig
comment "python-pam needs a toolchain w/ wchar, locale, dynamic library"
	depends on BR2_PACKAGE_PYTHON
	depends on !BR2_ENABLE_LOCALE || !BR2_USE_WCHAR || BR2_STATIC_LIBS

config BR2_PACKAGE_PYTHON_PAM
	bool "python-pam"
	depends on BR2_PACKAGE_PYTHON # C extension not compatible with python3
	depends on BR2_ENABLE_LOCALE # linux-pam
	depends on BR2_USE_WCHAR # linux-pam
	depends on BR2_USE_MMU # linux-pam
	depends on !BR2_STATIC_LIBS # linux-pam
	select BR2_PACKAGE_LINUX_PAM
	help
	  PAM (Pluggable Authentication Module) bindings for Python.

	  https://admin.fedoraproject.org/pkgdb/package/PyPAM/
```

## package/python-pantilthat/Config.in
```kconfig
config BR2_PACKAGE_PYTHON_PANTILTHAT
	bool "python-pantilthat"
    select BR2_PACKAGE_PYTHON_SPIDEV
    select BR2_PACKAGE_PYTHON_RPI_GPIO
	help
	  Python library for driving Pimoroni PanTiltHAT!
      
	  https://github.com/pimoroni/pantilt-hat
```

## package/python-paramiko/Config.in
```kconfig
config BR2_PACKAGE_PYTHON_PARAMIKO
	bool "python-paramiko"
	depends on BR2_INSTALL_LIBSTDCPP # python-cryptography
	select BR2_PACKAGE_PYTHON_BCRYPT # runtime
	select BR2_PACKAGE_PYTHON_CRYPTOGRAPHY # runtime
	select BR2_PACKAGE_PYTHON_PYASN1 # runtime
	select BR2_PACKAGE_PYTHON_PYNACL # runtime
	select BR2_PACKAGE_PYTHON_ZLIB if BR2_PACKAGE_PYTHON # runtime
	select BR2_PACKAGE_PYTHON3_ZLIB if BR2_PACKAGE_PYTHON3 # runtime
	help
	  SSH2 protocol library.

	  https://github.com/paramiko/paramiko/

comment "python-paramiko needs a toolchain w/ C++"
	depends on !BR2_INSTALL_LIBSTDCPP
```

## package/python-parso/Config.in
```kconfig
config BR2_PACKAGE_PYTHON_PARSO
	bool "python-parso"
	help
	  A Python Parser.

	  https://github.com/davidhalter/parso
```

## package/python-passlib/Config.in
```kconfig
config BR2_PACKAGE_PYTHON_PASSLIB
	bool "python-passlib"
	help
	  comprehensive password hashing framework supporting over 30
	  schemes.

	  https://bitbucket.org/ecollins/passlib
```

## package/python-pathlib2/Config.in
```kconfig
config BR2_PACKAGE_PYTHON_PATHLIB2
	bool "python-pathlib2"
	depends on BR2_PACKAGE_PYTHON
	select BR2_PACKAGE_PYTHON_SIX # runtime
	help
	  Object-oriented filesystem paths.

	  The goal of pathlib2 is to provide a backport of standard
	  pathlib module which tracks the standard library module, so
	  all the newest features of the standard pathlib can be used
	  also on older Python versions.

	  https://pypi.python.org/pypi/pathlib2
```

## package/python-pathpy/Config.in
```kconfig
config BR2_PACKAGE_PYTHON_PATHPY
	bool "python-pathpy"
	depends on BR2_PACKAGE_PYTHON3
	help
	  path.py implements a path objects as first-class
	  entities, allowing common operations on files to
	  be invoked on those path objects directly.

	  https://github.com/jaraco/path.py
```

## package/python-pathtools/Config.in
```kconfig
config BR2_PACKAGE_PYTHON_PATHTOOLS
	bool "python-pathtools"
	help
	  File system general utilities.

	  http://github.com/gorakhargosh/pathtools
```

## package/python-pathvalidate/Config.in
```kconfig
config BR2_PACKAGE_PYTHON_PATHVALIDATE
	bool "python-pathvalidate"
	help
	  pathvalidate is a python library to validate/sanitize a string
	  such as filename/variable-name.

	  https://github.com/thombashi/pathvalidate
```

## package/python-pbr/Config.in
```kconfig
config BR2_PACKAGE_PYTHON_PBR
	bool "python-pbr"
	depends on BR2_PACKAGE_PYTHON || BR2_PACKAGE_PYTHON3
	help
	  PBR is a library that injects some useful and sensible default behaviors into your setuptools run. It started off life as the chunks of code that were copied between all of the OpenStack projects. Around the time that OpenStack hit 18 different projects each with at least 3 active branches, it seemed like a good time to make that code into a proper reusable library.

	  https://docs.openstack.org/pbr/latest/
```

## package/python-peewee-migrate/Config.in
```kconfig
config BR2_PACKAGE_PYTHON_PEEWEE_MIGRATE
	bool "python-peewee-migrate"
	depends on BR2_PACKAGE_PYTHON3
	help
	  Simple migration engine for Peewee.

	  https://github.com/klen/peewee_migrate
```

## package/python-peewee/Config.in
```kconfig
config BR2_PACKAGE_PYTHON_PEEWEE
	bool "python-peewee"
	depends on BR2_PACKAGE_PYTHON3
	help
	  A little ORM.

	  https://github.com/coleifer/peewee
```

## package/python-periphery/Config.in
```kconfig
config BR2_PACKAGE_PYTHON_PERIPHERY
	bool "python-periphery"
	help
	  A pure Python 2/3 library for peripheral I/O (GPIO, LED,
	  PWM, SPI, I2C, MMIO, Serial) in Linux.

	  https://github.com/vsergeev/python-periphery
```

## package/python-pexpect/Config.in
```kconfig
config BR2_PACKAGE_PYTHON_PEXPECT
	bool "python-pexpect"
	select BR2_PACKAGE_PYTHON_PTYPROCESS # runtime
	help
	  Pexpect is a pure Python module for spawning child
	  applications; controlling them; and responding to expected
	  patterns in their output. Pexpect works like Don Libes’
	  Expect. Pexpect allows your script to spawn a child
	  application and control it as if a human were typing
	  commands.

	  https://pexpect.readthedocs.org
```

## package/python-pickleshare/Config.in
```kconfig
config BR2_PACKAGE_PYTHON_PICKLESHARE
	bool "python-pickleshare"
	select BR2_PACKAGE_PYTHON_PATHLIB2 if BR2_PACKAGE_PYTHON # runtime
	help
	  Tiny 'shelve'-like database with concurrency support

	  https://pypi.python.org/pypi/pickleshare
```

## package/python-pigpio/Config.in
```kconfig
config BR2_PACKAGE_PYTHON_PIGPIO
	bool "python-pigpio"
	help
	  Pigpio is a Python module for the Raspberry Pi
	  which talks to the pigpio daemon to allow control
	  of the general purpose input outputs (GPIO).

	  http://abyz.me.uk/rpi/pigpio/python.html
```

## package/python-pillow/Config.in
```kconfig
config BR2_PACKAGE_PYTHON_PILLOW
	bool "python-pillow"
	depends on BR2_PACKAGE_PYTHON3
	help
	  Pillow is the "friendly" PIL fork by Alex Clark and
	  Contributors. PIL is the Python Imaging Library by Fredrik
	  Lundh and Contributors.

	  Pillow relies on external libraries to provide support
	  various image formats. Select the corresponding package(s)
	  to get this support. Pillow can use jpeg, zlib (for PNG),
	  tiff, freetype, webp, and openjpeg (JPEG-2000).

	  https://pypi.python.org/pypi/Pillow/
```

## package/python-pip/Config.in
```kconfig
config BR2_PACKAGE_PYTHON_PIP
	bool "python-pip"
	select BR2_PACKAGE_PYTHON_SETUPTOOLS # runtime
	select BR2_PACKAGE_PYTHON_SSL if BR2_PACKAGE_PYTHON # runtime
	select BR2_PACKAGE_PYTHON3_SSL if BR2_PACKAGE_PYTHON3 # runtime
	help
	  The PyPA recommended tool for installing Python packages.

	  https://pip.pypa.io/
```

## package/python-ply/Config.in
```kconfig
config BR2_PACKAGE_PYTHON_PLY
	bool "python-ply"
	help
	  Python Lex & Yacc.

	  http://www.dabeaz.com/ply/
```

## package/python-portend/Config.in
```kconfig
config BR2_PACKAGE_PYTHON_PORTEND
	bool "python-portend"
	depends on BR2_PACKAGE_PYTHON3 # python-tempora
	select BR2_PACKAGE_PYTHON_TEMPORA # runtime
	help
	  TCP port monitoring utilities.

	  https://github.com/jaraco/portend
```

## package/python-posix-ipc/Config.in
```kconfig
config BR2_PACKAGE_PYTHON_POSIX_IPC
	bool "python-posix-ipc"
	depends on BR2_TOOLCHAIN_HAS_THREADS
	help
	  The Python extension module posix_ipc gives access to POSIX
	  inter-process semaphores, shared memory and message queues
	  on systems that support the POSIX Realtime Extensions
	  a.k.a. POSIX 1003.1b-1993.

	  http://semanchuk.com/philip/posix_ipc/

comment "python-posix-ipc needs a toolchain w/ threads"
	depends on !BR2_TOOLCHAIN_HAS_THREADS
```

## package/python-priority/Config.in
```kconfig
config BR2_PACKAGE_PYTHON_PRIORITY
	bool "python-priority"
	help
	  A pure-Python implementation of the HTTP/2 priority tree.

	  http://python-hyper.org/priority/
```

## package/python-prompt-toolkit/Config.in
```kconfig
config BR2_PACKAGE_PYTHON_PROMPT_TOOLKIT
	bool "python-prompt-toolkit"
	select BR2_PACKAGE_PYTHON_SIX # runtime
	select BR2_PACKAGE_PYTHON_WCWIDTH # runtime
	select BR2_PACKAGE_PYTHON_PYEXPAT if BR2_PACKAGE_PYTHON # runtime
	select BR2_PACKAGE_PYTHON3_PYEXPAT if BR2_PACKAGE_PYTHON3 # runtime
	help
	  Library for building powerful interactive command lines in
	  Python.

	  https://github.com/jonathanslenders/python-prompt-toolkit
```
