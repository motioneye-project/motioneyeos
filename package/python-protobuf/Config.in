## package/python-protobuf/Config.in
```kconfig
config BR2_PACKAGE_PYTHON_PROTOBUF
	bool "python-protobuf"
	# host-protobuf only builds on certain architectures
	depends on BR2_HOSTARCH = "x86_64" || BR2_HOSTARCH = "x86"
	depends on BR2_HOST_GCC_AT_LEAST_4_5 # host-protobuf
	select BR2_PACKAGE_PYTHON_SIX # runtime
	help
	  Python implementation of the Google Protocol Buffers.

	  Protocol buffers are Google's language-neutral,
	  platform-neutral, extensible mechanism for serializing
	  structured data.

	  https://github.com/protobuf-c/protobuf-c
```

## package/python-psutil/Config.in
```kconfig
config BR2_PACKAGE_PYTHON_PSUTIL
	bool "python-psutil"
	# sys/sysinfo.h conflict with kernel headers
	depends on !BR2_TOOLCHAIN_USES_MUSL
	help
	  psutil is a cross-platform library for retrieving
	  information on running processes and system utilization
	  (CPU, memory, disks, network) in Python.

	  https://pypi.python.org/pypi/psutil

comment "python-psutil needs a uClibc or glibc toolchain"
	depends on BR2_TOOLCHAIN_USES_MUSL
```

## package/python-psycopg2/Config.in
```kconfig
config BR2_PACKAGE_PYTHON_PSYCOPG2
	bool "python-psycopg2"
	depends on BR2_USE_WCHAR # postgresql
	select BR2_PACKAGE_POSTGRESQL
	help
	  Psycopg is the most popular PostgreSQL database adapter for
	  the Python programming language. Its main features are the
	  complete implementation of the Python DB API 2.0 specification
	  and the thread safety (several threads can share the same
	  connection). It was designed for heavily multi-threaded
	  applications that create and destroy lots of cursors and make
	  a large number of concurrent INSERTs or UPDATEs.

	  Psycopg 2 is mostly implemented in C as a libpq wrapper,
	  resulting in being both efficient and secure. It features
	  client-side and server-side cursors, asynchronous
	  communication and notifications, COPY support. Many Python
	  types are supported out-of-the-box and adapted to matching
	  PostgreSQL data types; adaptation can be extended and
	  customized thanks to a flexible objects adaptation system.
	  Psycopg 2 is both Unicode and Python 3 friendly.

	  http://initd.org/psycopg/

comment "python-psycopg2 needs a toolchain w/ wchar"
	depends on !BR2_USE_WCHAR
```

## package/python-ptyprocess/Config.in
```kconfig
config BR2_PACKAGE_PYTHON_PTYPROCESS
	bool "python-ptyprocess"
	help
	  Launch a subprocess in a pseudo terminal (pty), and interact
	  with both the process and its pty.

	  https://github.com/pexpect/ptyprocess
```

## package/python-py/Config.in
```kconfig
config BR2_PACKAGE_PYTHON_PY
	bool "python-py"
	help
	  library with cross-python path, ini-parsing, io, code, log
	  facilities.

	  http://py.readthedocs.io/
```

## package/python-pyaes/Config.in
```kconfig
config BR2_PACKAGE_PYTHON_PYAES
	bool "python-pyaes"
	help
	  Pure-Python Implementation of the AES block-cipher and
	  common modes of operation.

	  https://github.com/ricmoo/pyaes
```

## package/python-pyalsa/Config.in
```kconfig
config BR2_PACKAGE_PYTHON_PYALSA
	bool "python-pyalsa"
	depends on BR2_TOOLCHAIN_HAS_THREADS
	select BR2_PACKAGE_ALSA_LIB
	select BR2_PACKAGE_ALSA_LIB_HWDEP
	select BR2_PACKAGE_ALSA_LIB_MIXER
	select BR2_PACKAGE_ALSA_LIB_RAWMIDI
	select BR2_PACKAGE_ALSA_LIB_SEQ
	help
	  Official ALSA Python binding, including hardware
	  management, mixer and sequencer control.

	  http://www.alsa-project.org/

comment "python-pyalsa needs a toolchain w/ threads"
	depends on !BR2_TOOLCHAIN_HAS_THREADS
```

## package/python-pyasn-modules/Config.in
```kconfig
config BR2_PACKAGE_PYTHON_PYASN_MODULES
	bool "python-pyasn-modules"
	depends on BR2_INSTALL_LIBSTDCPP
	select BR2_PACKAGE_PYTHON_PYASN # runtime
	help
	  A collection of ASN.1-based protocols modules.

	  https://pypi.python.org/pypi/pyasn1-modules

comment "python-pyasn-modules needs a toolchain w/ C++"
	depends on !BR2_INSTALL_LIBSTDCPP
```

## package/python-pyasn/Config.in
```kconfig
config BR2_PACKAGE_PYTHON_PYASN
	bool "python-pyasn"
	depends on BR2_PACKAGE_PYTHON || BR2_PACKAGE_PYTHON3
	depends on BR2_INSTALL_LIBSTDCPP
	help
	  PyASN is a Python extension module that enables you to
	  perform very fast IP address to Autonomous System Number
	  lookups.

	  https://code.google.com/p/pyasn/

comment "python-pyasn needs a toolchain w/ C++"
	depends on !BR2_INSTALL_LIBSTDCPP
```

## package/python-pyasn1-modules/Config.in
```kconfig
config BR2_PACKAGE_PYTHON_PYASN1_MODULES
	bool "python-pyasn1-modules"
	select BR2_PACKAGE_PYTHON_PYASN1 # runtime
	help
	  A collection of ASN.1-based protocols modules.

	  https://github.com/etingof/pyasn1-modules
```

## package/python-pyasn1/Config.in
```kconfig
config BR2_PACKAGE_PYTHON_PYASN1
	bool "python-pyasn1"
	help
	  ASN.1 types and codecs.

	  https://github.com/etingof/pyasn1
```

## package/python-pycairo/Config.in
```kconfig
config BR2_PACKAGE_PYTHON_PYCAIRO
	bool "python-pycairo"
	depends on BR2_PACKAGE_PYTHON3
	select BR2_PACKAGE_CAIRO
	help
	  Python interface for cairo.

	  https://pycairo.readthedocs.io
```

## package/python-pycares/Config.in
```kconfig
config BR2_PACKAGE_PYTHON_PYCARES
	bool "python-pycares"
	depends on BR2_PACKAGE_PYTHON3
	select BR2_PACKAGE_PYTHON_CFFI # runtime
	help
	  Python interface for c-ares.

	  http://github.com/saghul/pycares
```

## package/python-pycli/Config.in
```kconfig
config BR2_PACKAGE_PYTHON_PYCLI
	bool "python-pycli"
	help
	  The cli package is a framework for making simple, correct
	  command line applications in Python.

	  https://pythonhosted.org/pyCLI/
```

## package/python-pycparser/Config.in
```kconfig
config BR2_PACKAGE_PYTHON_PYCPARSER
	bool "python-pycparser"
	help
	  C parser in Python

	  https://github.com/eliben/pycparser
```

## package/python-pycrypto/Config.in
```kconfig
config BR2_PACKAGE_PYTHON_PYCRYPTO
	bool "python-pycrypto"
	select BR2_PACKAGE_GMP
	help
	  PyCrypto is a collection of cryptographic algorithms and
	  protocols, implemented for use from Python.

	  http://www.pycrypto.org/
```

## package/python-pycryptodomex/Config.in
```kconfig
config BR2_PACKAGE_PYTHON_PYCRYPTODOMEX
	bool "python-pycryptodomex"
	help
	  Cryptographic library for Python.

	  http://www.pycryptodome.org
```

## package/python-pydal/Config.in
```kconfig
config BR2_PACKAGE_PYTHON_PYDAL
	bool python-pydal
	help

	  pyDAL is a pure Python Database Abstraction Layer.  It
	  dynamically generates the SQL in real time using the
	  specified dialect for the database back end, so that you do
	  not have to write SQL code or learn different SQL dialects
	  (the term SQL is used generically), and your code will be
	  portable among different types of databases.

	  pyDAL comes from the original web2py's DAL, with the aim of
	  being wide-compatible.  pyDAL doesn't require web2py and can
	  be used in any Python context.

	  https://github.com/web2py/pydal
```

## package/python-pydantic/Config.in
```kconfig
config BR2_PACKAGE_PYTHON_PYDANTIC
	bool "python-pydantic"
	depends on BR2_PACKAGE_PYTHON3
	help
	  Data validation and settings management using python 3.6
	  type hinting.

	  https://github.com/samuelcolvin/pydantic
```

## package/python-pygame/Config.in
```kconfig
config BR2_PACKAGE_PYTHON_PYGAME
	bool "python-pygame"
	select BR2_PACKAGE_SDL
	help
	  Pygame is a cross-platfrom library designed to make it easy to write
	  multimedia software, such as games, in Python. Pygame requires the
	  Python language and SDL multimedia library.
	  It can also make use of several other popular libraries.

	  http://www.pygame.org/

if BR2_PACKAGE_PYTHON_PYGAME
config BR2_PACKAGE_PYTHON_PYGAME_IMAGE
	bool "pygame.image"
	select BR2_PACKAGE_SDL_IMAGE
	select BR2_PACKAGE_SDL_IMAGE_PNG
	select BR2_PACKAGE_SDL_IMAGE_JPEG
	help
	  pygame module for loading, saving and transfering images.
	  Will autoselect sdl_image with png and jpeg support.

config BR2_PACKAGE_PYTHON_PYGAME_EXAMPLES
	bool "pygame.examples"
	help
	  Include examples.
	  Selecting this option adds about 1.5 MB to the target file system.

config BR2_PACKAGE_PYTHON_PYGAME_FONT
	bool "pygame.font"
	select BR2_PACKAGE_SDL_TTF
	help
	  pygame module for loading and rendering fonts.
	  Will autoselect sdl_ttf.

config BR2_PACKAGE_PYTHON_PYGAME_MIXER
	bool "pygame.mixer"
	select BR2_PACKAGE_SDL_MIXER
	help
	  pygame module for loading and playing sounds.
	  Will autoselect sdl_mixer.

config BR2_PACKAGE_PYTHON_PYGAME_MIXER_MUSIC
	bool "pygame.mixer.music"
	depends on BR2_PACKAGE_PYTHON_PYGAME_MIXER
	help
	  pygame module for controlling streamed audio

config BR2_PACKAGE_PYTHON_PYGAME_SCRAP
	bool "pygame.scrap"
	depends on BR2_PACKAGE_SDL_X11
	help
	  pygame module for clipboard support (X11 needed)

endif
```

## package/python-pygments/Config.in
```kconfig
config BR2_PACKAGE_PYTHON_PYGMENTS
	bool "python-pygments"
	help
	  Pygments is a syntax highlighting package written in Python.

	  https://pypi.python.org/pypi/Pygments
```

## package/python-pyhamcrest/Config.in
```kconfig
config BR2_PACKAGE_PYTHON_PYHAMCREST
	bool "python-pyhamcrest"
	select BR2_PACKAGE_PYTHON_SETUPTOOLS # runtime
	select BR2_PACKAGE_PYTHON_SIX # runtime
	help
	  Hamcrest framework for matcher objects.

	  https://github.com/hamcrest/PyHamcrest
```

## package/python-pyhocon/Config.in
```kconfig
config BR2_PACKAGE_PYTHON_PYHOCON
	bool "python-pyhocon"
	depends on BR2_PACKAGE_PYTHON || BR2_PACKAGE_PYTHON3
	select BR2_PACKAGE_PYTHON_PYPARSING
	help
	  HOCON parser for Python

	  https://github.com/chimpler/pyhocon
```

## package/python-pyicu/Config.in
```kconfig
config BR2_PACKAGE_PYTHON_PYICU
	bool "python-pyicu"
	depends on !BR2_BINFMT_FLAT # icu
	depends on BR2_INSTALL_LIBSTDCPP # icu
	depends on BR2_TOOLCHAIN_GCC_AT_LEAST_4_8 # icu
	select BR2_PACKAGE_ICU
	help
	  Python extension wrapping the ICU C++ API.

	  https://github.com/ovalhub/pyicu

comment "python-pyicu needs a toolchain w/ C++, gcc >= 4.8"
	depends on !BR2_BINFMT_FLAT
	depends on !BR2_INSTALL_LIBSTDCPP || \
		!BR2_TOOLCHAIN_GCC_AT_LEAST_4_8
```

## package/python-pyinotify/Config.in
```kconfig
config BR2_PACKAGE_PYTHON_PYINOTIFY
	bool "python-pyinotify"
	help
	  Monitoring filesystems events with inotify on Linux.

	  https://github.com/seb-m/pyinotify
```
