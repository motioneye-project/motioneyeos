## package/python-pyjwt/Config.in
```kconfig
config BR2_PACKAGE_PYTHON_PYJWT
	bool "python-pyjwt"
	help
	  JSON Web Token implementation in Python.

	  http://github.com/jpadilla/pyjwt
```

## package/python-pylibftdi/Config.in
```kconfig
config BR2_PACKAGE_PYTHON_PYLIBFTDI
	bool "python-pylibftdi"
	depends on BR2_TOOLCHAIN_HAS_THREADS # libusb
	select BR2_PACKAGE_LIBFTDI
	help
	  This package contains the python language binding libftdi.

	  https://pypi.python.org/pypi/pylibftdi

comment "python-pylibftdi needs a toolchain w/ threads"
	depends on !BR2_TOOLCHAIN_HAS_THREADS
```

## package/python-pylru/Config.in
```kconfig
config BR2_PACKAGE_PYTHON_PYLRU
	bool "python-pylru"
	help
	  A least recently used (LRU) cache implementation.

	  https://github.com/jlhutch/pylru
```

## package/python-pymodbus/Config.in
```kconfig
config BR2_PACKAGE_PYTHON_PYMODBUS
	bool "python-pymodbus"
	select BR2_PACKAGE_PYTHON_SIX # runtime
	select BR2_PACKAGE_PYTHON_SERIAL # runtime
	help
	  Pymodbus is a full Modbus protocol implementation.

	  https://github.com/riptideio/pymodbus
```

## package/python-pynacl/Config.in
```kconfig
config BR2_PACKAGE_PYTHON_PYNACL
	bool "python-pynacl"
	select BR2_PACKAGE_LIBSODIUM
	select BR2_PACKAGE_PYTHON_SIX # runtime
	select BR2_PACKAGE_PYTHON_CFFI # runtime
	help
	  Python binding to the Networking and Cryptography (NaCl)
	  library.

	  https://pypi.python.org/pypi/PyNaCl
```

## package/python-pyopenssl/Config.in
```kconfig
config BR2_PACKAGE_PYTHON_PYOPENSSL
	bool "python-pyopenssl"
	depends on BR2_INSTALL_LIBSTDCPP # python-cryptography
	select BR2_PACKAGE_PYTHON_CRYPTOGRAPHY # runtime
	select BR2_PACKAGE_PYTHON_SIX # runtime
	help
	  Python wrapper module around the OpenSSL library.

	  https://github.com/pyca/pyopenssl

comment "python-pyopenssl needs a toolchain w/ C++"
	depends on !BR2_INSTALL_LIBSTDCPP
```

## package/python-pyparsing/Config.in
```kconfig
config BR2_PACKAGE_PYTHON_PYPARSING
	bool "python-pyparsing"
	help
	  The pyparsing module is an alternative approach to creating and
	  executing simple grammars, vs. the traditional lex/yacc approach,
	  or the use of regular expressions. The pyparsing module provides
	  a library of classes that client code uses to construct the grammar
	  directly in Python code.

	  http://pyparsing.wikispaces.com/
```

## package/python-pyparted/Config.in
```kconfig
config BR2_PACKAGE_PYTHON_PYPARTED
	bool "python-pyparted"
	depends on BR2_ENABLE_LOCALE # parted
	depends on BR2_USE_WCHAR
	depends on !BR2_TOOLCHAIN_USES_UCLIBC # parted
	select BR2_PACKAGE_PARTED
	help
	  Python bindings for GNU parted (libparted).

	  https://github.com/rhinstaller/pyparted

comment "pyparted needs a glibc or musl toolchain w/ locale, wchar"
	depends on BR2_TOOLCHAIN_USES_UCLIBC || \
		!BR2_ENABLE_LOCALE || !BR2_USE_WCHAR
```

## package/python-pypcap/Config.in
```kconfig
config BR2_PACKAGE_PYTHON_PYPCAP
	bool "python-pypcap"
	depends on BR2_PACKAGE_PYTHON
	select BR2_PACKAGE_LIBPCAP
	help
	  The pypcap module is an object-oriented wrapper of the C
	  libpcap library.

	  https://code.google.com/p/pypcap/
```

## package/python-pyqrcode/Config.in
```kconfig
config BR2_PACKAGE_PYTHON_PYQRCODE
	bool "python-pyqrcode"
	select BR2_PACKAGE_PYTHON_PYEXPAT if BR2_PACKAGE_PYTHON # runtime
	select BR2_PACKAGE_PYTHON3_PYEXPAT if BR2_PACKAGE_PYTHON3 # runtime
	select BR2_PACKAGE_PYTHON_CODECSCJK if BR2_PACKAGE_PYTHON # runtime
	select BR2_PACKAGE_PYTHON3_CODECSCJK if BR2_PACKAGE_PYTHON3 # runtime
	help
	  A QR code generator written purely in Python with SVG, EPS,
	  PNG and terminal output.

	  https://github.com/mnooner256/pyqrcode
```

## package/python-pyqt/Config.in
```kconfig
comment "python-pyqt needs a toolchain w/ C++, threads"
	depends on BR2_USE_MMU
	depends on !BR2_INSTALL_LIBSTDCPP || !BR2_TOOLCHAIN_HAS_THREADS

config BR2_PACKAGE_PYTHON_PYQT
	bool "python-pyqt"
	depends on BR2_INSTALL_LIBSTDCPP
	depends on BR2_TOOLCHAIN_HAS_THREADS # qt
	depends on BR2_USE_MMU # qt
	select BR2_PACKAGE_QT
	select BR2_PACKAGE_PYTHON_SIP
	help
	  PyQt4 for Qt Embedded 4 bindings.

	  http://www.riverbankcomputing.com/software/pyqt/

if BR2_PACKAGE_PYTHON_PYQT

config BR2_PACKAGE_PYTHON_PYQT_ARCH_USES_QREAL_FLOAT
	bool
	default y if BR2_arm || BR2_armeb
	default y if BR2_sh4 || BR2_sh4eb || BR2_sh4a || BR2_sh4aeb
	default y if (BR2_mipsel || BR2_mips) && BR2_PACKAGE_QT_EMBEDDED

endif
```

## package/python-pyqt5/Config.in
```kconfig
comment "python-pyqt5 needs Qt5"
	depends on !BR2_PACKAGE_QT5

config BR2_PACKAGE_PYTHON_PYQT5
	bool "python-pyqt5"
	depends on BR2_PACKAGE_QT5
	select BR2_PACKAGE_PYTHON_SIP
	select BR2_PACKAGE_QT5BASE_GUI
	help
	  Python bindings for Qt 5

	  http://www.riverbankcomputing.com/software/pyqt/
```

## package/python-pyratemp/Config.in
```kconfig
config BR2_PACKAGE_PYTHON_PYRATEMP
	bool "python-pyratemp"
	help
	  python-pyratemp is a Python library for doing html
	  templates.  written entirely in Python, that is designed to
	  be very easy to use and very like writing Python.

	  https://pypi.python.org/pypi/pyratemp/
```

## package/python-pyro/Config.in
```kconfig
config BR2_PACKAGE_PYTHON_PYRO
	bool "python-pyro"
	depends on BR2_PACKAGE_PYTHON
	help
	  python-pyro is a Python library stands for PYthon Remote Objects.
	  It is an advanced and powerful Distributed Object Technology system
	  written entirely in Python, that is designed to be very easy to use..

	  https://pypi.python.org/pypi/Pyro/
```

## package/python-pyroute2/Config.in
```kconfig
config BR2_PACKAGE_PYTHON_PYROUTE2
	bool "python-pyroute2"
	select BR2_PACKAGE_PYTHON_SQLITE if BR2_PACKAGE_PYTHON
	select BR2_PACKAGE_PYTHON3_SQLITE if BR2_PACKAGE_PYTHON3
	help
	  Python netlink library - Linux network / netns / wireless /
	  ipset configuration.

	  https://github.com/svinota/pyroute2
```

## package/python-pysendfile/Config.in
```kconfig
config BR2_PACKAGE_PYTHON_PYSENDFILE
	bool "python-pysendfile"
	help
	  A Python interface to sendfile(2) syscall

	  https://github.com/giampaolo/pysendfile
```

## package/python-pysftp/Config.in
```kconfig
config BR2_PACKAGE_PYTHON_PYSFTP
	bool "python-pysftp"
	select BR2_PACKAGE_PYTHON_PARAMIKO # runtime
	help
	  A friendly face on SFTP.

	  https://bitbucket.org/dundeemt/pysftp
```

## package/python-pysmb/Config.in
```kconfig
config BR2_PACKAGE_PYTHON_PYSMB
	bool "python-pysmb"
	depends on BR2_INSTALL_LIBSTDCPP
	select BR2_PACKAGE_PYTHON_PYASN
	help
	  pysmb is an experimental SMB/CIFS library written in Python.
	  It implements the client-side SMB/CIFS protocol (SMB1 and
	  SMB2) which allows your Python application to access and
	  transfer files to/from SMB/CIFS shared folders like your
	  Windows file sharing and Samba folders.

	  https://miketeo.net/wp/index.php/projects/pysmb

comment "python-pysmb needs a toolchain w/ C++"
	depends on !BR2_INSTALL_LIBSTDCPP
```

## package/python-pysmi/Config.in
```kconfig
config BR2_PACKAGE_PYTHON_PYSMI
	bool "python-pysmi"
	select BR2_PACKAGE_PYTHON_PLY # runtime
	help
	  SNMP SMI/MIB Parser.

	  https://github.com/etingof/pysmi
```

## package/python-pysnmp-apps/Config.in
```kconfig
config BR2_PACKAGE_PYTHON_PYSNMP_APPS
	bool "python-pysnmp-apps"
	depends on BR2_INSTALL_LIBSTDCPP # pysnmp -> pyasn
	select BR2_PACKAGE_PYTHON_PYSNMP
	help
	  A collection of command-line tools for SNMP management
	  purposes built on top of the PySNMP package.

	  http://pysnmp.sf.net

comment "python-pysnmp-apps needs a toolchain w/ C++"
	depends on !BR2_INSTALL_LIBSTDCPP
```

## package/python-pysnmp-mibs/Config.in
```kconfig
config BR2_PACKAGE_PYTHON_PYSNMP_MIBS
	bool "python-pysnmp-mibs"
	depends on BR2_INSTALL_LIBSTDCPP # pysnmp -> pyasn
	select BR2_PACKAGE_PYTHON_PYSNMP
	help
	  PySNMP MIBs is a set of IETF & IANA MIBs pre-compiled and
	  packaged to simplify their use with the PySNMP library.

	  http://pysnmp.sf.net

comment "python-pysnmp-libs needs a toolchain w/ C++"
	depends on !BR2_INSTALL_LIBSTDCPP
```

## package/python-pysnmp/Config.in
```kconfig
config BR2_PACKAGE_PYTHON_PYSNMP
	bool "python-pysnmp"
	select BR2_PACKAGE_PYTHON_PYSMI # runtime
	select BR2_PACKAGE_PYTHON_PYCRYPTODOMEX # runtime
	select BR2_PACKAGE_PYTHON_PYASN1 # runtime
	help
	  PySNMP is a cross-platform, pure-Python SNMP engine
	  implementation.

	  http://pysnmp.sf.net
```

## package/python-pysocks/Config.in
```kconfig
config BR2_PACKAGE_PYTHON_PYSOCKS
	bool "python-pysocks"
	help
	  A Python SOCKS client module.

	  https://github.com/Anorov/PySocks
```

## package/python-pytablewriter/Config.in
```kconfig
config BR2_PACKAGE_PYTHON_PYTABLEWRITER
	bool "python-pytablewriter"
	depends on BR2_PACKAGE_PYTHON3 # python-dataproperty, python-mbstrdecoder
	select BR2_PACKAGE_PYTHON_DATAPROPERTY # runtime
	select BR2_PACKAGE_PYTHON_MBSTRDECODER # runtime
	select BR2_PACKAGE_PYTHON_MSGFY # runtime
	select BR2_PACKAGE_PYTHON_PATHVALIDATE # runtime
	select BR2_PACKAGE_PYTHON_SIX # runtime
	select BR2_PACKAGE_PYTHON_TABLEDATA # runtime
	select BR2_PACKAGE_PYTHON_TYPEPY # runtime
	help
	  pytablewriter is a python library to write a table in various
	  formats: CSV, HTML, JavaScript, JSON, Markdown, Excel, Pandas,
	  Python, reStructuredText.

	  https://github.com/thombashi/pytablewriter
```

## package/python-pytrie/Config.in
```kconfig
config BR2_PACKAGE_PYTHON_PYTRIE
	bool "python-pytrie"
	select BR2_PACKAGE_PYTHON_SORTEDCONTAINERS # runtime
	help
	  A pure Python implementation of the trie data structure.

	  https://pypi.python.org/pypi/PyTrie
```
