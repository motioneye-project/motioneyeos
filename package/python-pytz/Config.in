## package/python-pytz/Config.in
```kconfig
config BR2_PACKAGE_PYTHON_PYTZ
	bool "python-pytz"
	help
	  World timezone definitions, modern and historical.

	  http://pythonhosted.org/pytz
```

## package/python-pyudev/Config.in
```kconfig
config BR2_PACKAGE_PYTHON_PYUDEV
	bool "python-pyudev"
	depends on BR2_PACKAGE_HAS_UDEV
	select BR2_PACKAGE_PYTHON_ZLIB if BR2_PACKAGE_PYTHON # runtime
	select BR2_PACKAGE_PYTHON3_ZLIB if BR2_PACKAGE_PYTHON3 # runtime
	select BR2_PACKAGE_PYTHON_SIX # runtime
	help
	  pyudev is a LGPL licenced, pure Python 2/3 binding to
	  libudev, the device and hardware management and information
	  library of Linux.

	  https://github.com/pyudev/pyudev

comment "python-pyudev needs udev /dev management"
	depends on !BR2_PACKAGE_HAS_UDEV
```

## package/python-pyusb/Config.in
```kconfig
config BR2_PACKAGE_PYTHON_PYUSB
	bool "python-pyusb"
	depends on BR2_PACKAGE_PYTHON
	depends on BR2_TOOLCHAIN_HAS_THREADS # libusb
	select BR2_PACKAGE_LIBUSB
	help
	  The PyUSB module provides easy access to the Universal
	  Serial Bus (USB) from Python.

	  http://sourceforge.net/apps/trac/pyusb/

comment "python-pyusb needs a toolchain w/ threads"
	depends on BR2_PACKAGE_PYTHON
	depends on !BR2_TOOLCHAIN_HAS_THREADS
```

## package/python-pyxb/Config.in
```kconfig
config BR2_PACKAGE_PYTHON_PYXB
	bool "python-pyxb"
	help
	  PyXB is a pure Python package that generates Python code
	  for classes that correspond to data structures defined by XMLSchema.

	  http://pyxb.sourceforge.net/
```

## package/python-pyxml/Config.in
```kconfig
config BR2_PACKAGE_PYTHON_PYXML
	bool "python-pyxml"
	depends on BR2_PACKAGE_PYTHON
	select BR2_PACKAGE_EXPAT
	help
	  This is the Python XML package. The distribution contains a
	  validating XML parser, an implementation of the SAX and DOM
	  programming interfaces, an interface to the Expat parser (and the
	  Expat parser itself), and a C helper module that can speed up
	  xmllib.py by a factor of 5. There's even documentation!

	  http://pyxml.sourceforge.net/topics/index.html
```

## package/python-pyyaml/Config.in
```kconfig
config BR2_PACKAGE_PYTHON_PYYAML
	bool "python-pyyaml"
	select BR2_PACKAGE_LIBYAML
	help
	  The PyYAML package contains binding to the libyaml API.

	  http://pyyaml.org/
```

## package/python-pyzmq/Config.in
```kconfig
config BR2_PACKAGE_PYTHON_PYZMQ
	bool "python-pyzmq"
	depends on BR2_INSTALL_LIBSTDCPP # zeromq
	depends on BR2_TOOLCHAIN_HAS_THREADS_NPTL # zeromq
	select BR2_PACKAGE_ZEROMQ
	help
	  This package contains the python language binding for zeromq.

	  http://zeromq.org/bindings:python

comment "python-pyzmq needs a toolchain w/ C++, NPTL"
	depends on BR2_PACKAGE_PYTHON
	depends on !(BR2_INSTALL_LIBSTDCPP && BR2_TOOLCHAIN_HAS_THREADS_NPTL)
```

## package/python-raven/Config.in
```kconfig
config BR2_PACKAGE_PYTHON_RAVEN
	bool "python-raven"
	select BR2_PACKAGE_PYTHON_ZLIB if BR2_PACKAGE_PYTHON
	select BR2_PACKAGE_PYTHON3_ZLIB if BR2_PACKAGE_PYTHON3
	select BR2_PACKAGE_PYTHON_SSL if BR2_PACKAGE_PYTHON
	select BR2_PACKAGE_PYTHON3_SSL if BR2_PACKAGE_PYTHON3
	select BR2_PACKAGE_PYTHON_UNICODEDATA if BR2_PACKAGE_PYTHON
	select BR2_PACKAGE_PYTHON3_UNICODEDATA if BR2_PACKAGE_PYTHON3
	help
	  Raven is a client for Sentry (https://getsentry.com).

	  https://github.com/getsentry/raven-python
```

## package/python-redis/Config.in
```kconfig
config BR2_PACKAGE_PYTHON_REDIS
	bool "python-redis"
	help
	  Python client for Redis key-value store.

	  https://github.com/andymccurdy/redis-py
```

## package/python-reentry/Config.in
```kconfig
config BR2_PACKAGE_PYTHON_REENTRY
	bool "python-reentry"
	select BR2_PACKAGE_PYTHON_SETUPTOOLS # runtime
	select BR2_PACKAGE_PYTHON_CLICK # runtime
	select BR2_PACKAGE_PYTHON_SIX # runtime
	select BR2_PACKAGE_PYTHON_PY # runtime
	help
	  A plugin manager based on setuptools entry points mechanism.

	  https://pypi.org/project/reentry/
```

## package/python-regex/Config.in
```kconfig
config BR2_PACKAGE_PYTHON_REGEX
	bool "python-regex"
	help
	  Alternative regular expression module, to replace re.

	  https://bitbucket.org/mrabarnett/mrab-regex
```

## package/python-remi/Config.in
```kconfig
config BR2_PACKAGE_PYTHON_REMI
	bool "python-remi"
	help
	  Remi is a GUI library for Python applications which transpiles
	  an application's interface into HTML to be rendered in a web
	  browser. This removes platform-specific dependencies and lets
	  you easily develop cross-platform applications in Python!

	  https://github.com/dddomodossola/remi/tree/master
```

## package/python-request-id/Config.in
```kconfig
config BR2_PACKAGE_PYTHON_REQUEST_ID
	bool "python-request-id"
	select BR2_PACKAGE_PYTHON_WEBOB # runtime
	help
	  Attach a unique identifier to every WSGI request.

	  https://github.com/mmerickel/request_id
```

## package/python-requests-oauthlib/Config.in
```kconfig
config BR2_PACKAGE_PYTHON_REQUESTS_OAUTHLIB
	bool "python-requests-oauthlib"
	select BR2_PACKAGE_PYTHON_OAUTHLIB # runtime
	select BR2_PACKAGE_PYTHON_REQUESTS # runtime
	help
	  OAuthlib authentication support for Requests.

	  https://github.com/requests/requests-oauthlib
```

## package/python-requests/Config.in
```kconfig
config BR2_PACKAGE_PYTHON_REQUESTS
	bool "python-requests"
	select BR2_PACKAGE_PYTHON_CERTIFI # runtime
	select BR2_PACKAGE_PYTHON_CHARDET # runtime
	select BR2_PACKAGE_PYTHON_IDNA # runtime
	select BR2_PACKAGE_PYTHON_URLLIB3 # runtime
	select BR2_PACKAGE_PYTHON_HASHLIB if BR2_PACKAGE_PYTHON # runtime
	select BR2_PACKAGE_PYTHON_SSL if BR2_PACKAGE_PYTHON # runtime
	select BR2_PACKAGE_PYTHON3_SSL if BR2_PACKAGE_PYTHON3 # runtime
	select BR2_PACKAGE_PYTHON_ZLIB if BR2_PACKAGE_PYTHON # runtime
	select BR2_PACKAGE_PYTHON3_ZLIB if BR2_PACKAGE_PYTHON3 # runtime
	help
	  Requests is an Apache2 Licensed HTTP library, written in
	  Python, for human beings.

	  http://www.python-requests.org/
```

## package/python-rpi-ws281x/Config.in
```kconfig
config BR2_PACKAGE_PYTHON_RPI_WS281X
	bool "python-rpi-ws281x"
	help
	  Userspace Raspberry Pi PWM/PCM/SPI library for SK6812 and
	  WS281X LEDs.

	  https://github.com/rpi-ws281x/rpi-ws281x-python/
```

## package/python-rq/Config.in
```kconfig
config BR2_PACKAGE_PYTHON_RQ
	bool "python-rq"
	depends on BR2_PACKAGE_PYTHON || BR2_PACKAGE_PYTHON3
	help
	  Simple job queues for Python.

	  https://python-rq.org/
```

## package/python-rtslib-fb/Config.in
```kconfig
config BR2_PACKAGE_PYTHON_RTSLIB_FB
	bool "python-rtslib-fb"
	help
	  rtslib-fb is an object-based Python library for configuring
	  the LIO generic SCSI target, present in 3.x Linux kernel
	  versions.

	  https://github.com/agrover/rtslib-fb
```

## package/python-scandir/Config.in
```kconfig
config BR2_PACKAGE_PYTHON_SCANDIR
	bool "python-scandir"
	help
	  scandir, a better directory iterator and faster os.walk()

	  https://pypi.python.org/pypi/scandir
```

## package/python-scapy/Config.in
```kconfig
config BR2_PACKAGE_PYTHON_SCAPY
	bool "python-scapy"
	select BR2_PACKAGE_PYTHON_ZLIB if BR2_PACKAGE_PYTHON
	select BR2_PACKAGE_PYTHON3_ZLIB if BR2_PACKAGE_PYTHON3
	help
	  Scapy: interactive packet manipulation tool.

	  http://www.secdev.org/projects/scapy
```

## package/python-scapy3k/Config.in
```kconfig
config BR2_PACKAGE_PYTHON_SCAPY3K
	bool "python-scapy3k"
	depends on BR2_PACKAGE_PYTHON3
	select BR2_PACKAGE_PYTHON3_ZLIB
	help
	  Network packet and pcap file crafting/sniffing/manipulation
	  security tool (based on scapy) with python3 compatibility.

	  https://github.com/phaethon/scapy
```

## package/python-schedule/Config.in
```kconfig
config BR2_PACKAGE_PYTHON_SCHEDULE
	bool "python-schedule"
	help
	  Job scheduling for humans.

	  https://github.com/dbader/schedule
```

## package/python-sdnotify/Config.in
```kconfig
config BR2_PACKAGE_PYTHON_SDNOTIFY
	bool "python-sdnotify"
	help
	  A pure Python implementation of systemd's service notification
	  protocol (sd_notify).

	  https://github.com/bb4242/sdnotify
```

## package/python-secretstorage/Config.in
```kconfig
config BR2_PACKAGE_PYTHON_SECRETSTORAGE
	bool "python-secretstorage"
	depends on BR2_PACKAGE_PYTHON3
	depends on BR2_INSTALL_LIBSTDCPP # python-cryptography
	select BR2_PACKAGE_PYTHON_CRYPTOGRAPHY # runtime
	help
	  Python bindings to FreeDesktop.org Secret Service API.

	  https://github.com/mitya57/secretstorage

comment "python-secretstorage needs a toolchain w/ C++"
	depends on !BR2_INSTALL_LIBSTDCPP
```
