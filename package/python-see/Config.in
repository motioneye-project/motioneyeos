## package/python-see/Config.in
```kconfig
config BR2_PACKAGE_PYTHON_SEE
	bool "python-see"
	help
	  dir for humans.

	  https://ljcooke.github.io/see/
```

## package/python-semver/Config.in
```kconfig
config BR2_PACKAGE_PYTHON_SEMVER
	bool "python-semver"
	help
	  Python helper for Semantic Versioning (http://semver.org/).

	  https://github.com/k-bx/python-semver
```

## package/python-sentry-sdk/Config.in
```kconfig
config BR2_PACKAGE_PYTHON_SENTRY_SDK
	bool "python-sentry-sdk"
	select BR2_PACKAGE_PYTHON_URLLIB3 # runtime
	select BR2_PACKAGE_PYTHON_CERTIFI # runtime
	help
	  Python client for Sentry (https://getsentry.com).

	  https://github.com/getsentry/sentry-python
```

## package/python-serial-asyncio/Config.in
```kconfig
config BR2_PACKAGE_PYTHON_SERIAL_ASYNCIO
	bool "python-serial-asyncio"
	depends on BR2_PACKAGE_PYTHON3
	select BR2_PACKAGE_PYTHON_SERIAL
	help
	  asyncio extension package for pyserial.

	  https://github.com/pyserial/pyserial-asyncio
```

## package/python-serial/Config.in
```kconfig
config BR2_PACKAGE_PYTHON_SERIAL
	bool "python-serial"
	help
	  python-serial is a Python library to access serial ports.

	  https://github.com/pyserial/pyserial
```

## package/python-service-identity/Config.in
```kconfig
config BR2_PACKAGE_PYTHON_SERVICE_IDENTITY
	bool "python-service-identity"
	depends on BR2_INSTALL_LIBSTDCPP # python-pyopenssl
	select BR2_PACKAGE_PYTHON_ATTRS # runtime
	select BR2_PACKAGE_PYTHON_CHARACTERISTIC # runtime
	select BR2_PACKAGE_PYTHON_IPADDRESS if BR2_PACKAGE_PYTHON # runtime
	select BR2_PACKAGE_PYTHON_PYASN1 # runtime
	select BR2_PACKAGE_PYTHON_PYASN1_MODULES # runtime
	select BR2_PACKAGE_PYTHON_PYOPENSSL # runtime
	help
	  Service identity verification for pyOpenSSL.

	  https://pypi.python.org/pypi/service_identity

comment "python-service-identify needs a toolchain w/ C++"
	depends on !BR2_INSTALL_LIBSTDCPP
```

## package/python-setproctitle/Config.in
```kconfig
config BR2_PACKAGE_PYTHON_SETPROCTITLE
	bool "python-setproctitle"
	help
	  A Python module to customize the process title.

	  https://pypi.python.org/pypi/setproctitle
```

## package/python-setupnovernormalize/Config.in.host
```kconfig
config BR2_PACKAGE_HOST_PYTHON_SETUPNOVERNORMALIZE
	bool "host python-setupnovernormalize"
	help
	  Prevent version normalization when packaging Python projects with setuptools. For more details, see https://github.com/pypa/setuptools/issues/308.

	  https://github.com/ccrisan/setup-no-ver-normalize
```

## package/python-setuptools/Config.in
```kconfig
config BR2_PACKAGE_PYTHON_SETUPTOOLS
	bool "python-setuptools"
	depends on BR2_PACKAGE_PYTHON
	select BR2_PACKAGE_PYTHON_ZLIB
	help
	  Download, build, install, upgrade, and uninstall Python packages.

	  http://pypi.python.org/pypi/setuptools
```

## package/python-sh/Config.in
```kconfig
config BR2_PACKAGE_PYTHON_SH
	bool "python-sh"
	help
	  Python subprocess replacement that allows you to call any
	  program as if it were a function.

	  https://github.com/amoffat/sh
```

## package/python-shutilwhich/Config.in
```kconfig
config BR2_PACKAGE_PYTHON_SHUTILWHICH
	bool "python-shutilwhich"
	help
	  shutil.which for those not using Python 3.3 yet.

	  https://pypi.python.org/pypi/shutilwhich/
```

## package/python-simpleaudio/Config.in
```kconfig
config BR2_PACKAGE_PYTHON_SIMPLEAUDIO
	bool "python-simpleaudio"
	depends on BR2_PACKAGE_PYTHON3
	depends on BR2_TOOLCHAIN_HAS_THREADS # alsa-lib
	select BR2_PACKAGE_ALSA_LIB
	help
	  The simplaudio package provides cross-platform,
	  dependency-free audio playback capability for Python 3 on
	  OSX, Windows, and Linux.

	  https://github.com/hamiltron/py-simple-audio

comment "python-simpleaudio needs a toolchain w/ threads"
	depends on !BR2_TOOLCHAIN_HAS_THREADS
```

## package/python-simplegeneric/Config.in
```kconfig
config BR2_PACKAGE_PYTHON_SIMPLEGENERIC
	bool "python-simplegeneric"
	help
	  Simple generic functions (similar to Python's own len(),
	  pickle.dump(), etc.)

	  https://pypi.python.org/pypi/simplegeneric
```

## package/python-simplejson/Config.in
```kconfig
config BR2_PACKAGE_PYTHON_SIMPLEJSON
	bool "python-simplejson"
	help
	  Simple, fast, extensible JSON encoder/decoder for Python.

	  https://pypi.python.org/pypi/simplejson/
```

## package/python-simplelogging/Config.in
```kconfig
config BR2_PACKAGE_PYTHON_SIMPLELOGGING
	bool "python-simplelogging"
	select BR2_PACKAGE_PYTHON_COLORLOG # runtime
	help
	  Logging made simple, no excuse for any debug print call.

	  https://github.com/vpoulailleau/simplelogging
```

## package/python-simplesqlite/Config.in
```kconfig
config BR2_PACKAGE_PYTHON_SIMPLESQLITE
	bool "python-simplesqlite"
	depends on BR2_PACKAGE_PYTHON3 # python-mbstrdecoder
	select BR2_PACKAGE_PYTHON_DATAPROPERTY # runtime
	select BR2_PACKAGE_PYTHON_MBSTRDECODER # runtime
	select BR2_PACKAGE_PYTHON_PATHVALIDATE # runtime
	select BR2_PACKAGE_PYTHON_SETUPTOOLS # runtime
	select BR2_PACKAGE_PYTHON_SIX # runtime
	select BR2_PACKAGE_PYTHON3_SQLITE # runtime
	select BR2_PACKAGE_PYTHON_SQLITESCHEMA # runtime
	select BR2_PACKAGE_PYTHON_TABLEDATA # runtime
	select BR2_PACKAGE_PYTHON_TYPEPY # runtime
	help
	  SimpleSQLite is a Python library to simplify SQLite database
	  operations: table creation, data insertion and get data as
	  other data formats.

	  https://github.com/thombashi/SimpleSQLite
```

## package/python-sip/Config.in
```kconfig
comment "python-sip needs a toolchain w/ C++, threads"
	depends on BR2_USE_MMU
	depends on !BR2_INSTALL_LIBSTDCPP || !BR2_TOOLCHAIN_HAS_THREADS

comment "python-sip needs qt or qt5"
	depends on BR2_USE_MMU
	depends on BR2_INSTALL_LIBSTDCPP && BR2_TOOLCHAIN_HAS_THREADS
	depends on !BR2_PACKAGE_QT && !BR2_PACKAGE_QT5

config BR2_PACKAGE_PYTHON_SIP
	bool "python-sip"
	depends on BR2_INSTALL_LIBSTDCPP # qt
	depends on BR2_TOOLCHAIN_HAS_THREADS # qt
	depends on BR2_USE_MMU # qt
	depends on BR2_PACKAGE_QT || BR2_PACKAGE_QT5
	help
	  SIP is a tool that makes it very easy to create Python
	  bindings for C and C++ libraries. It was originally
	  developed to create PyQt, the Python bindings for the Qt
	  toolkit, but can be used to create bindings for any C or C++
	  library.

	  SIP comprises a code generator and a Python module. The code
	  generator processes a set of specification files and
	  generates C or C++ code which is then compiled to create the
	  bindings extension module. The SIP Python module provides
	  support functions to the automatically generated code.

	  http://www.riverbankcomputing.com/software/sip/intro
```

## package/python-six/Config.in
```kconfig
config BR2_PACKAGE_PYTHON_SIX
	bool "python-six"
	help
	  Six is a Python 2 and 3 compatibility library. It provides
	  utility functions for smoothing over the differences between
	  the Python versions with the goal of writing Python code that
	  is compatible on both Python versions.

	  http://pythonhosted.org/six
```

## package/python-slob/Config.in
```kconfig
config BR2_PACKAGE_PYTHON_SLOB
	bool "python-slob"
	depends on !BR2_BINFMT_FLAT # python-pyicu -> icu
	depends on BR2_INSTALL_LIBSTDCPP # python-pyicu -> icu
	depends on BR2_HOST_GCC_AT_LEAST_4_8 # python-pyicu -> icu
	depends on BR2_TOOLCHAIN_GCC_AT_LEAST_4_8 # python-pyicu -> icu
	depends on BR2_PACKAGE_PYTHON3
	select BR2_PACKAGE_PYTHON_PYICU # runtime
	# although optional, it is used as default compression
	select BR2_PACKAGE_PYTHON3_XZ # runtime
	help
	  slob.py is a reference implementation of slob format reader
	  and writer.

	  https://github.com/itkach/slob

comment "python-slob needs a toolchain w/ C++, gcc >= 4.8, host gcc >= 4.8"
	depends on BR2_PACKAGE_PYTHON3 && !BR2_BINFMT_FLAT
	depends on !BR2_INSTALL_LIBSTDCPP || \
		!BR2_HOST_GCC_AT_LEAST_4_8 || \
		!BR2_TOOLCHAIN_GCC_AT_LEAST_4_8
```

## package/python-smbus-cffi/Config.in
```kconfig
config BR2_PACKAGE_PYTHON_SMBUS_CFFI
	bool "python-smbus-cffi"
	select BR2_PACKAGE_PYTHON_CFFI
	help
	  This Python module allows SMBus access through the I2C /dev
	  interface on Linux hosts. The host kernel must have I2C
	  support, I2C device interface support, and a bus adapter
	  driver.

	  https://github.com/bivab/smbus-cffi
```

## package/python-smmap2/Config.in
```kconfig
config BR2_PACKAGE_PYTHON_SMMAP2
	bool "python-smmap2"
	help
	  Smmap wraps an interface around mmap and tracks the mapped
	  files as well as the amount of clients who use it. If the
	  system runs out of resources, or if a memory limit is reached,
	  it will automatically unload unused maps to allow continued
	  operation.

	  https://github.com/gitpython-developers/smmap
```

## package/python-snappy/Config.in
```kconfig
config BR2_PACKAGE_PYTHON_SNAPPY
	bool "python-snappy"
	depends on BR2_INSTALL_LIBSTDCPP # snappy
	select BR2_PACKAGE_SNAPPY
	help
	  Python library for the snappy compression library from
	  Google.

	  http://github.com/andrix/python-snappy

comment "python-snappy needs a toolchain w/ C++"
	depends on !BR2_INSTALL_LIBSTDCPP
```

## package/python-socketio/Config.in
```kconfig
config BR2_PACKAGE_PYTHON_SOCKETIO
	bool "python-socketio"
	select BR2_PACKAGE_PYTHON_SIX # runtime
	select BR2_PACKAGE_PYTHON_ENGINEIO # runtime
	help
	  Socket.IO server.

	  http://github.com/miguelgrinberg/python-socketio/
```

## package/python-sockjs/Config.in
```kconfig
config BR2_PACKAGE_PYTHON_SOCKJS
	bool "python-sockjs"
	depends on BR2_PACKAGE_PYTHON3
	select BR2_PACKAGE_PYTHON_AIOHTTP # runtime
	help
	  SockJS server implementation for aiohttp.

	  https://github.com/aio-libs/sockjs/
```

## package/python-sortedcontainers/Config.in
```kconfig
config BR2_PACKAGE_PYTHON_SORTEDCONTAINERS
	bool "python-sortedcontainers"
	help
	  Python Sorted Container Types: SortedList, SortedDict, and
	  SortedSet.

	  http://www.grantjenks.com/docs/sortedcontainers/
```
