## package/python-soupsieve/Config.in
```kconfig
config BR2_PACKAGE_PYTHON_SOUPSIEVE
	bool "python-soupsieve"
	select BR2_PACKAGE_PYTHON_BACKPORTS_FUNCTOOLS_LRU_CACHE \
	       if BR2_PACKAGE_PYTHON # runtime
	help
	  A modern CSS selector implementation for Beautiful Soup.

	  https://github.com/facelessuser/soupsieve
```

## package/python-spidev/Config.in
```kconfig
config BR2_PACKAGE_PYTHON_SPIDEV
	bool "python-spidev"
	help
	  Python module for interfacing with SPI devices from user
	  space via the spidev linux kernel driver.

	  https://pypi.python.org/pypi/spidev
```

## package/python-sqlalchemy/Config.in
```kconfig
config BR2_PACKAGE_PYTHON_SQLALCHEMY
	bool "python-sqlalchemy"
	help
	  SQLAlchemy is the Python SQL toolkit and Object Relational
	  Mapper that gives application developers the full power and
	  flexibility of SQL.

	  It provides a full suite of well known enterprise-level
	  persistence patterns, designed for efficient and
	  high-performing database access, adapted into a simple and
	  Pythonic domain language.

	  http://www.sqlalchemy.org
```

## package/python-sqliteschema/Config.in
```kconfig
config BR2_PACKAGE_PYTHON_SQLITESCHEMA
	bool "python-sqliteschema"
	depends on BR2_PACKAGE_PYTHON3 # python-mbstrdecoder
	select BR2_PACKAGE_PYTHON_SETUPTOOLS # runtime
	select BR2_PACKAGE_PYTHON_MBSTRDECODER # runtime
	select BR2_PACKAGE_PYTHON_SIX # runtime
	select BR2_PACKAGE_PYTHON_TABLEDATA # runtime
	select BR2_PACKAGE_PYTHON_TYPEPY # runtime
	help
	  A Python library to dump table schema of a SQLite database
	  file.

	  https://github.com/thombashi/sqliteschema
```

## package/python-sqlparse/Config.in
```kconfig
config BR2_PACKAGE_PYTHON_SQLPARSE
	bool "python-sqlparse"
	help
	  sqlparse is a non-validating SQL parser for Python.
	  It provides support for parsing, splitting and formatting
	  SQL statements.

	  https://github.com/andialbrecht/sqlparse
```

## package/python-subprocess32/Config.in
```kconfig
config BR2_PACKAGE_PYTHON_SUBPROCESS32
	bool "python-subprocess32"
	depends on BR2_PACKAGE_PYTHON
	depends on BR2_TOOLCHAIN_HEADERS_AT_LEAST_3_10 || !BR2_MIPS_NABI64
	help
	  A backport of the Python 3 subprocess module for use
	  on Python 2.

	  https://github.com/google/python-subprocess32

comment "python-subprocess32 needs a toolchain w/ headers >= 3.10 on MIPS N64"
	depends on BR2_MIPS_NABI64
	depends on !BR2_TOOLCHAIN_HEADERS_AT_LEAST_3_10
```

## package/python-systemd/Config.in
```kconfig
config BR2_PACKAGE_PYTHON_SYSTEMD
	bool "python-systemd"
	depends on BR2_PACKAGE_SYSTEMD
	help
	  Python module for native access to the systemd facilities.

	  https://github.com/systemd/python-systemd

comment "python-systemd needs systemd"
	depends on !BR2_PACKAGE_SYSTEMD
```

## package/python-tabledata/Config.in
```kconfig
config BR2_PACKAGE_PYTHON_TABLEDATA
	bool "python-tabledata"
	depends on BR2_PACKAGE_PYTHON3 # python-dataproperty, python-typepy
	select BR2_PACKAGE_PYTHON_DATAPROPERTY # runtime
	select BR2_PACKAGE_PYTHON_SETUPTOOLS # runtime
	select BR2_PACKAGE_PYTHON_SIX # runtime
	select BR2_PACKAGE_PYTHON_TYPEPY # runtime
	help
	  A Python library to represent tabular data for
	  pytablewriter/pytablereader/SimpleSQLite.

	  https://github.com/thombashi/tabledata
```

## package/python-tempora/Config.in
```kconfig
config BR2_PACKAGE_PYTHON_TEMPORA
	bool "python-tempora"
	depends on BR2_PACKAGE_PYTHON3 # python-jaraco-functools
	select BR2_PACKAGE_PYTHON_JARACO_FUNCTOOLS # runtime
	select BR2_PACKAGE_PYTHON_SIX # runtime
	select BR2_PACKAGE_PYTHON_PYTZ # runtime
	help
	  Objects and routines pertaining to date and time.

	  https://github.com/jaraco/tempora
```

## package/python-termcolor/Config.in
```kconfig
config BR2_PACKAGE_PYTHON_TERMCOLOR
	bool "python-termcolor"
	help
	  ANSII Color formatting for output in terminal.

	  http://pypi.python.org/pypi/termcolor
```

## package/python-terminaltables/Config.in
```kconfig
config BR2_PACKAGE_PYTHON_TERMINALTABLES
	bool "python-terminaltables"
	help
	  Generate simple tables in terminals from a nested list of
	  strings.

	  https://github.com/Robpol86/terminaltables
```

## package/python-texttable/Config.in
```kconfig
config BR2_PACKAGE_PYTHON_TEXTTABLE
	bool "python-texttable"
	help
	  module for creating simple ASCII tables.

	  https://github.com/foutaise/texttable/
```

## package/python-thrift/Config.in
```kconfig
config BR2_PACKAGE_PYTHON_THRIFT
	bool "python-thrift"
	select BR2_PACKAGE_PYTHON_SIX # runtime
	help
	  python-thrift is a Python bindings for the Apache Thrift RPC
	  system.

	  http://thrift.apache.org/
```

## package/python-tinyrpc/Config.in
```kconfig
config BR2_PACKAGE_PYTHON_TINYRPC
	bool "python-tinyrpc"
	select BR2_PACKAGE_PYTHON_SIX # runtime
	help
	  A small, modular, transport and protocol neutral RPC
	  library that, among other things, supports JSON-RPC and
	  zmq.

	  http://github.com/mbr/tinyrpc
```

## package/python-tomako/Config.in
```kconfig
config BR2_PACKAGE_PYTHON_TOMAKO
	bool "python-tomako"
	depends on BR2_PACKAGE_PYTHON3 # python-tornado
	select BR2_PACKAGE_PYTHON_TORNADO # runtime
	select BR2_PACKAGE_PYTHON_MAKO # runtime
	help
	  Tomako is the easiest way to use Mako as a template engine for
	  Tornado.

	  https://github.com/rcmachado/tomako
```

## package/python-tornado/Config.in
```kconfig
config BR2_PACKAGE_PYTHON_TORNADO
	bool "python-tornado"
	depends on BR2_PACKAGE_PYTHON3
	select BR2_PACKAGE_PYTHON3_ZLIB
	select BR2_PACKAGE_PYTHON3_SSL
	help
	  Tornado is a Python web framework and asynchronous networking
	  library, originally developed at FriendFeed.

	  http://www.tornadoweb.org
```

## package/python-tqdm/Config.in
```kconfig
config BR2_PACKAGE_PYTHON_TQDM
	bool "python-tqdm"
	help
	  A Fast, Extensible Progress Bar for Python and CLI.

	  https://tqdm.github.io
```

## package/python-traitlets/Config.in
```kconfig
config BR2_PACKAGE_PYTHON_TRAITLETS
	bool "python-traitlets"
	select BR2_PACKAGE_PYTHON_ENUM34 if BR2_PACKAGE_PYTHON # runtime
	select BR2_PACKAGE_PYTHON_SIX  # runtime
	select BR2_PACKAGE_PYTHON_IPYTHON_GENUTILS  # runtime
	select BR2_PACKAGE_PYTHON_DECORATOR  # runtime
	help
	  A configuration system for Python applications.

	  https://pypi.python.org/pypi/traitlets
```

## package/python-treq/Config.in
```kconfig
config BR2_PACKAGE_PYTHON_TREQ
	bool "python-treq"
	depends on BR2_INSTALL_LIBSTDCPP # python-pyopenssl
	select BR2_PACKAGE_PYTHON_ATTRS # runtime
	select BR2_PACKAGE_PYTHON_IDNA # runtime
	select BR2_PACKAGE_PYTHON_PYOPENSSL # runtime
	select BR2_PACKAGE_PYTHON_REQUESTS # runtime
	select BR2_PACKAGE_PYTHON_SERVICE_IDENTITY # runtime
	select BR2_PACKAGE_PYTHON_SIX # runtime
	select BR2_PACKAGE_PYTHON_TWISTED # runtime
	help
	  treq is an HTTP library inspired by requests but written on
	  top of Twisted's Agents. It provides a simple, higher level
	  API for making HTTP requests when using Twisted.

	  https://github.com/twisted/treq

comment "python-treq needs a toolchain w/ C++"
	depends on !BR2_INSTALL_LIBSTDCPP
```

## package/python-twisted/Config.in
```kconfig
config BR2_PACKAGE_PYTHON_TWISTED
	bool "python-twisted"
	select BR2_PACKAGE_PYTHON_INCREMENTAL
	select BR2_PACKAGE_PYTHON_ATTRS # runtime
	select BR2_PACKAGE_PYTHON_AUTOMAT # runtime
	select BR2_PACKAGE_PYTHON_CONSTANTLY # runtime
	select BR2_PACKAGE_PYTHON_HYPERLINK # runtime
	select BR2_PACKAGE_PYTHON_PYHAMCREST # runtime
	select BR2_PACKAGE_PYTHON_ZOPE_INTERFACE # runtime
	help
	  Twisted is an event-driven networking engine written in
	  Python.

	  https://twistedmatrix.com/trac/

if BR2_PACKAGE_PYTHON_TWISTED

config BR2_PACKAGE_PYTHON_TWISTED_HTTP2
	bool "HTTP2 support"
	select BR2_PACKAGE_PYTHON_H2 # runtime
	select BR2_PACKAGE_PYTHON_PRIORITY # runtime

config BR2_PACKAGE_PYTHON_TWISTED_TLS
	bool "TLS support"
	depends on BR2_INSTALL_LIBSTDCPP # python-{pyopenssl,service-identity}
	select BR2_PACKAGE_PYTHON_IDNA # runtime
	select BR2_PACKAGE_PYTHON_PYOPENSSL # runtime
	select BR2_PACKAGE_PYTHON_SERVICE_IDENTITY # runtime

comment "TLS support needs a toolchain w/ C++"
	depends on !BR2_INSTALL_LIBSTDCPP

endif
```

## package/python-txaio/Config.in
```kconfig
config BR2_PACKAGE_PYTHON_TXAIO
	bool "python-txaio"
	depends on BR2_PACKAGE_PYTHON3
	help
	  Compatibility API between asyncio/Twisted/Trollius.

	  https://pypi.python.org/pypi/txaio
```

## package/python-txdbus/Config.in
```kconfig
config BR2_PACKAGE_PYTHON_TXDBUS
	bool "python-txdbus"
	select BR2_PACKAGE_PYTHON_TWISTED # runtime
	select BR2_PACKAGE_PYTHON_SIX # runtime
	help
	  A native Python implementation of the DBus protocol for
	  Twisted applications.

	  https://github.com/cocagne/txdbus
```

## package/python-txtorcon/Config.in
```kconfig
config BR2_PACKAGE_PYTHON_TXTORCON
	bool "python-txtorcon"
	depends on BR2_INSTALL_LIBSTDCPP # python-pyopenssl, python-service-identity
	select BR2_PACKAGE_PYTHON_AUTOMAT # runtime
	select BR2_PACKAGE_PYTHON_IDNA # runtime
	select BR2_PACKAGE_PYTHON_INCREMENTAL # runtime
	select BR2_PACKAGE_PYTHON_IPADDRESS if BR2_PACKAGE_PYTHON # runtime
	select BR2_PACKAGE_PYTHON_PYOPENSSL # runtime
	select BR2_PACKAGE_PYTHON_SERVICE_IDENTITY # runtime
	select BR2_PACKAGE_PYTHON_TWISTED # runtime
	select BR2_PACKAGE_PYTHON_ZOPE_INTERFACE # runtime
	help
	  Twisted-based Tor controller client, with state-tracking and
	  configuration abstractions.

	  https://github.com/meejah/txtorcon

comment "python-txtorcon needs a toolchain w/ C++"
	depends on !BR2_INSTALL_LIBSTDCPP
```

## package/python-typepy/Config.in
```kconfig
config BR2_PACKAGE_PYTHON_TYPEPY
	bool "python-typepy"
	depends on BR2_PACKAGE_PYTHON3 # python-mbstrdecoder
	select BR2_PACKAGE_PYTHON_DATEUTIL # runtime
	select BR2_PACKAGE_PYTHON_MBSTRDECODER # runtime
	select BR2_PACKAGE_PYTHON_PYTZ # runtime
	select BR2_PACKAGE_PYTHON_SIX # runtime
	help
	  A Python library for variable type
	  checker/validator/converter at a run time.

	  https://github.com/thombashi/typepy
```

## package/python-typing-extensions/Config.in
```kconfig
config BR2_PACKAGE_PYTHON_TYPING_EXTENSIONS
	bool "python-typing-extensions"
	depends on BR2_PACKAGE_PYTHON || BR2_PACKAGE_PYTHON3
	help
	  Typing Extensions – Backported and Experimental Type Hints for Python

	  https://github.com/python/typing/
```
