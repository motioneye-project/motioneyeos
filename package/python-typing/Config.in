## package/python-typing/Config.in
```kconfig
config BR2_PACKAGE_PYTHON_TYPING
	bool "python-typing"
	depends on BR2_PACKAGE_PYTHON
	help
	  Type Hints for Python. This is a backport of the standard
	  library typing module to Python versions older than 3.5.

	  https://docs.python.org/3/library/typing.html
```

## package/python-u-msgpack/Config.in
```kconfig
config BR2_PACKAGE_PYTHON_U_MSGPACK
	bool "python-u-msgpack"
	help
	  A portable, lightweight MessagePack serializer and
	  deserializer written in pure Python.

	  https://github.com/vsergeev/u-msgpack-python
```

## package/python-ubjson/Config.in
```kconfig
config BR2_PACKAGE_PYTHON_UBJSON
	bool "python-ubjson"
	help
	  This is a Python v3.2+ (and 2.7+) Universal Binary JSON
	  encoder/decoder based on the draft-12 specification.

	  https://pypi.python.org/pypi/py-ubjson
```

## package/python-urllib3/Config.in
```kconfig
config BR2_PACKAGE_PYTHON_URLLIB3
	bool "python-urllib3"
	select BR2_PACKAGE_PYTHON_ZLIB if BR2_PACKAGE_PYTHON # runtime
	select BR2_PACKAGE_PYTHON3_ZLIB if BR2_PACKAGE_PYTHON3 # runtime
	help
	  Python HTTP library with thread-safe connection pooling, file
	  post support, sanity friendly, and more.

	  http://urllib3.readthedocs.org/
```

## package/python-urwid/Config.in
```kconfig
config BR2_PACKAGE_PYTHON_URWID
	bool "python-urwid"
	help
	  Urwid is a console user interface library for Python

	  http://urwid.org/
```

## package/python-uvloop/Config.in
```kconfig
config BR2_PACKAGE_PYTHON_UVLOOP
	bool "python-uvloop"
	depends on BR2_PACKAGE_PYTHON3
	depends on BR2_TOOLCHAIN_HAS_SYNC_4 # libuv
	depends on BR2_USE_MMU # libuv
	depends on !BR2_STATIC_LIBS # libuv
	depends on BR2_TOOLCHAIN_HAS_THREADS_NPTL # libuv
	select BR2_PACKAGE_LIBUV
	select BR2_PACKAGE_PYTHON3_SSL
	help
	  Fast implementation of asyncio event loop on top of libuv.

	  http://github.com/MagicStack/uvloop

comment "python-uvloop needs a toolchain w/ NPTL, dynamic library"
	depends on !BR2_TOOLCHAIN_HAS_THREADS_NPTL || BR2_STATIC_LIBS
	depends on BR2_TOOLCHAIN_HAS_SYNC_4
	depends on BR2_USE_MMU
```

## package/python-validators/Config.in
```kconfig
config BR2_PACKAGE_PYTHON_VALIDATORS
	bool "python-validators"
	select BR2_PACKAGE_PYTHON_SIX # runtime
	select BR2_PACKAGE_PYTHON_DECORATOR # runtime
	help
	  Python Data Validation for Humans.

	  https://github.com/kvesteri/validators
```

## package/python-versiontools/Config.in
```kconfig
config BR2_PACKAGE_PYTHON_VERSIONTOOLS
	bool "python-versiontools"
	help
	  Smart replacement for plain tuple used in __version__.

	  https://pypi.python.org/pypi/versiontools
```

## package/python-visitor/Config.in
```kconfig
config BR2_PACKAGE_PYTHON_VISITOR
	bool "python-visitor"
	help
	  A tiny pythonic visitor implementation.

	  http://github.com/mbr/visitor
```

## package/python-watchdog/Config.in
```kconfig
config BR2_PACKAGE_PYTHON_WATCHDOG
	bool "python-watchdog"
	select BR2_PACKAGE_PYTHON_ARGH # runtime
	select BR2_PACKAGE_PYTHON_PATHTOOLS # runtime
	select BR2_PACKAGE_PYTHON_PYYAML # runtime
	select BR2_PACKAGE_PYTHON_SETUPTOOLS # runtime
	help
	  Python API and shell utilities to monitor file system events.

	  http://github.com/gorakhargosh/watchdog
```

## package/python-web2py/Config.in
```kconfig
config BR2_PACKAGE_PYTHON_WEB2PY
	bool "python-web2py"
	select BR2_PACKAGE_PYTHON_PYDAL
	select BR2_PACKAGE_PYTHON_ZLIB if BR2_PACKAGE_PYTHON # runtime
	select BR2_PACKAGE_PYTHON3_ZLIB if BR2_PACKAGE_PYTHON3 # runtime
	select BR2_PACKAGE_PYTHON_PYEXPAT if BR2_PACKAGE_PYTHON # runtime
	select BR2_PACKAGE_PYTHON3_PYEXPAT if BR2_PACKAGE_PYTHON3 # runtime
	select BR2_PACKAGE_PYTHON_SQLITE if BR2_PACKAGE_PYTHON # runtime
	select BR2_PACKAGE_PYTHON3_SQLITE if BR2_PACKAGE_PYTHON3 # runtime
	help
	  web2py is a free open source full-stack framework for rapid
	  development of fast, scalable, secure and portable
	  database-driven web-based applications.

	  http://web2py.com

if BR2_PACKAGE_PYTHON_WEB2PY

config BR2_PACKAGE_PYTHON_WEB2PY_INSTALL_ADMIN
	bool "install admin panel application"
	default y
	help
	  This option install web2py admin panel application.
	  It can be removed to save space on embedded systems.

if BR2_PACKAGE_PYTHON_WEB2PY_INSTALL_ADMIN

config BR2_PACKAGE_PYTHON_WEB2PY_PASSWORD
	string "admin panel password"
	default web2py
	help
	  Set the admin panel password.

endif

endif
```

## package/python-webargs/Config.in
```kconfig
config BR2_PACKAGE_PYTHON_WEBARGS
	bool "python-webargs"
	depends on BR2_PACKAGE_PYTHON || BR2_PACKAGE_PYTHON3
	help
	  webargs is a Python library for parsing and validating HTTP request objects, with built-in support for popular web frameworks, including Flask, Django, Bottle, Tornado, Pyramid, webapp2, Falcon, and aiohttp.

	  https://github.com/marshmallow-code/webargs
```

## package/python-webencodings/Config.in
```kconfig
config BR2_PACKAGE_PYTHON_WEBENCODINGS
	bool "python-webencodings"
	help
	  Character encoding aliases for legacy web content.

	  https://github.com/SimonSapin/python-webencodings
```

## package/python-webob/Config.in
```kconfig
config BR2_PACKAGE_PYTHON_WEBOB
	bool "python-webob"
	select BR2_PACKAGE_PYTHON_HASHLIB if BR2_PACKAGE_PYTHON # runtime
	select BR2_PACKAGE_PYTHON_ZLIB if BR2_PACKAGE_PYTHON # runtime
	select BR2_PACKAGE_PYTHON3_ZLIB if BR2_PACKAGE_PYTHON3 # runtime
	help
	  WSGI request and response object.

	  http://webob.org/
```

## package/python-webpy/Config.in
```kconfig
config BR2_PACKAGE_PYTHON_WEBPY
	bool "python-webpy"
	depends on BR2_PACKAGE_PYTHON3 # python-cheroot
	select BR2_PACKAGE_PYTHON_CHEROOT # runtime
	select BR2_PACKAGE_PYTHON_MARKDOWN # runtime
	help
	  web.py is a web framework for Python that is as simple as it
	  is powerful.

	  http://webpy.org/
```

## package/python-websocket-client/Config.in
```kconfig
config BR2_PACKAGE_PYTHON_WEBSOCKET_CLIENT
	bool "python-websocket-client"
	select BR2_PACKAGE_PYTHON_SIX # runtime
	select BR2_PACKAGE_PYTHON_SSL if BR2_PACKAGE_PYTHON # runtime
	select BR2_PACKAGE_PYTHON3_SSL if BR2_PACKAGE_PYTHON3 # runtime
	help
	  WebSocket client for python. hybi13 is supported.

	  https://github.com/websocket-client/websocket-client.git
```

## package/python-websockets/Config.in
```kconfig
config BR2_PACKAGE_PYTHON_WEBSOCKETS
	bool "python-websockets"
	depends on BR2_PACKAGE_PYTHON3
	select BR2_PACKAGE_PYTHON3_ZLIB
	select BR2_PACKAGE_PYTHON3_SSL
	help
	  An implementation of the WebSocket Protocol (RFC 6455 &
	  7692).

	  https://github.com/aaugustin/websockets
```

## package/python-werkzeug/Config.in
```kconfig
config BR2_PACKAGE_PYTHON_WERKZEUG
	bool "python-werkzeug"
	help
	  Werkzeug is a WSGI utility library for Python. It's widely
	  used and BSD licensed.

	  http://werkzeug.pocoo.org/
```

## package/python-wrapt/Config.in
```kconfig
config BR2_PACKAGE_PYTHON_WRAPT
	bool "python-wrapt"
	help
	  Module for decorators, wrappers and monkey patching.

	  https://github.com/GrahamDumpleton/wrapt
```

## package/python-ws4py/Config.in
```kconfig
config BR2_PACKAGE_PYTHON_WS4PY
	bool "python-ws4py"
	help
	  ws4py is a Python package implementing the WebSocket protocol
	  as defined in RFC 6455.

	  https://ws4py.readthedocs.org
```

## package/python-wsaccel/Config.in
```kconfig
config BR2_PACKAGE_PYTHON_WSACCEL
	bool "python-wsaccel"
	help
	  Accelerator for ws4py and AutobahnPython.

	  https://pypi.python.org/pypi/wsaccel
```

## package/python-wtforms/Config.in
```kconfig
config BR2_PACKAGE_PYTHON_WTFORMS
	bool "python-wtforms"
	help
	  A flexible forms validation and rendering library for
	  Python web development.

	  https://wtforms.readthedocs.io/
```

## package/python-xlib/Config.in
```kconfig
config BR2_PACKAGE_PYTHON_XLIB
	bool "python-xlib"
	select BR2_PACKAGE_PYTHON_SIX # runtime
	help
	  XLib in pure Python (Py2/Py3 compatible)

	  https://github.com/python-xlib/python-xlib
```

## package/python-xlrd/Config.in
```kconfig
config BR2_PACKAGE_PYTHON_XLRD
	bool "python-xlrd"
	select BR2_PACKAGE_PYTHON_PYEXPAT if BR2_PACKAGE_PYTHON
	select BR2_PACKAGE_PYTHON3_PYEXPAT if BR2_PACKAGE_PYTHON3
	select BR2_PACKAGE_PYTHON_ZLIB if BR2_PACKAGE_PYTHON
	select BR2_PACKAGE_PYTHON3_ZLIB if BR2_PACKAGE_PYTHON3
	help
	  Library for developers to extract data from Microsoft Excel (tm)
	  spreadsheet files.

	  http://www.python-excel.org/
```

## package/python-xlrd/Config.in.host
```kconfig
config BR2_PACKAGE_HOST_PYTHON_XLRD
	bool "host python-xlrd"
	help
	  Library for developers to extract data from Microsoft
	  Excel(tm) spreadsheet files.

	  http://www.python-excel.org/
```
