## package/python-xlsxwriter/Config.in
```kconfig
config BR2_PACKAGE_PYTHON_XLSXWRITER
	bool "python-xlsxwriter"
	select BR2_PACKAGE_PYTHON_ZLIB if BR2_PACKAGE_PYTHON
	select BR2_PACKAGE_PYTHON3_ZLIB if BR2_PACKAGE_PYTHON3
	help
	  A Python module for creating Excel XLSX files.

	  https://github.com/jmcnamara/XlsxWriter
```

## package/python-xlwt/Config.in
```kconfig
config BR2_PACKAGE_PYTHON_XLWT
	bool "python-xlwt"
	help
	  Library to create spreadsheet files compatible with MS Excel
	  97/2000/XP/2003 XLS files, on any platform, with Python 2.6,
	  2.7, 3.3+.

	  http://www.python-excel.org/
```

## package/python-xmltodict/Config.in
```kconfig
config BR2_PACKAGE_PYTHON_XMLTODICT
	bool "python-xmltodict"
	select BR2_PACKAGE_PYTHON_PYEXPAT if BR2_PACKAGE_PYTHON # runtime
	select BR2_PACKAGE_PYTHON3_PYEXPAT if BR2_PACKAGE_PYTHON3 # runtime
	help
	  Makes working with XML feel like you are working with JSON.

	  https://github.com/martinblech/xmltodict
```

## package/python-yarl/Config.in
```kconfig
config BR2_PACKAGE_PYTHON_YARL
	bool "python-yarl"
	depends on BR2_PACKAGE_PYTHON3
	select BR2_PACKAGE_PYTHON_MULTIDICT
	select BR2_PACKAGE_PYTHON_IDNA
	help
	  Yet another URL library.

	  http://yarl.readthedocs.io/
```

## package/python-yieldfrom/Config.in
```kconfig
config BR2_PACKAGE_PYTHON_YIELDFROM
	bool "python-yieldfrom"
	depends on BR2_PACKAGE_PYTHON
	help
	  A backport of the `yield from` semantic from Python 3.x to
	  Python 2.7.

	  https://github.com/Nurdok/yieldfrom/
```

## package/python-zc-lockfile/Config.in
```kconfig
config BR2_PACKAGE_PYTHON_ZC_LOCKFILE
	bool "python-zc-lockfile"
	help
	  Basic inter-process locks.

	  https://github.com/zopefoundation/zc.lockfile
```

## package/python-zeroconf/Config.in
```kconfig
config BR2_PACKAGE_PYTHON_ZEROCONF
	bool "python-zeroconf"
	depends on BR2_PACKAGE_PYTHON3
	select BR2_PACKAGE_PYTHON_IFADDR # runtime
	help
	  Pure Python Multicast DNS Service Discovery Library
	  (Bonjour/Avahi compatible).

	  https://github.com/jstasiak/python-zeroconf
```

## package/python-zope-interface/Config.in
```kconfig
config BR2_PACKAGE_PYTHON_ZOPE_INTERFACE
	bool "python-zope-interface"
	select BR2_PACKAGE_PYTHON_SETUPTOOLS # runtime
	help
	  This package provides an implementation of "object interfaces" for
	  Python. Interfaces are a mechanism for labeling objects as conforming
	  to a given API or contract. So, this package can be considered as
	  implementation of the Design By Contract methodology support in Python.

	  http://docs.zope.org/zope.interface/
```

## package/python/Config.in
```kconfig
comment "python needs a toolchain w/ wchar, threads, dynamic library"
	depends on BR2_USE_MMU
	depends on !BR2_USE_WCHAR || !BR2_TOOLCHAIN_HAS_THREADS || BR2_STATIC_LIBS

config BR2_PACKAGE_PYTHON
	bool "python"
	depends on BR2_USE_WCHAR
	# uses fork()
	depends on BR2_USE_MMU
	depends on BR2_TOOLCHAIN_HAS_THREADS # libffi
	depends on !BR2_STATIC_LIBS
	select BR2_PACKAGE_LIBFFI
	help
	  The python language interpreter.

	  http://www.python.org/

if BR2_PACKAGE_PYTHON

choice
	prompt "python module format to install"
	default BR2_PACKAGE_PYTHON_PYC_ONLY
	help
	  Select Python module format to install on target (py, pyc or both)

config BR2_PACKAGE_PYTHON_PY_ONLY
	bool ".py sources only"

config BR2_PACKAGE_PYTHON_PYC_ONLY
	bool ".pyc compiled sources only"

config BR2_PACKAGE_PYTHON_PY_PYC
	bool ".py sources and .pyc compiled"

endchoice

menu "core python modules"

comment "The following modules are unusual or require extra libraries"

config BR2_PACKAGE_PYTHON_BZIP2
	bool "bzip2 module"
	select BR2_PACKAGE_BZIP2
	help
	  bzip2 module for Python

config BR2_PACKAGE_PYTHON_BSDDB
	bool "bsddb module"
	select BR2_PACKAGE_BERKELEYDB
	help
	  bsddb module for Python.

config BR2_PACKAGE_PYTHON_CODECSCJK
	bool "codecscjk module"
	help
	  Chinese/Japanese/Korean codecs module for Python (large).

config BR2_PACKAGE_PYTHON_CURSES
	bool "curses module"
	select BR2_PACKAGE_NCURSES
	help
	  curses module for Python.

config BR2_PACKAGE_PYTHON_OSSAUDIODEV
	bool "ossaudiodev module"
	help
	  ossaudiodev module for Python.

config BR2_PACKAGE_PYTHON_READLINE
	bool "readline"
	select BR2_PACKAGE_READLINE
	help
	  readline module for Python (required for command-line
	  editing in the Python shell).

config BR2_PACKAGE_PYTHON_SSL
	bool "ssl"
	select BR2_PACKAGE_OPENSSL
	help
	  _ssl module for Python (required for https in urllib etc).

config BR2_PACKAGE_PYTHON_UNICODEDATA
	bool "unicodedata module"
	default y
	help
	  Unicode character database (used by stringprep module) (large).

if BR2_PACKAGE_PYTHON_UNICODEDATA

choice
	prompt "Python unicode database format"
	default BR2_PACKAGE_PYTHON_UCS2
	help
	  Select Python unicode database format for target

config BR2_PACKAGE_PYTHON_UCS2
	bool "Universal Character Set 2-byte (UCS2)"

config BR2_PACKAGE_PYTHON_UCS4
	bool "Universal Character Set 4-byte (UCS4)"

endchoice

endif

config BR2_PACKAGE_PYTHON_SQLITE
	bool "sqlite module"
	select BR2_PACKAGE_SQLITE
	help
	  SQLite database support

config BR2_PACKAGE_PYTHON_PYEXPAT
	bool "xml module"
	select BR2_PACKAGE_EXPAT
	help
	  pyexpat and xml libraries for Python

config BR2_PACKAGE_PYTHON_ZLIB
	bool "zlib module"
	select BR2_PACKAGE_ZLIB
	help
	  zlib support in Python

config BR2_PACKAGE_PYTHON_HASHLIB
	bool "hashlib module"
	select BR2_PACKAGE_OPENSSL
	help
	  hashlib support in Python

endmenu

endif
```

## package/python/Config.in.host
```kconfig
config BR2_PACKAGE_HOST_PYTHON
	bool "host python"
	help
	  The python language interpreter. Host package.

	  http://www.python.org/

if BR2_PACKAGE_HOST_PYTHON

config BR2_PACKAGE_HOST_PYTHON_SSL
	bool "ssl"
	select BR2_PACKAGE_HOST_OPENSSL
	help
	  _ssl module for host Python.

endif
```

## package/python3/Config.in
```kconfig
comment "python3 needs a toolchain w/ wchar, threads, dynamic library"
	depends on BR2_USE_MMU
	depends on !BR2_USE_WCHAR || !BR2_TOOLCHAIN_HAS_THREADS || BR2_STATIC_LIBS

config BR2_PACKAGE_PYTHON3
	bool "python3"
	depends on !BR2_PACKAGE_PYTHON
	depends on BR2_USE_WCHAR
	# uses fork()
	depends on BR2_USE_MMU
	depends on BR2_TOOLCHAIN_HAS_THREADS # libffi
	depends on !BR2_STATIC_LIBS
	select BR2_PACKAGE_LIBFFI
	help
	  The python language interpreter.

	  http://www.python.org/

if BR2_PACKAGE_PYTHON3

choice
	prompt "python3 module format to install"
	default BR2_PACKAGE_PYTHON3_PYC_ONLY
	help
	  Select Python module format to install on target (py, pyc or
	  both)

config BR2_PACKAGE_PYTHON3_PY_ONLY
	bool ".py sources only"

config BR2_PACKAGE_PYTHON3_PYC_ONLY
	bool ".pyc compiled sources only"

config BR2_PACKAGE_PYTHON3_PY_PYC
	bool ".py sources and .pyc compiled"

endchoice

menu "core python3 modules"

comment "The following modules are unusual or require extra libraries"

config BR2_PACKAGE_PYTHON3_BZIP2
	bool "bz2 module"
	select BR2_PACKAGE_BZIP2
	help
	  bzip2 module for Python3

config BR2_PACKAGE_PYTHON3_CODECSCJK
	bool "codecscjk module"
	help
	  Chinese/Japanese/Korean codecs module for Python (large).

config BR2_PACKAGE_PYTHON3_CURSES
	bool "curses module"
	select BR2_PACKAGE_NCURSES
	help
	  curses module for Python3.

config BR2_PACKAGE_PYTHON3_DECIMAL
	bool "decimal module"
	select BR2_PACKAGE_MPDECIMAL
	help
	  decimal module for Python3.

config BR2_PACKAGE_PYTHON3_OSSAUDIODEV
	bool "ossaudiodev module"
	help
	  ossaudiodev module for Python3.

config BR2_PACKAGE_PYTHON3_READLINE
	bool "readline"
	select BR2_PACKAGE_READLINE
	help
	  readline module for Python3 (required for command-line
	  editing in the Python shell).

config BR2_PACKAGE_PYTHON3_SSL
	bool "ssl"
	select BR2_PACKAGE_OPENSSL
	help
	  _ssl module for Python3 (required for https in urllib etc).

config BR2_PACKAGE_PYTHON3_UNICODEDATA
	bool "unicodedata module"
	default y
	help
	  Unicode character database (used by stringprep module)
	  (large).

config BR2_PACKAGE_PYTHON3_SQLITE
	bool "sqlite module"
	select BR2_PACKAGE_SQLITE
	help
	  SQLite database support

config BR2_PACKAGE_PYTHON3_PYEXPAT
	bool "xml module"
	select BR2_PACKAGE_EXPAT
	help
	  pyexpat and xml libraries for Python3.

config BR2_PACKAGE_PYTHON3_XZ
	bool "xz module"
	select BR2_PACKAGE_XZ
	help
	  xz (a.k.a lzma) module for Python3

config BR2_PACKAGE_PYTHON3_ZLIB
	bool "zlib module"
	select BR2_PACKAGE_ZLIB
	help
	  zlib support in Python3

endmenu

endif
```

## package/python3/Config.in.host
```kconfig
config BR2_PACKAGE_HOST_PYTHON3
	bool "host python3"
	help
	  The python language interpreter. Host package.

	  http://www.python.org/

if BR2_PACKAGE_HOST_PYTHON3

config BR2_PACKAGE_HOST_PYTHON3_SSL
	bool "ssl"
	select BR2_PACKAGE_HOST_OPENSSL
	help
	  _ssl module for host Python3.

endif
```

## package/qdecoder/Config.in
```kconfig
config BR2_PACKAGE_QDECODER
	bool "qdecoder"
	depends on !BR2_STATIC_LIBS
	help
	  qDecoder is a simple and powerful CGI library
	  for the C/C++ programming language.

	  http://wolkykim.github.io/qdecoder
```

## package/qemu/Config.in
```kconfig
config BR2_PACKAGE_QEMU_ARCH_SUPPORTS_TARGET
	bool
	# Only tested on these architectures
	default y if BR2_aarch64 || BR2_i386 || BR2_mips || BR2_mipsel \
		|| BR2_x86_64 || BR2_arm \
		|| BR2_powerpc64 || BR2_powerpc64le

comment "QEMU requires a toolchain with wchar, threads"
	depends on BR2_PACKAGE_QEMU_ARCH_SUPPORTS_TARGET
	depends on BR2_USE_MMU
	depends on !(BR2_TOOLCHAIN_HAS_THREADS && BR2_USE_WCHAR)

config BR2_PACKAGE_QEMU
	bool "QEMU"
	depends on BR2_PACKAGE_QEMU_ARCH_SUPPORTS_TARGET
	depends on BR2_TOOLCHAIN_HAS_THREADS
	depends on BR2_USE_WCHAR # gettext
	depends on BR2_USE_MMU # fork()
	select BR2_PACKAGE_LIBGLIB2
	select BR2_PACKAGE_PIXMAN
	select BR2_PACKAGE_ZLIB
	help
	  QEMU is a generic and open source machine emulator and
	  virtualizer.

	  When used as a machine emulator, QEMU can run OSes and
	  programs made for one machine (e.g. an ARM board) on a
	  different machine (e.g.  your own PC). By using dynamic
	  translation, it achieves very good performance.

	  When used as a virtualizer, QEMU achieves near native
	  performances by executing the guest code directly on the
	  host CPU. QEMU supports virtualization when executing under
	  the Xen hypervisor or using the KVM kernel module in
	  Linux. When using KVM, QEMU can virtualize x86, server and
	  embedded PowerPC, and S390 guests.

	  http://qemu.org/

if BR2_PACKAGE_QEMU

comment "Emulators selection"

config BR2_PACKAGE_QEMU_CUSTOM_TARGETS
	string "Enable specific targets"
	help
	  Enter here the list of QEMU targets you want to build. For
	  example:

	    System emulation      | User-land emulation
	    ----------------------+-----------------------
	    i386-softmmu          | i386-linux-user
	    arm-softmmu           | ppc-linux-user
	    x86_64-softmmu        | sparc-bsd-user
	    ...                   | ...

comment "Networking options"

config BR2_PACKAGE_QEMU_SLIRP
	bool "Enable user mode networking (SLIRP)"
	help
	  Enable user mode network stack, which is the default
	  networking backend. It requires no administrator privileges
	  and generally is the easiest to use but has some
	  limitations:

	  - there is a lot of overhead so the performance is poor;
	  - in general ICMP does not work (can't ping from/to a guest)
	  - on Linux hosts, ping does work from within the guest, but it
	    needs initial setup by root (once per host)
	  - the guest is not directly accessible from the host or the
	    external network

	  User Networking is implemented using "slirp", which provides a
	  full TCP/IP stack within QEMU and uses that stack to implement
	  a virtual NAT'd network.

	  Notice that this option does not disable other networking
	  modes.

if BR2_PACKAGE_QEMU_CUSTOM_TARGETS = ""

comment "... or you can select emulator families to enable, below:"

config BR2_PACKAGE_QEMU_SYSTEM
	bool "Enable all systems emulation"
	depends on !BR2_STATIC_LIBS # dtc
	select BR2_PACKAGE_QEMU_FDT
	help
	  Say 'y' to build all system emulators/virtualisers that QEMU
	  supports.

comment "systems emulation needs a toolchain w/ dynamic library"
	depends on BR2_STATIC_LIBS

config BR2_PACKAGE_QEMU_LINUX_USER
	bool "Enable all Linux user-land emulation"
	# Incompatible "struct sigevent" definition on musl
	depends on !BR2_TOOLCHAIN_USES_MUSL
	help
	  Say 'y' to build all Linux user-land emulators that QEMU
	  supports.

# Note: bsd-user can not be build on Linux

comment "Linux user-land emulation needs a glibc or uClibc toolchain"
	depends on BR2_TOOLCHAIN_USES_MUSL

endif # BR2_PACKAGE_QEMU_CUSTOM_TARGETS == ""

config BR2_PACKAGE_QEMU_HAS_EMULS
	def_bool y
	depends on BR2_PACKAGE_QEMU_SYSTEM || BR2_PACKAGE_QEMU_LINUX_USER || BR2_PACKAGE_QEMU_CUSTOM_TARGETS != ""

if BR2_PACKAGE_QEMU_HAS_EMULS

comment "Frontends"

config BR2_PACKAGE_QEMU_SDL
	bool "Enable SDL frontend"
	depends on !BR2_STATIC_LIBS # sdl2
	select BR2_PACKAGE_SDL2
	help
	  Say 'y' to enable the SDL frontend, that is, a graphical
	  window presenting the VM's display.

comment "SDL frontend needs a toolchain w/ dynamic library"
	depends on BR2_STATIC_LIBS

comment "Misc. features"

config BR2_PACKAGE_QEMU_FDT
	bool "Enable FDT"
	depends on !BR2_STATIC_LIBS # dtc
	select BR2_PACKAGE_DTC
	help
	  Say 'y' here to have QEMU capable of constructing Device
	  Trees, and passing them to the VMs.

comment "FDT support needs a toolchain w/ dynamic library"
	depends on BR2_STATIC_LIBS

endif # BR2_PACKAGE_QEMU_HAS_EMULS

config BR2_PACKAGE_QEMU_TOOLS
	bool "Enable tools"
	help
	  Say 'y' here to include tools packaged with QEMU
	  (e.g. qemu-img).

endif # BR2_PACKAGE_QEMU
```
