## package/qemu/Config.in.host
```kconfig
config BR2_PACKAGE_HOST_QEMU_ARCH_SUPPORTS
	bool
	default y if BR2_arm
	default y if BR2_armeb
	default y if BR2_aarch64
	default y if BR2_i386
	default y if BR2_m68k
	default y if BR2_microblazeel
	default y if BR2_microblazebe
	default y if BR2_mips
	default y if BR2_mipsel
	default y if BR2_nios2
	default y if BR2_or1k
	default y if BR2_powerpc
	default y if BR2_powerpc64
	default y if BR2_powerpc64le
	default y if BR2_riscv
	default y if BR2_sh
	default y if BR2_sparc
	default y if BR2_sparc64
	default y if BR2_xtensa
	default y if BR2_x86_64
	depends on !BR2_x86_steamroller && !BR2_x86_core_avx2
	depends on !BR2_powerpc_620 && !BR2_powerpc_630 && !BR2_powerpc_970

config BR2_PACKAGE_HOST_QEMU_SYSTEM_ARCH_SUPPORTS
	bool
	default y if BR2_PACKAGE_HOST_QEMU_ARCH_SUPPORTS
	default y if BR2_mips64
	default y if BR2_mips64el

config BR2_PACKAGE_HOST_QEMU_USER_ARCH_SUPPORTS
	bool
	default y if BR2_PACKAGE_HOST_QEMU_ARCH_SUPPORTS

config BR2_PACKAGE_HOST_QEMU
	bool "host qemu"
	depends on BR2_PACKAGE_HOST_QEMU_SYSTEM_ARCH_SUPPORTS || BR2_PACKAGE_HOST_QEMU_USER_ARCH_SUPPORTS
	select BR2_PACKAGE_HOST_QEMU_LINUX_USER_MODE \
		if !BR2_PACKAGE_HOST_QEMU_SYSTEM_MODE && BR2_PACKAGE_HOST_QEMU_USER_ARCH_SUPPORTS
	select BR2_PACKAGE_HOST_QEMU_SYSTEM_MODE \
		if !BR2_PACKAGE_HOST_QEMU_USER_ARCH_SUPPORTS
	help
	  QEMU is a generic and open source machine emulator and
	  virtualizer.

	  This option builds an emulator for your selected architecture.

	  http://www.qemu.org

if BR2_PACKAGE_HOST_QEMU

comment "Emulators selection"

config BR2_PACKAGE_HOST_QEMU_SYSTEM_MODE
	bool "Enable system emulation"
	depends on BR2_PACKAGE_HOST_QEMU_SYSTEM_ARCH_SUPPORTS
	help
	  Enables the build of the system emulator, which allows to
	  boot an entire system in Qemu.

config BR2_PACKAGE_HOST_QEMU_LINUX_USER_MODE
	bool "Enable Linux user-land emulation"
	depends on BR2_PACKAGE_HOST_QEMU_USER_ARCH_SUPPORTS
	help
	  Enables the build of the user-land emulator, which allows to
	  run user-space applications.

	  Note that system calls made by the emulated user-land are
	  serviced by the running host kernel. Therefore, if the
	  kernel headers used by your target are more recent than
	  the running host kernel, you may run into invalid system
	  calls, which may yield surprising effects.

config BR2_PACKAGE_HOST_QEMU_VDE2
	bool "VDE2 support"
	help
	  Enables VDE2 support. VDE2 stands for Virtual Distributed
	  Ethernet and can be used to create virtual switches to
	  "plug" both physical and virtual machines in them.

config BR2_PACKAGE_HOST_QEMU_VIRTFS
	bool "Virtual filesystem support"
	help
	  Enables support for virtual filesystem in Qemu allowing
	  shared filesystem between Qemu and its emulated target.

config BR2_PACKAGE_HOST_QEMU_USB
	bool "USB passthrough support"
	help
	  Enables USB passthrough support from guest to host.

endif
```

## package/qextserialport/Config.in
```kconfig
config BR2_PACKAGE_QEXTSERIALPORT
	bool "qextserialport"
	depends on BR2_PACKAGE_QT5
	help
	  A Qt library to manage serial ports

	  http://qextserialport.github.io/
```

## package/qhull/Config.in
```kconfig
config BR2_PACKAGE_QHULL
	bool "qhull"
	depends on BR2_INSTALL_LIBSTDCPP
	depends on !BR2_STATIC_LIBS
	help
	  Qhull computes the convex hull, Delaunay triangulation,
	  Voronoi diagram, halfspace intersection about a point,
	  furthest-site Delaunay triangulation, and furthest-site
	  Voronoi diagram. The source code runs in 2-d, 3-d, 4-d, and
	  higher dimensions. Qhull implements the Quickhull algorithm
	  for computing the convex hull. It handles roundoff errors
	  from floating point arithmetic. It computes volumes, surface
	  areas, and approximations to the convex hull.

	  http://www.qhull.org

comment "qhull needs a toolchain w/ C++, dynamic library"
	depends on !BR2_INSTALL_LIBSTDCPP
	depends on BR2_STATIC_LIBS
```

## package/qjson/Config.in
```kconfig
config BR2_PACKAGE_QJSON
	bool "qjson"
	depends on BR2_PACKAGE_QT || BR2_PACKAGE_QT5
	help
	  QJson is a Qt-based library that maps JSON data to
	  QVariant objects and vice versa.

	  http://qjson.sourceforge.net
```

## package/qlibc/Config.in
```kconfig
config BR2_PACKAGE_QLIBC
	bool "qlibc"
	select BR2_PACKAGE_LIBICONV if !BR2_ENABLE_LOCALE
	depends on BR2_TOOLCHAIN_HAS_THREADS
	depends on BR2_USE_WCHAR
	depends on !BR2_PREFER_STATIC_LIB
	help
	  qLibc is currently one of the most functionally complete
	  public licensed C/C++ libraries.  The C/C++ library which
	  includes all kinds of containers and general library
	  routines. It provides ready-made set of common container
	  APIs with consistant API look.

	  https://github.com/wolkykim/qlibc

comment "qlibc needs a toolchain w/ threads, wchar, dynamic library"
	depends on !BR2_TOOLCHAIN_HAS_THREADS || !BR2_USE_WCHAR || BR2_PREFER_STATIC_LIB
```

## package/qpdf/Config.in
```kconfig
config BR2_PACKAGE_QPDF
	bool "qpdf"
	depends on BR2_INSTALL_LIBSTDCPP
	depends on BR2_USE_WCHAR
	depends on BR2_TOOLCHAIN_GCC_AT_LEAST_4_7 # C++11
	select BR2_PACKAGE_ZLIB
	select BR2_PACKAGE_JPEG
	help
	  QPDF is a command-line program that does structural,
	  content- preserving transformations on PDF files. It could
	  have been called something like pdf-to-pdf. It also provides
	  many useful capabilities to developers of PDF-producing
	  software or for people who just want to look at the innards
	  of a PDF file to learn more about how they work.

	  http://qpdf.sourceforge.net/

comment "qpdf needs a toolchain w/ C++, wchar, gcc >= 4.7"
	depends on !BR2_INSTALL_LIBSTDCPP || !BR2_USE_WCHAR || \
		!BR2_TOOLCHAIN_GCC_AT_LEAST_4_7
```

## package/qpid-proton/Config.in
```kconfig
config BR2_PACKAGE_QPID_PROTON
	bool "qpid-proton"
	depends on !BR2_STATIC_LIBS # build a shared library
	select BR2_PACKAGE_UTIL_LINUX
	select BR2_PACKAGE_UTIL_LINUX_LIBUUID
	help
	  The AMQP messaging toolkit

	  Qpid Proton is a high-performance, lightweight messaging
	  library. It can be used in the widest range of messaging
	  applications, including brokers, client libraries, routers,
	  bridges, proxies, and more.

	  https://qpid.apache.org/proton/

comment "qpid-proton needs a toolchain w/ dynamic library"
	depends on BR2_STATIC_LIBS
```

## package/qt-webkit-kiosk/Config.in
```kconfig
config BR2_PACKAGE_QT_WEBKIT_KIOSK
	bool "qt-webkit-kiosk"
	depends on BR2_PACKAGE_QT5
	depends on !BR2_STATIC_LIBS # qt5webkit
	depends on BR2_PACKAGE_QT5_JSCORE_AVAILABLE # qt5webkit
	depends on BR2_HOST_GCC_AT_LEAST_4_8 # qt5webkit -> icu
	depends on BR2_TOOLCHAIN_GCC_AT_LEAST_4_8 # qt5webkit -> icu
	depends on !BR2_BINFMT_FLAT # qt5webkit -> icu
	depends on !BR2_MIPS_SOFT_FLOAT # qt5webkit
	select BR2_PACKAGE_OPENSSL
	select BR2_PACKAGE_QT5BASE_GUI
	select BR2_PACKAGE_QT5BASE_WIDGETS
	select BR2_PACKAGE_QT5WEBKIT
	select BR2_PACKAGE_QT5MULTIMEDIA
	help
	  Simple kiosk-mode browser powered by Qt5Webkit

if BR2_PACKAGE_QT_WEBKIT_KIOSK

config BR2_PACKAGE_QT_WEBKIT_KIOSK_SOUNDS
	bool "Install browser sound files"
	help
	  Deploy browser sound files on target

endif

comment "qt-webkit-kiosk needs a toolchain w/ dynamic library, gcc >= 4.8, host gcc >= 4.8"
	depends on BR2_STATIC_LIBS || !BR2_TOOLCHAIN_GCC_AT_LEAST_4_8 || \
		!BR2_HOST_GCC_AT_LEAST_4_8
	depends on BR2_PACKAGE_QT5_JSCORE_AVAILABLE
	depends on !BR2_BINFMT_FLAT
	depends on !BR2_MIPS_SOFT_FLOAT
```
