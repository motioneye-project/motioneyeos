## package/qt5/qt5quickcontrols/Config.in
```kconfig
config BR2_PACKAGE_QT5QUICKCONTROLS
	bool "qt5quickcontrols"
	depends on BR2_PACKAGE_QT5_GL_AVAILABLE
	depends on BR2_PACKAGE_QT5_JSCORE_AVAILABLE
	select BR2_PACKAGE_QT5DECLARATIVE
	select BR2_PACKAGE_QT5DECLARATIVE_QUICK
	help
	  Qt is a cross-platform application and UI framework for
	  developers using C++.

	  The Qt Quick Controls module provides a set of controls
	  that can be used to build complete interfaces in Qt Quick.

	  http://doc.qt.io/qt-5/qtquickcontrols-index.html

comment "qt5quickcontrols needs an OpenGL-capable backend"
	depends on !BR2_PACKAGE_QT5_GL_AVAILABLE
	depends on BR2_PACKAGE_QT5_JSCORE_AVAILABLE
```

## package/qt5/qt5quickcontrols2/Config.in
```kconfig
config BR2_PACKAGE_QT5QUICKCONTROLS2
	bool "qt5quickcontrols2"
	select BR2_PACKAGE_QT5DECLARATIVE
	select BR2_PACKAGE_QT5DECLARATIVE_QUICK
	depends on BR2_PACKAGE_QT5_GL_AVAILABLE # qt5declarative/quick
	depends on BR2_PACKAGE_QT5_JSCORE_AVAILABLE # qt5declarative/quick
	help
	  Qt is a cross-platform application and UI framework for
	  developers using C++.

	  This package corresponds to the qt5quickcontrols2 module.

	  http://qt.io

comment "qt5quickcontrols2 needs an OpenGL-capable backend"
	depends on !BR2_PACKAGE_QT5_GL_AVAILABLE
	depends on BR2_PACKAGE_QT5_JSCORE_AVAILABLE
```

## package/qt5/qt5script/Config.in
```kconfig
config BR2_PACKAGE_QT5SCRIPT
	bool "qt5script"
	depends on BR2_PACKAGE_QT5_JSCORE_AVAILABLE
	select BR2_PACKAGE_QT5BASE
	help
	  Qt is a cross-platform application and UI framework for
	  developers using C++.

	  Qt Script provides support for making Qt applications
	  scriptable. Provided for Qt 4.x compatibility.

	  This package has been tagged as deprecated since version
	  5.5.0 and should be replaced by Qt QML module in new
	  design.

	  http://doc.qt.io/qt-5/qtscript-index.html
```

## package/qt5/qt5scxml/Config.in
```kconfig
config BR2_PACKAGE_QT5SCXML
	bool "qt5scxml"
	depends on BR2_PACKAGE_QT5_VERSION_LATEST
	depends on BR2_PACKAGE_QT5_JSCORE_AVAILABLE # qt5declarative
	select BR2_PACKAGE_QT5BASE
	select BR2_PACKAGE_QT5DECLARATIVE
	help
	  Qt is a cross-platform application and UI framework for
	  developers using C++.

	  The Qt SCXML module provides functionality to create state
	  machines from SCXML files.

	  https://doc.qt.io/qt-5/qtscxml-index.html

comment "qt5scxml needs at least qt-5.9"
	depends on BR2_PACKAGE_QT5_JSCORE_AVAILABLE
	depends on !BR2_PACKAGE_QT5_VERSION_LATEST
```

## package/qt5/qt5sensors/Config.in
```kconfig
config BR2_PACKAGE_QT5SENSORS
	bool "qt5sensors"
	select BR2_PACKAGE_QT5BASE
	help
	  Qt is a cross-platform application and UI framework for
	  developers using C++.

	  This package corresponds to the qt5sensors module.

	  http://qt-project.org
```

## package/qt5/qt5serialbus/Config.in
```kconfig
config BR2_PACKAGE_QT5SERIALBUS
	bool "qt5serialbus"
	depends on BR2_TOOLCHAIN_HEADERS_AT_LEAST_3_6 # CAN FD
	select BR2_PACKAGE_QT5BASE
	select BR2_PACKAGE_QT5SERIALPORT
	help
	  Qt is a cross-platform application and UI framework for
	  developers using C++.

	  This package corresponds to the qt5serialbus module.

	  This module was in tech preview in Qt 5.6, and promoted
	  to a core module in Qt 5.8.0.

	  http://doc.qt.io/qt-5/qtserialbus-index.html

comment "qt5serialbus needs headers >= 3.6"
	depends on !BR2_TOOLCHAIN_HEADERS_AT_LEAST_3_6
```

## package/qt5/qt5serialport/Config.in
```kconfig
config BR2_PACKAGE_QT5SERIALPORT
	bool "qt5serialport"
	select BR2_PACKAGE_QT5BASE
	help
	  Qt is a cross-platform application and UI framework for
	  developers using C++.

	  Qt Serial Port provides the basic functionality, which
	  includes configuring, I/O operations, getting and setting
	  the control signals of the RS-232 pinouts.

	  http://doc.qt.io/qt-5/qtserialport-index.html
```

## package/qt5/qt5svg/Config.in
```kconfig
config BR2_PACKAGE_QT5SVG
	bool "qt5svg"
	select BR2_PACKAGE_QT5BASE
	select BR2_PACKAGE_QT5BASE_GUI
	help
	  Qt is a cross-platform application and UI framework for
	  developers using C++.

	  Qt SVG provides classes for rendering and displaying SVG
	  drawings in widgets and on other paint devices.

	  http://doc.qt.io/qt-5/qtsvg-index.html
```

## package/qt5/qt5tools/Config.in
```kconfig
config BR2_PACKAGE_QT5TOOLS
	bool "qt5tools"
	help
	  Qt is a cross-platform application and UI framework for
	  developers using C++.

	  Qt Tools provides tools facilitate the development
	  and design of applications.

	  http://doc.qt.io/qt-5/qtmodules.html#qt-tools

if BR2_PACKAGE_QT5TOOLS

config BR2_PACKAGE_QT5TOOLS_LINGUIST_TOOLS
	bool "Linguist host tools (lconvert, lrelease, lupdate)"
	help
	  This option enables the linguist host tools
	  lconvert, lrelease and lupdate.

config BR2_PACKAGE_QT5TOOLS_QDOC_TOOL
	bool "qdoc host tool"
	# Needs llvm-config and libclang for the host, which is not
	# currently supported in Buildroot, unless the target is
	# already supported by llvm.
	depends on BR2_PACKAGE_LLVM_ARCH_SUPPORTS # llvm, clang
	depends on BR2_TOOLCHAIN_GCC_AT_LEAST_4_8 # llvm, clang
	depends on BR2_TOOLCHAIN_HAS_THREADS # llvm, clang
	depends on BR2_INSTALL_LIBSTDCPP # llvm, clang
	depends on !BR2_TOOLCHAIN_HAS_GCC_BUG_64735 # llvm, clang
	depends on !BR2_STATIC_LIBS # llvm, clang
	depends on BR2_USE_WCHAR # llvm, clang
	help
	  This option enables the qdoc host tool.

config BR2_PACKAGE_QT5TOOLS_PIXELTOOL
	bool "pixeltool"
	select BR2_PACKAGE_QT5BASE_GUI
	select BR2_PACKAGE_QT5BASE_WIDGETS
	select BR2_PACKAGE_QT5BASE_PNG # saving png images
	help
	  Compile and install the pixeltool program.

config BR2_PACKAGE_QT5TOOLS_QTDIAG
	bool "qtdiag"
	select BR2_PACKAGE_QT5BASE_GUI
	help
	  Compile and install the qtdiag program.

config BR2_PACKAGE_QT5TOOLS_QTPATHS
	bool "qtpaths"
	help
	  Compile and install the qtpaths program.

config BR2_PACKAGE_QT5TOOLS_QTPLUGININFO
	bool "qtplugininfo"
	help
	  Compile and install the qtplugininfo program.

endif
```

## package/qt5/qt5virtualkeyboard/Config.in
```kconfig
comment "qt5virtualkeyboard needs an OpenGL-capable backend"
	depends on BR2_PACKAGE_QT5_JSCORE_AVAILABLE
	depends on !BR2_PACKAGE_QT5_GL_AVAILABLE

config BR2_PACKAGE_QT5VIRTUALKEYBOARD
	bool "qt5virtualkeyboard"
	depends on BR2_PACKAGE_QT5_JSCORE_AVAILABLE # qt5declarative
	depends on BR2_PACKAGE_QT5_GL_AVAILABLE || BR2_PACKAGE_QT5_VERSION_LATEST # qt5declarative/quick
	select BR2_PACKAGE_QT5DECLARATIVE
	select BR2_PACKAGE_QT5DECLARATIVE_QUICK
	select BR2_PACKAGE_QT5SVG
	help
	  Qt Virtual Keyboard is a virtual keyboard framework that
	  consists of a C++ backend supporting custom input methods as
	  well as a UI frontend implemented in QML.

if BR2_PACKAGE_QT5VIRTUALKEYBOARD

config BR2_PACKAGE_QT5VIRTUALKEYBOARD_LANGUAGE_LAYOUTS
	string "language layouts"
	default "en_GB"
	help
	  The Virtual Keyboard supports the following languages:
	  - Arabic (ar_AR)
	  - Danish (da_DK)
	  - English (en_GB)
	  - Finnish (fi_FI)
	  - French (fr_FR)
	  - German (de_DE)
	  - Hindi (hi_IN)
	  - Italian (it_IT)
	  - Japanese (ja_JP)
	  - Korean (ko_KR)
	  - Norwegian (nb_NO)
	  - Persian/Farsi (fa_FA)
	  - Polish (pl_PL)
	  - Portugese (pt_PT)
	  - Romanian (ro_RO)
	  - Russian (ru_RU)
	  - Simplified Chinese (zh_CN)
	  - Traditional Chinese (zh_TW)
	  - Spanish (es_ES)
	  - Swedish (sv_SE)

	  Note: the special value "all" can be used to install support
	  for all supported languages.

config BR2_PACKAGE_QT5VIRTUALKEYBOARD_HANDWRITING
	bool "handwriting"
	help
	  Handwriting support, with gestures for fullscreen input.

	  Lipi Toolkit (LipiTk) is an open source toolkit for online
	  Handwriting Recognition.

endif
```

## package/qt5/qt5wayland/Config.in
```kconfig
comment "qt5wayland needs an OpenGL-capable backend"
	depends on BR2_PACKAGE_QT5_JSCORE_AVAILABLE
	depends on !BR2_PACKAGE_QT5_GL_AVAILABLE

config BR2_PACKAGE_QT5WAYLAND
	bool "qt5wayland"
	depends on BR2_PACKAGE_QT5_GL_AVAILABLE
	depends on BR2_PACKAGE_QT5_JSCORE_AVAILABLE # qt5declarative
	select BR2_PACKAGE_QT5DECLARATIVE
	select BR2_PACKAGE_WAYLAND
	help
	  Qt is a cross-platform application and UI framework for
	  developers using C++.

	  This package corresponds to the qt5wayland module.

	  http://qt.io

if BR2_PACKAGE_QT5WAYLAND

config BR2_PACKAGE_QT5WAYLAND_COMPOSITOR
	bool "Enable compositor (experimental)"
	help
	  The compositor API is still experimental, and not built by
	  default.

endif
```

## package/qt5/qt5webchannel/Config.in
```kconfig
config BR2_PACKAGE_QT5WEBCHANNEL
	bool "qt5webchannel"
	select BR2_PACKAGE_QT5BASE
	select BR2_PACKAGE_QT5WEBSOCKETS
	help
	  Qt is a cross-platform application and UI framework for
	  developers using C++.

	  This package corresponds to the qt5webchannel module.

	  http://qt.io
```

## package/qt5/qt5webengine/Config.in
```kconfig
config BR2_PACKAGE_QT5WEBENGINE_ARCH_SUPPORTS
	bool
	default y if BR2_aarch64 || BR2_arm || \
		BR2_i386 || BR2_x86_64 || \
		BR2_mips || BR2_mips64
	# -m32 flag is used for 32bit builds and host tools have
	# limited architecture support
	depends on BR2_HOSTARCH = "x86_64" || BR2_HOSTARCH = "x86"
	depends on BR2_PACKAGE_QT5_JSCORE_AVAILABLE # qt5declarative
	depends on !BR2_BINFMT_FLAT # qt5base-icu
	depends on BR2_USE_MMU # libglib2, qt5base-dbus

comment "qt5webengine needs udev /dev management and a glibc toolchain w/ gcc >= 4.8, host gcc >= 4.8, threads, wchar"
	depends on BR2_PACKAGE_QT5WEBENGINE_ARCH_SUPPORTS
	depends on !BR2_PACKAGE_HAS_UDEV || !BR2_TOOLCHAIN_USES_GLIBC || \
		!BR2_HOST_GCC_AT_LEAST_4_8 || !BR2_TOOLCHAIN_GCC_AT_LEAST_4_8 || \
		!BR2_TOOLCHAIN_HAS_THREADS || !BR2_USE_WCHAR

comment "qt5webengine needs an OpenGL and EGL-capable backend"
	depends on BR2_PACKAGE_QT5WEBENGINE_ARCH_SUPPORTS
	depends on !BR2_PACKAGE_QT5_GL_AVAILABLE || !BR2_PACKAGE_HAS_LIBEGL

config BR2_PACKAGE_QT5WEBENGINE
	bool "qt5webengine"
	depends on BR2_PACKAGE_QT5WEBENGINE_ARCH_SUPPORTS
	depends on BR2_TOOLCHAIN_USES_GLIBC # execinfo.h, mallinfo
	depends on BR2_HOST_GCC_AT_LEAST_4_8 # qt5base-icu
	depends on BR2_TOOLCHAIN_GCC_AT_LEAST_4_8 # qt5base-icu
	depends on BR2_TOOLCHAIN_HAS_THREADS # libglib2, libvpx, qt5base-dbus
	depends on BR2_USE_WCHAR # libglib2
	depends on BR2_PACKAGE_QT5_GL_AVAILABLE # qt5declarative, qt5base-eglfs
	depends on BR2_PACKAGE_HAS_LIBEGL # qt5base-eglfs
	depends on BR2_PACKAGE_HAS_UDEV
	# v8 (a chromium 3rd-party) compiles its internal host-tools with the
	# same word size as the target. For 32-bits targets, it adds the -m32
	# flag (for 64-bits, it adds the -m64 flag).
	# https://github.com/v8/v8/blob/5.6.326.55/gypfiles/toolchain.gypi#L1036-L1037
	select BR2_HOSTARCH_NEEDS_IA32_COMPILER if !BR2_ARCH_IS_64 # v8/chromium
	select BR2_PACKAGE_FFMPEG
	select BR2_PACKAGE_LIBGLIB2
	select BR2_PACKAGE_LIBVPX
	select BR2_PACKAGE_OPUS
	select BR2_PACKAGE_WEBP
	select BR2_PACKAGE_WEBP_DEMUX
	select BR2_PACKAGE_QT5BASE_DBUS
	select BR2_PACKAGE_QT5BASE_EGLFS
	select BR2_PACKAGE_QT5BASE_FONTCONFIG
	select BR2_PACKAGE_QT5BASE_ICU
	select BR2_PACKAGE_QT5BASE_GUI
	select BR2_PACKAGE_QT5BASE_WIDGETS
	select BR2_PACKAGE_QT5DECLARATIVE
	select BR2_PACKAGE_QT5DECLARATIVE_QUICK
	select BR2_PACKAGE_QT5QUICKCONTROLS
	select BR2_PACKAGE_QT5QUICKCONTROLS2
	select BR2_PACKAGE_QT5WEBCHANNEL
	select BR2_PACKAGE_XLIB_LIBXCOMPOSITE if BR2_PACKAGE_QT5BASE_XCB
	select BR2_PACKAGE_XLIB_LIBXCURSOR if BR2_PACKAGE_QT5BASE_XCB
	select BR2_PACKAGE_XLIB_LIBXI if BR2_PACKAGE_QT5BASE_XCB
	select BR2_PACKAGE_XLIB_LIBXRANDR if BR2_PACKAGE_QT5BASE_XCB
	select BR2_PACKAGE_XLIB_LIBXSCRNSAVER if BR2_PACKAGE_QT5BASE_XCB
	select BR2_PACKAGE_XLIB_LIBXTST if BR2_PACKAGE_QT5BASE_XCB
	help
	  The Qt WebEngine module provides a web browser engine that
	  makes it easy to embed content from the World Wide Web into
	  your Qt application.

	  Qt WebEngine provides C++ classes and QML types for rendering
	  HTML, XHTML, and SVG documents, styled using Cascading Style
	  Sheets (CSS) and scripted with JavaScript. HTML documents can
	  be made fully editable by the user through the use of the
	  contenteditable attribute on HTML elements.

	  http://doc.qt.io/qt-5/qtwebengine-index.html

if BR2_PACKAGE_QT5WEBENGINE

config BR2_PACKAGE_QT5WEBENGINE_PROPRIETARY_CODECS
	bool "proprietary codecs"
	help
	  Qt WebEngine supports the MPEG-4 Part 14 (MP4) file format,
	  which includes required proprietary audio and video codecs,
	  such as H.264 and MPEG layer-3 (MP3).

config BR2_PACKAGE_QT5WEBENGINE_ALSA
	bool "alsa"
	select BR2_PACKAGE_ALSA_LIB
	select BR2_PACKAGE_ALSA_LIB_MIXER
	select BR2_PACKAGE_ALSA_LIB_RAWMIDI
	select BR2_PACKAGE_ALSA_LIB_HWDEP
	select BR2_PACKAGE_ALSA_LIB_SEQ
	help
	  Enable ALSA support.

endif
```
