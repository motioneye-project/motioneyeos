## package/qtopia4/Config.in
```kconfig
config BR2_PACKAGE_QTOPIA4
	bool "qtopia4"
	select BR2_INSTALL_LIBSTDCPP
	select BR2_PTHREADS_NATIVE
	help
	  Qtopia core 4.

	  http://www.trolltech.com/

if BR2_PACKAGE_QTOPIA4

config BR2_PACKAGE_QTOPIA4_DEBUG
	bool "Compile with debug support"
	help
	  If unsure, say N.

choice
	prompt "Library type"
	default BR2_PACKAGE_QTOPIA4_SHARED
	help
	  Selects the library type: Shared or Static

config BR2_PACKAGE_QTOPIA4_SHARED
	bool "Shared library"
	help
	  Create and use shared Qt libraries.
	  If you have multiple programs that depend on Qt or intend to use
	  plugins, say Y.

config BR2_PACKAGE_QTOPIA4_STATIC
	bool "Static Library"
	help
	  Create and use static Qt libraries.
	  If you don't have multiple programs on the target that depends on
	  Qt, then this will save you quite some of storage space.
	  If unsure, say Y.

endchoice

choice
	prompt "Qtopia 4 Core license type"
	default BR2_PACKAGE_QTOPIA4_LICENSE_TYPE_GPL
	help
	  Selects the type of license you which to use for Qtopia 4 Core.

config BR2_PACKAGE_QTOPIA4_LICENSE_TYPE_GPL
	bool "GPL license"

config BR2_PACKAGE_QTOPIA4_LICENSE_TYPE_COMMERCIAL
	bool "Commercial license"

endchoice

config BR2_PACKAGE_QTOPIA4_GPL_LICENSE_APPROVED
	bool "Approve Qtopia Core 4 GPL licence"
	depends on BR2_PACKAGE_QTOPIA4_LICENSE_TYPE_GPL
	help
	  Select this if you approve the GNU GENERAL PUBLIC LICENSE Version 2
	  on the Qtopia Core 4 library. By doing this you will not be asked
	  while the library is compiled. Please read and understand the GPL
	  licence before approving this.

	  For full GPL version 2 see http://www.gnu.org/licenses/gpl.txt


config BR2_PACKAGE_QTOPIA4_COMMERCIAL_USERNAME
	string "Qtopia Core 4 Commercial License Username"
	default ""
	depends on BR2_PACKAGE_QTOPIA4_LICENSE_TYPE_COMMERCIAL
	help
	  Commercial users can download their source directly by
	  providing a username.

config BR2_PACKAGE_QTOPIA4_COMMERCIAL_PASSWORD
	string "Qtopia Core 4 Commercial License Password"
	default ""
	depends on BR2_PACKAGE_QTOPIA4_LICENSE_TYPE_COMMERCIAL
	help
	  Commercial users can download their source directly by
	  providing a password.

config BR2_PACKAGE_QTOPIA4_QT3SUPPORT
	bool "Compatibility with Qt3"
	help
	  Turns on support for older Qt3. This will create an additional
	  library with proxy code and increase the space required on target.
	  If unsure say n.

config BR2_PACKAGE_QTOPIA4_DEPTHS
	string "color depths to support"
	default "-depths 24,16,8"
	help
	  Which color depths to support for the library. Default is "-depths
	  24,16,8". Different depths are specified by a comma separated list.

config BR2_PACKAGE_QTOPIA4_GIF
	bool "Enable GIF support"
	help
	  This compiles and installs the plugin for GIF reading support.

config BR2_PACKAGE_QTOPIA4_LIBMNG
	bool "Enable libmng support"
	help
	  This compiles and installs the plugin for MNG support.

choice
	prompt "JPEG support"
	default BR2_PACKAGE_QTOPIA4_NOJPEG
	help
	  Select libjpeg support.

config BR2_PACKAGE_QTOPIA4_NOJPEG
	bool "No jpeg support"
	help
	  Disable JPEG support

config BR2_PACKAGE_QTOPIA4_SYSTEMJPEG
	select BR2_PACKAGE_JPEG
	bool "System libjpeg"
	help
	  Link against system libjpeg

config BR2_PACKAGE_QTOPIA4_QTJPEG
	bool "Use Qt bundled libjpeg"
	help
	  Link against libjpeg proveded with Qt
endchoice

choice
	prompt "PNG support"
	default BR2_PACKAGE_QTOPIA4_NOPNG
	help
	  Select which library to use if PNG support should be enabled.

config BR2_PACKAGE_QTOPIA4_NOPNG
	bool "No PNG support"

config BR2_PACKAGE_QTOPIA4_SYSTEMPNG
	bool "System libpng"
	select BR2_PACKAGE_LIBPNG

config BR2_PACKAGE_QTOPIA4_QTPNG
	bool "Use Qt bundled libpng"
endchoice

choice
	prompt "TIFF support"
	default BR2_PACKAGE_QTOPIA4_NOTIFF
	help
	  Select which library to use if TIFF support should be enabled.

config BR2_PACKAGE_QTOPIA4_NOTIFF
	bool "No TIFF support"

config BR2_PACKAGE_QTOPIA4_SYSTEMTIFF
	bool "System libtiff"
	select BR2_PACKAGE_TIFF

config BR2_PACKAGE_QTOPIA4_QTTIFF
	bool "Use Qt bundled libtiff"
endchoice

choice
	prompt "zlib support"
	default BR2_PACKAGE_QTOPIA4_QTZLIB
	help
	  Select zlib support.

config BR2_PACKAGE_QTOPIA4_QTZLIB
	bool "Qt zlib"
	help
	  Use the zlib bundled with Qt.

config BR2_PACKAGE_QTOPIA4_SYSTEMZLIB
	bool "System zlib"
	select BR2_PACKAGE_ZLIB
	help
	  Use the shared zlib from the system.
endchoice

choice
	prompt "freetype2 support"
	default BR2_PACKAGE_QTOPIA4_NOFREETYPE
	help
	  Select freetype2 support.

config BR2_PACKAGE_QTOPIA4_NOFREETYPE
	bool "no freetype2 support"
	help
	  Do not compile in Freetype2 support.


config BR2_PACKAGE_QTOPIA4_QTFREETYPE
	bool "Qt freetype2"
	help
	  Use the libfreetype bundled with Qt.

config BR2_PACKAGE_QTOPIA4_SYSTEMFREETYPE
	bool "System freetype2"
	select BR2_PACKAGE_FREETYPE
	help
	  Use shared libfreetype from the target system.
	  See http://www.freetype.org/
endchoice

config BR2_PACKAGE_QTOPIA4_EMB_PLATFORM
	string "The embedded platform we are making Qtopia4 for"
	default "arm"	if BR2_arm
	default "arm"	if BR2_armeb
	default "avr32"	if BR2_avr32
	default "x86"	if BR2_i386
	default "x86_64"	if BR2_x86_64
	default "mips"	if BR2_mips
	default "mips"	if BR2_mipsel
# Not that I really believe these will work..
	default "generic"	if BR2_alpha
	default "generic"	if BR2_chris
	default "generic"	if BR2_m68k
	default "generic"	if BR2_nios2
	default "generic"	if BR2_powerpc
	default "generic"	if BR2_sh
	default "generic"	if BR2_sh64
	default "generic"	if BR2_sparc
	help
	  The target platform.

source "package/qtopia4/Config.sql.in"
source "package/qtopia4/Config.gfx.in"
source "package/qtopia4/Config.mouse.in"

config BR2_PACKAGE_QTOPIA4_PHONON
	bool "Phonon Module"
	select BR2_PACKAGE_GSTREAMER
	select BR2_PACKAGE_GST_PLUGINS_BASE
	help
	  Build the Phonon module. Support for different audio/video
	  formats can be configured at the GStreamer package.
	  If unsure, say n.

config BR2_PACKAGE_QTOPIA4_XMLPATTERNS
	bool "XML Patterns Module"
	help
	  Build QtXmlPatterns module.
	  If unsure, say n

config BR2_PACKAGE_QTOPIA4_SVG
	bool "SVG Module"
	help
	  Build the SVG module.
	  If unsure, say n

config BR2_PACKAGE_QTOPIA4_WEBKIT
	bool "WebKit Module"
	help
	  Build the WebKit module.
	  If unsure, say n.

config BR2_PACKAGE_QTOPIA4_OPENSSL
	bool "Enable OpenSSL support"
	select BR2_PACKAGE_OPENSSL
	help
	  Enable support for the OpenSSL encryption library. If you use
	  QSslSocket say y here, otherwise, say no to save space on the
	  target.
	  If unsure, say n.

endif # BR2_PACKAGE_QTOPIA4
```

## package/qtuio/Config.in
```kconfig
config BR2_PACKAGE_QTUIO
	bool "qtuio"
	depends on BR2_PACKAGE_QT_GUI_MODULE
	help
	  Implementation of an interface connecting TUIO messages
	  and QT events

	  https://github.com/x29a/qTUIO

if BR2_PACKAGE_QTUIO

config BR2_QTUIO_EXAMPLES
	bool "qtuio examples"
	help
	  Build and install qtuio examples

endif

comment "qtuio depends on QT gui module"
	depends on !BR2_PACKAGE_QT_GUI_MODULE
```

## package/quagga/Config.in
```kconfig
config BR2_PACKAGE_QUAGGA
	bool "quagga"
	help
	  Routing software suite, providing implementations of
	  OSPFv2, OSPFv3 (IPv6), RIP v1 and v2, RIPng (IPv6) and BGPv4+.

	  http://www.quagga.net/

if BR2_PACKAGE_QUAGGA

config BR2_PACKAGE_QUAGGA_ZEBRA
	bool "zebra daemon"
	depends on BR2_INET_IPV6
	help
	  Build zebra daemon.

comment "Zebra daemon requires a toolchain with IPV6 support"
	depends on BR2_PACKAGE_QUAGGA && !BR2_INET_IPV6

config BR2_PACKAGE_QUAGGA_TCP_ZEBRA
	bool "Use TCP sockets between zebra and protocol daemons"
	depends on BR2_PACKAGE_QUAGGA_ZEBRA
	help
	  Use a TCP socket to communicate between zebra (supervisor) and
	  the different protocol daemons.

	  You'll want this enabled if zebra and the protocol daemon(s) run
	  on different hosts.

config BR2_PACKAGE_QUAGGA_BABELD
	bool "BABEL protocol"
	depends on BR2_INET_IPV6
	help
	  Build babeld daemon.

config BR2_PACKAGE_QUAGGA_BGPD
	bool "BPGv4+ protocol"
	help
	  Build bpgd daemon.

config BR2_PACKAGE_QUAGGA_BGP_ANNOUNCE
	bool "BGP route announcement"
	depends on BR2_PACKAGE_QUAGGA_BGPD

config BR2_PACKAGE_QUAGGA_ISISD
	bool "IS-IS protocol"
	help
	  Enable isisd support in quagga.

config BR2_PACKAGE_QUAGGA_OSPFD
	bool "OSPFv2 protocol"
	help
	  Build ospfd daemon.

config BR2_PACKAGE_QUAGGA_OPAQUE_LSA
	bool "OSPF Opaque-LSA with OSPFAPI support (RFC2370)"
	depends on BR2_PACKAGE_QUAGGA_OSPFD

config BR2_PACKAGE_QUAGGA_OSPF6D
	bool "OSPFv3 (IPv6) protocol"
	depends on BR2_INET_IPV6
	help
	  Build ospf6d daemon.

config BR2_PACKAGE_QUAGGA_RIPD
	bool "RIPv2/v3 protocol"
	help
	  Build ripd daemon.

config BR2_PACKAGE_QUAGGA_RIPNGD
	bool "RIPng (IPv6) protocol"
	depends on BR2_INET_IPV6
	help
	  Build ripngd daemon.

config BR2_PACKAGE_QUAGGA_WATCHQUAGGA
	bool "Build watchquagga"
	help
	  Build and install watchquagga, a zebra/protocol daemon supervisor.

config BR2_PACKAGE_QUAGGA_SNMP
	bool "SNMP support"
	select BR2_PACKAGE_NETSNMP
	help
	  Make quagga information available via SNMP SMUX.

comment "AgentX support must be enabled in net-snmp or the build will break"
	depends on BR2_PACKAGE_QUAGGA_SNMP

endif
```

## package/quazip/Config.in
```kconfig
config BR2_PACKAGE_QUAZIP
	bool "quazip"
	depends on BR2_PACKAGE_QT5
	select BR2_PACKAGE_ZLIB
	help
	  QuaZIP is a simple C++ wrapper over Gilles Vollant's
	  ZIP/UNZIP package that can be used to access ZIP
	  archives. It uses the Qt toolkit.

	  http://quazip.sourceforge.net
```

## package/quota/Config.in
```kconfig
config BR2_PACKAGE_QUOTA
	bool "quota"
	depends on BR2_USE_WCHAR
	depends on BR2_USE_MMU # fork()
	depends on BR2_TOOLCHAIN_HAS_NATIVE_RPC || BR2_TOOLCHAIN_HAS_THREADS # libtirpc
	select BR2_PACKAGE_LIBTIRPC if !BR2_TOOLCHAIN_HAS_NATIVE_RPC
	help
	  Implementation of the disk quota system.

	  http://sourceforge.net/projects/linuxquota/

comment "quota needs a toolchain w/ wchar, threads"
	depends on BR2_USE_MMU
	depends on !BR2_USE_WCHAR || \
		!(BR2_TOOLCHAIN_HAS_THREADS || BR2_TOOLCHAIN_HAS_NATIVE_RPC)
```

## package/quotatool/Config.in
```kconfig
config BR2_PACKAGE_QUOTATOOL
	bool "quotatool"
	help
	  Quotatool is a utility to manipulate filesystem quotas from
	  the commandline.

	  http://quotatool.ekenberg.se/
```

## package/qwt/Config.in
```kconfig
config BR2_PACKAGE_QWT
	bool "qwt"
	depends on BR2_PACKAGE_QT5
	select BR2_PACKAGE_QT5BASE
	select BR2_PACKAGE_QT5BASE_GUI
	select BR2_PACKAGE_QT5BASE_WIDGETS # printsupport
	select BR2_PACKAGE_QT5BASE_CONCURRENT
	help
	  Qwt is a graphics extension to the Qt GUI application
	  framework. It provides a 2D plotting widget and more.

	  http://qwt.sourceforge.net/

if BR2_PACKAGE_QWT

config BR2_PACKAGE_QWT_SVG
	bool "SVG support"
	select BR2_PACKAGE_QT5SVG

config BR2_PACKAGE_QWT_MATHML
	bool "MathML support"

config BR2_PACKAGE_QWT_OPENGL
	bool "OpenGL support"
	depends on BR2_PACKAGE_QT5_GL_AVAILABLE
	select BR2_PACKAGE_QT5BASE_OPENGL
	select BR2_PACKAGE_QT5BASE_OPENGL_LIB

endif
```

## package/rabbitmq-c/Config.in
```kconfig
config BR2_PACKAGE_RABBITMQ_C
	bool "rabbitmq-c"
	depends on !BR2_STATIC_LIBS
	depends on BR2_TOOLCHAIN_HAS_THREADS
	help
	  This is a C-language AMQP client library for use with v2.0+
	  of the RabbitMQ broker.

	  https://github.com/alanxz/rabbitmq-c

comment "rabbitmq-c needs a toolchain w/ dynamic library, threads"
	depends on BR2_STATIC_LIBS || !BR2_TOOLCHAIN_HAS_THREADS
```

## package/racehound/Config.in
```kconfig
config BR2_PACKAGE_RACEHOUND
	bool "racehound"
	depends on BR2_LINUX_KERNEL
	depends on BR2_TOOLCHAIN_HEADERS_AT_LEAST_3_14
	depends on BR2_INSTALL_LIBSTDCPP
	depends on BR2_USE_WCHAR # elfutils
	depends on !BR2_STATIC_LIBS # elfutils
	depends on BR2_TOOLCHAIN_USES_UCLIBC || BR2_TOOLCHAIN_USES_GLIBC # elfutils
	# only x86/x86_64 supported
	depends on BR2_i386 || BR2_x86_64
	select BR2_PACKAGE_ELFUTILS
	select BR2_LINUX_NEEDS_MODULES # not using kernel-module infra
	help
	  RaceHound can be used to detect data races in the Linux
	  kernel on x86.

	  RaceHound needs the following kernel configurations enabled:
	  - CONFIG_X86_32 or CONFIG_X86_64
	  - CONFIG_MODULES
	  - CONFIG_MODULE_UNLOAD
	  - CONFIG_SYSFS
	  - CONFIG_DEBUG_FS
	  - CONFIG_KALLSYMS
	  - CONFIG_KALLSYMS_ALL
	  - CONFIG_KPROBES

	  https://github.com/winnukem/racehound

comment "racehound needs an Linux kernel >= 3.14 to be built"
	depends on !BR2_LINUX_KERNEL || !BR2_TOOLCHAIN_HEADERS_AT_LEAST_3_14
	depends on BR2_i386 || BR2_x86_64

comment "racehound needs a uClibc or (e)glibc toolchain w/ C++, wchar, dynamic library"
	depends on BR2_i386 || BR2_x86_64
	depends on !BR2_INSTALL_LIBSTDCPP || !BR2_USE_WCHAR || BR2_STATIC_LIBS \
		|| !(BR2_TOOLCHAIN_USES_UCLIBC || BR2_TOOLCHAIN_USES_GLIBC)
```

## package/radvd/Config.in
```kconfig
config BR2_PACKAGE_RADVD
	bool "radvd"
	depends on BR2_USE_MMU # fork()
	help
	  IPv6 Router Advertisement Daemon.

	  On busybox and sysvinit systems, radvd will be started only if
	  a /etc/radvd.conf exists.

	  To enable it at build time with systemd, add /etc/radvd.conf
	  and a /etc/systemd/system-preset/40-radvd.preset file with

	    enable radvd.service

	  http://www.litech.org/radvd/
```

## package/raidtools/Config.in
```kconfig
config BR2_PACKAGE_RAIDTOOLS
	bool "raidtools"
	help
	  Utilities to support 'old-style' RAID disks.

	  http://people.redhat.com/mingo/raidtools/
```

## package/ramsmp/Config.in
```kconfig
config BR2_PACKAGE_RAMSMP
	bool "ramspeed/smp"
	depends on BR2_USE_MMU # fork()
	help
	  RAMspeed/SMP is a free open source command line utility
	  to measure cache and memory performance of multiprocessor machines.

	  http://alasir.com/software/ramspeed/
```

## package/ranger/Config.in
```kconfig
config BR2_PACKAGE_RANGER
	bool "ranger"
	depends on BR2_USE_MMU # python3
	depends on BR2_USE_WCHAR # python3
	depends on BR2_TOOLCHAIN_HAS_THREADS # python3
	depends on !BR2_STATIC_LIBS # python3
	select BR2_PACKAGE_PYTHON3 if !BR2_PACKAGE_PYTHON
	select BR2_PACKAGE_PYTHON_CURSES if BR2_PACKAGE_PYTHON
	select BR2_PACKAGE_PYTHON3_CURSES if BR2_PACKAGE_PYTHON3
	help
	  ranger is a console file manager with VI key bindings. It
	  provides a minimalistic and nice curses interface with a
	  view on the directory hierarchy.  It ships with "rifle", a
	  file launcher that is good at automatically finding out
	  which program to use for what file type.

	  http://ranger.nongnu.org

comment "ranger needs a toolchain w/ wchar, threads, dynamic library"
	depends on BR2_USE_MMU
	depends on !BR2_USE_WCHAR || !BR2_TOOLCHAIN_HAS_THREADS || BR2_STATIC_LIBS
```

## package/rapidjson/Config.in
```kconfig
config BR2_PACKAGE_RAPIDJSON
	bool "rapidjson"
	depends on BR2_INSTALL_LIBSTDCPP
	help
	  A fast JSON parser/generator for C++ with both SAX/DOM style API.

	  http://rapidjson.org/

comment "rapidjson needs a toolchain w/ C++"
	depends on !BR2_INSTALL_LIBSTDCPP
```

## package/rapidxml/Config.in
```kconfig
config BR2_PACKAGE_RAPIDXML
	bool "rapidxml"
	help
	  RapidXml is an attempt to create the fastest XML parser
	  possible, while retaining useability, portability and
	  reasonable W3C compatibility. It is an in-situ parser with
	  parsing speed approaching speed of strlen function executed
	  on the same data.

	  http://sourceforge.net/projects/rapidxml/
	  https://en.wikipedia.org/wiki/RapidXml
```

## package/raspberrypi-usbboot/Config.in.host
```kconfig
config BR2_PACKAGE_HOST_RASPBERRYPI_USBBOOT
	bool "host raspberrypi-usbboot"
	depends on BR2_arm
	help
	  This package builds and install the "rpiboot" tool for the
	  host machine. This tool allows to boot the Broadcom BCM
	  processor used in the RaspberryPi to boot over USB, and have
	  it expose a USB mass storage device in order to reflash the
	  built-in storage of the RaspberryPi (useful for the eMMC
	  built into the Compute module).

	  https://github.com/raspberrypi/usbboot
```
