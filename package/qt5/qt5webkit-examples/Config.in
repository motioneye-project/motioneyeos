## package/qt5/qt5webkit-examples/Config.in
```kconfig
config BR2_PACKAGE_QT5WEBKIT_EXAMPLES
	bool "qt5webkit examples"
	depends on BR2_PACKAGE_QT5WEBKIT
	help
	  Qt is a cross-platform application and UI framework for
	  developers using C++.

	  This package contains examples for the qt5webkit module.

	  This package has been tagged as deprecated since version
	  5.5.0 and should be replaced by Qt WebEngine module in
	  new design.

	  http://qt.io
```

## package/qt5/qt5webkit/Config.in
```kconfig
config BR2_PACKAGE_QT5WEBKIT
	bool "qt5webkit"
	select BR2_PACKAGE_QT5BASE
	select BR2_PACKAGE_QT5BASE_ICU
	select BR2_PACKAGE_QT5BASE_GUI
	select BR2_PACKAGE_SQLITE
	select BR2_PACKAGE_XLIB_LIBXEXT if BR2_PACKAGE_QT5BASE_XCB
	select BR2_PACKAGE_XLIB_LIBXRENDER if BR2_PACKAGE_QT5BASE_XCB
	depends on !BR2_STATIC_LIBS
	depends on BR2_PACKAGE_QT5_JSCORE_AVAILABLE
	depends on !BR2_BINFMT_FLAT # icu
	help
	  Qt is a cross-platform application and UI framework for
	  developers using C++.

	  This package corresponds to the qt5webkit module.

	  This package has been removed from the official release packages
	  since Qt5.6.0, but it is still available for users to build it
	  from source. This is useful for platforms without GPU since the
	  successor (QtWebEngine) requires OpenGL support.

	  http://qt.io

comment "qt5webkit needs a toolchain w/ dynamic library"
	depends on BR2_STATIC_LIBS
	depends on BR2_PACKAGE_QT5_JSCORE_AVAILABLE
	depends on !BR2_BINFMT_FLAT
```

## package/qt5/qt5websockets/Config.in
```kconfig
config BR2_PACKAGE_QT5WEBSOCKETS
	bool "qt5websockets"
	select BR2_PACKAGE_QT5BASE
	select BR2_PACKAGE_QT5BASE_NETWORK
	help
	  Qt is a cross-platform application and UI framework for
	  developers using C++.

	  The Qt WebSockets module provides C++ and QML interfaces
	  that enable Qt applications to act as a server that can
	  process WebSocket requests, or a client that can
	  consume data received from the server, or both.

	  http://doc.qt.io/qt-5/qtwebsockets-index.html
```

## package/qt5/qt5webview/Config.in
```kconfig
config BR2_PACKAGE_QT5WEBVIEW
	bool "qt5webview"
	depends on BR2_PACKAGE_QT5WEBENGINE
	help
	  Qt is a cross-platform application and UI framework for
	  developers using C++.

	  Qt WebView provides a way to display web content in
	  a QML application without necessarily including
	  a full web browser stack by using native APIs where
	  it makes sense.

	  https://doc.qt.io/qt-5/qtwebview-index.html

comment "qt5webview needs qt5webengine module"
	depends on !BR2_PACKAGE_QT5WEBENGINE
```

## package/qt5/qt5x11extras/Config.in
```kconfig
config BR2_PACKAGE_QT5X11EXTRAS
	bool "qt5x11extras"
	depends on BR2_PACKAGE_QT5BASE_XCB
	select BR2_PACKAGE_QT5BASE_WIDGETS
	help
	  Qt is a cross-platform application and UI framework for
	  developers using C++.

	  Qt X11 Extras enables the Qt programmer to write
	  applications for the Linux/X11 platform.

	  http://doc.qt.io/qt-5/qtx11extras-index.html
```

## package/qt5/qt5xmlpatterns/Config.in
```kconfig
config BR2_PACKAGE_QT5XMLPATTERNS
	bool "qt5xmlpatterns"
	select BR2_PACKAGE_QT5BASE
	help
	  Qt is a cross-platform application and UI framework for
	  developers using C++.

	  The Qt XML Patterns module provides support for XPath,
	  XQuery, XSLT, and XML Schema validation.

	  http://doc.qt.io/qt-5/qtxmlpatterns-index.html
```

## package/qt5cinex/Config.in
```kconfig
comment "qt5cinex needs an Open(E)GL-capable backend"
	depends on BR2_PACKAGE_QT5
	depends on BR2_PACKAGE_QT5_JSCORE_AVAILABLE
	depends on !BR2_PACKAGE_QT5_GL_AVAILABLE || !BR2_PACKAGE_HAS_LIBEGL

config BR2_PACKAGE_QT5CINEX
	bool "qt5cinex"
	depends on BR2_PACKAGE_QT5
	depends on BR2_PACKAGE_HAS_LIBEGL # qt5base-eglfs
	depends on BR2_PACKAGE_QT5_GL_AVAILABLE
	# No comment needed for this option, it's an architecture
	# dependency.
	depends on BR2_PACKAGE_QT5_JSCORE_AVAILABLE
	select BR2_PACKAGE_QT5BASE_NETWORK
	select BR2_PACKAGE_QT5BASE_PNG
	select BR2_PACKAGE_QT5BASE_WIDGETS
	select BR2_PACKAGE_QT5BASE_EGLFS
	select BR2_PACKAGE_QT5GRAPHICALEFFECTS
	help
	  This application demonstrates the power of Qt5 and few of the new
	  additions available in QtQuick 2.0.

	  http://quitcoding.com/?page=work#cinex

if BR2_PACKAGE_QT5CINEX

config BR2_PACKAGE_QT5CINEX_HD
	bool "High-definition version (aka RPi Edition)"
	help
	  High definition version (1920x1080 resolution) of the
	  application, optimised for Raspberry PI cards. This version
	  can also be run on any platform supported by Qt5.

endif
```

## package/qte/Config.in
```kconfig
config BR2_PACKAGE_QTE
	bool "Qt/E"
	default n
	select BR2_INSTALL_LIBSTDCPP
	select BR2_PTHREADS_NATIVE
	select BR2_PACKAGE_JPEG
	select BR2_PACKAGE_LIBPNG
	help
	  Trolltech's Qt/Embedded, which offers the same APIs used in building desktop applications tailored to a smaller footprint.

	  http://trolltech.com/

	  Only tested with threading on, PACKAGE_JPEG, PACKAGE_LIBPNG, but remove those if you like.


config BR2_PACKAGE_QTE_COMMERCIAL_USERNAME
	string "Qt/E Commercial License Username"
	default ""
	depends BR2_PACKAGE_QTE
	help
	    Commercial users can download their source directly by providing a username.  I do not mean this to be a political or economic statement, just a convenience function


config BR2_PACKAGE_QTE_COMMERCIAL_PASSWORD
	string "Qt/E Commercial License Password"
	default ""
	depends BR2_PACKAGE_QTE
	help
	    Commercial users can download their source directly by providing a password.  I do not mean this to be a political or economic statement, just a convenience function


choice
	prompt "Qt/E Version"
	default BR2_QTE_VERSION_2_3_11
	depends BR2_PACKAGE_QTE
	help
	  Select the version of Qt/E you wish to use.

	config BR2_QTE_VERSION_2_3_8
	        bool "Qt/E 2.3.8"

	config BR2_QTE_VERSION_2_3_9
	        bool "Qt/E 2.3.9"

	config BR2_QTE_VERSION_2_3_10
	        bool "Qt/E 2.3.10"

	config BR2_QTE_VERSION_2_3_11
	        bool "Qt/E 2.3.11"

endchoice

config BR2_QTE_VERSION
	string
	default "2.3.8"		if BR2_QTE_VERSION_2_3_8
	default "2.3.9"		if BR2_QTE_VERSION_2_3_9
	default "2.3.10"		if BR2_QTE_VERSION_2_3_10
	default "2.3.11"		if BR2_QTE_VERSION_2_3_11


config BR2_PACKAGE_QTE_QVFB
	bool "QVfb"
	default n
	depends BR2_PACKAGE_QTE
	help
	  Trolltech provides a Virtual Framebuffer used to simulate the embedded device during development

	  http://trolltech.com/

choice
	prompt "QVfb Version"
	default BR2_QTE_QVFB_VERSION_2_3_2
	depends BR2_PACKAGE_QTE_QVFB
	help
	  Select the version of QVfb you wish to use.

	config BR2_QTE_QVFB_VERSION_2_3_2
	        bool "QVfb 2.3.2"

	config BR2_QTE_QVFB_VERSION_2_3_9
	        bool "QVfb 2.3.9"

endchoice

config BR2_QTE_QVFB_VERSION
	string
	default "2.3.2"		if BR2_QTE_QVFB_VERSION_2_3_2
	default "2.3.9"		if BR2_QTE_QVFB_VERSION_2_3_9



config BR2_PACKAGE_QTE_QT3
	bool "Qt/E-3.3.x for Qtopia build"
	default n
	depends BR2_PACKAGE_QTE_QTOPIA
	help
	  Qtopia requires a Qt/E version >= 3.3.0; when using a Qt/E-2.3.x on the runtime, Qtopia still needs a Qt/E-3.3.x codebase to build

	  http://trolltech.com/

choice
	prompt "QT/E v3 Version"
	default BR2_QTE_QT3_VERSION_3_3_4
	depends BR2_PACKAGE_QTE_QT3
	help
	  Select the version of QVfb you wish to use.

	config BR2_QTE_QT3_VERSION_3_3_4
	        bool "Qt/E 3.3.4"

	config BR2_QTE_QT3_VERSION_3_3_3
	        bool "Qt/E 3.3.3"

endchoice

config BR2_QTE_QT3_VERSION
	string
	default "3.3.4"		if BR2_QTE_QT3_VERSION_3_3_4
	default "3.3.3"		if BR2_QTE_QT3_VERSION_3_3_3


config BR2_PACKAGE_QTE_QTOPIA
	bool "Qtopia"
	default n
	depends BR2_PACKAGE_QTE
	help
	  Qtopia defines some more advanced components used for mobile devices

	  http://trolltech.com/

choice
	prompt "Qtopia Version"
	default BR2_QTE_QTOPIA_VERSION_2_1_2
	depends BR2_PACKAGE_QTE_QTOPIA
	help
	  Select the version of Qtopia you wish to use.

	config BR2_QTE_QTOPIA_VERSION_2_1_1
	        bool "Qtopia 2.1.1"

	config BR2_QTE_QTOPIA_VERSION_2_1_2
	        bool "Qtopia 2.1.2"

endchoice

config BR2_QTE_QTOPIA_VERSION
	string
	default "2.1.1"		if BR2_QTE_QTOPIA_VERSION_2_1_1
	default "2.1.2"		if BR2_QTE_QTOPIA_VERSION_2_1_2

config BR2_QTE_TMAKE_VERSION
	string
	default "1.13"
	depends BR2_PACKAGE_QTE

# generated from:
# ls ~/src/buildroot/build_arm/qt-2.3.10/configs/*-static|cut -c56-|sed -e 's/-static//g'|\
#   awk '{BR="BR2_QTE_CROSS_"toupper($1); gsub("-","_",BR); gsub("+","P",BR); printf"\tconfig %s\n\t\tbool \"%s\"\n\n",BR,$1}'

choice
	prompt "Qt/E Cross-Compiler Target Platform"
	default BR2_QTE_CROSS_LINUX_ARM_GPP
	depends BR2_PACKAGE_QTE
	help
	  Select the Qt cross-platform string for your build

	config BR2_QTE_CROSS_CYGWIN_ARM_GPP
		# qtopia-phone does not have this platform in qtopia-phone-2.1.1/src/libraries/qtopia/custom-cygwin-arm-g++.{cpp,h}
		depends !BR2_PACKAGE_QTE_QTOPIA
		bool "cygwin-arm-g++"

	config BR2_QTE_CROSS_CYGWIN_IPAQ_GPP
		# qtopia-phone does not have this platform in qtopia-phone-2.1.1/src/libraries/qtopia/custom-cygwin-ipaq-g++.{cpp,h}
		depends !BR2_PACKAGE_QTE_QTOPIA
		bool "cygwin-ipaq-g++"

	config BR2_QTE_CROSS_CYGWIN_SHARP_GPP
		# qtopia-phone does not have this platform in qtopia-phone-2.1.1/src/libraries/qtopia/custom-cygwin-sharp-g++.{cpp,h}
		depends !BR2_PACKAGE_QTE_QTOPIA
		bool "cygwin-sharp-g++"

	config BR2_QTE_CROSS_FREEBSD_GPP
		# qtopia-phone does not have this platform in qtopia-phone-2.1.1/src/libraries/qtopia/custom-freebsd-g++.{cpp,h}
		depends !BR2_PACKAGE_QTE_QTOPIA
		bool "freebsd-g++"

	config BR2_QTE_CROSS_LINUX_ARM_GPP
		# qtopia-phone does not have this platform in qtopia-phone-2.1.1/src/libraries/qtopia/custom-linux-arm-g++.{cpp,h}
		depends !BR2_PACKAGE_QTE_QTOPIA
		bool "linux-arm-g++"

	config BR2_QTE_CROSS_LINUX_CASSIOPEIA_GPP
		bool "linux-cassiopeia-g++"

	config BR2_QTE_CROSS_LINUX_GENERIC_GPP
		bool "linux-generic-g++"

	config BR2_QTE_CROSS_LINUX_INNOVATOR_GPP
		bool "linux-innovator-g++"

	config BR2_QTE_CROSS_LINUX_IPAQ_GPP
		bool "linux-ipaq-g++"

	config BR2_QTE_CROSS_LINUX_KOALA_GPP
		# qtopia-phone does not have this platform in qtopia-phone-2.1.1/src/libraries/qtopia/custom-linux-koala-g++.{cpp,h}
		depends !BR2_PACKAGE_QTE_QTOPIA
		bool "linux-koala-g++"

	config BR2_QTE_CROSS_LINUX_MIPS_GPP
		# qtopia-phone does not have this platform in qtopia-phone-2.1.1/src/libraries/qtopia/custom-linux-mips-g++.{cpp,h}
		depends !BR2_PACKAGE_QTE_QTOPIA
		bool "linux-mips-g++"

	config BR2_QTE_CROSS_LINUX_SH3_GPP
		# qtopia-phone does not have this platform in qtopia-phone-2.1.1/src/libraries/qtopia/custom-linux-sh3-g++.{cpp,h}
		depends !BR2_PACKAGE_QTE_QTOPIA
		bool "linux-sh3-g++"

	config BR2_QTE_CROSS_LINUX_SHARP_GPP
		bool "linux-sharp-g++"

	config BR2_QTE_CROSS_LINUX_X86_GPP
		bool "linux-x86-g++"

	config BR2_QTE_CROSS_QNX_RTP_GPP
		# qtopia-phone does not have this platform in qtopia-phone-2.1.1/src/libraries/qtopia/custom-qnx-rtp-g++.{cpp,h}
		depends !BR2_PACKAGE_QTE_QTOPIA
		bool "qnx-rtp-g++"

	config BR2_QTE_CROSS_SOLARIS_GPP
		# qtopia-phone does not have this platform in qtopia-phone-2.1.1/src/libraries/qtopia/custom-solaris-g++.{cpp,h}
		depends !BR2_PACKAGE_QTE_QTOPIA
		bool "solaris-g++"

	config BR2_QTE_CROSS_WIN32_MSVC
		# qtopia-phone does not have this platform in qtopia-phone-2.1.1/src/libraries/qtopia/custom-win32-msvc.{cpp,h}
		depends !BR2_PACKAGE_QTE_QTOPIA
		bool "win32-msvc"

endchoice

config BR2_QTE_CROSS_PLATFORM
	string
# generated from:
# ls ~/src/buildroot/build_arm/qt-2.3.10/configs/*-static|cut -c56-|sed -e 's/-static//g'|\
#   awk '{BR="BR2_QTE_CROSS_"toupper($1); gsub("-","_",BR); gsub("+","P",BR); printf"\tdefault \"%s\"\tif %s\n",$1,BR}'
	default "cygwin-arm-g++"	if BR2_QTE_CROSS_CYGWIN_ARM_GPP
	default "cygwin-ipaq-g++"	if BR2_QTE_CROSS_CYGWIN_IPAQ_GPP
	default "cygwin-sharp-g++"	if BR2_QTE_CROSS_CYGWIN_SHARP_GPP
	default "freebsd-g++"	if BR2_QTE_CROSS_FREEBSD_GPP
	default "linux-arm-g++"	if BR2_QTE_CROSS_LINUX_ARM_GPP
	default "linux-cassiopeia-g++"	if BR2_QTE_CROSS_LINUX_CASSIOPEIA_GPP
	default "linux-generic-g++"	if BR2_QTE_CROSS_LINUX_GENERIC_GPP
	default "linux-innovator-g++"	if BR2_QTE_CROSS_LINUX_INNOVATOR_GPP
	default "linux-ipaq-g++"	if BR2_QTE_CROSS_LINUX_IPAQ_GPP
	default "linux-koala-g++"	if BR2_QTE_CROSS_LINUX_KOALA_GPP
	default "linux-mips-g++"	if BR2_QTE_CROSS_LINUX_MIPS_GPP
	default "linux-sh3-g++"	if BR2_QTE_CROSS_LINUX_SH3_GPP
	default "linux-sharp-g++"	if BR2_QTE_CROSS_LINUX_SHARP_GPP
	default "linux-x86-g++"	if BR2_QTE_CROSS_LINUX_X86_GPP
	default "qnx-rtp-g++"	if BR2_QTE_CROSS_QNX_RTP_GPP
	default "solaris-g++"	if BR2_QTE_CROSS_SOLARIS_GPP
	default "win32-msvc"	if BR2_QTE_CROSS_WIN32_MSVC
```
