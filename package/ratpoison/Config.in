## package/ratpoison/Config.in
```kconfig
config BR2_PACKAGE_RATPOISON
	bool "ratpoison"
	depends on BR2_USE_MMU
	depends on BR2_PACKAGE_XORG7
	select BR2_PACKAGE_FONTCONFIG
	select BR2_PACKAGE_LIBERATION
	select BR2_PACKAGE_XLIB_LIBX11
	help
	  Ratpoison is a simple Window Manager. It is largely modelled
	  after GNU Screen and focuses on the keyboard instead of a
	  mouse.

	  The screen can be split into non-overlapping frames.  All
	  windows are kept maximized inside their frames to take full
	  advantage of your precious screen real estate.

	  http://www.nongnu.org/ratpoison/
```

## package/rauc/Config.in
```kconfig
config BR2_PACKAGE_RAUC
	bool "rauc"
	depends on BR2_TOOLCHAIN_HAS_THREADS # glib2
	depends on BR2_USE_MMU # glib2
	depends on BR2_USE_WCHAR # glib2
	select BR2_PACKAGE_LIBGLIB2
	select BR2_PACKAGE_OPENSSL
	select BR2_PACKAGE_DBUS
	select BR2_PACKAGE_SQUASHFS # run-time dependency
	select BR2_PACKAGE_UBOOT_TOOLS if BR2_TARGET_UBOOT # run-time dependency
	select BR2_PACKAGE_UBOOT_TOOLS_FWPRINTENV if BR2_TARGET_UBOOT
	help
	  RAUC is the Robust Auto-Update Controller developed by
	  Pengutronix. It supports updating embedded Linux
	  systems over the network or from disks and provides a
	  d-bus interface.

	  http://rauc.io/

if BR2_PACKAGE_RAUC

config BR2_PACKAGE_RAUC_NETWORK
	bool "network support"
	select BR2_PACKAGE_LIBCURL
	help
	  This option enables support for updating firmware over
	  the network using libcurl.

config BR2_PACKAGE_RAUC_JSON
	bool "JSON output support"
	select BR2_PACKAGE_JSON_GLIB
	help
	  This option enables support for providing output in
	  JSON format.

endif

comment "rauc needs a toolchain w/ wchar, threads"
	depends on !BR2_USE_WCHAR || !BR2_TOOLCHAIN_HAS_THREADS
	depends on BR2_USE_MMU
```

## package/rauc/Config.in.host
```kconfig
config BR2_PACKAGE_HOST_RAUC
	bool "host rauc"
	select BR2_PACKAGE_HOST_SQUASHFS # run-time dependency
	help
	  RAUC is the Robust Auto-Update Controller developed by
	  Pengutronix. Enable this option to build the rauc
	  host tool which may be used to generate firmware
	  bundles that are handled by the target rauc service.

	  http://rauc.io/
```

## package/rcw/Config.in.host
```kconfig
config BR2_PACKAGE_HOST_RCW
	bool "host rcw"
	help
	  This package provides an reset configuration word(RCW)
	  compiler to build NXP QoriQ/LS PBL/RCW binary(s).

	  The package installs example configurations and scripts
	  for each devkit supported in the current release see
	  $(HOST_DIR)/share/rcw. Either a SDK or post scripts can
	  then use this toolset and examples.

	  https://source.codeaurora.org/external/qoriq/qoriq-components/rcw/

if BR2_PACKAGE_HOST_RCW

config BR2_PACKAGE_HOST_RCW_CUSTOM_PATH
	string "RCW Source file paths"
	help
	  Space-separated list of .rcw and .rcwi files, that will be
	  used to generate a RCW binary. The entire list of .rcwi files
	  used by the .rcw file must be specified. There must be a
	  single .rcw file in the list.

	  This is optional. If left empty, the rcw package will be
	  included for use in the SDK or with post scripts but no
	  RCW binary will not be generated.

endif
```

## package/rdesktop/Config.in
```kconfig
config BR2_PACKAGE_RDESKTOP
	bool "rdesktop"
	depends on BR2_USE_MMU # fork()
	depends on !BR2_STATIC_LIBS # gnutls
	depends on BR2_USE_WCHAR # gnutls
	depends on BR2_PACKAGE_XORG7
	select BR2_PACKAGE_GNUTLS
	select BR2_PACKAGE_LIBICONV if !BR2_ENABLE_LOCALE
	select BR2_PACKAGE_LIBTASN1
	select BR2_PACKAGE_NETTLE
	select BR2_PACKAGE_XLIB_LIBX11
	select BR2_PACKAGE_XLIB_LIBXCURSOR
	select BR2_PACKAGE_XLIB_LIBXT
	help
	  rdesktop is an open source client for Windows NT Terminal
	  Server and Windows 2000/2003 Terminal Services, capable of
	  natively speaking Remote Desktop Protocol (RDP) in order to
	  present the user's NT desktop.

	  http://rdesktop.sf.net/

comment "rdesktop needs a toolchain w/ wchar, dynamic library"
	depends on BR2_USE_MMU
	depends on !BR2_USE_WCHAR || BR2_STATIC_LIBS
```

## package/readline/Config.in
```kconfig
config BR2_PACKAGE_READLINE
	bool "readline"
	select BR2_PACKAGE_NCURSES
	help
	  The GNU Readline library provides a set of functions for use
	  by applications that allow users to edit command lines
	  as they are typed in.

	  https://tiswww.case.edu/php/chet/readline/rltop.html
```

## package/reaver/Config.in
```kconfig
config BR2_PACKAGE_REAVER
	bool "reaver"
	select BR2_PACKAGE_LIBPCAP
	help
	  Reaver is a tool to audit networks against brute WPS pins
	  attacks. It is complementary to "Aircrack-ng".

	  https://code.google.com/archive/p/reaver-wps/wikis/README.wiki
	  https://github.com/t6x/reaver-wps-fork-t6x
```

## package/redis/Config.in
```kconfig
config BR2_PACKAGE_REDIS
	bool "redis"
	depends on BR2_USE_MMU # fork()
	depends on !BR2_STATIC_LIBS # dlfcn.h
	depends on BR2_TOOLCHAIN_HAS_ATOMIC
	depends on BR2_TOOLCHAIN_HAS_THREADS
	help
	  Redis is an open source, advanced key-value store. It is
	  often referred to as a data structure server since keys can
	  contain strings, hashes, lists, sets and sorted sets.

	  http://www.redis.io

comment "redis needs a toolchain w/ dynamic library, threads"
	depends on BR2_USE_MMU
	depends on BR2_TOOLCHAIN_HAS_ATOMIC
	depends on BR2_STATIC_LIBS || !BR2_TOOLCHAIN_HAS_THREADS
```

## package/refpolicy/Config.in
```kconfig
config BR2_PACKAGE_REFPOLICY
	bool "refpolicy"
	depends on BR2_TOOLCHAIN_HAS_THREADS # libsepol
	# Even though libsepol is not necessary for building, we get
	# the policy version from libsepol, so we select it, and treat
	# it like a runtime dependency.
	select BR2_PACKAGE_LIBSEPOL
	help
	  The SELinux Reference Policy project (refpolicy) is a
	  complete SELinux policy that can be used as the system
	  policy for a variety of systems and used as the basis for
	  creating other policies. Reference Policy was originally
	  based on the NSA example policy, but aims to accomplish many
	  additional goals.

	  The current refpolicy does not fully support Buildroot and
	  needs modifications to work with the default system file
	  layout. These changes should be added as patches to the
	  refpolicy that modify a single SELinux policy.

	  The refpolicy works for the most part in permissive
	  mode. Only the basic set of utilities are enabled in the
	  example policy config and some of the pathing in the
	  policies is not correct.  Individual policies would need to
	  be tweaked to get everything functioning properly.

	  https://github.com/TresysTechnology/refpolicy

if BR2_PACKAGE_REFPOLICY

choice
	prompt "SELinux default state"
	default BR2_PACKAGE_REFPOLICY_POLICY_STATE_PERMISSIVE

config BR2_PACKAGE_REFPOLICY_POLICY_STATE_ENFORCING
	bool "Enforcing"
	help
	  SELinux security policy is enforced

config BR2_PACKAGE_REFPOLICY_POLICY_STATE_PERMISSIVE
	bool "Permissive"
	help
	  SELinux prints warnings instead of enforcing

config BR2_PACKAGE_REFPOLICY_POLICY_STATE_DISABLED
	bool "Disabled"
	help
	  No SELinux policy is loaded
endchoice

config BR2_PACKAGE_REFPOLICY_POLICY_STATE
	string
	default "permissive" if BR2_PACKAGE_REFPOLICY_POLICY_STATE_PERMISSIVE
	default "enforcing" if BR2_PACKAGE_REFPOLICY_POLICY_STATE_ENFORCING
	default "disabled" if BR2_PACKAGE_REFPOLICY_POLICY_STATE_DISABLED

endif

comment "refpolicy needs a toolchain w/ threads"
	depends on !BR2_TOOLCHAIN_HAS_THREADS
```

## package/restclient-cpp/Config.in
```kconfig
config BR2_PACKAGE_RESTCLIENT_CPP
	bool "restclient-cpp"
	depends on BR2_INSTALL_LIBSTDCPP
	depends on BR2_TOOLCHAIN_GCC_AT_LEAST_4_8 # C++11
	select BR2_PACKAGE_LIBCURL
	help
	  restclient-cpp is a C++ client library for
	  making HTTP/REST requests

	  http://code.mrtazz.com/restclient-cpp/

comment "restclient-cpp needs a toolchain w/ C++, gcc >= 4.8"
	depends on !BR2_INSTALL_LIBSTDCPP || !BR2_TOOLCHAIN_GCC_AT_LEAST_4_8
```

## package/restorecond/Config.in
```kconfig
config BR2_PACKAGE_RESTORECOND
	bool "restorecond"
	depends on BR2_USE_MMU # libglib2
	depends on BR2_USE_WCHAR # libglib2
	depends on BR2_TOOLCHAIN_HAS_THREADS # libglib2
	depends on !BR2_STATIC_LIBS # libselinux
	select BR2_PACKAGE_DBUS
	select BR2_PACKAGE_DBUS_GLIB
	select BR2_PACKAGE_LIBGLIB2
	select BR2_PACKAGE_LIBSELINUX
	select BR2_PACKAGE_LIBSEPOL
	help
	  restorecond is a daemon that watches for file creation and
	  then sets the default SELinux file context for that file.

	  https://github.com/SELinuxProject/selinux/wiki/Releases

comment "restorecond needs a toolchain w/ wchar, threads, dynamic library"
	depends on BR2_USE_MMU
	depends on !BR2_TOOLCHAIN_HAS_THREADS || !BR2_USE_WCHAR || \
		BR2_STATIC_LIBS
```

## package/rfkill/Config.in
```kconfig
config BR2_PACKAGE_RFKILL
	bool "rfkill"
	help
	  rfkill is a small userspace tool to query the state of the
	  rfkill switches.

	  https://wireless.wiki.kernel.org/en/users/documentation/rfkill
```

## package/rhash/Config.in
```kconfig
config BR2_PACKAGE_RHASH
	bool "rhash"
	help
	  LibRHash is a professional, portable, thread-safe C library
	  for computing a wide variety of hash sums, such as CRC32,
	  MD4, MD5, SHA1, SHA256, SHA512, SHA3, AICH, ED2K, Tiger,
	  DC++ TTH, BitTorrent BTIH, GOST R 34.11-94, RIPEMD-160,
	  HAS-160, EDON-R, Whirlpool and Snefru.

	  https://github.com/rhash/RHash

if BR2_PACKAGE_RHASH

config BR2_PACKAGE_RHASH_BIN
	bool "rhash binary"
	depends on !BR2_STATIC_LIBS
	help
	  Install rhash console utility

comment "rhash binary needs a toolchain w/ dynamic library"
	depends on BR2_STATIC_LIBS

endif
```

## package/rings/Config.in
```kconfig
config BR2_PACKAGE_RINGS
	bool "rings"
	help
	  Provides a way to create new Lua states from within Lua.

	  http://github.com/keplerproject/rings
```

## package/ripgrep/Config.in
```kconfig
config BR2_PACKAGE_RIPGREP
	bool "ripgrep"
	depends on BR2_PACKAGE_HOST_RUSTC_TARGET_ARCH_SUPPORTS
	select BR2_PACKAGE_HOST_CARGO
	help
	  ripgrep is a line-oriented search tool that
	  recursively searches your current directory
	  for a regex pattern while respecting your gitignore
	  rules.

	  ripgrep is similar to other popular search tools like
	  The Silver Searcher, ack and grep.

	  https://github.com/BurntSushi/ripgrep
```

## package/rng-tools/Config.in
```kconfig
config BR2_PACKAGE_RNG_TOOLS
	bool "rng-tools"
	# pthread_setaffinity_np
	depends on BR2_TOOLCHAIN_HAS_THREADS_NPTL
	select BR2_PACKAGE_ARGP_STANDALONE if BR2_TOOLCHAIN_USES_UCLIBC || BR2_TOOLCHAIN_USES_MUSL
	select BR2_PACKAGE_JITTERENTROPY_LIBRARY
	select BR2_PACKAGE_LIBSYSFS
	select BR2_PACKAGE_OPENSSL
	help
	  Daemon to use hardware random number generators.

	  http://sourceforge.net/projects/gkernel/

if BR2_PACKAGE_RNG_TOOLS

config BR2_PACKAGE_RNG_TOOLS_NISTBEACON
	bool "NIST Entropy Beacon support"
	select BR2_PACKAGE_JANSSON
	select BR2_PACKAGE_LIBCURL
	select BR2_PACKAGE_LIBXML2
	help
	  Enable NIST Entropy Beacon support.

	  Entropy gathered from the NIST network entropy beacon. Note
	  that this entropy source is disabled by default as it should
	  never be used for cryptographic purposes, or any use case in
	  which random data should be known only by a single entity.

endif

comment "rng-tools needs a toolchain w/ NPTL"
	depends on !BR2_TOOLCHAIN_HAS_THREADS_NPTL
```

## package/rocksdb/Config.in
```kconfig
config BR2_PACKAGE_ROCKSDB
	bool "rocksdb"
	depends on BR2_INSTALL_LIBSTDCPP
	depends on BR2_TOOLCHAIN_GCC_AT_LEAST_4_8 # C++11
	depends on BR2_TOOLCHAIN_HAS_THREADS
	depends on BR2_USE_WCHAR
	depends on !BR2_TOOLCHAIN_HAS_GCC_BUG_64735 # std::future
	help
	  The RocksDB library provides a persistent key value store.
	  Keys and values are arbitrary byte arrays. The keys are
	  ordered within the key value store according to a
	  user-specified comparator function.

	  The library is maintained by the Facebook Database Engineering
	  Team, and is based on LevelDB, by Sanjay Ghemawat and Jeff
	  Dean at Google.

	  http://rocksdb.org

comment "rocksdb needs a toolchain w/ C++, threads, wchar, gcc >= 4.8"
	depends on !BR2_INSTALL_LIBSTDCPP || \
		!BR2_TOOLCHAIN_HAS_THREADS || !BR2_USE_WCHAR || \
		!BR2_TOOLCHAIN_GCC_AT_LEAST_4_8

comment "rocksdb needs a toolchain not affected by GCC bug 64735"
	depends on BR2_TOOLCHAIN_HAS_GCC_BUG_64735
```

## package/rp-pppoe/Config.in
```kconfig
comment "rp-pppoe needs a uClibc or glibc toolchain w/ dynamic library"
	depends on BR2_STATIC_LIBS || BR2_TOOLCHAIN_USES_MUSL
	depends on BR2_USE_MMU

config BR2_PACKAGE_RP_PPPOE
	bool "rp-pppoe"
	depends on !BR2_STATIC_LIBS
	depends on !BR2_TOOLCHAIN_USES_MUSL # pppd
	depends on BR2_USE_MMU # fork()
	select BR2_PACKAGE_PPPD
	help
	  An implementation of the Point-to-point protocol over
	  Ethernet.  Has userspace client and server deamons. You
	  likely only need this package if you are implementing the
	  pppoe server that will service other pppoe client
	  devices. Otherwise the normal client functionality already
	  exists in the pppd package (and kernel).

	  https://dianne.skoll.ca/projects/rp-pppoe/
```

## package/rpcbind/Config.in
```kconfig
config BR2_PACKAGE_RPCBIND
	bool "rpcbind"
	# We really need libtirpc and can't work with the native RPC
	# implementation of toolchains.
	depends on BR2_TOOLCHAIN_HAS_THREADS # libtirpc
	depends on BR2_USE_MMU 	# fork()
	select BR2_PACKAGE_LIBTIRPC
	help
	  The rpcbind utility is a server that converts RPC program
	  numbers into universal addresses.

comment "rpcbind needs a toolchain w/ threads"
	depends on !BR2_TOOLCHAIN_HAS_THREADS
	depends on BR2_USE_MMU
```

## package/rpi-bt-firmware/Config.in
```kconfig
config BR2_PACKAGE_RPI_BT_FIRMWARE
	bool "rpi-bt-firmware"
	depends on BR2_arm || BR2_aarch64
	help
	  Raspberry Pi 3 and Zero W Broadcom BCM43438 Bluetooth module
	  firmware. Raspberry Pi 3 Model B+ Broadcom BCM4345C0
	  Bluetooth module firmware.

	  https://github.com/LibreELEC/brcmfmac_sdio-firmware-rpi
```
