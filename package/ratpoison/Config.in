## package/rpi-firmware/Config.in
```kconfig
config BR2_PACKAGE_RPI_FIRMWARE
	bool "rpi-firmware"
	depends on BR2_arm
	help
	  RaspberryPi Firmware
	  Pre-compiled binaries of the current bootloader and GPU firmware

	  https://github.com/raspberrypi/firmware

if BR2_PACKAGE_RPI_FIRMWARE

choice
	bool "Firmware to boot"
	default BR2_PACKAGE_RPI_FIRMWARE_DEFAULT
	help
	  There are three different firmware files:
	    - the default firmware, that enables standard GPU features;
	    - the extended firmware, that enables additional GPU features
	      (eg. more audio/video codecs);
	    - the cut-down firmware, for emergency situations, with only
	      features required to boot a Linux kernel.

config BR2_PACKAGE_RPI_FIRMWARE_DEFAULT
	bool "default"
	help
	  The default firmware, that enables standard GPU features.

config BR2_PACKAGE_RPI_FIRMWARE_X
	bool "extended ('x', more codecs)"
	help
	  The extended firmware, that enables additional GPU features
	  (eg. more audio/video codecs).

config BR2_PACKAGE_RPI_FIRMWARE_CD
	bool "cut-down ('cd', emergency)"
	help
	  The cut-down firmware, for emergency situations, with only
	  features required to boot a Linux kernel.

endchoice

config BR2_PACKAGE_RPI_FIRMWARE_BOOT
	string
	default ""      if BR2_PACKAGE_RPI_FIRMWARE_DEFAULT
	default "_x"    if BR2_PACKAGE_RPI_FIRMWARE_X
	default "_cd"   if BR2_PACKAGE_RPI_FIRMWARE_CD

config BR2_PACKAGE_RPI_FIRMWARE_INSTALL_DTBS
	bool "Install Device Tree Blobs (DTBs)"
	depends on !BR2_LINUX_KERNEL_DTS_SUPPORT
	default y
	help
	  If you are using a Linux kernel <= 3.18, you should say 'y' here.

	  If you are using a Linux kernel >= 3.19, you should say 'n' here,
	  and enable BR2_LINUX_KERNEL_DTS_SUPPORT to let the kernel build
	  the DTB.

config BR2_PACKAGE_RPI_FIRMWARE_INSTALL_DTB_OVERLAYS
	bool "Install DTB overlays"
	depends on BR2_PACKAGE_RPI_FIRMWARE_INSTALL_DTBS \
		|| BR2_LINUX_KERNEL_DTS_SUPPORT
	default y
	help
	  Say 'y' here if you need to load one or more of the DTB overlays,
	  to support HATs (Hardware Attached on Top, add-on modules).

config BR2_PACKAGE_RPI_FIRMWARE_INSTALL_VCDBG
	bool "vcdbg"
	depends on BR2_TOOLCHAIN_USES_GLIBC
	depends on BR2_INSTALL_LIBSTDCPP # rpi-userland
	select BR2_PACKAGE_RPI_USERLAND
	help
	  Install vcdbg, to help debug communication with the GPU.

comment "vcdbg needs an (e)glibc toolchain w/ C++"
	depends on !BR2_TOOLCHAIN_USES_GLIBC || !BR2_INSTALL_LIBSTDCPP

endif # BR2_PACKAGE_RPI_FIRMWARE
```

## package/rpi-userland/Config.in
```kconfig
config BR2_PACKAGE_RPI_USERLAND
	bool "rpi-userland"
	depends on BR2_arm
	depends on BR2_INSTALL_LIBSTDCPP
	depends on BR2_TOOLCHAIN_HAS_THREADS
	depends on !BR2_STATIC_LIBS
	select BR2_PACKAGE_HAS_LIBEGL
	select BR2_PACKAGE_HAS_LIBGLES
	select BR2_PACKAGE_HAS_LIBOPENVG
	select BR2_PACKAGE_HAS_LIBOPENMAX
	help
	  Raspberry Pi Userland contains the necessary library to use the
	  VideoCore driver.

	  Includes source for the ARM side code to interface to:
	  EGL, mmal, GLESv2, vcos, openmaxil, vchiq_arm, bcm_host, WFC, OpenVG.

	  https://github.com/raspberrypi/userland/

if BR2_PACKAGE_RPI_USERLAND

config BR2_PACKAGE_PROVIDES_LIBEGL
	default "rpi-userland"

config BR2_PACKAGE_PROVIDES_LIBGLES
	default "rpi-userland"

config BR2_PACKAGE_PROVIDES_LIBOPENVG
	default "rpi-userland"

config BR2_PACKAGE_PROVIDES_LIBOPENMAX
	default "rpi-userland"

config BR2_PACKAGE_RPI_USERLAND_START_VCFILED
	bool "Start vcfiled"
	depends on BR2_INIT_SYSV || BR2_INIT_BUSYBOX
	help
	  vcfiled is a daemon serving files to VideoCore from the host file
	  system.

config BR2_PACKAGE_RPI_USERLAND_HELLO
	bool "hello_pi examples"
	help
	  Install the hello-pi examples to test the HW (GPU, camera...)

endif

comment "rpi-userland needs a toolchain w/ C++, threads, dynamic library"
	depends on BR2_arm
	depends on !BR2_INSTALL_LIBSTDCPP || !BR2_TOOLCHAIN_HAS_THREADS || \
		BR2_STATIC_LIBS
```

## package/rpi-wifi-firmware/Config.in
```kconfig
config BR2_PACKAGE_RPI_WIFI_FIRMWARE
	bool "rpi-wifi-firmware"
	depends on BR2_arm || BR2_aarch64
	depends on !BR2_PACKAGE_LINUX_FIRMWARE_BRCM_BCM43XXX
	help
	  Raspberry Pi 3 and Zero W Broadcom BCM43430 wifi module
	  NVRAM data. Raspberry Pi 3 Model B+ Broadcom BCM43455
	  wifi module NVRAM data.

	  https://github.com/LibreELEC/brcmfmac_sdio-firmware-rpi

comment "rpi-wifi-firmware conflicts with linux-firmware Broadcom BRCM bcm43xx"
	depends on BR2_PACKAGE_LINUX_FIRMWARE_BRCM_BCM43XXX
```

## package/rpm/Config.in
```kconfig
comment "rpm needs a toolchain w/ dynamic library and threads"
	depends on !BR2_TOOLCHAIN_HAS_THREADS || BR2_STATIC_LIBS
	depends on BR2_PACKAGE_BUSYBOX_SHOW_OTHERS
	depends on BR2_USE_MMU

config BR2_PACKAGE_RPM
	bool "rpm"
	depends on !BR2_STATIC_LIBS # dlfcn.h
	depends on BR2_PACKAGE_BUSYBOX_SHOW_OTHERS
	depends on BR2_TOOLCHAIN_HAS_THREADS # beecrypt
	depends on BR2_USE_MMU # fork()
	select BR2_PACKAGE_BEECRYPT if !BR2_PACKAGE_LIBNSS
	select BR2_PACKAGE_BERKELEYDB
	select BR2_PACKAGE_FILE
	select BR2_PACKAGE_POPT
	select BR2_PACKAGE_ZLIB
	help
	  The RPM Package Manager (RPM).

	  http://www.rpm.org/
```

## package/rrdtool/Config.in
```kconfig
config BR2_PACKAGE_RRDTOOL
	bool "rrdtool"
	depends on BR2_USE_WCHAR # libglib2
	depends on BR2_TOOLCHAIN_HAS_THREADS # libglib2
	depends on BR2_USE_MMU # libglib2
	select BR2_PACKAGE_LIBGLIB2
	help
	  RRDtool is the OpenSource industry standard, high performance
	  data logging and graphing system for time series data.

	  http://oss.oetiker.ch/rrdtool/

if BR2_PACKAGE_RRDTOOL

config BR2_PACKAGE_RRDTOOL_RRDGRAPH
	bool "rrd_graph"
	default y
	depends on BR2_TOOLCHAIN_HAS_SYNC_4 # pango -> harfbuzz
	depends on BR2_TOOLCHAIN_GCC_AT_LEAST_4_8 # pango -> harfbuzz
	depends on BR2_INSTALL_LIBSTDCPP # freetype support from pango
	select BR2_PACKAGE_CAIRO
	select BR2_PACKAGE_CAIRO_PDF
	select BR2_PACKAGE_CAIRO_PNG
	select BR2_PACKAGE_CAIRO_PS
	select BR2_PACKAGE_CAIRO_SVG
	select BR2_PACKAGE_PANGO
	help
	  This enables the graphing capabilities ('rrdgraph').
	  Without this it will only act as a database backend.

comment "rrd_graph support needs a toolchain w/ C++, gcc >= 4.8"
	depends on !BR2_INSTALL_LIBSTDCPP || \
		!BR2_TOOLCHAIN_GCC_AT_LEAST_4_8
	depends on BR2_TOOLCHAIN_HAS_SYNC_4

endif

comment "rrdtool needs a toolchain w/ wchar, threads"
	depends on BR2_USE_MMU
	depends on !BR2_USE_WCHAR || !BR2_TOOLCHAIN_HAS_THREADS
```
