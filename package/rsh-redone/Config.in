## package/rsh-redone/Config.in
```kconfig
config BR2_PACKAGE_RSH_REDONE
	bool "rsh-redone"
	help
	  Rsh-redone is a reimplementation of the remote shell clients and
	  servers. It is written from the ground up to avoid the bugs found
	  in the standard clients and servers. It also fully supports IPv6.

	  http://packages.debian.org/source/sid/rsh-redone

if BR2_PACKAGE_RSH_REDONE

config BR2_PACKAGE_RSH_REDONE_RLOGIN
	bool "rlogin"

config BR2_PACKAGE_RSH_REDONE_RLOGIND
	bool "rlogind"
	depends on !BR2_STATIC_LIBS
	depends on BR2_ENABLE_LOCALE && BR2_USE_WCHAR
	depends on !BR2_TOOLCHAIN_USES_MUSL # linux-pam
	depends on BR2_USE_MMU # linux-pam
	select BR2_PACKAGE_LINUX_PAM

comment "rlogind needs a uClibc or glibc toolchain w/ wchar, locale, dynamic library"
	depends on !(BR2_ENABLE_LOCALE && BR2_USE_WCHAR) \
		|| BR2_STATIC_LIBS || BR2_TOOLCHAIN_USES_MUSL

config BR2_PACKAGE_RSH_REDONE_RSH
	bool "rsh"

config BR2_PACKAGE_RSH_REDONE_RSHD
	bool "rshd"
	depends on BR2_ENABLE_LOCALE && BR2_USE_WCHAR
	depends on !BR2_STATIC_LIBS
	depends on !BR2_TOOLCHAIN_USES_MUSL # linux-pam
	depends on BR2_USE_MMU # linux-pam
	select BR2_PACKAGE_LINUX_PAM

comment "rshd needs a uClibc or glibc toolchain w/ wchar, locale, dynamic library"
	depends on !(BR2_ENABLE_LOCALE && BR2_USE_WCHAR) \
		|| BR2_STATIC_LIBS || BR2_TOOLCHAIN_USES_MUSL

endif
```

## package/rsync/Config.in
```kconfig
config BR2_PACKAGE_RSYNC
	bool "rsync"
	# fork()
	depends on BR2_USE_MMU
	select BR2_PACKAGE_ZLIB
	select BR2_PACKAGE_POPT
	help
	  File transfer program to keep remote files in sync.

	  http://rsync.samba.org/
```

## package/rsyslog/Config.in
```kconfig
config BR2_PACKAGE_RSYSLOG
	bool "rsyslog"
	depends on BR2_TOOLCHAIN_HAS_THREADS
	depends on BR2_USE_MMU # fork()
	depends on !BR2_STATIC_LIBS # modules
	depends on !BR2_TOOLCHAIN_USES_MUSL # GLOB_BRACE
	# Propagate the exact same dependency from libfastjson,
	# even though rsyslog already depends on threads for itself:
	depends on BR2_TOOLCHAIN_HAS_SYNC_4 || BR2_TOOLCHAIN_HAS_THREADS
	depends on BR2_PACKAGE_BUSYBOX_SHOW_OTHERS
	select BR2_PACKAGE_ZLIB
	select BR2_PACKAGE_LIBESTR
	select BR2_PACKAGE_LIBLOGGING
	select BR2_PACKAGE_LIBFASTJSON
	help
	  Rsyslog is a powerful and flexible syslog implementation

	  http://www.rsyslog.com

comment "rsyslog needs a uClibc or glibc toolchain w/ threads, dynamic library"
	depends on BR2_USE_MMU
	depends on BR2_TOOLCHAIN_HAS_SYNC_4
	depends on !BR2_TOOLCHAIN_HAS_THREADS || BR2_STATIC_LIBS \
		|| BR2_TOOLCHAIN_USES_MUSL
	depends on BR2_PACKAGE_BUSYBOX_SHOW_OTHERS
```

## package/rt-tests/Config.in
```kconfig
config BR2_PACKAGE_RT_TESTS
	bool "rt-tests"
	depends on BR2_TOOLCHAIN_HAS_THREADS
	depends on BR2_USE_MMU # fork()
	depends on !BR2_STATIC_LIBS # dlopen
	help
	  Set of utilities for testing the real-time behaviour of a
	  Linux system.

	  All tools are simple C programs with no dependencies, except
	  the hwlatdetect utility, which is a Python script and
	  therefore requires the Python interpreter. It will only be
	  installed if a Python interpreter has been selected in the
	  Buildroot configuration.

	  Note that this package requires a toolchain built with the
	  NPTL implementation of the pthread API (this is always the
	  case with glibc/eglibc toolchains, but may not necessarily
	  be the case with uClibc toolchains, since the thread
	  implementation is configurable).

	  http://rt.wiki.kernel.org


comment "rt-tests may not work on MIPS with an external uClibc toolchain"
	depends on BR2_PACKAGE_RT_TESTS
	depends on BR2_TOOLCHAIN_EXTERNAL_UCLIBC
	depends on BR2_mips || BR2_mipsel || BR2_mips64 || BR2_mips64el

comment "rt-tests needs a toolchain w/ threads, dynamic library"
	depends on !BR2_TOOLCHAIN_HAS_THREADS || BR2_STATIC_LIBS
	depends on BR2_USE_MMU
```

## package/rtai/Config.in
```kconfig
config BR2_PACKAGE_RTAI
	bool "rtai"
	depends on BR2_LINUX_KERNEL_EXT_RTAI
	select BR2_LINUX_NEEDS_MODULES # not using kernel-module infra
	help
	  RTAI - the RealTime Application Interface for Linux.

	  http://www.rtai.org
```

## package/rtc-tools/Config.in
```kconfig
config BR2_PACKAGE_RTC_TOOLS
	bool "rtc-tools"
	help
	  This package provide a set of user-space tools that can be
	  used to manipulate Real Time Clock Devices.

	  https://git.kernel.org/pub/scm/linux/kernel/git/abelloni/rtc-tools.git/
```

## package/rtl8188eu/Config.in
```kconfig
config BR2_PACKAGE_RTL8188EU
	bool "rtl8188eu"
	depends on BR2_LINUX_KERNEL
	help
	  A standalone driver for the RTL8188EU USB Wi-Fi adapter.
	  This is needed only for Linux kernels before 3.12.
	  Since 3.12, there is a (staging) driver in mainline, with a
	  similar codebase.

	  Make sure your target kernel has the CONFIG_WIRELESS_EXT
	  config option enabled.

	  Note: this package needs a firmware loading mechanism to load
	  the binary blob for the chip to work.

	  https://github.com/lwfinger/rtl8188eu

comment "rtl8188eu needs a Linux kernel to be built"
	depends on !BR2_LINUX_KERNEL
```

## package/rtl8189fs/Config.in
```kconfig
config BR2_PACKAGE_RTL8189FS
	bool "rtl8189fs"
	depends on BR2_LINUX_KERNEL
	help
	  Wireless driver rtl8189fs.

	  https://github.com/jwrdegoede/rtl8189ES_linux.git

comment "rtl8189fs needs a Linux kernel to be built"
	depends on !BR2_LINUX_KERNEL
```

## package/rtl8723bu/Config.in
```kconfig
config BR2_PACKAGE_RTL8723BU
	bool "rtl8723bu"
	depends on BR2_LINUX_KERNEL
	help
	  rtl8723bu wifi driver

	  https://github.com/lwfinger/rtl8723bu

comment "rtl8723bu needs a Linux kernel to be built"
	depends on !BR2_LINUX_KERNEL
```

## package/rtl8821au/Config.in
```kconfig
comment "rtl8821au needs a Linux kernel to be built"
	depends on !BR2_LINUX_KERNEL

config BR2_PACKAGE_RTL8821AU
	bool "rtl8821au"
	depends on BR2_LINUX_KERNEL
	help
	  rtl8821au wifi driver

	  https://github.com/paralin/rtl8821au
```

## package/rtmpdump/Config.in
```kconfig
config BR2_PACKAGE_RTMPDUMP
	bool "librtmp"
	select BR2_PACKAGE_ZLIB
	help
	  rtmpdump - RTMPDump Real-Time Messaging Protocol API
	  Only librtmp is installed by this package.

	  http://rtmpdump.mplayerhq.hu
```

## package/rtorrent/Config.in
```kconfig
config BR2_PACKAGE_RTORRENT
	bool "rtorrent"
	depends on BR2_INSTALL_LIBSTDCPP
	depends on BR2_USE_WCHAR
	depends on BR2_TOOLCHAIN_HAS_THREADS
	depends on BR2_USE_MMU # fork()
	depends on BR2_TOOLCHAIN_HAS_SYNC_1 && BR2_TOOLCHAIN_HAS_SYNC_4
	select BR2_PACKAGE_LIBCURL
	select BR2_PACKAGE_LIBTORRENT
	select BR2_PACKAGE_NCURSES
	select BR2_PACKAGE_OPENSSL
	help
	  BitTorrent Client using libtorrent

	  https://github.com/rakshasa/rtorrent

comment "rtorrent needs a toolchain w/ C++, threads, wchar"
	depends on BR2_USE_MMU
	depends on BR2_TOOLCHAIN_HAS_SYNC_1 && BR2_TOOLCHAIN_HAS_SYNC_4
	depends on !(BR2_INSTALL_LIBSTDCPP && BR2_USE_WCHAR && BR2_TOOLCHAIN_HAS_THREADS)
```

## package/rtptools/Config.in
```kconfig
config BR2_PACKAGE_RTPTOOLS
	bool "rtptools"
	help
	  The rtptools distribution consists of a number of small
	  applications that can be used for processing RTP data.

	  http://www.cs.columbia.edu/irt/software/rtptools/
```

## package/rtty/Config.in
```kconfig
config BR2_PACKAGE_RTTY
	bool "rtty"
	depends on BR2_USE_MMU # fork()
	select BR2_PACKAGE_LIBEV
	help
	  Access your device's terminal from anywhere via the web.

	  https://github.com/zhaojh329/rtty
```

## package/rubix/Config.in
```kconfig
config BR2_PACKAGE_RUBIX
	bool "rubix"
	depends on BR2_PACKAGE_XORG7
	select BR2_PACKAGE_XLIB_LIBX11
	help
	  A 3D rubiks cube game for X

	  http://sed.free.fr/rubix
```

## package/ruby/Config.in
```kconfig
config BR2_PACKAGE_RUBY
	bool "ruby"
	depends on BR2_USE_WCHAR
	depends on BR2_TOOLCHAIN_HAS_THREADS
	depends on !BR2_STATIC_LIBS
	help
	  Object Oriented Scripting Language.

	  http://www.ruby-lang.org/

comment "ruby needs a toolchain w/ wchar, threads, dynamic library"
	depends on !BR2_USE_WCHAR || !BR2_TOOLCHAIN_HAS_THREADS || \
		BR2_STATIC_LIBS
```

## package/runc/Config.in
```kconfig
config BR2_PACKAGE_RUNC
	bool "runc"
	depends on BR2_PACKAGE_HOST_GO_TARGET_ARCH_SUPPORTS
	depends on BR2_PACKAGE_HOST_GO_TARGET_CGO_LINKING_SUPPORTS
	depends on BR2_TOOLCHAIN_HAS_THREADS
	depends on !BR2_TOOLCHAIN_USES_UCLIBC # no fexecve
	help
	  runC is a CLI tool for spawning and running containers
	  according to the OCP specification.

	  https://github.com/opencontainers/runc

comment "runc needs a glibc or musl toolchain w/ threads"
	depends on BR2_PACKAGE_HOST_GO_TARGET_ARCH_SUPPORTS && \
		BR2_PACKAGE_HOST_GO_TARGET_CGO_LINKING_SUPPORTS
	depends on !BR2_TOOLCHAIN_HAS_THREADS || BR2_TOOLCHAN_USES_UCLIBC
```

## package/rustc/Config.in.host
```kconfig
# All host rust packages should depend on this option
config BR2_PACKAGE_HOST_RUSTC_ARCH_SUPPORTS
	bool
	default y if BR2_HOSTARCH = "x86_64" || BR2_HOSTARCH = "x86"

# All target rust packages should depend on this option
config BR2_PACKAGE_HOST_RUSTC_TARGET_ARCH_SUPPORTS
	bool
	# The pre-built Rust standard library is only available for the
	# following architectures/ABIs, and is built against glibc.
	default y if BR2_i386
	default y if BR2_x86_64
	default y if BR2_aarch64
	default y if BR2_arm && !BR2_ARM_CPU_ARMV4 && !BR2_ARM_CPU_ARMV5 \
	        && !(BR2_ARM_CPU_ARMV7A && BR2_ARM_EABI)
	default y if BR2_powerpc || BR2_powerpc64 || BR2_powerpc64le
	default y if (BR2_mips || BR2_mipsel) && !BR2_MIPS_CPU_MIPS32R6
	default y if (BR2_mips64 || BR2_mips64el) && !BR2_MIPS_CPU_MIPS64R6 \
		&& BR2_MIPS_NABI64
	depends on BR2_TOOLCHAIN_USES_GLIBC
	depends on BR2_PACKAGE_HOST_RUSTC_ARCH_SUPPORTS

config BR2_PACKAGE_HOST_RUSTC_ARCH
	string
	default "armv7"  if BR2_ARM_CPU_ARMV7A
	default BR2_ARCH if !BR2_ARM_CPU_ARMV7A

config BR2_PACKAGE_HOST_RUSTC_ABI
	string
	default "eabi"   if BR2_ARM_EABI
	default "eabihf" if BR2_ARM_EABIHF
	default "abi64"  if BR2_MIPS_NABI64

config BR2_PACKAGE_HOST_RUSTC
	bool "host rustc"
	depends on BR2_PACKAGE_HOST_RUSTC_ARCH_SUPPORTS
	help
	  Compiler for the Rust language

	  http://www.rust-lang.org

if BR2_PACKAGE_HOST_RUSTC

choice
	prompt "Rust compiler variant"
	default BR2_PACKAGE_HOST_RUST_BIN
	help
	  Select a Rust compiler

config BR2_PACKAGE_HOST_RUST
	bool "host rust"
	# RUSTC_TARGET_NAME must be set for building host-rust
	# otherwise config.toml is broken.
	depends on BR2_PACKAGE_HOST_RUSTC_TARGET_ARCH_SUPPORTS
	# triggers ICE on trunc_int_for_mode, at explow.c:56
	depends on BR2_TOOLCHAIN_GCC_AT_LEAST_5 || !BR2_aarch64
	help
	  This package will build the compiler for the host as well as
	  two flavors of the standard library: one for the host, another
	  for the target. Both are installed in the host directory.

comment "host-rust needs a toolchain w/ gcc >= 5"
	depends on BR2_aarch64
	depends on !BR2_TOOLCHAIN_GCC_AT_LEAST_5

config BR2_PACKAGE_HOST_RUST_BIN
	bool "host rust (pre-built)"
	help
	  This package will install pre-built versions of the compiler
	  for the host and the Rust standard library for the target.

endchoice

endif

config BR2_PACKAGE_PROVIDES_HOST_RUSTC
	string
	default "host-rust" if BR2_PACKAGE_HOST_RUST
	# Default to host-rust-bin as long as host arch supports it
	default "host-rust-bin" if !BR2_PACKAGE_HOST_RUST
	depends on BR2_PACKAGE_HOST_RUSTC_ARCH_SUPPORTS
```

## package/rxvt/Config.in
```kconfig
config BR2_PACKAGE_RXVT
	bool "rxvt"
	depends on BR2_PACKAGE_XORG7
	help
	  A nice small colour vt102 X terminal emulator.

	  http://www.rxvt.org/
```

## package/rygel/Config.in
```kconfig
config BR2_PACKAGE_RYGEL
	bool "rygel"
	depends on BR2_USE_WCHAR # gupnp-av
	depends on BR2_TOOLCHAIN_HAS_THREADS # gupnp-av
	depends on BR2_USE_MMU # gupnp-av
	select BR2_PACKAGE_GUPNP_AV
	select BR2_PACKAGE_LIBGEE
	select BR2_PACKAGE_LIBMEDIAART
	select BR2_PACKAGE_SQLITE
	help
	  Rygel is a home media solution (UPnP AV MediaServer) that
	  allows you to easily share audio, video and pictures to other
	  devices.

	  Additionally, media player software may use Rygel to become a
	  MediaRenderer that may be controlled remotely by a UPnP or
	  DLNA Controller.

	  Rygel achieves interoperability with other devices in the
	  market by trying to conform to the very strict requirements of
	  DLNA and by converting media on-the-fly to formats that client
	  devices can handle.

	  Most Rygel functionality is implemented through a plug-in
	  mechanism.

	  https://wiki.gnome.org/Projects/Rygel

if BR2_PACKAGE_RYGEL

choice
	prompt "media engine"
	default BR2_PACKAGE_RYGEL_MEDIA_ENGINE_SIMPLE

config BR2_PACKAGE_RYGEL_MEDIA_ENGINE_SIMPLE
	bool "simple"

config BR2_PACKAGE_RYGEL_MEDIA_ENGINE_GSTREAMER1
	bool "gstreamer1"
	select BR2_PACKAGE_GDK_PIXBUF
	select BR2_PACKAGE_GUPNP_DLNA
	select BR2_PACKAGE_GSTREAMER1
	select BR2_PACKAGE_GST1_PLUGINS_BASE

endchoice

comment "rygel needs a toolchain w/ wchar, threads"
	depends on BR2_USE_MMU
	depends on !BR2_USE_WCHAR || !BR2_TOOLCHAIN_HAS_THREADS

endif # BR2_PACKAGE_RYGEL
```

## package/s6-dns/Config.in
```kconfig
config BR2_PACKAGE_S6_DNS
	bool "s6-dns"
	depends on BR2_USE_MMU # skalibs
	select BR2_PACKAGE_SKALIBS
	help
	  s6-dns is a suite of DNS client programs and libraries for
	  Unix systems, as an alternative to the BIND, djbdns or other
	  DNS clients.

	  http://skarnet.org/software/s6-dns/
```

## package/s6-linux-init/Config.in
```kconfig
config BR2_PACKAGE_S6_LINUX_INIT
	bool "s6-linux-init"
	depends on BR2_USE_MMU # s6
	select BR2_PACKAGE_S6
	select BR2_PACKAGE_S6_LINUX_UTILS
	select BR2_PACKAGE_S6_PORTABLE_UTILS
	help
	  s6-linux-init is a set of minimalistic tools to create a
	  s6-based init system, including a /sbin/init binary, on a
	  Linux kernel.

	  http://skarnet.org/software/s6-linux-init/
```

## package/s6-linux-utils/Config.in
```kconfig
config BR2_PACKAGE_S6_LINUX_UTILS
	bool "s6-linux-utils"
	depends on BR2_USE_MMU # skalibs
	select BR2_PACKAGE_SKALIBS
	help
	  s6-linux-utils is a set of minimalistic Linux-specific
	  system utilities.

	  http://skarnet.org/software/s6-linux-utils/
```

## package/s6-networking/Config.in
```kconfig
config BR2_PACKAGE_S6_NETWORKING
	bool "s6-networking"
	depends on BR2_USE_MMU # s6
	select BR2_PACKAGE_S6_DNS
	select BR2_PACKAGE_S6
	help
	  s6-networking is a suite of small networking utilities for
	  Unix systems. It includes command-line client and server
	  management, TCP access control, privilege escalation across
	  UNIX domain sockets, IDENT protocol management and clock
	  synchronization.

	  http://skarnet.org/software/s6-networking/
```

## package/s6-portable-utils/Config.in
```kconfig
config BR2_PACKAGE_S6_PORTABLE_UTILS
	bool "s6-portable-utils"
	depends on BR2_USE_MMU # skalibs
	select BR2_PACKAGE_SKALIBS
	help
	  s6-portable-utils is a set of tiny general Unix utilities,
	  often performing well-known tasks such as cut and grep, but
	  optimized for simplicity and small size. They were designed
	  for embedded systems and other constrained environments, but
	  they work everywhere.

	  http://skarnet.org/software/s6-portable-utils/
```
