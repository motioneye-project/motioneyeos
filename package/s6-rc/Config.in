## package/sdbusplus/Config.in
```kconfig
config BR2_PACKAGE_SDBUSPLUS
	bool "sdbusplus"
	depends on BR2_INSTALL_LIBSTDCPP
	depends on BR2_PACKAGE_SYSTEMD
	depends on BR2_TOOLCHAIN_GCC_AT_LEAST_7 # C++17
	help
	  A C++ library for sd-bus with a bindings and doc generator.

	  This will build the target library.  See the host package for
	  the bindings and documentation generation program.

	  https://github.com/openbmc/sdbusplus

comment "sdbusplus needs systemd and a toolchain w/ C++, gcc >= 7"
	depends on !BR2_PACKAGE_SYSTEMD || !BR2_INSTALL_LIBSTDCPP || \
		!BR2_TOOLCHAIN_GCC_AT_LEAST_7
```

## package/sdbusplus/Config.in.host
```kconfig
config BR2_PACKAGE_HOST_SDBUSPLUS
	bool "host-sdbusplus"
	select BR2_PACKAGE_HOST_PKGCONF
	help
	  A C++ library for sd-bus with a bindings and doc generator.

	  This will build the Python host side generation tool for
	  bindings and documentation.

	  https://github.com/openbmc/sdbusplus
```

## package/sdl/Config.in
```kconfig
config BR2_PACKAGE_SDL
	bool "SDL"
	help
	  Simple DirectMedia Layer - SDL is a library that allows
	  programs portable low level access to a video framebuffer,
	  audio output, mouse, and keyboard.

	  http://www.libsdl.org/

if BR2_PACKAGE_SDL

config BR2_PACKAGE_SDL_FBCON
	bool "SDL framebuffer console video driver"
	default y

config BR2_PACKAGE_SDL_DIRECTFB
	bool "SDL DirectFB video driver"
	depends on BR2_PACKAGE_DIRECTFB

config BR2_PACKAGE_SDL_X11
	bool "SDL X11 video driver"
	depends on BR2_PACKAGE_XORG7
	select BR2_PACKAGE_XLIB_LIBX11
	select BR2_PACKAGE_XLIB_LIBXEXT

endif
```

## package/sdl2/Config.in
```kconfig
config BR2_PACKAGE_SDL2
	bool "sdl2"
	depends on !BR2_STATIC_LIBS
	help
	  Simple DirectMedia Layer 2 - SDL2 is a library that allows
	  programs portable low level access to a video framebuffer,
	  audio output, mouse, and keyboard. It is not compatible with
	  SDL1.

	  http://www.libsdl.org/

if BR2_PACKAGE_SDL2

config BR2_PACKAGE_SDL2_DIRECTFB
	bool "DirectFB video driver"
	depends on BR2_PACKAGE_DIRECTFB

comment "DirectFB video driver needs directfb"
	depends on !BR2_PACKAGE_DIRECTFB

config BR2_PACKAGE_SDL2_X11
	bool "X11 video driver"
	depends on BR2_PACKAGE_XORG7
	depends on BR2_USE_MMU # fork()
	select BR2_PACKAGE_XLIB_LIBX11
	select BR2_PACKAGE_XLIB_LIBXEXT

comment "X11 video driver needs X.org"
	depends on !BR2_PACKAGE_XORG7
	depends on BR2_USE_MMU

config BR2_PACKAGE_SDL2_OPENGL
	bool "OpenGL (GLX)"
	depends on BR2_PACKAGE_HAS_LIBGL
	depends on BR2_PACKAGE_XORG7
	depends on BR2_USE_MMU # X11 video driver
	select BR2_PACKAGE_SDL2_X11

comment "OpenGL support needs X11 and an OpenGL provider"
	depends on BR2_USE_MMU
	depends on !BR2_PACKAGE_HAS_LIBGL || !BR2_PACKAGE_XORG7

config BR2_PACKAGE_SDL2_OPENGLES
	bool "OpenGL ES"
	depends on BR2_PACKAGE_HAS_LIBGLES

comment "OpenGL ES support needs an OpenGL ES provider"
	depends on !BR2_PACKAGE_HAS_LIBGLES

endif

comment "sdl2 needs a toolchain w/ dynamic library"
	depends on BR2_STATIC_LIBS
```

## package/sdl2_gfx/Config.in
```kconfig
config BR2_PACKAGE_SDL2_GFX
	bool "sdl2_gfx"
	depends on BR2_PACKAGE_SDL2
	help
	  The SDL2_gfx library is an extension to the SDL2 library
	  which provides basic antialiased drawing routines such as
	  lines, circles or polygons, an interpolating rotozoomer for
	  SDL surfaces, framerate control and MMX image filters.

	  http://www.ferzkopp.net/wordpress/2016/01/02/sdl_gfx-sdl2_gfx
```

## package/sdl2_image/Config.in
```kconfig
config BR2_PACKAGE_SDL2_IMAGE
	bool "sdl2_image"
	depends on BR2_PACKAGE_SDL2
	help
	  SDL2_image is an image file loading library. It loads images
	  as SDL surfaces, and supports the following formats: BMP,
	  GIF, JPEG, LBM, PCX, PNG, PNM, TGA, TIFF, XCF, XPM, XV.

	  http://www.libsdl.org/projects/SDL_image/
```

## package/sdl2_mixer/Config.in
```kconfig
config BR2_PACKAGE_SDL2_MIXER
	bool "sdl2_mixer"
	depends on BR2_PACKAGE_SDL2
	help
	  SDL_mixer is a sample multi-channel audio mixer library.  It
	  supports any number of simultaneously playing channels of 16
	  bit stereo audio, plus a single channel of music, mixed by
	  the popular FLAC, MikMod MOD, Timidity MIDI, Ogg Vorbis, and
	  SMPEG MP3 libraries.

	  http://www.libsdl.org/projects/SDL_mixer/
```

## package/sdl2_net/Config.in
```kconfig
config BR2_PACKAGE_SDL2_NET
	bool "sdl2_net"
	depends on BR2_PACKAGE_SDL2
	help
	  This is a small sample cross-platform networking library,
	  with a sample chat client and server application. The chat
	  client uses the GUIlib GUI framework library.

	  http://www.libsdl.org/projects/SDL_net/
```

## package/sdl2_ttf/Config.in
```kconfig
config BR2_PACKAGE_SDL2_TTF
	bool "SDL2_TTF"
	depends on BR2_PACKAGE_SDL2
	select BR2_PACKAGE_FREETYPE
	help
	  SDL2_ttf is a sample TrueType font library. It allows you to
	  use TrueType fonts in your SDL2 applications.

	  http://www.libsdl.org/projects/SDL_ttf/
```

## package/sdl_gfx/Config.in
```kconfig
config BR2_PACKAGE_SDL_GFX
	bool "SDL_gfx"
	depends on BR2_PACKAGE_SDL
	help
	  The SDL_gfx library is an extension to the SDL library which
	  provides basic antialiased drawing routines such as lines,
	  circles or polygons, an interpolating rotozoomer for SDL
	  surfaces, framerate control and MMX image filters.

	  http://www.ferzkopp.net/joomla/content/view/19/14/
```
