## package/s6-rc/Config.in
```kconfig
config BR2_PACKAGE_S6_RC
	bool "s6-rc"
	select BR2_PACKAGE_S6
	depends on BR2_USE_MMU # s6
	help
	  s6-rc is a service manager for s6-based systems, i.e. a
	  suite of programs that can start and stop services, both
	  long-running daemons and one-time initialization scripts, in
	  the proper order according to a dependency tree.

	  http://skarnet.org/software/s6-rc/
```

## package/s6-rc/Config.in.host
```kconfig
config BR2_PACKAGE_HOST_S6_RC
	bool "host s6-rc"
	depends on BR2_PACKAGE_S6_RC
	help
	  This package provides the host variant of the s6-rc tools,
	  required to build the s6-rc service database offline.

	  http://skarnet.org/software/s6-rc/
```

## package/s6/Config.in
```kconfig
config BR2_PACKAGE_S6
	bool "s6"
	select BR2_PACKAGE_EXECLINE
	depends on BR2_USE_MMU # execline
	help
	  s6 is a small suite of programs for UNIX, designed to allow
	  process supervision (a.k.a service supervision), in the line
	  of daemontools and runit, as well as various operations on
	  processes and daemons.

	  http://skarnet.org/software/s6/
```

## package/safeclib/Config.in
```kconfig
config BR2_PACKAGE_SAFECLIB
	bool "safeclib"
	help
	  safec fork with all C11 Annex K functions

	  This library implements the secure C11 Annex K functions on
	  top of most libc implementations, which are missing from them.

	  https://rurban.github.io/safeclib/
```

## package/sam-ba/Config.in.host
```kconfig
config BR2_PACKAGE_HOST_SAM_BA
	bool "host sam-ba"
	depends on BR2_HOSTARCH = "x86_64" || BR2_HOSTARCH = "x86"
	help
	  Atmel SAM-BA software provides an open set of tools for
	  programming the Atmel SAM3, SAM7 and SAM9 ARM-based
	  microcontrollers.

	  http://www.at91.com/linux4sam/bin/view/Linux4SAM/SoftwareTools
```

## package/samba/Config.in
```kconfig
config BR2_PACKAGE_SAMBA
	bool "samba"
	depends on BR2_TOOLCHAIN_HAS_THREADS
	depends on BR2_USE_MMU # fork()
	select BR2_PACKAGE_POPT
	help
	  Provides print services to all manner of SMB/CIFS clients,
	  including the numerous versions of Microsoft Windows
	  operating systems.

	  http://www.samba.org/

	  NOTE: A complete Samba install takes over 50MB of space,
		so choose only the components you need.

comment "samba needs a toolchain w/ threads"
	depends on !BR2_TOOLCHAIN_HAS_THREADS

if BR2_PACKAGE_SAMBA

config BR2_PACKAGE_SAMBA_MAX_DEBUGLEVEL
	int "Maximum level of compiled-in debug messages"
	range -1 10000
	default -1
	help
	  Define the level of compiled-in debug messages.
	  This allows for big space savings, -1 being the lowest (none).

config BR2_PACKAGE_SAMBA_LIBICONV
	bool "extended encodings (libiconv)"
	depends on !BR2_ENABLE_LOCALE
	select BR2_PACKAGE_LIBICONV
	help
	  Include libiconv support for extended conversion of filename
	  enconding. Samba has built-in support for UTF-8, ISO-8859-1
	  and ASCII, so this is only required if you want to support
	  other encodings.

menu "Samba tools selection"

config BR2_PACKAGE_SAMBA_EVENTLOGADM
	bool "eventlogadm"
	default y
	help
	  Write Eventlog records to a tdb or perform other eventlog functions

config BR2_PACKAGE_SAMBA_FINDSMB
	bool "findsmb"
	default y
	depends on BR2_PACKAGE_SAMBA_SMBCLIENT
	depends on BR2_PACKAGE_SAMBA_NMBLOOKUP
	depends on BR2_PACKAGE_PERL
	help
	  Script to browse network

comment "findsmb       - disabled (requires nmblookup, smbclient and perl)"
	depends on !BR2_PACKAGE_SAMBA_SMBCLIENT || !BR2_PACKAGE_SAMBA_NMBLOOKUP || !BR2_PACKAGE_PERL

config BR2_PACKAGE_SAMBA_NET
	bool "net"
	default y
	help
	  Distributed SMB/CIFS Server Management Utility

config BR2_PACKAGE_SAMBA_NMBD
	bool "nmbd"
	default y
	help
	  NetBIOS name server to provide NetBIOS over IP naming services
	  to clients

config BR2_PACKAGE_SAMBA_NMBLOOKUP
	bool "nmblookup"
	default y
	help
	  Query NetBIOS names and map them to IP addresses in a network
	  using NetBIOS over TCP/IP queries

config BR2_PACKAGE_SAMBA_NTLM_AUTH
	bool "ntlm_auth"
	default y
	help
	  Helper utility that authenticates users using NT/LM authentication

config BR2_PACKAGE_SAMBA_PDBEDIT
	bool "pdbedit"
	default y
	help
	  Manage the SAM database (Database of Samba Users)

config BR2_PACKAGE_SAMBA_PROFILES
	bool "profiles"
	default y
	help
	  Utility that reports and changes SIDs in Windows NT registry files

config BR2_PACKAGE_SAMBA_RPCCLIENT
	bool "rpcclient"
	select BR2_PACKAGE_READLINE
	default y
	help
	  Tool for executing client side MS-RPC functions using RPC
	  calls from a UNIX workstation.

config BR2_PACKAGE_SAMBA_SMBCACLS
	bool "smbcacls"
	default y
	help
	  Set or get ACLs on an NT file or directory names

config BR2_PACKAGE_SAMBA_SMBCLIENT
	bool "smbclient"
	select BR2_PACKAGE_READLINE
	default y
	help
	  ftp-like client to access SMB/CIFS resources on servers

config BR2_PACKAGE_SAMBA_SMBCONTROL
	bool "smbcontrol"
	default y
	help
	  Send messages to smbd, nmbd or winbindd processes

config BR2_PACKAGE_SAMBA_SMBCQUOTAS
	bool "smbcquotas"
	default y
	help
	  Set or get QUOTAs of NTFS 5 shares

config BR2_PACKAGE_SAMBA_SMBD
	bool "smbd"
	default y
	help
	  The server daemon that provides filesharing and printing services

config BR2_PACKAGE_SAMBA_SMBGET
	bool "smbget"
	default y
	help
	  wget-like utility for download files over SMB

config BR2_PACKAGE_SAMBA_SMBLDBTOOLS
	bool "smbldbtools"
	default y
	help
	  ldbadd ldbdel ldbedit ldbmodify ldbrename ldbsearch tools

config BR2_PACKAGE_SAMBA_SMBPASSWD
	bool "smbpasswd"
	default y
	help
	  Change a user's SMB passwd

config BR2_PACKAGE_SAMBA_SMBSHARESEC
	bool "smbsharesec"
	default y
	help
	  Manipulate share permissions on SMB file shares

config BR2_PACKAGE_SAMBA_SMBSPOOL
	bool "smbspool"
	default y
	help
	  Send a print file to an SMB printer

config BR2_PACKAGE_SAMBA_SMBSTATUS
	bool "smbstatus"
	default y
	help
	  Report on current Samba connections

config BR2_PACKAGE_SAMBA_SMBTREE
	bool "smbtree"
	default y
	help
	  A text based smb network browser

config BR2_PACKAGE_SAMBA_SWAT
	bool "swat"
	default y
	help
	  Samba Web Administration Tool

config BR2_PACKAGE_SAMBA_SMBTA_UTIL
	bool "smbta-util"
	default y
	help
	  Tool to ease the configuration of the vfs_smb_traffic_analyzer
	  module regarding data encryption.

config BR2_PACKAGE_SAMBA_SMBTAR
	bool "smbtar"
	default y
	depends on BR2_PACKAGE_SAMBA_SMBCLIENT
	help
	  tar-like script that wraps smbclient

comment "smbtar        - disabled (requires smbclient)"
	depends on !BR2_PACKAGE_SAMBA_SMBCLIENT

config BR2_PACKAGE_SAMBA_TDB
	bool "tdb"
	default y
	help
	  Tools to operate on the .tdb database files

config BR2_PACKAGE_SAMBA_TESTPARM
	bool "testparm"
	default y
	help
	  Check an smb.conf configuration file for internal correctness

config BR2_PACKAGE_SAMBA_WINBINDD
	bool "winbindd"
	default y
	help
	  Name Service Switch daemon for resolving names from NT servers

config BR2_PACKAGE_SAMBA_WBINFO
	bool "wbinfo"
	default y
	depends on BR2_PACKAGE_SAMBA_WINBINDD
	help
	  Query information from winbind daemon

endmenu


menu "Samba libraries selection"

config BR2_PACKAGE_SAMBA_LIBSMBCLIENT
	bool "libsmbclient"
	help
	  libsmbclient is a library toolset that permits applications
	  to manipulate CIFS/SMB network resources using many of the
	  standards POSIX functions available for manipulating local
	  files.

endmenu


menu "Samba support selection"

config BR2_PACKAGE_SAMBA_AVAHI
	bool "support avahi"
	default y
	depends on BR2_PACKAGE_AVAHI_DAEMON
	depends on BR2_USE_MMU # dbus
	select BR2_PACKAGE_DBUS
	help
	  Include support for avahi

comment "support avahi - disabled (requires avahi-daemon)"
	depends on !BR2_PACKAGE_AVAHI_DAEMON

config BR2_PACKAGE_SAMBA_GAMIN
	bool "support gamin"
	default y
	depends on BR2_PACKAGE_GAMIN
	help
	  Include support for gamin

comment "support gamin - disabled (requires gamin)"
	depends on !BR2_PACKAGE_GAMIN

endmenu

endif
```

## package/samba4/Config.in
```kconfig
comment "samba4 needs a uClibc or glibc toolchain w/ wchar, dynamic library, NPTL"
	depends on BR2_TOOLCHAIN_HAS_SYNC_4
	depends on !BR2_USE_WCHAR || BR2_TOOLCHAIN_USES_MUSL \
		|| BR2_STATIC_LIBS || !BR2_TOOLCHAIN_HAS_THREADS_NPTL
	depends on BR2_USE_MMU

config BR2_PACKAGE_SAMBA4
	bool "samba4"
	depends on BR2_USE_MMU # fork()
	depends on BR2_USE_WCHAR # python
	depends on BR2_TOOLCHAIN_HAS_THREADS_NPTL # python -> libffi
	depends on !BR2_STATIC_LIBS # cmocka, python, gnutls
	depends on !BR2_nios2 # binary too large, relocations don't fit
	depends on BR2_TOOLCHAIN_HAS_SYNC_4
	depends on !BR2_TOOLCHAIN_USES_MUSL
	select BR2_PACKAGE_CMOCKA
	select BR2_PACKAGE_E2FSPROGS
	select BR2_PACKAGE_GNUTLS
	select BR2_PACKAGE_LIBTIRPC if !BR2_TOOLCHAIN_HAS_NATIVE_RPC
	select BR2_PACKAGE_POPT
	select BR2_PACKAGE_ZLIB
	help
	  Provides secure, stable and fast file and print services
	  for all clients using the SMB/CIFS protocol, such as all
	  versions of DOS, Windows, OS/2, Linux and many others.

	  http://www.samba.org/

if BR2_PACKAGE_SAMBA4

config BR2_PACKAGE_SAMBA4_AD_DC
	bool "AD DC"
	depends on BR2_PACKAGE_PYTHON3
	select BR2_PACKAGE_JANSSON
	help
	  Enable Active Directory Domain Controller functionality.

comment "AD DC depends on python3"
	depends on !BR2_PACKAGE_PYTHON3

config BR2_PACKAGE_SAMBA4_ADS
	bool "ADS"
	select BR2_PACKAGE_OPENLDAP
	help
	  Enable Active Directory member Server functionality.

config BR2_PACKAGE_SAMBA4_SMBTORTURE
	bool "smbtorture"
	help
	  Install the smbtorture test suite.
	  It's normally used for validation and stress testing.
	  Approximately +5 MB of stripped uncompressed target space.

endif
```

## package/sane-backends/Config.in
```kconfig
config BR2_PACKAGE_SANE_BACKENDS
	bool "sane-backends"
	depends on BR2_USE_MMU # fork()
	depends on !BR2_STATIC_LIBS
	help
	  SANE - Scanner Access Now Easy

	  http://www.sane-project.org

	  Backends are included automatically based on the libraries
	  that have been selected: libusb, jpeg, tiff, avahi (with
	  dbus and libglib2), and netsnmp.

comment "sane-backends needs a toolchain w/ dynamic library"
	depends on BR2_USE_MMU
	depends on BR2_STATIC_LIBS
```

## package/sawman/Config.in
```kconfig
config BR2_PACKAGE_SAWMAN
	bool "SawMan (Window Manager)"
	depends on BR2_PACKAGE_DIRECTFB
	help
	  SaWMan is a new window manager module for use with DirectFB.
	  Its main difference to the default module is that it allows
	  one process to be an application and window manager,
	  implementing all kinds of diversity, while SaWMan is only the
	  working horse.

	  See http://www.directfb.org/downloads/Extras/README.SaWMan
```

## package/sbc/Config.in
```kconfig
config BR2_PACKAGE_SBC
	bool "sbc"
	select BR2_PACKAGE_LIBSNDFILE
	help
	  An audio codec to connect bluetooth high quality audio
	  devices like headphones or loudspeakers.

	  http://www.bluez.org/
```

## package/schifra/Config.in
```kconfig
config BR2_PACKAGE_SCHIFRA
	bool "schifra"
	depends on BR2_INSTALL_LIBSTDCPP
	help
	  Schifra is a very robust, highly optimized and extremely configurable
	  Reed-Solomon error correcting code library for both software and IP
	  core based applications with implementations in C++ and VHDL.

	  http://www.schifra.com/

if BR2_PACKAGE_SCHIFRA

config BR2_PACKAGE_SCHIFRA_EXAMPLES
	bool "schifra examples"
	help
	  Build and install the schifra example applications.

endif

comment "schifra needs a toolchain w/ C++"
	depends on !BR2_INSTALL_LIBSTDCPP
```

## package/sconeserver/Config.in
```kconfig
menuconfig BR2_PACKAGE_SCONESERVER
	bool "sconeserver"
	depends on BR2_INSTALL_LIBSTDCPP
	depends on BR2_TOOLCHAIN_HAS_THREADS_NPTL
	depends on !BR2_STATIC_LIBS # dlopen()
	select BR2_PACKAGE_PCRE
	select BR2_PACKAGE_ZLIB
	help
	  Sconeserver is a modular, object-orientated and extremely
	  versatile network server framework for GNU/Linux and
	  UNIX-like platforms.

	  http://www.sconemad.com/sconeserver/

if BR2_PACKAGE_SCONESERVER

comment "Sconeserver modules"

config BR2_PACKAGE_SCONESERVER_EXAMPLES
	bool "examples"
	help
	  Example modules for Sconeserver

config BR2_PACKAGE_SCONESERVER_HTTP_SCONESITE
	bool "http::sconesite"
	select BR2_PACKAGE_LIBXML2
	help
	  http::sconesite module for Sconeserver

config BR2_PACKAGE_SCONESERVER_HTTP_SCONESITE_IMAGE
	bool "http::sconesite::image"
	depends on BR2_PACKAGE_SCONESERVER_HTTP_SCONESITE
	depends on BR2_USE_MMU # imagemagick
	select BR2_PACKAGE_IMAGEMAGICK
	help
	  http::sconesite::image module for Sconeserver

config BR2_PACKAGE_SCONESERVER_MYSQL
	bool "mysql"
	depends on BR2_USE_MMU # mysql
	select BR2_PACKAGE_MYSQL
	help
	  MySQL module for Sconeserver

config BR2_PACKAGE_SCONESERVER_BLUETOOTH
	bool "bluetooth"
	depends on BR2_USE_WCHAR # bluez5_utils -> libglib2
	depends on BR2_USE_MMU # bluez5_utils -> dbus
	depends on BR2_TOOLCHAIN_HAS_THREADS # bluez5_utils -> dbus, libglib2
	depends on !BR2_STATIC_LIBS # bluez5_utils
	depends on BR2_TOOLCHAIN_HEADERS_AT_LEAST_3_4 # bluez5_utils
	depends on BR2_TOOLCHAIN_HAS_SYNC_4 # bluez5_utils
	select BR2_PACKAGE_BLUEZ5_UTILS
	help
	  Bluetooth module for Sconeserver

comment "bluetooth support needs a toolchain w/ wchar, threads, dynamic library, headers >= 3.4"
	depends on BR2_USE_MMU
	depends on BR2_TOOLCHAIN_HAS_SYNC_4
	depends on !BR2_USE_WCHAR || !BR2_TOOLCHAIN_HAS_THREADS || \
		BR2_STATIC_LIBS || !BR2_TOOLCHAIN_HEADERS_AT_LEAST_3_4

config BR2_PACKAGE_SCONESERVER_RSS
	bool "rss"
	select BR2_PACKAGE_LIBXML2
	help
	  RSS module for Sconeserver

config BR2_PACKAGE_SCONESERVER_LOCATION
	bool "location"
	depends on BR2_USE_MMU # gpsd
	depends on BR2_TOOLCHAIN_HAS_THREADS # gpsd
	depends on !BR2_STATIC_LIBS # gpsd
	select BR2_PACKAGE_GPSD
	help
	  Location module for Sconeserver

comment "location support needs a toolchain w/ theads, dynamic library"
	depends on BR2_USE_MMU
	depends on !BR2_TOOLCHAIN_HAS_THREADS || BR2_STATIC_LIBRARY

config BR2_PACKAGE_SCONESERVER_LETTUCE
	bool "lettuce"
	help
	  Sconeserver module for Lettuce embedded automation platform

	  http://www.sconemad.com/lettuce/

config BR2_PACKAGE_SCONESERVER_MATHS
	bool "maths"
	select BR2_PACKAGE_MPFR
	help
	  Mathematics module for Sconeserver

config BR2_PACKAGE_SCONESERVER_TESTBUILDER
	bool "testbuilder"
	help
	  Testbuilder module for Sconeserver

config BR2_PACKAGE_SCONESERVER_UI
	bool "ui"
	depends on BR2_PACKAGE_XORG7
	select BR2_PACKAGE_XLIB_LIBX11
	help
	  UI module for Sconeserver

comment "ui module requires X.org"
	depends on !BR2_PACKAGE_XORG7

endif # BR2_PACKAGE_SCONESERVER

comment "sconeserver needs a toolchain with dynamic library, C++, NPTL"
	depends on !BR2_INSTALL_LIBSTDCPP || !BR2_TOOLCHAIN_HAS_THREADS_NPTL \
		|| BR2_STATIC_LIBS
```

## package/screen/Config.in
```kconfig
config BR2_PACKAGE_SCREEN
	bool "screen"
	default n
	select BR2_PACKAGE_NCURSES
	help
	  Screen is a full-screen window manager that multiplexes a physical 
	  terminal between several processes, typically interactive shells. 
	  Each virtual terminal provides the functions of the DEC VT100 
	  terminal and, in addition, several control functions from the ANSI 
	  X3.64 (ISO 6429) and ISO 2022 standards (e.g., insert/delete line 
	  and support for multiple character sets).

	  http://www.gnu.org/software/screen/
```

## package/scrub/Config.in
```kconfig
config BR2_PACKAGE_SCRUB
	bool "scrub"
	help
	  Scrub iteratively writes patterns on files or disk devices
	  to make retrieving the data more difficult.

	  https://github.com/chaos/scrub/
```

## package/scrypt/Config.in
```kconfig
config BR2_PACKAGE_SCRYPT
	bool "scrypt"
	select BR2_PACKAGE_OPENSSL
	help
	  A password-based key derivation function specifically
	  designed to make it costly to perform large-scale custom
	  hardware attacks by requiring large amounts of memory.

	  http://www.tarsnap.com/scrypt.html
```
