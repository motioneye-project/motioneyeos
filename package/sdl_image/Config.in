## package/sdl_image/Config.in
```kconfig
menuconfig BR2_PACKAGE_SDL_IMAGE
	bool "SDL_image"
	depends on BR2_PACKAGE_SDL
	help
	  SDL_image is an image file loading library. It loads images
	  as SDL surfaces, and supports the following formats:
	  BMP, GIF, JPEG, LBM, PCX, PNG, PNM, TGA, TIFF, XCF, XPM, XV.

	  http://www.libsdl.org/projects/SDL_image/

if BR2_PACKAGE_SDL_IMAGE

config BR2_PACKAGE_SDL_IMAGE_BMP
	bool "BMP support"
	default y

config BR2_PACKAGE_SDL_IMAGE_GIF
	bool "GIF support"

config BR2_PACKAGE_SDL_IMAGE_JPEG
	bool "JPEG support"
	select BR2_PACKAGE_JPEG

config BR2_PACKAGE_SDL_IMAGE_LBM
	bool "LBM support"

config BR2_PACKAGE_SDL_IMAGE_PCX
	bool "PCX support"

config BR2_PACKAGE_SDL_IMAGE_PNG
	bool "PNG support"
	select BR2_PACKAGE_LIBPNG

config BR2_PACKAGE_SDL_IMAGE_PNM
	bool "PNM support"

config BR2_PACKAGE_SDL_IMAGE_TARGA
	bool "TARGA support"

config BR2_PACKAGE_SDL_IMAGE_TIFF
	bool "TIFF support"
	select BR2_PACKAGE_TIFF

config BR2_PACKAGE_SDL_IMAGE_WEBP
	bool "WEBP support"
	select BR2_PACKAGE_WEBP

config BR2_PACKAGE_SDL_IMAGE_XCF
	bool "XCF support"

config BR2_PACKAGE_SDL_IMAGE_XPM
	bool "XPM support"

config BR2_PACKAGE_SDL_IMAGE_XV
	bool "XV support"

endif
```

## package/sdl_mixer/Config.in
```kconfig
config BR2_PACKAGE_SDL_MIXER
	bool "SDL_mixer"
	default n
	help

	  SDL_mixer is a sample multi-channel audio mixer library.
	  It supports any number of simultaneously playing channels of
	  16 bit stereo audio, plus a single channel of music, mixed
	  by the popular MikMod MOD, Timidity MIDI, Ogg Vorbis, and
	  SMPEG MP3 libraries.

	  http://www.libsdl.org/projects/SDL_mixer/
```

## package/sdl_net/Config.in
```kconfig
config BR2_PACKAGE_SDL_NET
	bool "SDL_net"
	depends on BR2_PACKAGE_SDL
	help
	  SDL_net is a small, low-level, cross-platform network
	  library, that can be used with the Simple DirectMedia Layer
	  library (SDL).

	  http://www.libsdl.org/projects/SDL_net/
```

## package/sdl_sound/Config.in
```kconfig
config BR2_PACKAGE_SDL_SOUND
	bool "SDL_sound"
	depends on BR2_PACKAGE_SDL
	select BR2_PACKAGE_LIBICONV if !BR2_ENABLE_LOCALE
	help
	  SDL_sound is a library that handles the decoding of several
	  popular sound file formats, such as .WAV and .MP3.
	  It is meant to make the programmer's sound playback tasks
	  simpler. The programmer gives SDL_sound a filename, or feeds
	  it data directly from one of many sources, and then reads the
	  decoded waveform data back at her leisure.

	  http://icculus.org/SDL_sound/

if BR2_PACKAGE_SDL_SOUND

config BR2_PACKAGE_SDL_SOUND_PLAYSOUND
	bool "install playsound tool"
	help
	  Enable this option to install the playsound/playsound_simple
	  tools to target.

endif
```

## package/sdl_ttf/Config.in
```kconfig
config BR2_PACKAGE_SDL_TTF
	bool "SDL_TTF"
	depends on BR2_PACKAGE_SDL
	default n
	select BR2_PACKAGE_FREETYPE
	help
	  SDL_ttf is a sample TrueType font library. It allows you to
	  use TrueType fonts in your SDL applications.

	  http://www.libsdl.org/projects/SDL_ttf/
```

## package/sdparm/Config.in
```kconfig
config BR2_PACKAGE_SDPARM
	bool "sdparm"
	help
	  Utility to accesses SCSI device parameters.

	  http://sg.danny.cz/sg/sdparm.html
```

## package/sed/Config.in
```kconfig
config BR2_PACKAGE_SED
	bool "sed"
	depends on BR2_USE_WCHAR
	depends on BR2_PACKAGE_BUSYBOX_SHOW_OTHERS
	help
	  sed (stream editor) is a non-interactive command-line text
	  editor.

	  https://www.gnu.org/software/sed/

comment "sed needs a toolchain w/ wchar"
	depends on !BR2_USE_WCHAR
	depends on BR2_PACKAGE_BUSYBOX_SHOW_OTHERS
```

## package/sedutil/Config.in
```kconfig
config BR2_PACKAGE_SEDUTIL_ARCH_SUPPORTS
	bool
	# no big endian support
	default y if BR2_arcle || BR2_arm || BR2_aarch64 || BR2_csky \
	       || BR2_i386 || BR2_microblazeel || BR2_mipsel \
	       || BR2_mips64el || BR2_nios2 || BR2_powerpc64le \
	       || BR2_sh4 || BR2_sh4a || BR2_x86_64 \
	       || BR2_XTENSA_LITTLE_ENDIAN

config BR2_PACKAGE_SEDUTIL
	bool "sedutil"
	depends on BR2_PACKAGE_SEDUTIL_ARCH_SUPPORTS
	depends on BR2_TOOLCHAIN_HEADERS_AT_LEAST_3_12 # linux/nvme.h
	depends on BR2_TOOLCHAIN_GCC_AT_LEAST_4_8 # C++11
	depends on !BR2_TOOLCHAIN_EXTERNAL_CODESOURCERY_MIPS # 4.4.1 headers
	depends on BR2_INSTALL_LIBSTDCPP
	help
	  The Drive Trust Alliance Self Encrypting Drive Utility,
	  allowing configuration the SEDs that comply with the
	  TCG OPAL 2.00 standard.

          https://github.com/Drive-Trust-Alliance/sedutil

comment "sedutil needs a toolchain w/ C++, gcc >= 4.8, headers >= 3.12"
	depends on BR2_PACKAGE_SEDUTIL_ARCH_SUPPORTS
	depends on !BR2_TOOLCHAIN_EXTERNAL_CODESOURCERY_MIPS
	depends on !BR2_INSTALL_LIBSTDCPP || \
		!BR2_TOOLCHAIN_GCC_AT_LEAST_4_8 || \
		!BR2_TOOLCHAIN_HEADERS_AT_LEAST_3_12
```

## package/selinux-python/Config.in
```kconfig
config BR2_PACKAGE_SELINUX_PYTHON
	bool "selinux-python"
	depends on !BR2_PACKAGE_PYTHON
	depends on BR2_USE_MMU
	depends on BR2_USE_WCHAR
	depends on BR2_TOOLCHAIN_HAS_THREADS
	depends on !BR2_STATIC_LIBS
	select BR2_PACKAGE_PYTHON3
	help
	  A set of SELinux tools written in python that help with
	  managing a system with SELinux enabled. If no packages are
	  selected nothing will actually be built.

	  https://github.com/SELinuxProject/selinux/wiki

if BR2_PACKAGE_SELINUX_PYTHON

config BR2_PACKAGE_SELINUX_PYTHON_AUDIT2ALLOW
	bool "audit2allow"
	select BR2_PACKAGE_CHECKPOLICY
	select BR2_PACKAGE_SELINUX_PYTHON_SEPOLGEN
	select BR2_PACKAGE_SEMODULE_UTILS
	help
	  This module installs two programs:

	  audit2allow - Generate SELinux policy allow/dontaudit rules
	  from logs of denied operations.

	  audit2why - translates SELinux audit messages into a
	  description of why the access was denied (audit2allow -w)

config BR2_PACKAGE_SELINUX_PYTHON_SEPOLGEN
	bool "sepolgen"
	select BR2_PACKAGE_SEMODULE_UTILS
	help
	  This package contains a Python module that allows you to
	  generate an initial SELinux policy module template.

endif

comment "selinux-python needs python3"
	depends on BR2_USE_MMU
	depends on BR2_PACKAGE_PYTHON

comment "selinux-python packages needs a toolchain w/ wchar, threads, dynamic library"
	depends on BR2_USE_MMU
	depends on !BR2_USE_WCHAR || !BR2_TOOLCHAIN_HAS_THREADS || \
		BR2_STATIC_LIBS
```

## package/semodule-utils/Config.in
```kconfig
config BR2_PACKAGE_SEMODULE_UTILS
	bool "semodule-utils"
	select BR2_PACKAGE_LIBSEPOL
	help
	  semodule-utils is a package that contains tools for handling
	  selinux modules.

	  The package will install the following utilities:
	  * semodule_deps - Show the dependencies between SELinux
	    policy packages.
	  * semodule_expand - Expand a SELinux policy module package.
	  * semodule_link - Link SELinux policy module packages together
	  * semodule_package - Create a SELinux policy module package.

	  https://github.com/SELinuxProject/selinux/wiki/Releases
```

## package/sepolgen/Config.in
```kconfig
config BR2_PACKAGE_SEPOLGEN
	bool "sepolgen"
	select BR2_PACKAGE_PYTHON3 if !BR2_PACKAGE_PYTHON
	depends on BR2_USE_WCHAR # python3
	depends on BR2_USE_MMU # python3
	depends on BR2_TOOLCHAIN_HAS_THREADS # python3
	depends on !BR2_STATIC_LIBS # python3
	help
	  This package contains a Python module that forms the core of
	  the modern audit2allow (which is a part of the package
	  policycoreutils).  It contains infrastructure for parsing
	  SELinux related messages as produced by the audit system.
	  It has facilities for generating policy based on required
	  access.

comment "sepolgen needs a toolchain w/ wchar, threads, dynamic library"
	depends on BR2_USE_MMU
	depends on !BR2_USE_WCHAR || !BR2_TOOLCHAIN_HAS_THREADS || \
		BR2_STATIC_LIBS
```

## package/ser2net/Config.in
```kconfig
config BR2_PACKAGE_SER2NET
	bool "ser2net"
	depends on BR2_USE_MMU # fork()
	select BR2_PACKAGE_GENSIO
	select BR2_PACKAGE_LIBYAML
	help
	  Ser2net provides a way for a user to connect from a network
	  connection to a serial port.

	  http://ser2net.sourceforge.net
```

## package/setools/Config.in
```kconfig
config BR2_PACKAGE_SETOOLS
	bool "setools"
	depends on !BR2_arc # arc: libselinux not available
	depends on !BR2_STATIC_LIBS
	depends on BR2_TOOLCHAIN_HAS_THREADS
	depends on BR2_USE_WCHAR
	depends on BR2_TOOLCHAIN_USES_GLIBC # libselinux
	depends on BR2_USE_MMU
	select BR2_PACKAGE_PYTHON3 if !BR2_PACKAGE_PYTHON
	select BR2_PACKAGE_PYTHON_ENUM34 if !BR2_PACKAGE_PYTHON3
	select BR2_PACKAGE_PYTHON_NETWORKX # runtime
	select BR2_PACKAGE_PYTHON_SETUPTOOLS
	select BR2_PACKAGE_LIBSELINUX
	help
	  SETools is an open source project designed to facilitate
	  SELinux policy analysis. The primary tools are:
	   * apol - analyze a SELinux policy. (requires python-qt5)
	   * sediff - semantic policy difference tool for SELinux.
	   * sedta - Perform domain transition analyses
	   * seinfoflow - information flow analysis for SELinux
	   * sesearch - Search rules (allow, type_transition, etc.)

	  https://github.com/TresysTechnology/setools

comment "setools needs a glibc toolchain w/ threads, C++, wchar, dynamic library"
	depends on BR2_USE_MMU && !BR2_arc
	depends on !BR2_TOOLCHAIN_HAS_THREADS || BR2_STATIC_LIBS || \
		!BR2_USE_WCHAR || !BR2_TOOLCHAIN_USES_GLIBC || \
		!BR2_INSTALL_LIBSTDCPP
```

## package/setserial/Config.in
```kconfig
config BR2_PACKAGE_SETSERIAL
	bool "setserial"
	# Uses fork()
	depends on BR2_USE_MMU
	help
	     Setserial : configuration of serial ports
```

## package/sfdisk/Config.in
```kconfig
config BR2_PACKAGE_SFDISK
	bool "sfdisk"
	depends on BR2_DEPRECATED
	help
	  Partition table manipulator for Linux.
```

## package/sg3_utils/Config.in
```kconfig
config BR2_PACKAGE_SG3_UTILS
	bool "sg3-utils"
	depends on BR2_LARGEFILE
	depends on BR2_TOOLCHAIN_HAS_THREADS
	help
	  Low level utilities for devices that use a SCSI command set.
	  This option install only libsgutils2 library not programs.

	  http://sg.danny.cz/sg/sg3_utils.html

config BR2_PACKAGE_SG3_UTILS_PROGS
	bool "install programs"
	depends on BR2_PACKAGE_SG3_UTILS

comment "sg3-utils needs a toolchain w/ largefile, threads"
	depends on !BR2_LARGEFILE || !BR2_TOOLCHAIN_HAS_THREADS
```

## package/shadowsocks-libev/Config.in
```kconfig
config BR2_PACKAGE_SHADOWSOCKS_LIBEV
	bool "shadowsocks-libev"
	depends on BR2_TOOLCHAIN_HAS_SYNC_4 # for libcork
	depends on BR2_TOOLCHAIN_HAS_SYNC_8 || !BR2_ARCH_IS_64 # for libcork
	depends on BR2_TOOLCHAIN_HAS_THREADS
	depends on BR2_USE_MMU # fork()
	select BR2_PACKAGE_C_ARES
	select BR2_PACKAGE_LIBEV
	select BR2_PACKAGE_LIBSODIUM
	select BR2_PACKAGE_MBEDTLS
	select BR2_PACKAGE_PCRE
	help
	  Shadowsocks-libev is a lightweight secured SOCKS5 proxy for
	  embedded devices and low-end boxes.

	  https://github.com/shadowsocks/shadowsocks-libev

config BR2_PACKAGE_SHADOWSOCKS_LIBEV_CONNMARKTOS
	bool "connmarktos support in ss-server"
	depends on BR2_PACKAGE_SHADOWSOCKS_LIBEV
	select BR2_PACKAGE_LIBNETFILTER_CONNTRACK
	help
	  Build ss-server with the connmark to TOS feature.

	  This feature requires advanced tc, iptables and conntrack
	  rules to perform QoS on the server side.

	  If unsure, don't enable this option

comment "shadowsocks-libev needs a toolchain w/ threads"
	depends on BR2_TOOLCHAIN_HAS_SYNC_4
	depends on BR2_TOOLCHAIN_HAS_SYNC_8 || !BR2_ARCH_IS_64
	depends on BR2_USE_MMU
	depends on !BR2_TOOLCHAIN_HAS_THREADS
```

## package/shairport-sync/Config.in
```kconfig
config BR2_PACKAGE_SHAIRPORT_SYNC
	bool "shairport-sync"
	depends on BR2_USE_MMU # libdaemon
	depends on BR2_TOOLCHAIN_HAS_THREADS_NPTL
	select BR2_PACKAGE_ALSA_LIB
	select BR2_PACKAGE_ALSA_LIB_MIXER
	select BR2_PACKAGE_LIBDAEMON
	select BR2_PACKAGE_POLARSSL if !BR2_PACKAGE_OPENSSL
	select BR2_PACKAGE_POPT
	help
	  Shairport Sync emulates an AirPort Express for the purpose of
	  streaming audio from iTunes, iPods, iPhones, iPads and AppleTVs.
	  Audio played by a Shairport Sync-powered device stays in synchrony
	  with the source and thus with other devices that are playing the same
	  source synchronously. Thus, for example, synchronised multi-room
	  audio is possible without difficulty.

	  https://github.com/mikebrady/shairport-sync

if BR2_PACKAGE_SHAIRPORT_SYNC

config BR2_PACKAGE_SHAIRPORT_SYNC_LIBSOXR
	bool "libsoxr support"
	select BR2_PACKAGE_LIBSOXR
	help
	  Enable support for libsoxr, the SoX Resampler library.

	  Briefly, Shairport Sync keeps in step with the audio source by
	  deleting or inserting frames of audio into the stream as needed. This
	  "interpolation" is normally inaudible, but it can be heard in some
	  circumstances. Libsoxr allows this interpolation to be done much more
	  smoothly and subtly.

endif

comment "shairport-sync needs a toolchain w/ NPTL"
	depends on BR2_USE_MMU
	depends on !BR2_TOOLCHAIN_HAS_THREADS_NPTL
```

## package/shapelib/Config.in
```kconfig
config BR2_PACKAGE_SHAPELIB
	bool "shapelib"
	depends on BR2_INSTALL_LIBSTDCPP
	depends on BR2_TOOLCHAIN_HAS_THREADS
	select BR2_PACKAGE_PROJ
	help
	  The Shapefile C Library provides the ability to write simple
	  C programs for reading, writing and updating (to a limited
	  extent) ESRI Shapefiles, and the associated attribute file
	  (.dbf).

	  http://shapelib.maptools.org/

comment "shapelib needs a toolchain w/ C++, threads"
	depends on !BR2_INSTALL_LIBSTDCPP || !BR2_TOOLCHAIN_HAS_THREADS
```

## package/shared-mime-info/Config.in
```kconfig
config BR2_PACKAGE_SHARED_MIME_INFO
	bool "shared-mime-info"
	depends on BR2_USE_WCHAR # glib2
	depends on BR2_TOOLCHAIN_HAS_THREADS # glib2
	select BR2_PACKAGE_LIBGLIB2
	select BR2_PACKAGE_LIBXML2
	help
	  The shared-mime-info package contains the core
	  database of common types and the update-mime-database
	  command used to extend it.

	  http://freedesktop.org/wiki/Software/shared-mime-info

comment "shared-mime-info requires a toolchain with WCHAR and threading support"
	depends on !BR2_USE_WCHAR || !BR2_TOOLCHAIN_HAS_THREADS
```

## package/shellinabox/Config.in
```kconfig
config BR2_PACKAGE_SHELLINABOX
	bool "shellinabox"
	depends on BR2_USE_MMU # fork()
	depends on !BR2_STATIC_LIBS # dlfcn.h
	select BR2_PACKAGE_OPENSSL
	select BR2_PACKAGE_ZLIB
	help
	  Shell In A Box implements a web server that can export
	  arbitrary command line tools to a web based terminal
	  emulator. This emulator is accessible to any JavaScript and
	  CSS enabled web browser and does not require any additional
	  browser plugins.

	  https://github.com/shellinabox/shellinabox

comment "shellinabox needs a toolchain w/ dynamic library"
	depends on BR2_USE_MMU
	depends on BR2_STATIC_LIBS
```

## package/sigrok-cli/Config.in
```kconfig
config BR2_PACKAGE_SIGROK_CLI
	bool "sigrok-cli"
	# libsigrok->libglib2:
	depends on BR2_USE_WCHAR
	depends on BR2_TOOLCHAIN_HAS_THREADS
	depends on BR2_USE_MMU
	# libsigrok->libzip
	depends on !BR2_STATIC_LIBS
	# libsigrok
	depends on BR2_TOOLCHAIN_GCC_AT_LEAST_4_7
	depends on BR2_ENABLE_LOCALE
	select BR2_PACKAGE_LIBSIGROK
	help
	  Sigrok-cli is a command-line frontend for the sigrok
	  software suite.

	  http://sigrok.org/wiki/Sigrok-cli

comment "sigrok-cli needs a toolchain w/ locale, wchar, threads, dynamic library, gcc >= 4.7"
	depends on BR2_USE_MMU
	depends on !BR2_USE_WCHAR || !BR2_TOOLCHAIN_HAS_THREADS \
		|| !BR2_TOOLCHAIN_GCC_AT_LEAST_4_7 || BR2_STATIC_LIBS \
		|| !BR2_ENABLE_LOCALE
```

## package/sispmctl/Config.in
```kconfig
config BR2_PACKAGE_SISPMCTL
	bool "sispmctl"
	depends on BR2_TOOLCHAIN_HAS_THREADS # libusb
	depends on BR2_USE_WCHAR
	depends on BR2_USE_MMU # fork()
	select BR2_PACKAGE_LIBUSB
	select BR2_PACKAGE_LIBUSB_COMPAT
	help
	  sispmctl is an application enabling the use of the GEMBIRD
	  SiS-PM and mSiS(sispm) USB-controlled power-outlet device
	  under Linux. Note that the device is also sold under
	  different Names, i.e. as "IntelliPlug" in Germany.

	  http://sispmctl.sourceforge.net/

comment "sispmctl needs a toolchain w/ threads, wchar"
	depends on !BR2_TOOLCHAIN_HAS_THREADS || !BR2_USE_WCHAR
	depends on BR2_USE_MMU
```
