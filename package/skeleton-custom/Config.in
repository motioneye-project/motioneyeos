## package/skeleton-custom/Config.in
```kconfig
config BR2_PACKAGE_SKELETON_CUSTOM
	bool
	select BR2_PACKAGE_HAS_SKELETON

config BR2_PACKAGE_PROVIDES_SKELETON
	default "skeleton-custom" if BR2_PACKAGE_SKELETON_CUSTOM
```

## package/skeleton-init-none/Config.in
```kconfig
config BR2_PACKAGE_SKELETON_INIT_NONE
	bool
	select BR2_PACKAGE_HAS_SKELETON
	select BR2_PACKAGE_SKELETON_INIT_COMMON

config BR2_PACKAGE_PROVIDES_SKELETON
	default "skeleton-init-none" if BR2_PACKAGE_SKELETON_INIT_NONE
```

## package/skeleton-init-openrc/Config.in
```kconfig
config BR2_PACKAGE_SKELETON_INIT_OPENRC
	bool
	select BR2_PACKAGE_HAS_SKELETON
	select BR2_PACKAGE_SKELETON_INIT_COMMON

config BR2_PACKAGE_PROVIDES_SKELETON
	default "skeleton-init-openrc" if BR2_PACKAGE_SKELETON_INIT_OPENRC
```

## package/skeleton-init-systemd/Config.in
```kconfig
config BR2_PACKAGE_SKELETON_INIT_SYSTEMD
	bool
	select BR2_PACKAGE_HAS_SKELETON
	select BR2_PACKAGE_SKELETON_INIT_COMMON

config BR2_PACKAGE_PROVIDES_SKELETON
	default "skeleton-init-systemd" if BR2_PACKAGE_SKELETON_INIT_SYSTEMD
```

## package/skeleton-init-sysv/Config.in
```kconfig
config BR2_PACKAGE_SKELETON_INIT_SYSV
	bool
	select BR2_PACKAGE_HAS_SKELETON
	select BR2_PACKAGE_SKELETON_INIT_COMMON

config BR2_PACKAGE_PROVIDES_SKELETON
	default "skeleton-init-sysv" if BR2_PACKAGE_SKELETON_INIT_SYSV
```

## package/skeleton-none/Config.in
```kconfig
config BR2_PACKAGE_SKELETON_NONE
	bool
	select BR2_PACKAGE_HAS_SKELETON
	select BR2_PACKAGE_SKELETON_COMMON

config BR2_PACKAGE_PROVIDES_SKELETON
	default "skeleton-none" if BR2_PACKAGE_SKELETON_NONE
```

## package/skeleton-systemd/Config.in
```kconfig
config BR2_PACKAGE_SKELETON_SYSTEMD
	bool
	select BR2_PACKAGE_HAS_SKELETON
	select BR2_PACKAGE_SKELETON_COMMON

config BR2_PACKAGE_PROVIDES_SKELETON
	default "skeleton-systemd" if BR2_PACKAGE_SKELETON_SYSTEMD
```

## package/skeleton-sysv/Config.in
```kconfig
config BR2_PACKAGE_SKELETON_SYSV
	bool
	select BR2_PACKAGE_HAS_SKELETON
	select BR2_PACKAGE_SKELETON_COMMON

config BR2_PACKAGE_PROVIDES_SKELETON
	default "skeleton-sysv" if BR2_PACKAGE_SKELETON_SYSV
```

## package/skeleton/Config.in
```kconfig
config BR2_PACKAGE_SKELETON
	bool
	default y

config BR2_PACKAGE_HAS_SKELETON
	bool

config BR2_PACKAGE_PROVIDES_SKELETON
	string
```

## package/sl/Config.in
```kconfig
config BR2_PACKAGE_SL
	bool "sl"
	select BR2_PACKAGE_NCURSES
	help
	  SL (Steam Locomotive) runs across your terminal when you
	  type "sl" as you meant to type "ls". It's just a joke
	  command, and not useful at all.

	  https://github.com/mtoyoda/sl
```

## package/slang/Config.in
```kconfig
config BR2_PACKAGE_SLANG
	bool "slang"
	depends on BR2_USE_MMU # fork()
	help
	  Multi-platform console display library.

	  http://www.jedsoft.org/slang/index.html
```

## package/slirp/Config.in
```kconfig
config BR2_PACKAGE_SLIRP
	bool "slirp"
	help
	  The Spice project aims to provide a complete open source
	  solution for interaction with virtualized desktop devices.
	  The Spice project deals with both the virtualized devices
	  and the front-end. Interaction between front-end and
	  back-end is done using VD-Interfaces.

	  This package implements the slirp-part for Spice. Slirp
	  emulates a PPP or SLIP connection over a normal terminal.

	  http://www.spice-space.org/

	  NOTE:
	  This package has some history of a unique kind:
	    - originally developped as 'slirp' by Danny Gasparovski, and
	      seemingly abandonned (developper /disapeared/)
	    - then re-maintained at sourceforge by "Kelly", up to some
	      time around 2009: http://slirp.sourceforge.net/
	    - during that period, QEMU (Fabrice BELLARD) forked the code
	      and included it in QEMU
	    - and it was imported from this breed by the Spice project
	      around May 2009
	    - which is what we use here
```

## package/smack/Config.in
```kconfig
config BR2_PACKAGE_SMACK
	bool "smack"
	depends on !BR2_PREFER_STATIC_LIB # dlfcn.h
	depends on BR2_TOOLCHAIN_HAS_THREADS
	depends on BR2_TOOLCHAIN_HEADERS_AT_LEAST_3_0
	help
	  User space programs and libraries for SMACK.

	  SMACK stands for Simplified Mandatory Access Control Kernel.
	  It is a Linux Security Module which provides a Mandatory Access
	  Control mechanism, aimed towards simplicity.

	  This package provides a library which allows applications to work
	  with SMACK and tools to load/unload rules from the kernel, as well
	  as query the policy.

	  SMACK requires the following kernel options to be enabled:

	  - CONFIG_SECURITY
	  - CONFIG_SECURITY_SMACK
	  - CONFIG_SECURITY_NETWORK

	  These options will be automatically enabled by Buildroot if it is
	  responsible for building the kernel. Otherwise, if you are building
	  your kernel outside of Buildroot, make sure these options are
	  enabled.

	  To activate SMACK, do not forget to add "security=smack" to your
	  kernel command line.

	  https://github.com/smack-team/smack

comment "smack needs a toolchain w/ dynamic library, threads, headers >= 3.0"
	depends on BR2_PREFER_STATIC_LIB || !BR2_TOOLCHAIN_HEADERS_AT_LEAST_3_0 \
		|| !BR2_TOOLCHAIN_HAS_THREADS
```

## package/smartmontools/Config.in
```kconfig
config BR2_PACKAGE_SMARTMONTOOLS
	bool "smartmontools"
	depends on BR2_INSTALL_LIBSTDCPP
	depends on BR2_USE_MMU # fork()
	help
	  Control and monitor storage systems using S.M.A.R.T.

	  http://smartmontools.sourceforge.net/

comment "smartmontools needs a toolchain w/ C++"
	depends on !BR2_INSTALL_LIBSTDCPP
```

## package/smcroute/Config.in
```kconfig
config BR2_PACKAGE_SMCROUTE
	bool "smcroute"
	depends on BR2_USE_MMU # fork()
	help
	  SMCRoute is a command line tool to manipulate the multicast
	  routes of a UNIX kernel. It supports both IPv4 and IPv6 multicast
	  routing. SMCRoute can be used as an alternative to dynamic
	  multicast routers like mrouted or pimd in setups where static
	  multicast routes should be maintained and/or no proper IGMP or
	  MLD signaling exists.

	  https://github.com/troglobit/smcroute
```

## package/snappy/Config.in
```kconfig
config BR2_PACKAGE_SNAPPY
	bool "snappy"
	depends on BR2_INSTALL_LIBSTDCPP
	help
	  Snappy is a compression/decompression library. It does not aim for
	  maximum compression, or compatibility with any other compression
	  library; instead, it aims for very high speeds and reasonable
	  compression.

	  http://google.github.io/snappy/

comment "snappy needs a toolchain w/ C++"
	depends on !BR2_INSTALL_LIBSTDCPP
```

## package/snmpclitools/Config.in
```kconfig
config BR2_PACKAGE_SNMPCLITOOLS
	bool "snmpclitools"
	depends on BR2_PACKAGE_PYTHON || BR2_PACKAGE_PYTHON3
	select BR2_PACKAGE_PYTHON_PYSMI # runtime
	select BR2_PACKAGE_PYTHON_PYSNMP # runtime
	help
	  SNMP command-line tools.

	  https://github.com/etingof/snmpclitools
```

## package/snmppp/Config.in
```kconfig
config BR2_PACKAGE_SNMPPP
	bool "snmp++"
	depends on BR2_INSTALL_LIBSTDCPP
	depends on BR2_TOOLCHAIN_HAS_THREADS
	depends on !BR2_PREFER_STATIC_LIB
	help
	  SNMP++v3.x is a C++ API which supports SNMP v1, v2c, and v3.

	  http://www.agentpp.com/snmp_pp3_x/snmp_pp3_x.html

if BR2_PACKAGE_SNMPPP

config BR2_PACKAGE_SNMPPP_LOGGING
	bool "enable logging"
	help
	  Enable logging output for SNMP++.
	  According to the SNMP++ documentation, disabling logging "increases
	  performance drastically and minimizes memory consumption".

config BR2_PACKAGE_SNMPPP_SNMPV3
	bool "enable SNMPv3"
	default y
	select BR2_PACKAGE_OPENSSL
	help
	  Enable optional support for SNMP++. This selects OpenSSL.

endif

comment "snmp++ needs a toolchain w/ threads, C++, dynamic library"
	depends on !BR2_INSTALL_LIBSTDCPP || !BR2_TOOLCHAIN_HAS_THREADS || \
		BR2_PREFER_STATIC_LIB
```

## package/snort/Config.in
```kconfig
config BR2_PACKAGE_SNORT
	bool "snort"
	depends on BR2_USE_WCHAR
	depends on BR2_USE_MMU # fork()
	depends on !BR2_STATIC_LIBS # daq
	depends on BR2_TOOLCHAIN_HAS_NATIVE_RPC || BR2_TOOLCHAIN_HAS_THREADS # libtirpc
	select BR2_PACKAGE_LIBDNET
	select BR2_PACKAGE_LIBPCAP
	select BR2_PACKAGE_DAQ
	select BR2_PACKAGE_PCRE
	select BR2_PACKAGE_LIBTIRPC if !BR2_TOOLCHAIN_HAS_NATIVE_RPC
	select BR2_PACKAGE_ZLIB
	help
	  Snort is a free and open source network intrusion
	  prevention system (IPS) and network intrusion detection
	  system (IDS). It can perform protocol analysis, content
	  searching/matching, and can be used to detect a variety
	  of attacks and probes, such as buffer overflows, stealth
	  port scans, CGI attacks, SMB probes, OS fingerprinting
	  attempts, and much more.

	  https://www.snort.org

comment "snort needs a toolchain w/ wchar, threads, dynamic library"
	depends on BR2_USE_MMU
	depends on !BR2_USE_WCHAR || BR2_STATIC_LIBS || \
		!(BR2_TOOLCHAIN_HAS_THREADS || BR2_TOOLCHAIN_HAS_NATIVE_RPC)
```

## package/snowball-hdmiservice/Config.in
```kconfig
config BR2_PACKAGE_SNOWBALL_HDMISERVICE
	bool "snowball-hdmiservice"
	depends on BR2_TOOLCHAIN_HAS_THREADS
	depends on !BR2_STATIC_LIBS
	help
	  HDMI userspace control daemon

	  This package contains the HDMI userspace control daemon for the
	  snowball board

	  http://www.igloocommunity.org

comment "snowball-hdmiservice needs a toolchain w/ threads, dynamic library"
	depends on !BR2_TOOLCHAIN_HAS_THREADS || BR2_STATIC_LIBS
```

## package/snowball-init/Config.in
```kconfig
config BR2_PACKAGE_SNOWBALL_INIT
	bool "snowball-init"
	# Runtime dependency, needed by snowball startup script
	select BR2_PACKAGE_BLUEZ_UTILS
	depends on !BR2_STATIC_LIBS # bluez_utils
	depends on BR2_USE_WCHAR # libglib2
	depends on BR2_TOOLCHAIN_HAS_THREADS # dbus, alsa-lib, libglib2
	depends on BR2_USE_MMU # dbus
	select BR2_PACKAGE_UX500_FIRMWARE
	help
	  Snowball init scripts

	  http://www.igloocommunity.org

comment "snowball-init needs a toolchain w/ wchar, threads, dynamic library"
	depends on BR2_USE_MMU
	depends on !BR2_USE_WCHAR || !BR2_TOOLCHAIN_HAS_THREADS || BR2_STATIC_LIBS
```

## package/socat/Config.in
```kconfig
config BR2_PACKAGE_SOCAT
	bool "socat"
	depends on BR2_USE_MMU # fork()
	help
	  Multipurpose socket relay program.

	  http://www.dest-unreach.org/socat/
```

## package/socketcand/Config.in
```kconfig
config BR2_PACKAGE_SOCKETCAND
	bool "socketcand"
	depends on BR2_TOOLCHAIN_HAS_THREADS
	depends on BR2_USE_MMU # fork()
	help
	  Socketcand is a daemon that provides access to CAN interfaces
	  on a machine via a network interface.

	  https://github.com/dschanoeh/socketcand

comment "socketcand needs a toolchain w/ threads"
	depends on BR2_USE_MMU
	depends on !BR2_TOOLCHAIN_HAS_THREADS
```

## package/sofia-sip/Config.in
```kconfig
config BR2_PACKAGE_SOFIA_SIP
	bool "sofia-sip"
	depends on BR2_TOOLCHAIN_HAS_THREADS
	help
	  Sofia-SIP is an open-source SIP User-Agent library,
	  compliant with the IETF RFC3261 specification (see the
	  feature table). It can be used as a building block for SIP
	  client software for uses such as VoIP, IM, and many other
	  real-time and person-to-person communication services.

	  http://sofia-sip.sourceforge.net/

comment "sofia-sip needs a toolchain w/ threads"
	depends on !BR2_TOOLCHAIN_HAS_THREADS
```
