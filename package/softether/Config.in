## package/squeezelite/Config.in
```kconfig
config BR2_PACKAGE_SQUEEZELITE
	bool "squeezelite"
	depends on BR2_USE_WCHAR # flac
	depends on BR2_TOOLCHAIN_HAS_THREADS_NPTL
	depends on BR2_USE_MMU # mpg123
	depends on !BR2_STATIC_LIBS # dlopen
	select BR2_PACKAGE_ALSA_LIB
	select BR2_PACKAGE_ALSA_LIB_MIXER
	select BR2_PACKAGE_FLAC
	select BR2_PACKAGE_LIBMAD
	select BR2_PACKAGE_LIBVORBIS
	select BR2_PACKAGE_FAAD2
	select BR2_PACKAGE_MPG123
	help
	  Logitech Media Server client

	  https://code.google.com/p/squeezelite/

if BR2_PACKAGE_SQUEEZELITE

config BR2_PACKAGE_SQUEEZELITE_FFMPEG
	bool "Enable WMA and ALAC decoding"
	default y
	depends on BR2_PACKAGE_FFMPEG_ARCH_SUPPORTS
	select BR2_PACKAGE_FFMPEG

config BR2_PACKAGE_SQUEEZELITE_DSD
	bool "Enable DSD decoding"

config BR2_PACKAGE_SQUEEZELITE_RESAMPLE
	bool "Enable resampling support"
	select BR2_PACKAGE_LIBSOXR

config BR2_PACKAGE_SQUEEZELITE_VISEXPORT
	bool "Enable visualiser support"

endif

comment "squeezelite needs a toolchain w/ wchar, NPTL, dynamic library"
	depends on BR2_USE_MMU
	depends on !BR2_USE_WCHAR || !BR2_TOOLCHAIN_HAS_THREADS_NPTL \
		|| BR2_STATIC_LIBS
```

## package/squid/Config.in
```kconfig
comment "squid needs a toolchain w/ C++"
	depends on BR2_USE_MMU
	depends on !BR2_INSTALL_LIBSTDCPP

config BR2_PACKAGE_SQUID
	bool "squid"
	depends on BR2_INSTALL_LIBSTDCPP
	# needs fork()
	depends on BR2_USE_MMU
	select BR2_PACKAGE_LIBCAP
	help
	  Caching proxy for the Web supporting HTTP, HTTPS, FTP, and
	  more.

	  http://www.squid-cache.org/
```

## package/sredird/Config.in
```kconfig
config BR2_PACKAGE_SREDIRD
	bool "sredird"
	help
	  Sredird is a serial port redirector that is compliant with
	  the RFC 2217 "Telnet Com Port Control Option" protocol. This
	  protocol lets you share a serial port through the network.
```

## package/sshfs/Config.in
```kconfig
config BR2_PACKAGE_SSHFS
	bool "sshfs (FUSE)"
	depends on BR2_USE_WCHAR # glib2
	depends on BR2_TOOLCHAIN_HAS_THREADS # libfuse, glib2
	depends on BR2_USE_MMU # libfuse, glib2
	depends on !BR2_STATIC_LIBS # libfuse
	select BR2_PACKAGE_LIBFUSE
	select BR2_PACKAGE_LIBGLIB2
	select BR2_PACKAGE_LIBICONV if !BR2_ENABLE_LOCALE
	select BR2_PACKAGE_OPENSSH
	help
	  FUSE filesystem client based on the SSH File Transfer Protocol.

	  https://github.com/libfuse/sshfs

comment "sshfs needs a toolchain w/ wchar, threads, dynamic library"
	depends on BR2_USE_MMU
	depends on !BR2_USE_WCHAR || !BR2_TOOLCHAIN_HAS_THREADS || BR2_STATIC_LIBS
```
