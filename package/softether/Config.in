## package/softether/Config.in
```kconfig
config BR2_PACKAGE_SOFTETHER
	bool "softether"
	depends on BR2_TOOLCHAIN_HAS_THREADS
	depends on BR2_USE_MMU # fork()
	depends on BR2_USE_WCHAR
	select BR2_PACKAGE_LIBICONV if !BR2_ENABLE_LOCALE
	select BR2_PACKAGE_OPENSSL
	select BR2_PACKAGE_READLINE
	help
	  The SoftEther Server is a fully integrated implementation of the SSTP,
	  L2TP, L2TPv3, OpenVPN, and IPSec virtual private networking protocols
	  on Linux and several other platforms. It is generally compatible with
	  other implementations by Apple, Cisco, Juniper, Microsoft, et al.

	  Convenient Layer-2 and Layer-3 bridging capabilities can connect
	  several branch offices into a single broadcast or routing domain, even
	  behind a NAT or without a static IPv4 address.

	  In addition to supporting most VPN protocols, the SoftEther Client can
	  penetrate hardened firewalls and captured gateways through HTTPS, DNS,
	  and ICMP exfiltration.

	  http://www.softether.org

comment "softether needs a toolchain w/ wchar, threads"
	depends on BR2_USE_MMU
	depends on !(BR2_USE_WCHAR && BR2_TOOLCHAIN_HAS_THREADS)
```

## package/solarus/Config.in
```kconfig
config BR2_PACKAGE_SOLARUS
	bool "solarus"
	depends on BR2_INSTALL_LIBSTDCPP
	depends on BR2_PACKAGE_LUAJIT_ARCH_SUPPORTS
	depends on BR2_PACKAGE_OPENAL_ARCH_SUPPORTS
	depends on BR2_TOOLCHAIN_GCC_AT_LEAST_4_8 # C++11
	depends on BR2_TOOLCHAIN_HAS_THREADS_NPTL # openal
	depends on !BR2_STATIC_LIBS # SDL2
	depends on BR2_PACKAGE_HAS_LIBGL
	select BR2_PACKAGE_LIBMODPLUG
	select BR2_PACKAGE_LIBOGG
	select BR2_PACKAGE_LIBPNG # runtime
	select BR2_PACKAGE_LIBVORBIS
	select BR2_PACKAGE_LUAJIT if !BR2_PACKAGE_LUA_5_1
	select BR2_PACKAGE_OPENAL
	select BR2_PACKAGE_PHYSFS
	select BR2_PACKAGE_SDL2
	select BR2_PACKAGE_SDL2_IMAGE
	select BR2_PACKAGE_SDL2_TTF
	help
	  Solarus is an open-source Zelda-like 2D game engine written
	  in C++. It can run games scripted in Lua. This engine is used
	  by our Zelda fangames. Solarus is licensed under GPL v3.

	  http://www.solarus-games.org
	  https://github.com/solarus-games/solarus

comment "solarus needs OpenGL and a toolchain w/ C++, gcc >= 4.8, NPTL, dynamic library"
	depends on BR2_PACKAGE_LUAJIT_ARCH_SUPPORTS || BR2_PACKAGE_LUA_5_1
	depends on BR2_PACKAGE_OPENAL_ARCH_SUPPORTS
	depends on !BR2_INSTALL_LIBSTDCPP || !BR2_TOOLCHAIN_GCC_AT_LEAST_4_8 \
		|| !BR2_TOOLCHAIN_HAS_THREADS_NPTL || BR2_STATIC_LIBS \
		|| !BR2_PACKAGE_HAS_LIBGL
```

## package/sound-theme-freedesktop/Config.in
```kconfig
config BR2_PACKAGE_SOUND_THEME_FREEDESKTOP
	bool "sound-theme-freedesktop"
	help
	  Default theme for the XDG Sound Theme Specification.

	  http://freedesktop.org/wiki/Specifications/sound-theme-spec
```

## package/sox/Config.in
```kconfig
config BR2_PACKAGE_SOX
	bool "sox"
	help
	  SoX is a cross-platform (Windows, Linux, MacOS X, etc.)
	  command line utility that can convert various formats of
	  computer audio files into other formats.

	  It can also apply various effects to these sound files, and,
	  as an added bonus, SoX can play and record audio files on
	  most platforms.

	  http://sox.sourceforge.net/
```

## package/sp-oops-extract/Config.in
```kconfig
config BR2_PACKAGE_SP_OOPS_EXTRACT
	bool "sp-oops-extract"
	help
	  A tool for extracting OOPS/panic logs from MTD.

	  http://maemo.org/packages/view/sp-oops-extract/
```

## package/spandsp/Config.in
```kconfig
config BR2_PACKAGE_SPANDSP
	bool "spandsp"
	select BR2_PACKAGE_TIFF
	help
	  Spandsp is a library of many DSP functions for telephony.
	  These range from simple modules, such as DTMF detection, to
	  a complete software FAX machine.

	  http://www.soft-switch.org/
```

## package/spawn-fcgi/Config.in
```kconfig
config BR2_PACKAGE_SPAWN_FCGI
	bool "spawn-fcgi"
	depends on BR2_USE_MMU # fork()
	help
	  FastCGI process spawner.
	  Project split from lighttpd.

	  http://redmine.lighttpd.net/projects/spawn-fcgi
```

## package/spdlog/Config.in
```kconfig
config BR2_PACKAGE_SPDLOG
	bool "spdlog"
	depends on BR2_INSTALL_LIBSTDCPP
	depends on BR2_TOOLCHAIN_HAS_THREADS
	depends on BR2_USE_WCHAR # fmt
	select BR2_PACKAGE_FMT
	help
	  Very fast, header only, C++ logging library.

	  https://github.com/gabime/spdlog

comment "spdlog needs a toolchain w/ C++, threads, wchar"
	depends on !BR2_INSTALL_LIBSTDCPP || !BR2_TOOLCHAIN_HAS_THREADS \
		|| !BR2_USE_WCHAR
```

## package/speex/Config.in
```kconfig
config BR2_PACKAGE_SPEEX
	bool "speex"
	select BR2_PACKAGE_LIBOGG
	help
	  Speex is an Open Source/Free Software patent-free
	  audio compression format designed for speech.
	  It can be used for Voice over IP

	  http://www.speex.org/

if BR2_PACKAGE_SPEEX

config BR2_PACKAGE_SPEEX_ARM4
	bool
	default y
	depends on BR2_ARM_CPU_ARMV4

config BR2_PACKAGE_SPEEX_ARM5E
	bool
	default y
	depends on BR2_arm && !BR2_PACKAGE_SPEEX_ARM4

endif
```

## package/speexdsp/Config.in
```kconfig
config BR2_PACKAGE_SPEEXDSP
	bool "speexdsp"
	help
	  DSP library derived from speex.

	  https://www.speex.org
```

## package/sphinxbase/Config.in
```kconfig
config BR2_PACKAGE_SPHINXBASE
	bool "sphinxbase"
	depends on BR2_TOOLCHAIN_HAS_THREADS
	help
	  CMUSphinx toolkit is a leading speech recognition toolkit
	  with various tools used to build speech applications. CMU
	  Sphinx toolkit has a number of packages for different tasks
	  and applications.

	  http://cmusphinx.sourceforge.net/

comment "sphinxbase needs a toolchain with threads"
	depends on !BR2_TOOLCHAIN_HAS_THREADS
```

## package/spi-tools/Config.in
```kconfig
config BR2_PACKAGE_SPI_TOOLS
	bool "spi-tools"
	help
	  This package contains some simple command line tools to help
	  using Linux spidev devices.

	  https://github.com/cpb-/spi-tools
```

## package/spice-protocol/Config.in
```kconfig
config BR2_PACKAGE_SPICE_PROTOCOL
	bool "spice protocol"
	help
	  The Spice project aims to provide a complete open source
	  solution for interaction with virtualized desktop devices.
	  The Spice project deals with both the virtualized devices
	  and the front-end. Interaction between front-end and
	  back-end is done using VD-Interfaces.

	  This package implements the protocol-part of Spice.

	  http://www.spice-space.org/
```

## package/spice/Config.in
```kconfig
comment "spice server needs a toolchain w/ wchar, threads"
	depends on BR2_i386 || BR2_x86_64
	depends on !BR2_USE_WCHAR || !BR2_TOOLCHAIN_HAS_THREADS

config BR2_PACKAGE_SPICE
	bool "spice server"
	depends on BR2_i386 || BR2_x86_64
	depends on BR2_USE_WCHAR # libglib2
	depends on BR2_TOOLCHAIN_HAS_THREADS # libglib2
	select BR2_PACKAGE_JPEG
	select BR2_PACKAGE_LIBGLIB2
	select BR2_PACKAGE_OPENSSL
	select BR2_PACKAGE_PIXMAN
	select BR2_PACKAGE_SPICE_PROTOCOL
	help
	  The Spice project aims to provide a complete open source
	  solution for interaction with virtualized desktop devices.
	  The Spice project deals with both the virtualized devices
	  and the front-end. Interaction between front-end and
	  back-end is done using VD-Interfaces.

	  This package implements the server-part of Spice.

	  http://www.spice-space.org/
```

## package/spidermonkey/Config.in
```kconfig
config BR2_PACKAGE_SPIDERMONKEY_ARCH_SUPPORTS
	bool
	default y if BR2_aarch64
	default y if BR2_arm || BR2_armeb
	default y if BR2_i386 || BR2_x86_64
	default y if BR2_mips || BR2_mipsel || BR2_mips64 || BR2_mips64el
	default y if BR2_powerpc || BR2_powerpc64 || BR2_powerpc64le
	default y if BR2_riscv
	default y if BR2_sh4 || BR2_sh4a
	default y if BR2_sparc || BR2_sparc64
	depends on BR2_PACKAGE_LIBNSPR_ARCH_SUPPORT # libnspr

config BR2_PACKAGE_SPIDERMONKEY_JIT_ARCH_SUPPORTS
	bool
	default y if BR2_aarch64  || BR2_arm || BR2_armeb || BR2_i386 || BR2_x86_64

config BR2_PACKAGE_SPIDERMONKEY
	bool "spidermonkey"
	depends on BR2_HOST_GCC_AT_LEAST_4_9
	depends on BR2_INSTALL_LIBSTDCPP
	depends on BR2_PACKAGE_SPIDERMONKEY_ARCH_SUPPORTS
	depends on BR2_TOOLCHAIN_GCC_AT_LEAST_4_9
	depends on BR2_TOOLCHAIN_HAS_THREADS_NPTL # needs pthread_getattr_np()
	depends on BR2_USE_MMU # fork in executable tools.
	depends on BR2_USE_WCHAR
	depends on !BR2_TOOLCHAIN_USES_UCLIBC # No way to check for fenv support.
	depends on !BR2_STATIC_LIBS # dlopen
	select BR2_PACKAGE_HOST_PYTHON
	select BR2_PACKAGE_HOST_PYTHON_SSL
	select BR2_PACKAGE_LIBNSPR
	select BR2_PACKAGE_ZLIB
	help
	  SpiderMonkey is the code-name for Mozilla Firefox's C++
	  implementation of JavaScript. It is intended to be embedded in
	  other applications that provide host environments for
	  JavaScript.

	  https://developer.mozilla.org/en-US/docs/Mozilla/Projects/SpiderMonkey

if BR2_PACKAGE_SPIDERMONKEY

config BR2_PACKAGE_SPIDERMONKEY_JS_SHELL
	bool "JS shell"
	help
	  Build the JavaScript shell.

	  WARNING: increases target image size by around 24 MiB.

endif

comment "spidermonkey needs a glibc or musl toolchain with C++, wchar, dynamic library, NPTL, gcc >= 4.9"
	depends on BR2_USE_MMU
	depends on BR2_PACKAGE_SPIDERMONKEY_ARCH_SUPPORTS
	depends on BR2_TOOLCHAIN_USES_UCLIBC || \
		!BR2_INSTALL_LIBSTDCPP || \
		BR2_STATIC_LIBS || \
		!BR2_TOOLCHAIN_HAS_THREADS_NPTL || \
		!BR2_HOST_GCC_AT_LEAST_4_9 || \
		!BR2_TOOLCHAIN_GCC_AT_LEAST_4_9 || \
		!BR2_USE_WCHAR
```

## package/spidev_test/Config.in
```kconfig
config BR2_PACKAGE_SPIDEV_TEST
	bool "spidev_test"
	help
	  SPI testing utility (using spidev driver).

	  This package builds and installs the userspace 'spidev_test'
	  command. It is up to the user to ensure that the kernel
	  configuration has all suitable options enabled to allow a
	  proper operation of 'spidev_test'.

	  The version used is based on your toolchain headers version,
	  if it's older than 3.15 then 3.0 is used, otherwise 3.15
	  is used.
	  This means you won't have quad-pumped SPI support if your
	  toolchain is too old.

	  https://www.kernel.org/doc/Documentation/spi/spidev_test.c
```

## package/sqlcipher/Config.in
```kconfig
config BR2_PACKAGE_SQLCIPHER
	bool "sqlcipher"
	depends on !BR2_PACKAGE_SQLITE
	depends on BR2_TOOLCHAIN_HAS_THREADS
	select BR2_PACKAGE_OPENSSL
	help
	  SQLCipher is an SQLite extension that provides 256 bits AES
	  encryption of database files. Note that it is a fork of
	  SQLite and they cannot be installed side-by-side.

	  http://sqlcipher.net

if BR2_PACKAGE_SQLCIPHER

config BR2_PACKAGE_SQLCIPHER_READLINE
	bool "Command-line editing"
	select BR2_PACKAGE_NCURSES
	select BR2_PACKAGE_READLINE
	help
	  Enable command-line editing. This requires ncurses and
	  readline.

config BR2_PACKAGE_SQLCIPHER_STAT3
	bool "Additional query optimizations (stat3)"
	help
	  Adds additional logic to the ANALYZE command and to the
	  query planner that can help SQLite to choose a better query
	  plan under certain situations.

endif

comment "sqlcipher conflicts with sqlite"
	depends on BR2_PACKAGE_SQLITE

comment "sqlcipher needs a toolchain w/ threads"
	depends on !BR2_PACKAGE_SQLITE
	depends on !BR2_TOOLCHAIN_HAS_THREADS
```

## package/sqlite/Config.in
```kconfig
config BR2_PACKAGE_SQLITE
	bool "sqlite"
	help
	  SQLite is a small C library that implements a
	  self-contained, embeddable, zero-configuration SQL database
	  engine.

	  http://www.sqlite.org/

if BR2_PACKAGE_SQLITE

config BR2_PACKAGE_SQLITE_STAT4
	bool "Additional query optimizations (stat4)"
	help
	  Adds additional logic to the ANALYZE command and to the
	  query planner that can help SQLite to choose a better query
	  plan under certain situations.

config BR2_PACKAGE_SQLITE_ENABLE_COLUMN_METADATA
	bool "Enable convenient access to meta-data about tables and queries"
	help
	  When this option is defined there are some additional APIs
	  enabled to acces meta-data about tables and queries (see
	  https://sqlite.org/compile.html).

config BR2_PACKAGE_SQLITE_ENABLE_FTS3
	bool "Enable version 3 of the full-text search engine"
	help
	  When this option is defined in the amalgamation (see
	  http://www.sqlite.org/amalgamation.html), version 3 of the
	  full-text search engine is added to the build automatically.

config BR2_PACKAGE_SQLITE_ENABLE_JSON1
	bool "Enable the JSON extensions for SQLite"
	help
	  When this option is defined in the amalgamation, the JSON
	  extensions are added to the build automatically.

config BR2_PACKAGE_SQLITE_ENABLE_UNLOCK_NOTIFY
	bool "Enable sqlite3_unlock_notify() interface"
	help
	  This option enables the sqlite3_unlock_notify() interface
	  and its accosiated functionality. See the documentation
	  http://www.sqlite.org/unlock_notify.html for additional
	  information.

config BR2_PACKAGE_SQLITE_SECURE_DELETE
	bool "Set the secure_delete pragma on by default"
	help
	  This compile-time option changes the default settings of the
	  secure_delete pragma. When this option is not used,
	  secure_delete defaults to off. When this option is present,
	  secure_delete defaults to on.

	  The secure_delete setting causes deleted content to be
	  overwritten with zeros. There is a small performance penalty
	  for this since additional I/O must occur. On the other hand,
	  secure_delete can prevent sensitive information from
	  lingering in unused parts of the database file after it has
	  allegedly been deleted. See the documentation on the
	  http://www.sqlite.org/pragma.html#pragma_secure_delete for
	  additional information.

config BR2_PACKAGE_SQLITE_NO_SYNC
	bool "Disable fsync"
	help
	  By default SQLite forces all database transactions to
	  storage immediately using fsync() to protect against data
	  loss in case of power failure. This option turns this
	  behavior off resulting in higher performance especially when
	  using slow flash storage.

endif
```

## package/squashfs/Config.in
```kconfig
config BR2_PACKAGE_SQUASHFS
	bool "squashfs"
	depends on BR2_TOOLCHAIN_HAS_THREADS
	depends on BR2_USE_MMU # fork()
	# ensure at least on compression backend (defaults to gzip)
	select BR2_PACKAGE_SQUASHFS_GZIP if !( \
	       BR2_PACKAGE_SQUASHFS_LZ4 || \
	       BR2_PACKAGE_SQUASHFS_LZMA || \
	       BR2_PACKAGE_SQUASHFS_LZO || \
	       BR2_PACKAGE_SQUASHFS_XZ || \
	       BR2_PACKAGE_SQUASHFS_ZSTD)
	help
	  Tools to generate SquashFS filesystems.

	  https://github.com/plougher/squashfs-tools

if BR2_PACKAGE_SQUASHFS

config BR2_PACKAGE_SQUASHFS_GZIP
	bool "gzip support"
	default y
	select BR2_PACKAGE_ZLIB
	help
	  Support GZIP compression algorithm

config BR2_PACKAGE_SQUASHFS_LZ4
	bool "lz4 support"
	select BR2_PACKAGE_LZ4
	help
	  Support LZ4 compression algorithm

config BR2_PACKAGE_SQUASHFS_LZMA
	bool "lzma support"
	select BR2_PACKAGE_XZ
	help
	  Support LZMA compression algorithm

config BR2_PACKAGE_SQUASHFS_LZO
	bool "lzo support"
	select BR2_PACKAGE_LZO
	help
	  Support LZO compression algorithm

config BR2_PACKAGE_SQUASHFS_XZ
	bool "xz support"
	select BR2_PACKAGE_XZ
	help
	  Support XZ compression algorithm

config BR2_PACKAGE_SQUASHFS_ZSTD
	bool "zstd support"
	select BR2_PACKAGE_ZSTD
	help
	  Support ZSTD compression algorithm

endif

comment "squashfs needs a toolchain w/ threads"
	depends on !BR2_TOOLCHAIN_HAS_THREADS
	depends on BR2_USE_MMU
```

## package/squashfs/Config.in.host
```kconfig
config BR2_PACKAGE_HOST_SQUASHFS
	bool "host squashfs"
	help
	  Tools to generate SquashFS filesystems.

	  https://github.com/plougher/squashfs-tools
```

## package/squashfs3/Config.in
```kconfig
config BR2_PACKAGE_SQUASHFS3
	bool "squashfs3"
	depends on BR2_DEPRECATED_SINCE_2010_05
	depends on BR2_LARGEFILE
	help
	  Tools to generate SquashFS 3.x filesystems.

	  http://squashfs.sourceforge.net/

comment "squashfs3 needs a toolchain w/ largefile"
	depends on BR2_DEPRECATED_SINCE_2010_05
	depends on !BR2_LARGEFILE
```
