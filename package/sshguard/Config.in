## package/sshguard/Config.in
```kconfig
config BR2_PACKAGE_SSHGUARD
	bool "sshguard"
	depends on BR2_TOOLCHAIN_HAS_THREADS
	select BR2_PACKAGE_IPTABLES # runtime
	help
	  sshguard protects hosts from brute-force attacks against SSH
	  and other services. It aggregates system logs and blocks
	  repeat offenders using one of several firewall backends,
	  including iptables, ipfw, and pf.

	  https://www.sshguard.net

comment "sshguard needs a toolchain w/ threads"
	depends on !BR2_TOOLCHAIN_HAS_THREADS
```

## package/sstrip/Config.in
```kconfig
config BR2_PACKAGE_SSTRIP
	bool "sstrip"
	depends on BR2_DEPRECATED_SINCE_2016_08
	help
	  Small utility that removes a few bytes from an executable that
	  strip leaves behind.

	  http://www.muppetlabs.com/~breadbox/software/elfkickers.html
```

## package/start-stop-daemon/Config.in
```kconfig
config BR2_PACKAGE_START_STOP_DAEMON
	bool "start-stop-daemon"
	depends on BR2_USE_MMU # fork()
	depends on BR2_PACKAGE_BUSYBOX_SHOW_OTHERS
	help
	  start-stop-daemon is used to control the creation and
	  termination of system-level processes.

	  https://tracker.debian.org/pkg/dpkg
```

## package/startup-notification/Config.in
```kconfig
config BR2_PACKAGE_STARTUP_NOTIFICATION
	bool "startup-notification"
	select BR2_PACKAGE_XLIB_LIBX11
	depends on BR2_PACKAGE_XORG7
	depends on BR2_USE_MMU # fork()
	help
	  Startup-notification is a library used to monitor application startup.

	  http://freedesktop.org/software/startup-notification/releases
```

## package/statserial/Config.in
```kconfig
config BR2_PACKAGE_STATSERIAL
	bool "statserial"
	select BR2_PACKAGE_NCURSES
	help
	  Displays a table of the signals on a standard
	  9-pin or 25-pin serial port, and indicates the
	  status of the handshaking lines. It can be
	  useful for debugging problems with serial
	  ports or modems.

	  https://sites.google.com/site/tranter/software
```

## package/stella/Config.in
```kconfig
config BR2_PACKAGE_STELLA
	bool "stella"
	depends on !BR2_STATIC_LIBS # sdl2
	depends on BR2_INSTALL_LIBSTDCPP
	depends on BR2_TOOLCHAIN_HAS_THREADS
	depends on BR2_TOOLCHAIN_GCC_AT_LEAST_6 # C++14
	depends on !BR2_TOOLCHAIN_HAS_GCC_BUG_64735 # exception_ptr
	select BR2_PACKAGE_SDL2
	select BR2_PACKAGE_LIBPNG
	select BR2_PACKAGE_ZLIB
	help
	  Stella is a multi-platform Atari 2600 VCS emulator.

	  https://stella-emu.github.io/

comment "stella needs a toolchain w/ dynamic library, C++, threads, gcc >= 6"
	depends on BR2_STATIC_LIBS || !BR2_INSTALL_LIBSTDCPP || \
		!BR2_TOOLCHAIN_HAS_THREADS || \
		!BR2_TOOLCHAIN_GCC_AT_LEAST_6

comment "stella needs a toolchain not affected by GCC bug 64735"
	depends on BR2_TOOLCHAIN_HAS_GCC_BUG_64735
```

## package/stellarium/Config.in
```kconfig
config BR2_PACKAGE_STELLARIUM
	bool "stellarium"
	depends on BR2_PACKAGE_QT5
	depends on BR2_PACKAGE_QT5_GL_AVAILABLE
	depends on BR2_PACKAGE_HAS_LIBGL # does not support OpenGL ES
	select BR2_PACKAGE_QT5BASE_CONCURRENT
	select BR2_PACKAGE_QT5BASE_GUI
	select BR2_PACKAGE_QT5BASE_NETWORK
	select BR2_PACKAGE_QT5BASE_OPENGL
	select BR2_PACKAGE_QT5BASE_PRINTSUPPORT
	select BR2_PACKAGE_QT5BASE_WIDGETS
	select BR2_PACKAGE_QT5LOCATION
	select BR2_PACKAGE_QT5MULTIMEDIA
	select BR2_PACKAGE_ZLIB
	help
	  Stellarium is a free open source planetarium for your
	  computer. It shows a realistic sky in 3D, just like what
	  you see with the naked eye, binoculars or a telescope.

	  https://stellarium.org

comment "stellarium needs Qt5 and an OpenGL provider"
	depends on !BR2_PACKAGE_QT5 || !BR2_PACKAGE_HAS_LIBGL
```

## package/stm32flash/Config.in
```kconfig
config BR2_PACKAGE_STM32FLASH
	bool "stm32flash"
	help
	  Open source cross platform flash program for the STM32 ARM
	  microcontrollers using the built-in ST serial bootloader
	  over UART or I2C.

	  http://sourceforge.net/projects/stm32flash/
```

## package/strace/Config.in
```kconfig
config BR2_PACKAGE_STRACE
	bool "strace"
	# needs at least kernel headers 4.0 on nios2
	depends on BR2_TOOLCHAIN_HEADERS_AT_LEAST_4_0 || !BR2_nios2
	depends on !BR2_nds32 && !BR2_RISCV_32
	help
	  A useful diagnostic, instructional, and debugging tool.
	  Allows you to track what system calls a program makes
	  while it is running.

	  If you want 'strace -k' to work, make sure to enable the
	  'libunwind' package.

	  https://strace.io

comment "strace needs a toolchain w/ headers >= 4.0 on nios2"
	depends on BR2_nios2
	depends on !BR2_TOOLCHAIN_HEADERS_AT_LEAST_4_0
```

## package/stress-ng/Config.in
```kconfig
config BR2_PACKAGE_STRESS_NG
	bool "stress-ng"
	depends on BR2_USE_MMU # fork()
	# disabled on musl: stress-malloc.c needs mallopt() and M_MMAP_THRESHOLD
	depends on !BR2_TOOLCHAIN_USES_MUSL
	# perf.c needs PERF_COUNT_HW_REF_CPU_CYCLES
	depends on BR2_TOOLCHAIN_HEADERS_AT_LEAST_3_3
	depends on !BR2_microblaze # keyutils
	# fenv.h lacks FE_INVALID, FE_OVERFLOW & FE_UNDERFLOW on nios2 and ARC
	depends on !BR2_nios2
	depends on !BR2_arc
	depends on !BR2_STATIC_LIBS # keyutils
	select BR2_PACKAGE_KEYUTILS # stress-key.c needs keyutils.h
	select BR2_PACKAGE_ATTR # stress-xattr.c needs xattr.h
	help
	  stress-ng will stress test a computer system in various
	  selectable ways. It was designed to exercise various physical
	  subsystems of a computer as well as the various operating
	  system kernel interfaces.

	  http://kernel.ubuntu.com/~cking/stress-ng/

comment "stress-ng needs a glibc or uClibc toolchain w/ dynamic library, headers >= 3.3"
	depends on !BR2_microblaze && !BR2_nios2 && !BR2_arc
	depends on BR2_USE_MMU
	depends on BR2_STATIC_LIBS || !BR2_TOOLCHAIN_HEADERS_AT_LEAST_3_3 \
		|| BR2_TOOLCHAIN_USES_MUSL
```

## package/stress/Config.in
```kconfig
config BR2_PACKAGE_STRESS
	bool "stress"
	help
	  A deliberately simple workload generator for POSIX systems.
	  It imposes a configurable amount of CPU, memory, I/O, and
	  disk stress on the system.

	  http://weather.ou.edu/~apw/projects/stress/
```

## package/strongswan/Config.in
```kconfig
menuconfig BR2_PACKAGE_STRONGSWAN
	bool "strongswan"
	depends on BR2_USE_MMU # fork()
	help
	  strongSwan is an OpenSource IPsec implementation for the
	  Linux operating system. It is based on the discontinued
	  FreeS/WAN project and the X.509 patch.

	  The focus is on:
	     - simplicity of configuration
	     - strong encryption and authentication methods
	     - powerful IPsec policies supporting large and complex VPN networks

	  strongSwan provide many plugins. Only a few are presented here.

	  http://www.strongswan.org/

if BR2_PACKAGE_STRONGSWAN

comment "kernel-netlink and socket-default options need a toolchain w/ IPv6"
	depends on !BR2_INET_IPV6

choice
	prompt "Cryptographic backend"
	default BR2_PACKAGE_STRONGSWAN_GMP

config BR2_PACKAGE_STRONGSWAN_OPENSSL
	bool "OpenSSL"
	select BR2_PACKAGE_OPENSSL

config BR2_PACKAGE_STRONGSWAN_GCRYPT
	bool "libgcrypt"
	select BR2_PACKAGE_LIBGCRYPT

config BR2_PACKAGE_STRONGSWAN_GMP
	bool "GNU MP (libgmp)"
	select BR2_PACKAGE_GMP

endchoice

config BR2_PACKAGE_STRONGSWAN_AF_ALG
	bool "Enable AF_ALG crypto interface to Linux Crypto API"

config BR2_PACKAGE_STRONGSWAN_CURL
	bool "Enable CURL fetcher plugin to fetch files via libcurl"
	select BR2_PACKAGE_LIBCURL

config BR2_PACKAGE_STRONGSWAN_CHARON
	bool "Enable the IKEv1/IKEv2 keying daemon charon"
	default y

if BR2_PACKAGE_STRONGSWAN_CHARON

config BR2_PACKAGE_STRONGSWAN_TNCCS_11
	bool "Enable TNCCS 1.1 protocol module"
	select BR2_PACKAGE_LIBXML2

config BR2_PACKAGE_STRONGSWAN_TNCCS_20
	bool "Enable TNCCS 2.0 protocol module"

config BR2_PACKAGE_STRONGSWAN_TNCCS_DYNAMIC
	bool "Enable dynamic TNCCS protocol discovery module"

config BR2_PACKAGE_STRONGSWAN_EAP
	bool "Enable EAP protocols"
	help
	  Enable various EAP protocols:
	    - mschapv2
	    - tls
	    - ttls
	    - peap
	    - sim
	    - sim-file
	    - aka
	    - aka-3gpp2
	    - simaka-sql
	    - simaka-pseudonym
	    - simaka-reauth
	    - identity
	    - md5
	    - gtc
	    - tnc
	    - dynamic
	    - radius

if BR2_PACKAGE_STRONGSWAN_EAP

config BR2_PACKAGE_STRONGSWAN_EAP_SIM_PCSC
	bool "Enable EAP-SIM smart card backend"
	select BR2_PACKAGE_PCSC_LITE

endif

config BR2_PACKAGE_STRONGSWAN_UNITY
	bool "Enables Cisco Unity extension plugin"

config BR2_PACKAGE_STRONGSWAN_STROKE
	bool "Enable charons stroke configuration backend"
	default y

config BR2_PACKAGE_STRONGSWAN_SQL
	bool "Enable SQL database configuration backend"
	depends on BR2_PACKAGE_SQLITE || BR2_PACKAGE_MYSQL

endif

config BR2_PACKAGE_STRONGSWAN_TOOLS
	bool "Enable additional utilities (openac, scepclient and pki)"
	default y

config BR2_PACKAGE_STRONGSWAN_SCRIPTS
	bool "Enable additional utilities (found in directory scripts)"
	depends on BR2_PACKAGE_STRONGSWAN_CHARON || BR2_PACKAGE_STRONGSWAN_TOOLS
	default y

endif
```

## package/stunnel/Config.in
```kconfig
config BR2_PACKAGE_STUNNEL
	bool "stunnel"
	depends on BR2_USE_MMU # fork()
	select BR2_PACKAGE_OPENSSL
	help
	  Stunnel is a program that wraps any TCP connection with an SSL
	  connection.

	  http://www.stunnel.org/
```

## package/subversion/Config.in
```kconfig
config BR2_PACKAGE_SUBVERSION
	bool "subversion"
	# apr really needs shared library support
	depends on !BR2_STATIC_LIBS
	depends on BR2_USE_MMU # apr
	select BR2_PACKAGE_APR
	select BR2_PACKAGE_APR_UTIL
	select BR2_PACKAGE_EXPAT
	select BR2_PACKAGE_LZ4
	select BR2_PACKAGE_UTF8PROC
	select BR2_PACKAGE_ZLIB
	select BR2_PACKAGE_SQLITE
	help
	  Subversion is an open source version control system

	  http://subversion.apache.org/

comment "subversion needs a toolchain w/ dynamic library"
	depends on BR2_USE_MMU
	depends on BR2_STATIC_LIBS
```

## package/sudo/Config.in
```kconfig
config BR2_PACKAGE_SUDO
	bool "sudo"
	help
	 Sudo is a program designed to allow a sysadmin to give limited root
	 privileges to users and log root activity.  The basic philosophy is to give
	 as few privileges as possible but still allow people to get their work done.
```

## package/sunwait/Config.in
```kconfig
config BR2_PACKAGE_SUNWAIT
	bool "sunwait"
	depends on BR2_INSTALL_LIBSTDCPP
	help
	  Sunwait calculates sunrise or sunset times with civil,
	  nautical, astronomical and custom twilights.

	  https://github.com/risacher/sunwait

comment "sunwait needs a toolchain w/ C++"
	depends on !BR2_INSTALL_LIBSTDCPP
```

## package/sunxi-boards/Config.in
```kconfig
config BR2_PACKAGE_SUNXI_BOARDS
	bool "sunxi script.bin board file"
	depends on BR2_arm
	select BR2_PACKAGE_HOST_SUNXI_TOOLS
	help
	  Sunxi-boards requires a compiled .fex files for hardware
	  description, used by the kernel during boot for hardware
	  initialization. This package is specific for linux-sunxi
	  kernel and it is useless for mainline kernel versions.

	  https://github.com/linux-sunxi/sunxi-boards

if BR2_PACKAGE_SUNXI_BOARDS
config BR2_PACKAGE_SUNXI_BOARDS_FEX_FILE
	string ".fex file to compile"
	help
	  This field defines the name of the .fex file for which the
	  .bin file should be generated.

	  This should be the path of the .fex file relative to the
	  sys_config/ directory, and including the .fex extension.

	  See inside sys_config/ directory in sunxi-boards source code
	  to see the list of valid .fex files.
endif
```

## package/sunxi-cedarx/Config.in
```kconfig
config BR2_PACKAGE_SUNXI_CEDARX
	bool "sunxi-cedarx"
	depends on BR2_arm
	depends on BR2_TOOLCHAIN_USES_GLIBC
	help
	  Sunxi CedarX decoder libraries. CedarX is Allwinner's
	  multimedia co-processing technology for hardware accelerated
	  video and image decoding, as used inside their A10 SoC's and
	  others.

	  http://github.com/linux-sunxi/cedarx-libs
	  http://linux-sunxi.org/CedarX

comment "sunxi-cedarx needs an (e)glibc toolchain"
	depends on BR2_arm
	depends on !BR2_TOOLCHAIN_USES_GLIBC
```

## package/sunxi-mali-mainline-driver/Config.in
```kconfig
comment "sunxi-mali-mainline-driver needs a Linux kernel to be built"
	depends on BR2_PACKAGE_SUNXI_MALI_MAINLINE
	depends on !BR2_LINUX_KERNEL

config BR2_PACKAGE_SUNXI_MALI_MAINLINE_DRIVER
	bool "sunxi-mali-mainline-driver"
	default y
	depends on BR2_PACKAGE_SUNXI_MALI_MAINLINE # runtime
	depends on BR2_LINUX_KERNEL
	select BR2_LINUX_NEEDS_MODULES # not using kernel-module infra
	help
	  This package builds and installs the Linux kernel driver for
	  the Mali GPU on Allwinner platforms, compatible with recent
	  Linux kernels (>= 4.4). Note that it should be installed
	  together with the corresponding userspace OpenGL libraries,
	  which are provided as binaries only at:
	  https://github.com/bootlin/mali-blobs

	  sunxi-mali-mainline-driver requires a Linux kernel >= 4.4
	  with the following options enabled:

	  - CONFIG_CMA
	  - CONFIG_DMA_CMA

	  https://github.com/mripard/sunxi-mali/blob/master/README.md
```

## package/sunxi-mali-mainline/Config.in
```kconfig
config BR2_PACKAGE_SUNXI_MALI_MAINLINE
	bool "sunxi-mali-mainline"
	depends on BR2_aarch64 || (BR2_ARM_EABIHF && BR2_arm)
	depends on BR2_TOOLCHAIN_USES_GLIBC
	select BR2_PACKAGE_HAS_LIBEGL
	select BR2_PACKAGE_HAS_LIBGLES
	help
	  Install userspace Allwinner OpenGL libraries.

	  https://github.com/bootlin/mali-blobs

if BR2_PACKAGE_SUNXI_MALI_MAINLINE

config BR2_PACKAGE_PROVIDES_LIBEGL
	default "sunxi-mali-mainline"

config BR2_PACKAGE_PROVIDES_LIBGLES
	default "sunxi-mali-mainline"

choice
	prompt "Version"
	default BR2_PACKAGE_SUNXI_MALI_MAINLINE_R6P2
	help
	  Select the version of the userspace module.

config BR2_PACKAGE_SUNXI_MALI_MAINLINE_R6P2
	bool "r6p2"
config BR2_PACKAGE_SUNXI_MALI_MAINLINE_R8P1
	bool "r8p1"

endchoice

config BR2_PACKAGE_SUNXI_MALI_MAINLINE_REVISION
	string
	default "r6p2"	if BR2_PACKAGE_SUNXI_MALI_MAINLINE_R6P2
	default "r8p1"	if BR2_PACKAGE_SUNXI_MALI_MAINLINE_R8P1

endif

comment "sunxi-mali needs an EABIhf glibc toolchain"
	depends on BR2_arm
	depends on !BR2_TOOLCHAIN_USES_GLIBC || !BR2_ARM_EABIHF
```

## package/sunxi-mali-prop/Config.in
```kconfig
# Sunxi-mali-prop is a git submodule of sunxi-mali. To use this package
# select the sunxi-mali option.
config BR2_PACKAGE_SUNXI_MALI_PROP
	bool
```

## package/sunxi-mali/Config.in
```kconfig
config BR2_PACKAGE_SUNXI_MALI
	bool "sunxi-mali"
	depends on BR2_arm
	# libump package only provide libUMP.so.3 which is used by
	# libMali for r3p0 and r3p1 Mali kernel module. This version
	# is only available for ARM EABIhf.
	# libMali for r2p4 Mali kernel module (available for ARM EABI)
	# requires libUMP.so.2.
	depends on BR2_ARM_EABIHF # libUMP.so.3 only
	depends on BR2_TOOLCHAIN_USES_GLIBC
	select BR2_PACKAGE_HAS_LIBEGL
	select BR2_PACKAGE_HAS_LIBGLES
	select BR2_PACKAGE_LIBUMP
	help
	  Install the ARM Mali drivers for sunxi based systems (i.e
	  systems based on ARM Allwinner SoCs). This driver requires
	  either the sunxi-kernel with the ARM Mali driver enabled or
	  the installation of the ARM Mali drivers as an external
	  module.

	  http://github.com/linux-sunxi/sunxi-mali

if BR2_PACKAGE_SUNXI_MALI

config BR2_PACKAGE_PROVIDES_LIBEGL
	default "sunxi-mali"

config BR2_PACKAGE_PROVIDES_LIBGLES
	default "sunxi-mali"

config BR2_PACKAGE_SUNXI_MALI_DBG
	bool "install malitest and maliver tools"
	help
	  Install 3D triangle demo malitest application and the
	  maliver application which describes the kernel module
	  version.

choice
	prompt "Version"
	default BR2_PACKAGE_SUNXI_MALI_R3P0
	help
	  Select the version of the kernel module. For the
	  sunxi-kernel, the appropriate version number is r3p0. For
	  other kernels, use the maliver application to determine the
	  appropriate version.

config BR2_PACKAGE_SUNXI_MALI_R3P0
	bool "r3p0"

config BR2_PACKAGE_SUNXI_MALI_R3P1
	bool "r3p1"

endchoice

endif

comment "sunxi-mali needs an EABIhf glibc toolchain"
	depends on BR2_arm
	depends on !BR2_TOOLCHAIN_USES_GLIBC || !BR2_ARM_EABIHF
```
