## package/tcf-agent/Config.in
```kconfig
config BR2_PACKAGE_TCF_AGENT
	bool "tcf-agent"
	depends on BR2_TOOLCHAIN_HAS_THREADS
	depends on BR2_PACKAGE_TCF_AGENT_ARCH_SUPPORTS
	depends on BR2_USE_MMU # util-linux
	select BR2_PACKAGE_UTIL_LINUX
	select BR2_PACKAGE_UTIL_LINUX_LIBUUID
	help
	  Target Communication Framework Agent is an example
	  application using the Target Communication Framework
	  Library.

	  Target Communication Framework is universal, extensible,
	  simple, lightweight, vendor agnostic framework for tools and
	  targets to communicate for purpose of debugging, profiling,
	  code patching and other device software development needs.

	  tcf-agent is a daemon, which provides TCF services that can
	  be used by local and remote clients.

	  https://wiki.eclipse.org/TCF

config BR2_PACKAGE_TCF_AGENT_ARCH
	string
	default "arm"        if BR2_arm || BR2_armeb
	default "a64"        if BR2_aarch64 || BR2_aarch64_be
	default "i686"       if BR2_i386 && BR2_ARCH="i686"
	default "i386"       if BR2_i386 && !BR2_ARCH="i686"
	default "x86_64"     if BR2_x86_64
	default "powerpc"    if BR2_powerpc || BR2_powerpcle
#	those architectures fail to build currently
#	default "ppc64"      if BR2_powerpc64 || BR2_powerpc64le
#	default "microblaze" if BR2_microblaze || BR2_microblazeel

config BR2_PACKAGE_TCF_AGENT_ARCH_SUPPORTS
	bool
	default y if BR2_PACKAGE_TCF_AGENT_ARCH != ""

comment "tcf-agent needs a toolchain w/ threads"
	depends on BR2_PACKAGE_TCF_AGENT_ARCH_SUPPORTS
	depends on BR2_USE_MMU
	depends on !BR2_TOOLCHAIN_HAS_THREADS
```

## package/tcl/Config.in
```kconfig
comment "tcl needs a toolchain w/ threads, dynamic library"
	depends on BR2_USE_MMU
	depends on !BR2_TOOLCHAIN_HAS_THREADS || BR2_STATIC_LIBS

config BR2_PACKAGE_TCL
	bool "tcl"
	# fork()
	depends on BR2_USE_MMU
	depends on BR2_TOOLCHAIN_HAS_THREADS
	# See this mailing list thread:
	# http://lists.busybox.net/pipermail/buildroot/2015-March/121198.html
	depends on !BR2_STATIC_LIBS
	help
	  TCL (Tool Command Language) is a simple textual language.

	  http://www.tcl.tk

if BR2_PACKAGE_TCL

config BR2_PACKAGE_TCL_DEL_ENCODINGS
	bool "delete encodings (saves 1.6Mb)"
	default y
	help
	  Delete encoding files for TCL. If your programs do not use
	  various tcl character recoding functions, you may safely
	  choose Y here.

	  It saves approx. 1.6 Mb of space.

config BR2_PACKAGE_TCL_SHLIB_ONLY
	bool "install only shared library"
	default y
	help
	  Install only TCL shared library and not binary tcl
	  interpreter (tclsh).

	  Saves ~14kb.

endif
```
