## package/supertux/Config.in
```kconfig
config BR2_PACKAGE_SUPERTUX
	bool "supertux"
	depends on BR2_INSTALL_LIBSTDCPP
	depends on BR2_PACKAGE_HAS_LIBGL # libglew
	depends on BR2_PACKAGE_OPENAL_ARCH_SUPPORTS
	depends on BR2_PACKAGE_XORG7 # libglew, SDL2 OpenGL (GLX)
	depends on BR2_TOOLCHAIN_GCC_AT_LEAST_6 # C++14
	depends on BR2_TOOLCHAIN_HAS_THREADS_NPTL # openal
	depends on BR2_USE_MMU # SDL2 OpenGL (GLX)
	depends on !BR2_STATIC_LIBS # SDL2
	depends on BR2_USE_WCHAR # Boost
	select BR2_PACKAGE_BOOST
	select BR2_PACKAGE_BOOST_DATE_TIME
	select BR2_PACKAGE_BOOST_FILESYSTEM
	select BR2_PACKAGE_BOOST_LOCALE
	select BR2_PACKAGE_BOOST_SYSTEM
	select BR2_PACKAGE_FREETYPE
	select BR2_PACKAGE_LIBCURL
	select BR2_PACKAGE_LIBGLEW
	select BR2_PACKAGE_LIBGLU # GL/glu.h
	select BR2_PACKAGE_LIBOGG
	select BR2_PACKAGE_LIBPNG
	select BR2_PACKAGE_LIBVORBIS
	select BR2_PACKAGE_OPENAL
	select BR2_PACKAGE_PHYSFS
	select BR2_PACKAGE_SDL2
	select BR2_PACKAGE_SDL2_IMAGE
	select BR2_PACKAGE_SDL2_OPENGL
	help
	  SuperTux is a free classic 2D jump'n run sidescroller game in
	  a style similar to the original Super Mario games covered
	  under the GNU GPL.

	  http://supertux.github.io/

comment "supertux needs OpenGL and a toolchain w/ C++, gcc >= 6, NPTL, dynamic library, wchar"
	depends on BR2_PACKAGE_OPENAL_ARCH_SUPPORTS
	depends on BR2_PACKAGE_XORG7
	depends on BR2_USE_MMU
	depends on !BR2_INSTALL_LIBSTDCPP || !BR2_PACKAGE_HAS_LIBGL || \
		!BR2_TOOLCHAIN_GCC_AT_LEAST_6 || !BR2_TOOLCHAIN_HAS_THREADS_NPTL || \
		BR2_STATIC_LIBS || !BR2_USE_WCHAR
```

## package/supertuxkart/Config.in
```kconfig
config BR2_PACKAGE_SUPERTUXKART
	bool "supertuxkart"
	depends on BR2_HOSTARCH = "x86_64" || BR2_HOSTARCH = "x86"
	depends on BR2_i386 || BR2_x86_64
	depends on BR2_USE_MMU # fork()
	depends on BR2_INSTALL_LIBSTDCPP # openal
	depends on BR2_TOOLCHAIN_HAS_THREADS_NPTL # openal
	depends on BR2_PACKAGE_OPENAL_ARCH_SUPPORTS # openal
	depends on BR2_PACKAGE_HAS_LIBGL
	depends on BR2_PACKAGE_XORG7
	depends on !BR2_TOOLCHAIN_USES_MUSL
	select BR2_PACKAGE_FREETYPE
	select BR2_PACKAGE_JPEG
	select BR2_PACKAGE_LIBCURL
	select BR2_PACKAGE_LIBGLU
	select BR2_PACKAGE_LIBOGG
	select BR2_PACKAGE_LIBPNG
	select BR2_PACKAGE_LIBVORBIS
	select BR2_PACKAGE_OPENAL
	select BR2_PACKAGE_XLIB_LIBXRANDR
	select BR2_PACKAGE_ZLIB
	help
	  Karts. Nitro. Action! SuperTuxKart is a free 3D arcade kart
	  racer with multiple karts, tracks and modes you can play.
	  Beat the evil Nolok by any means necessary, and make the
	  mascot kingdom safe once again!

	  http://supertuxkart.sourceforge.net/Main_Page

comment "supertuxkart needs an OpenGL backend, a uClibc or glibc toolchain w/ NPTL, C++"
	depends on BR2_HOSTARCH = "x86_64" || BR2_HOSTARCH = "x86"
	depends on BR2_i386 || BR2_x86_64
	depends on BR2_USE_MMU
	depends on BR2_PACKAGE_OPENAL_ARCH_SUPPORTS
	depends on BR2_PACKAGE_XORG7
	depends on !BR2_TOOLCHAIN_HAS_THREADS_NPTL \
		|| !BR2_INSTALL_LIBSTDCPP \
		|| !BR2_PACKAGE_HAS_LIBGL \
		|| BR2_TOOLCHAIN_USES_MUSL
```

## package/supervisor/Config.in
```kconfig
config BR2_PACKAGE_SUPERVISOR
	bool "supervisor"
	depends on BR2_PACKAGE_PYTHON || BR2_PACKAGE_PYTHON3
	select BR2_PACKAGE_PYTHON_MELD3
	select BR2_PACKAGE_PYTHON_SETUPTOOLS # runtime dependency
	help
	  A client/server system that allows its users to control a
	  number of processes on UNIX-like operating systems.

	  http://supervisord.org/

comment "supervisor needs a python interpreter"
	depends on !BR2_PACKAGE_PYTHON
	depends on !BR2_PACKAGE_PYTHON3
```

## package/suricata/Config.in
```kconfig
config BR2_PACKAGE_SURICATA
	bool "suricata"
	depends on BR2_USE_MMU # fork()
	depends on BR2_USE_WCHAR
	depends on BR2_TOOLCHAIN_HAS_THREADS
	select BR2_PACKAGE_LIBHTP
	select BR2_PACKAGE_LIBPCAP
	select BR2_PACKAGE_LIBYAML
	select BR2_PACKAGE_PCRE
	help
	  Suricata is a free and open source, mature, fast and robust
	  network threat detection engine.

	  The Suricata engine is capable of real time intrusion
	  detection (IDS), inline intrusion prevention (IPS), network
	  security monitoring (NSM) and offline pcap processing.

	  https://suricata-ids.org

comment "suricata needs a toolchain w/ wchar, threads"
	depends on BR2_USE_MMU
	depends on !BR2_USE_WCHAR || !BR2_TOOLCHAIN_HAS_THREADS
```

## package/swig/Config.in.host
```kconfig
config BR2_PACKAGE_HOST_SWIG
	bool "host swig"
	help
	  swig is a software development tool that connects programs
	  written in C and C++ with a variety of high-level
	  programming languages.

	  http://www.swig.org/
```

## package/swupdate/Config.in
```kconfig
config BR2_PACKAGE_SWUPDATE
	bool "swupdate"
	depends on BR2_TOOLCHAIN_HAS_THREADS
	depends on BR2_USE_MMU # fork()
	# swupdate requires a parser and uses libconfig as default
	select BR2_PACKAGE_LIBCONFIG if !BR2_PACKAGE_JSON_C && \
		!BR2_PACKAGE_LUA_5_2 && !BR2_PACKAGE_LUA_5_3
	help
	  swupdate provides a reliable way to update the software on an
	  embedded system.

	  swupdate is highly configurable to fit the targets requirements and
	  to minimize the footprint. The provided default configuration file
	  BR2_PACKAGE_SWUPDATE_CONFIG will enable swupdate with an embedded
	  webserver, a parser and a handler for raw NAND or NOR flash.

	  The default configuration file builds a reasonable firmware update
	  system with minimal external dependencies in my mind. If you like to
	  use your own modified configuration, you have to select the
	  necessary packages manually:

	  * Select BR2_PACKAGE_LUA_5_2 or BR2_PACKAGE_LUA_5_3 if you want
	    to have Lua support.
	  * Select BR2_LIBCURL if you want to use the download feature.
	  * Select BR2_PACKAGE_OPENSSL is you want to add encryption support.
	  * Select BR2_PACKAGE_MTD if you want to use swupdate with UBI
	    partitions.
	  * Select BR2_PACKAGE_ZLIB if you want to deal with gzip compressed
	    archives.
	  * Select BR2_PACKAGE_UBOOT_TOOLS and BR2_PACKAGE_ZLIB to add support
	    for setting the U-Boot environment.
	  * Select BR2_PACKAGE_ZEROMQ to add support for using a remote
	    handler.

	  https://sbabic.github.io/swupdate

if BR2_PACKAGE_SWUPDATE

config BR2_PACKAGE_SWUPDATE_CONFIG
	string "swupdate configuration file"
	default "package/swupdate/swupdate.config"
	help
	  Path to the swupdate configuration file.

	  I you wish to use your own modified swupdate configuration file
	  specify the config file location with this option.

config BR2_PACKAGE_SWUPDATE_INSTALL_WEBSITE
	bool "install default website"
	default y
	help
	  Install the provided website to /var/www/swupdate.

	  This is necessary if you want to run swupdate with the embedded
	  webserver and do not provide an own website to be installed to
	  /var/www/swupdate.
endif

comment "swupdate needs a toolchain w/ threads"
	depends on BR2_USE_MMU
	depends on !BR2_TOOLCHAIN_HAS_THREADS
```

## package/sylpheed/Config.in
```kconfig
config BR2_PACKAGE_SYLPHEED
	bool "sylpheed"
	depends on BR2_PACKAGE_LIBGTK2
	help
	  lightweight and user-friendly e-mail client.

	  http://sylpheed.sraoss.jp/en/
```

## package/synergy/Config.in
```kconfig
config BR2_PACKAGE_SYNERGY
	bool "synergy"
	depends on BR2_PACKAGE_XORG7
	depends on BR2_INSTALL_LIBSTDCPP
	depends on BR2_USE_WCHAR
	depends on BR2_USE_MMU # fork()
	depends on BR2_TOOLCHAIN_GCC_AT_LEAST_4_9 # C++14
	select BR2_PACKAGE_XLIB_LIBX11
	select BR2_PACKAGE_XLIB_LIBXTST
	help
	  Synergy lets you easily share a single mouse and
	  keyboard between multiple computers with different
	  operating systems, each with its own display,
	  without special hardware.

	  https://github.com/symless/synergy-core/

comment "synergy needs a toolchain w/ C++, wchar, gcc >= 4.9"
	depends on BR2_PACKAGE_XORG7
	depends on BR2_USE_MMU
	depends on !(BR2_INSTALL_LIBSTDCPP && BR2_USE_WCHAR && \
		BR2_TOOLCHAIN_GCC_AT_LEAST_4_9)
```

## package/sysdig/Config.in
```kconfig
config BR2_PACKAGE_SYSDIG
	bool "sysdig"
	depends on BR2_LINUX_KERNEL
	depends on BR2_INSTALL_LIBSTDCPP # libjson
	depends on BR2_PACKAGE_LUAJIT_ARCH_SUPPORTS
	depends on BR2_TOOLCHAIN_GCC_AT_LEAST_4_8
	depends on !BR2_STATIC_LIBS # luajit, elfutils
	depends on BR2_USE_WCHAR # elfutils
	depends on BR2_TOOLCHAIN_USES_UCLIBC || BR2_TOOLCHAIN_USES_GLIBC # elfutils
	select BR2_PACKAGE_ZLIB
	select BR2_PACKAGE_LUAJIT
	select BR2_PACKAGE_JSONCPP
	select BR2_PACKAGE_LIBCURL
	select BR2_PACKAGE_NCURSES
	select BR2_PACKAGE_OPENSSL
	select BR2_PACKAGE_JQ
	select BR2_PACKAGE_LIBB64
	select BR2_PACKAGE_ELFUTILS
	help
	  Sysdig is open source, system-level exploration:
	  capture system state and activity from a running Linux
	  instance, then save, filter and analyze.
	  Think of it as strace + tcpdump + lsof + awesome sauce.
	  With a little Lua cherry on top.

	  http://sysdig.org

comment "sysdig needs a glibc or uclibc toolchain w/ C++, gcc >= 4.8, dynamic library and a Linux kernel to be built"
	depends on !BR2_LINUX_KERNEL || !BR2_INSTALL_LIBSTDCPP \
		|| !BR2_TOOLCHAIN_GCC_AT_LEAST_4_8 || BR2_STATIC_LIBS \
		|| !(BR2_TOOLCHAIN_USES_UCLIBC || BR2_TOOLCHAIN_USES_GLIBC)
	depends on BR2_PACKAGE_LUAJIT_ARCH_SUPPORTS
```

## package/sysklogd/Config.in
```kconfig
config BR2_PACKAGE_SYSKLOGD
	bool "syslogd & klogd"
	depends on BR2_USE_MMU # fork()
	depends on BR2_PACKAGE_BUSYBOX_SHOW_OTHERS
	help
	  System log daemons syslogd and klogd.

	  https://github.com/troglobit/sysklogd/
```

## package/syslog-ng/Config.in
```kconfig
config BR2_PACKAGE_SYSLOG_NG
	bool "syslog-ng"
	select BR2_PACKAGE_EVENTLOG
	select BR2_PACKAGE_LIBGLIB2
	select BR2_PACKAGE_PCRE
	select BR2_PACKAGE_OPENSSL
	depends on BR2_USE_WCHAR # glib2
	depends on BR2_TOOLCHAIN_HAS_THREADS
	depends on BR2_USE_MMU # fork()
	help
	  syslog-ng is an enhanced log daemon, supporting a wide range
	  of input and output methods: syslog, unstructured text,
	  queueing, SQL & NoSQL

	  https://syslog-ng.org/

comment "syslog-ng needs a toolchain w/ wchar, threads"
	depends on BR2_USE_MMU
	depends on !BR2_USE_WCHAR || !BR2_TOOLCHAIN_HAS_THREADS
```

## package/sysprof/Config.in
```kconfig
config BR2_PACKAGE_SYSPROF
	bool "sysprof"
	depends on BR2_USE_WCHAR # glib2
	depends on BR2_TOOLCHAIN_HAS_THREADS # glib2
	depends on BR2_USE_MMU # glib2
	# In its util.h file, sysprof contains architecture-specific
	# code
	depends on BR2_i386 || BR2_x86_64 || BR2_powerpc || BR2_sh4a || BR2_sh4aeb
	select BR2_PACKAGE_LIBGLIB2
	help
	  Sysprof is a statistical, system-wide profiler that can
	  profile user and kernel code using the perf API.

	  http://sysprof.com

if BR2_PACKAGE_SYSPROF

config BR2_PACKAGE_SYSPROF_GUI
	bool "sysprof GUI"
	depends on BR2_PACKAGE_LIBGTK2
	select BR2_PACKAGE_LIBGLADE
	select BR2_PACKAGE_GDK_PIXBUF
	help
	  GUI for the sysprof system-wide statistical profiler.

endif

comment "sysprof needs a toolchain w/ wchar, threads"
	depends on BR2_USE_MMU
	depends on BR2_i386 || BR2_x86_64 || BR2_powerpc || BR2_sh4a || BR2_sh4aeb
	depends on !BR2_USE_WCHAR || !BR2_TOOLCHAIN_HAS_THREADS
```

## package/sysrepo/Config.in
```kconfig
config BR2_PACKAGE_SYSREPO
	bool "sysrepo"
	depends on BR2_USE_MMU
	depends on !BR2_STATIC_LIBS
	depends on BR2_INSTALL_LIBSTDCPP
	depends on BR2_TOOLCHAIN_HAS_THREADS_NPTL
	depends on BR2_TOOLCHAIN_GCC_AT_LEAST_4_8 # C++11
	select BR2_PACKAGE_LIBYANG
	select BR2_PACKAGE_PCRE
	select BR2_PACKAGE_PCRE_UCP
	help
	  Sysrepo is an YANG-based configuration and operational state
	  data store for Unix/Linux applications.

	  https://github.com/sysrepo

if BR2_PACKAGE_SYSREPO

config BR2_PACKAGE_SYSREPO_EXAMPLES
	bool "enable examples"
	help
	  Enable sysrepo examples.

endif

comment "sysrepo needs a toolchain w/ C++, NPTL, dynamic library, gcc >= 4.8"
	depends on BR2_USE_MMU
	depends on BR2_STATIC_LIBS || !BR2_INSTALL_LIBSTDCPP \
		|| !BR2_TOOLCHAIN_HAS_THREADS_NPTL
```

## package/sysstat/Config.in
```kconfig
config BR2_PACKAGE_SYSSTAT
	bool "sysstat"
	select BR2_PACKAGE_GETTEXT if BR2_NEEDS_GETTEXT_IF_LOCALE
	select BR2_PACKAGE_LIBINTL if BR2_NEEDS_GETTEXT_IF_LOCALE
	# Uses fork()
	depends on BR2_USE_MMU
	help
          The sysstat utilities are a collection of performance
          monitoring tools for Linux. These include sar, sadf, mpstat,
          iostat, pidstat and sa tools.

          Some Features :

           * Input / Output and transfer rate statistics (global, per
             device, per partition, per network filesystem and per
             Linux task / PID)
           * CPU statistics (global, per CPU and per Linux task /
             PID), including support for virtualization architectures
           * Memory and swap space utilization statistics
           * Virtual memory, paging and fault statistics
           * Per-task (per-PID) memory and page fault statistics
           * Global CPU and page fault statistics for tasks and all
             their children
           * Process creation activity
           * Interrupt statistics (global, per CPU and per interrupt,
             including potential APIC interrupt sources)
           * Extensive network statistics: network interface activity
             (number of packets and kB received and transmitted per
             second, etc.) including failures from network devices;
             network traffic statistics for IP, TCP, ICMP and UDP
             protocols based on SNMPv2 standards; support for
             IPv6-related protocols.
           * NFS server and client activity
           * Socket statistics
           * Run queue and system load statistics
           * Kernel internal tables utilization statistics
           * System and per Linux task switching activity
           * Swapping statistics
           * TTY device activity
           * Power management statistics

	  http://pagesperso-orange.fr/sebastien.godard/
```

## package/systemd-bootchart/Config.in
```kconfig
config BR2_PACKAGE_SYSTEMD_BOOTCHART_ARCH_SUPPORTS
	bool
	# see src/architecture.h
	default y if BR2_aarch64 || BR2_aarch64_be
	default y if BR2_arm || BR2_armeb
	default y if BR2_i386 || BR2_x86_64
	default y if BR2_m68k
	default y if BR2_mips || BR2_mipsel || BR2_mips64 || BR2_mips64el
	default y if BR2_powerpc || BR2_powerpc64 || BR2_powerpc64le
	default y if BR2_sh
	default y if BR2_sparc || BR2_sparc64

config BR2_PACKAGE_SYSTEMD_BOOTCHART
	bool "systemd-bootchart"
	depends on BR2_PACKAGE_SYSTEMD_BOOTCHART_ARCH_SUPPORTS
	depends on BR2_INIT_SYSTEMD
	depends on BR2_TOOLCHAIN_HEADERS_AT_LEAST_3_17
	help
	  systemd-bootchart is a tool, usually run at system startup,
	  that collects the CPU load, disk load, memory usage, as well
	  as per-process information from a running system. Collected
	  results are output as an SVG graph.

	  systemd-bootchart requires a Linux kernel >= 3.0 with the
	  following options enabled:

	  - CONFIG_SCHEDSTATS
	  - CONFIG_SCHED_DEBUG

	  These options will be automatically enabled by Buildroot if
	  it is responsible for building the kernel. Otherwise, if you
	  are building your kernel outside of Buildroot, make sure
	  these options are enabled.

	  http://www.freedesktop.org/software/systemd/man/systemd-bootchart.html

comment "systemd-bootchart needs a toolchain w/ headers >= 3.17"
	depends on BR2_PACKAGE_SYSTEMD_BOOTCHART_ARCH_SUPPORTS
	depends on BR2_INIT_SYSTEMD
	depends on !BR2_TOOLCHAIN_HEADERS_AT_LEAST_3_17
```
