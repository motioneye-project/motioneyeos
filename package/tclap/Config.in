## package/tclap/Config.in
```kconfig
comment "tclap needs a toolchain w/ C++"
	depends on !BR2_INSTALL_LIBSTDCPP

config BR2_PACKAGE_TCLAP
	bool "tclap"
	depends on BR2_INSTALL_LIBSTDCPP
	help
	  This is a small, flexible library that provides a simple
	  interface for defining and accessing command line
	  arguments. It was initially inspired by the user friendly
	  CLAP libary. The difference is that this library is
	  templatized, so the argument class is type independent. Type
	  independence avoids identical-except-for-type objects, such
	  as IntArg, FloatArg, and StringArg. While the library is not
	  strictly compliant with the GNU or POSIX standards, it is
	  close.

	  http://tclap.sourceforge.net/
```

## package/tcllib/Config.in
```kconfig
config BR2_PACKAGE_TCLLIB
	bool "tcllib"
	help
	  Tcllib is a collection of utility modules for Tcl. These
	  modules provide a wide variety of functionality, from
	  implementations of standard data structures to
	  implementations of common networking protocols. The intent
	  is to collect commonly used function into a single library,
	  which users can rely on to be available and stable

	  https://www.tcl.tk/software/tcllib/
```

## package/tcpdump/Config.in
```kconfig
config BR2_PACKAGE_TCPDUMP
	bool "tcpdump"
	select BR2_PACKAGE_LIBPCAP
	help
	  A tool for network monitoring and data acquisition.

	  http://www.tcpdump.org/

if BR2_PACKAGE_TCPDUMP

config BR2_PACKAGE_TCPDUMP_SMB
	bool "smb dump support"
	help
	  enable possibly-buggy SMB printer

endif
```

## package/tcpreplay/Config.in
```kconfig
config BR2_PACKAGE_TCPREPLAY
	bool "tcpreplay"
	depends on BR2_USE_MMU # fork()
	select BR2_PACKAGE_LIBPCAP
	help
	  Tcpreplay is a tool for replaying network traffic from files saved
	  with tcpdump or other tools which write pcap(3) files.

	  http://tcpreplay.synfin.net/
```

## package/tekui/Config.in
```kconfig
config BR2_PACKAGE_TEKUI
	bool "tekui"
	depends on !BR2_STATIC_LIBS
	depends on BR2_PACKAGE_HAS_LUAINTERPRETER
	depends on BR2_TOOLCHAIN_HAS_THREADS
	select BR2_PACKAGE_FREETYPE
	select BR2_PACKAGE_LUAFILESYSTEM	# runtime only
	select BR2_PACKAGE_LUAEXPAT		# runtime only
	select BR2_PACKAGE_LUASOCKET		# runtime only
	select BR2_PACKAGE_LUAPOSIX		# runtime only
	help
	  TekUI is a small, freestanding and portable graphical user
	  interface (GUI) toolkit written in Lua and C. It was
	  initially developed for the X Window System and has been
	  ported to DirectFB, Windows, Nano-X and a raw framebuffer
	  since

	  http://tekui.neoscientists.org/

comment "tekui needs a Lua interpreter and a toolchain w/ threads, dynamic library"
	depends on !BR2_PACKAGE_HAS_LUAINTERPRETER || !BR2_TOOLCHAIN_HAS_THREADS || \
		BR2_STATIC_LIBS
```

## package/terminology/Config.in
```kconfig
config BR2_PACKAGE_TERMINOLOGY
	bool "terminology"
	depends on BR2_PACKAGE_EFL
	select BR2_PACKAGE_ELEMENTARY
	help
	  Terminology is an EFL terminal emulator with some extra
	  bells and whistles.

	  https://www.enlightenment.org/about-terminology
```

## package/tesseract-ocr/Config.in
```kconfig
comment "tesseract-ocr needs a toolchain w/ threads, C++, gcc >= 4.8, dynamic library, wchar"
	depends on BR2_USE_MMU
	depends on !BR2_INSTALL_LIBSTDCPP || !BR2_TOOLCHAIN_HAS_THREADS || \
		!BR2_TOOLCHAIN_GCC_AT_LEAST_4_8 || BR2_STATIC_LIBS || !BR2_USE_WCHAR

menuconfig BR2_PACKAGE_TESSERACT_OCR
	bool "tesseract-ocr"
	depends on BR2_INSTALL_LIBSTDCPP
	depends on BR2_TOOLCHAIN_HAS_THREADS
	depends on BR2_TOOLCHAIN_GCC_AT_LEAST_4_8 # C++11
	depends on BR2_USE_MMU # fork()
	depends on !BR2_STATIC_LIBS
	depends on BR2_USE_WCHAR
	select BR2_PACKAGE_LEPTONICA
	help
	  Tesseract is an OCR (Optical Character Recognition) engine,
	  It can be used directly, or (for programmers) using an API.
	  It supports a wide variety of languages.

	  https://github.com/tesseract-ocr/tesseract

if BR2_PACKAGE_TESSERACT_OCR

comment "tesseract-ocr languages support"

config BR2_PACKAGE_TESSERACT_OCR_LANG_ENG
	bool "English"

config BR2_PACKAGE_TESSERACT_OCR_LANG_FRA
	bool "French"

config BR2_PACKAGE_TESSERACT_OCR_LANG_GER
	bool "German"

config BR2_PACKAGE_TESSERACT_OCR_LANG_SPA
	bool "Spanish"

config BR2_PACKAGE_TESSERACT_OCR_LANG_CHI_SIM
	bool "Simplified Chinese"

config BR2_PACKAGE_TESSERACT_OCR_LANG_CHI_TRA
	bool "Traditional Chinese"

endif
```

## package/tftpd/Config.in
```kconfig
config BR2_PACKAGE_TFTPD
	bool "tftpd"
	# linker issue with pre-6.x toolchains
	depends on !(BR2_nios2 && !BR2_TOOLCHAIN_GCC_AT_LEAST_6)
	depends on BR2_USE_MMU # fork()
	depends on BR2_PACKAGE_BUSYBOX_SHOW_OTHERS
	help
	  HPA's Trivial File Transfer Protocol (tftp) server.

	  https://git.kernel.org/pub/scm/network/tftp/tftp-hpa.git
```

## package/thermald/Config.in
```kconfig
config BR2_PACKAGE_THERMALD
	bool "thermald"
	depends on BR2_i386 || BR2_x86_64 # needs <cpuid.h>
	depends on BR2_USE_MMU # uses fork()
	depends on BR2_INSTALL_LIBSTDCPP
	depends on BR2_TOOLCHAIN_HAS_THREADS # dbus-glib -> glib2, dbus
	depends on BR2_USE_WCHAR # dbus-glib -> glib2
	select BR2_PACKAGE_DBUS
	select BR2_PACKAGE_DBUS_GLIB
	select BR2_PACKAGE_LIBXML2
	help
	  Thermal Daemon is a Linux daemon for monitoring and
	  controlling platform temperatures. Once the system temperature
	  reaches a certain threshold, the Linux daemon activates
	  various cooling methods to try to cool the system.

	  https://01.org/linux-thermal-daemon

comment "thermald needs a toolchain w/ C++, wchar, threads"
	depends on BR2_i386 || BR2_x86_64
	depends on BR2_USE_MMU
	depends on !BR2_USE_WCHAR || !BR2_TOOLCHAIN_HAS_THREADS || \
		!BR2_INSTALL_LIBSTDCPP
```

## package/thrift/Config.in
```kconfig
config BR2_PACKAGE_THRIFT
	bool "thrift"
	depends on BR2_INSTALL_LIBSTDCPP
	depends on BR2_USE_WCHAR
	depends on BR2_LARGEFILE
	depends on BR2_TOOLCHAIN_HAS_THREADS
	depends on !BR2_arc # atomic builtins
	select BR2_PACKAGE_BOOST
	select BR2_PACKAGE_LIBEVENT
	select BR2_PACKAGE_OPENSSL
	select BR2_PACKAGE_ZLIB
	help
	  The Apache Thrift software framework, for scalable cross-language
	  services development, combines a software stack with a
	  code generation engine to build services that work
	  efficiently and seamlessly between C++, Java, Python, PHP, Ruby,
	  Erlang, Perl, Haskell, C#, Cocoa, JavaScript, Node.js, Smalltalk,
	  OCaml and Delphi and other languages.

	  http://thrift.apache.org/

comment "thrift needs a toolchain w/ C++, largefile, wchar, threads"
	depends on !BR2_LARGEFILE || !BR2_USE_WCHAR || \
		!BR2_TOOLCHAIN_HAS_THREADS || !BR2_INSTALL_LIBSTDCPP
	depends on !BR2_arc
```

## package/thttpd/Config.in
```kconfig
config BR2_PACKAGE_THTTPD
	bool "thttpd"
	depends on BR2_USE_MMU # fork()
	help
	  thttpd is a simple, small, portable, fast, and secure HTTP
	  server

	  http://www.acme.com/software/thttpd/
```

## package/ti-gfx/Config.in
```kconfig
config BR2_PACKAGE_TI_GFX
	bool "ti-gfx"
	depends on BR2_LINUX_KERNEL && BR2_TOOLCHAIN_USES_GLIBC && BR2_arm
	depends on BR2_HOSTARCH = "x86_64" || BR2_HOSTARCH = "x86"
	select BR2_HOSTARCH_NEEDS_IA32_LIBS
	select BR2_PACKAGE_HAS_LIBEGL
	select BR2_PACKAGE_HAS_LIBGLES
	select BR2_PACKAGE_HAS_POWERVR
	select BR2_PACKAGE_FBSET if !BR2_PACKAGE_BUSYBOX # Runtime dependency only
	select BR2_LINUX_NEEDS_MODULES # not using kernel-module infra
	help
	  Graphics libraries for TI boards using SGX acceleration.

	  Supports OMAP35xx, DM37xx/AM37xx, DM816x, DM814x, AM335x and
	  AM43xx.

	  For newer CPUs or kernels use the ti-sgx-{km,um} packages.

	  http://downloads.ti.com/dsps/dsps_public_sw/gfxsdk/

if BR2_PACKAGE_TI_GFX

config BR2_PACKAGE_PROVIDES_LIBEGL
	default "ti-gfx"

config BR2_PACKAGE_PROVIDES_LIBGLES
	default "ti-gfx"

config BR2_PACKAGE_PROVIDES_POWERVR
	default "ti-gfx"

config BR2_PACKAGE_TI_GFX_DEBUG
	bool "enable debug support"
	help
	  Turns on debugging in the kernel module, install libraries built with
	  debugging enabled, installs various tests and installs esrev script.

config BR2_PACKAGE_TI_GFX_DEMOS
	bool "install demos"
	default y
	help
	  Install the OGLES2ChameleonMan and OGLES2MagicLantern demos

config BR2_PACKAGE_TI_GFX_EGLIMAGE
	bool "install eglimage version of libraries"
	help
	  Installs OpenGL libaries which support the eglimage api.

choice
	prompt "Target"
	default BR2_PACKAGE_TI_GFX_ES3
	help
	  Select the SOC for which you would like to install drivers. Please use the
	  chart at
	  http://processors.wiki.ti.com/index.php/OMAP35x_Graphics_SDK_Getting_Started_Guide

config BR2_PACKAGE_TI_GFX_ES3
	bool "es3.x (OMAP35xx, AM35xx Rev 3.1+)"
	help
	  OMAP35xx, AM35xx Rev 3.1+

config BR2_PACKAGE_TI_GFX_ES5
	bool "es5.x (AM37xx, DM37xx)"
	help
	  AM37xx, DM37xx

config BR2_PACKAGE_TI_GFX_ES6
	bool "es6.x (AM387x, DMA814x, AM389x, DM816x)"
	help
	  AM387x, DM814x, AM389x, DM816x

config BR2_PACKAGE_TI_GFX_ES8
	bool "es8.x (AM335x)"
	help
	  AM335x

endchoice

endif

comment "ti-gfx needs a glibc toolchain and a Linux kernel to be built"
	depends on BR2_arm
	depends on !(BR2_LINUX_KERNEL && BR2_TOOLCHAIN_USES_GLIBC)
```

## package/ti-sgx-demos/Config.in
```kconfig
config BR2_PACKAGE_TI_SGX_DEMOS
	bool "ti-sgx-demos"
	depends on BR2_PACKAGE_TI_SGX_UM
	help
	  These SGX powervr demo applications from Imagination
	  Technologies are availabe as binaries only.  The binaries
	  are compiled for the TI SGX implementation.

	  https://git.ti.com/cgit/graphics/img-pvr-sdk
```

## package/ti-sgx-km/Config.in
```kconfig
comment "ti-sgx-km needs a Linux kernel to be built"
	depends on BR2_arm
	depends on !BR2_LINUX_KERNEL

config BR2_PACKAGE_TI_SGX_KM
	bool "ti-sgx-km"
	depends on BR2_LINUX_KERNEL && BR2_arm
	select BR2_LINUX_NEEDS_MODULES
	help
	  Kernel modules for TI CPUs with SGX GPU.
	  This package supports AM335x only.
	  It builds the kernel module and the user space binaries.
	  For older CPUs or kernels use the ti-gfx package.

	  Note: it needs a TI specific kernel to build properly.

	  https://git.ti.com/cgit/graphics/omap5-sgx-ddk-linux
```

## package/ti-sgx-libgbm/Config.in
```kconfig
config BR2_PACKAGE_TI_SGX_LIBGBM
	bool "ti-sgx-libgbm"
	depends on BR2_TOOLCHAIN_HAS_THREADS
	depends on BR2_PACKAGE_HAS_UDEV
	select BR2_PACKAGE_LIBDRM
	help
	  TI SGX libgbm variant.

	  https://git.ti.com/cgit/glsdk/libgbm

comment "ti-sgx-libgbm needs udev and a toolchain w/ threads"
	depends on !BR2_PACKAGE_HAS_UDEV || !BR2_TOOLCHAIN_HAS_THREADS
```

## package/ti-sgx-um/Config.in
```kconfig
comment "ti-sgx-um needs the ti-sgx-km driver"
	depends on !BR2_PACKAGE_TI_SGX_KM

comment "ti-sgx-um needs udev and a glibc toolchain w/ threads"
	depends on !BR2_PACKAGE_HAS_UDEV || !BR2_TOOLCHAIN_USES_GLIBC \
		|| !BR2_TOOLCHAIN_HAS_THREADS

config BR2_PACKAGE_TI_SGX_UM
	bool "ti-sgx-um"
	depends on BR2_PACKAGE_TI_SGX_KM
	depends on BR2_TOOLCHAIN_HAS_THREADS # libdrm
	depends on BR2_PACKAGE_HAS_UDEV # ti-sgx-libgbm
	# pre-built binaries
	depends on BR2_TOOLCHAIN_USES_GLIBC
	select BR2_PACKAGE_LIBDRM
	select BR2_PACKAGE_LIBDRM_OMAP
	select BR2_PACKAGE_HAS_LIBEGL
	select BR2_PACKAGE_HAS_LIBGLES
	select BR2_PACKAGE_HAS_POWERVR
	select BR2_PACKAGE_TI_SGX_LIBGBM
	select BR2_PACKAGE_LIBFFI
	select BR2_PACKAGE_WAYLAND
	help
	  Graphics libraries for TI CPUs with SGX5xx GPU.
	  This package supports AM335x, AM437x, AM4430 and AM5430.
	  For older CPUs or kernels use the ti-gfx package.

	  https://git.ti.com/cgit/graphics/omap5-sgx-ddk-um-linux

if BR2_PACKAGE_TI_SGX_UM

config BR2_PACKAGE_PROVIDES_LIBEGL
	default "ti-sgx-um"

config BR2_PACKAGE_PROVIDES_LIBGLES
	default "ti-sgx-um"

config BR2_PACKAGE_PROVIDES_POWERVR
	default "ti-sgx-um"

endif
```

## package/ti-uim/Config.in
```kconfig
config BR2_PACKAGE_TI_UIM
	bool "ti-uim"
	help
	  User Mode Initialization Manager for TI wl12xx connectivity
	  chip shared transport drivers. This daemon is needed to get
	  the btwilink driver to work.

	  http://omappedia.org/wiki/Device_Driver_Interface_of_WiLink_Solution
```

## package/ti-utils/Config.in
```kconfig
config BR2_PACKAGE_TI_UTILS
	bool "ti-utils"
	depends on BR2_TOOLCHAIN_HAS_THREADS # libnl
	select BR2_PACKAGE_LIBNL
	help
	  The calibrator and other useful utilities for TI wireless
	  solution, based on wl12xx driver.

	  http://linuxwireless.sipsolutions.net/en/users/Drivers/wl12xx/calibrator/

comment "ti-utils needs a toolchain w/ threads"
	depends on !BR2_TOOLCHAIN_HAS_THREADS
```

## package/tiff/Config.in
```kconfig
menuconfig BR2_PACKAGE_TIFF
	bool "tiff"
	help
	  Library for handling TIFF (Tag Image File Format) images.

	  http://simplesystems.org/libtiff/

if BR2_PACKAGE_TIFF

config BR2_PACKAGE_TIFF_CCITT
	bool "CCITT Group 3 & 4 support"
	default y

config BR2_PACKAGE_TIFF_PACKBITS
	bool "Macintosh PackBits algorithm"
	default y

config BR2_PACKAGE_TIFF_LZW
	bool "LZW algorithm"
	default y

config BR2_PACKAGE_TIFF_THUNDER
	bool "ThunderScan 4-bit RLE algorithm"
	default y

config BR2_PACKAGE_TIFF_NEXT
	bool "NeXT 2-bit RLE algorithm"
	default y

config BR2_PACKAGE_TIFF_LOGLUV
	bool "LogLuv high dynamic range encoding"
	default y

config BR2_PACKAGE_TIFF_MDI
	bool "Microsoft Document Imaging"
	default y

config BR2_PACKAGE_TIFF_ZLIB
	bool "Zlib usage (required for Deflate compression)"
	default y
	select BR2_PACKAGE_ZLIB

config BR2_PACKAGE_TIFF_XZ
	bool "XZ compression"
	select BR2_PACKAGE_XZ

config BR2_PACKAGE_TIFF_PIXARLOG
	bool "Pixar log-format algorithm (requires Zlib)"
	default y
	select BR2_PACKAGE_TIFF_ZLIB

config BR2_PACKAGE_TIFF_JPEG
	bool "JPEG compression"
	default y
	select BR2_PACKAGE_JPEG

config BR2_PACKAGE_TIFF_OLD_JPEG
	bool "Old JPEG decompression"
	default y

config BR2_PACKAGE_TIFF_JBIG
	bool "JBIG compression"
	default y

config BR2_PACKAGE_TIFF_UTILITIES
	bool "tiff utilities"
	help
	  Install all tiff utilities.

endif
```

## package/time/Config.in
```kconfig
config BR2_PACKAGE_TIME
	bool "time"
	depends on BR2_USE_MMU # fork()
	help
	  The GNU time utility.

	  http://savannah.gnu.org/projects/time/
```

## package/tinc/Config.in
```kconfig
config BR2_PACKAGE_TINC
	bool "tinc"
	depends on !BR2_STATIC_LIBS # tinc requires libdl for OpenSSL
	depends on BR2_USE_MMU # fork()
	select BR2_PACKAGE_LZO
	select BR2_PACKAGE_OPENSSL
	select BR2_PACKAGE_ZLIB
	help
	  tinc is a Virtual Private Network (VPN) daemon that uses
	  tunnelling and encryption to create a secure private network
	  between hosts on the Internet.

	  http://www.tinc-vpn.org/

comment "tinc needs a toolchain w/ dynamic library"
	depends on BR2_STATIC_LIBS
```

## package/tini/Config.in
```kconfig
config BR2_PACKAGE_TINI
	bool "tini"
	depends on BR2_USE_MMU # fork()
	help
	  tini is a simple but valid init binary to
	  act as PID 1 for containers.

	  https://github.com/krallin/tini

if BR2_PACKAGE_TINI

config BR2_PACKAGE_TINI_MINIMAL
	bool "build minimal variant"
	help
	  Disables argument parsing and verbose output.

endif
```

## package/tinyalsa/Config.in
```kconfig
config BR2_PACKAGE_TINYALSA
	bool "tinyalsa"
	depends on !BR2_STATIC_LIBS
	help
	  a small library to interface with ALSA in the Linux kernel

	  The aims are:

	  - Provide a basic pcm and mixer API
	  - If it's not absolutely needed, don't add it to the API
	  - Avoid supporting complex and unnecessary operations that could be dealt
	    with at a higher level

	  https://github.com/tinyalsa/tinyalsa

comment "tinyalsa needs toolchain w/ dynamic library"
	depends on BR2_STATIC_LIBS
```

## package/tinycbor/Config.in
```kconfig
config BR2_PACKAGE_TINYCBOR
	bool "tinycbor"
	# package uses fopencookie(), not available with this toolchain
	depends on !BR2_TOOLCHAIN_EXTERNAL_BLACKFIN_UCLINUX
	help
	  Concise Binary Object Representation (CBOR) Library

	  https://github.com/01org/tinycbor
```
