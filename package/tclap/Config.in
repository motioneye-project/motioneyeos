## package/tinydtls/Config.in
```kconfig
config BR2_PACKAGE_TINYDTLS
	bool "tinydtls"
	depends on BR2_TOOLCHAIN_HAS_THREADS
	help
	  tinydtls is a library for Datagram Transport Layer Security
	  (DTLS) covering both the client and the server state
	  machine.  It is implemented in C and provides support for
	  the mandatory cipher suites specified in CoAP.

	  https://projects.eclipse.org/projects/iot.tinydtls

comment "tinydtls needs a toolchain w/ threads"
	depends on !BR2_TOOLCHAIN_HAS_THREADS
```
