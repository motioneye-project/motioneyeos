## package/tinyhttpd/Config.in
```kconfig
config BR2_PACKAGE_TINYHTTPD
	bool "tinyhttpd"
	depends on BR2_USE_MMU # fork()
	help
	  A relatively simple webserver written as a school project. It is
	  exceedingly simple, threaded and handles basic CGI scripts.

	  http://sourceforge.net/projects/tinyhttpd/
```

## package/tinylogin/Config.in
```kconfig
config BR2_PACKAGE_TINYLOGIN
	bool "tinylogin"
	help
	  Suite of tiny Unix utilities for handling logging into,
	  being authenticated by, changing one's password for, and
	  otherwise maintaining users and groups on an embedded system.

	  http://tinylogin.busybox.net/
```

## package/tinymembench/Config.in
```kconfig
config BR2_PACKAGE_TINYMEMBENCH
	bool "tinymembench"
	depends on !BR2_MIPS_NABI32 && !BR2_MIPS_NABI64
	help
	  Tinymembench is a simple memory benchmark program, which
	  tries to measure the peak bandwidth of sequential memory
	  accesses and the latency of random memory accesses.
	  Bandwidth is measured by running different assembly code for
	  the aligned memory blocks and attempting different prefetch
	  strategies.

	  https://github.com/ssvb/tinymembench
```

## package/tinyproxy/Config.in
```kconfig
config BR2_PACKAGE_TINYPROXY
	bool "tinyproxy"
	depends on BR2_USE_WCHAR
	depends on BR2_TOOLCHAIN_HAS_THREADS
	depends on BR2_USE_MMU # fork()
	help
	  Tinyproxy is a small, efficient HTTP/SSL proxy daemon released
	  under the GNU General Public License. Tinyproxy is very
	  useful in a small network setting, where a larger proxy would
	  be too resource intensive.

	  https://tinyproxy.github.io

comment "tinyproxy needs a toolchain w/ threads, wchar"
	depends on !BR2_TOOLCHAIN_HAS_THREADS || !BR2_USE_WCHAR
	depends on BR2_USE_MMU
```

## package/tinyssh/Config.in
```kconfig
config BR2_PACKAGE_TINYSSH
	bool "tinyssh"
	depends on BR2_USE_MMU # fork()
	help
	  TinySSH is a minimalistic SSH server which implements only
	  a subset of SSHv2 features.

	  https://tinyssh.org
```

## package/tinyx-old/Config.in
```kconfig
config BR2_PACKAGE_TINYX_OLD
	bool "tinyx (old version. which supposedly builds)"
	default n
	depends on BR2_PACKAGE_TINYX
	help
	  A tiny X server.  Also known as 'Xfbdev' and 'kdrive'.
```

## package/tinyx/Config.in
```kconfig
config BR2_PACKAGE_TINYX
	bool "tinyx"
	default y if BR2_PACKAGE_XSERVER_tinyx
	depends on BR2_USE_WCHAR
	depends on BR2_ENABLE_LOCALE
	help
	  A tiny X server.  Also known as 'Xfbdev' and 'kdrive'.

comment "tinyx X Window System disabled"
	depends on BR2_PACKAGE_XORG||BR2_PACKAGE_XORG7
```

## package/tinyxml/Config.in
```kconfig
config BR2_PACKAGE_TINYXML
	bool "tinyxml"
	depends on BR2_INSTALL_LIBSTDCPP
	help
	  TinyXML is a simple, small, C++ XML parser that can be
	  easily integrating into other programs.

	  https://github.com/leethomason/tinyxml2

comment "tinyxml needs a toolchain w/ C++"
	depends on !BR2_INSTALL_LIBSTDCPP
```

## package/tinyxml2/Config.in
```kconfig
config BR2_PACKAGE_TINYXML2
	bool "tinyxml2"
	depends on BR2_INSTALL_LIBSTDCPP
	help
	  TinyXML-2 is a simple, small, efficient, C++ XML parser that
	  can be easily integrating into other programs.

	  http://www.grinninglizard.com/tinyxml2/index.html

comment "tinyxml2 needs a toolchain w/ C++"
	depends on !BR2_INSTALL_LIBSTDCPP
```

## package/tio/Config.in
```kconfig
config BR2_PACKAGE_TIO
	bool "tio"
	help
	  "tio" is a simple TTY terminal application which features a
	  straightforward commandline interface to easily connect to
	  TTY devices for basic input/output.

	  https://tio.github.io/
```

## package/tk/Config.in
```kconfig
config BR2_PACKAGE_TK
	bool "tk"
	depends on BR2_USE_MMU # tcl
	depends on BR2_TOOLCHAIN_HAS_THREADS # tcl
	depends on !BR2_STATIC_LIBS # tcl
	depends on BR2_PACKAGE_XORG7
	select BR2_PACKAGE_TCL
	select BR2_PACKAGE_XLIB_LIBX11
	select BR2_PACKAGE_XLIB_LIBXFT
	help
	  A windowing toolkit for use with tcl

	  http://www.tcl.tk

comment "tk needs a toolchain w/ threads, dynamic library"
	depends on BR2_USE_MMU
	depends on BR2_PACKAGE_XORG7
	depends on !BR2_TOOLCHAIN_HAS_THREADS || BR2_STATIC_LIBS
```

## package/tmux/Config.in
```kconfig
config BR2_PACKAGE_TMUX
	bool "tmux"
	depends on BR2_USE_MMU # fork()
	depends on BR2_USE_WCHAR # mbtowc()
	depends on BR2_ENABLE_LOCALE # runtime
	select BR2_PACKAGE_LIBEVENT
	select BR2_PACKAGE_NCURSES
	help
	  tmux is a terminal multiplexer, it enables a number of
	  terminals (or windows) to be accessed and controlled from a
	  single terminal.

	  NOTE: tmux needs a working UTF-8 locale (BR2_GENERATE_LOCALE)

	  https://tmux.github.io/

comment "tmux needs a toolchain w/ wchar, locale"
	depends on BR2_USE_MMU
	depends on !BR2_USE_WCHAR || !BR2_ENABLE_LOCALE
```

## package/tn5250/Config.in
```kconfig
config BR2_PACKAGE_TN5250
	bool "tn5250"
	select BR2_PACKAGE_NCURSES
	help
	  Telnet client that emulates 5250 terminals and printers.

	  http://tn5250.sourceforge.net/
```

## package/tor/Config.in
```kconfig
config BR2_PACKAGE_TOR
	bool "tor"
	depends on BR2_USE_MMU # fork()
	depends on BR2_TOOLCHAIN_HAS_THREADS_NPTL
	select BR2_PACKAGE_LIBEVENT
	select BR2_PACKAGE_OPENSSL
	select BR2_PACKAGE_ZLIB
	help
	  Tor is free software and an open network that helps you
	  defend against traffic analysis, a form of network
	  surveillance that threatens personal freedom and privacy,
	  confidential business activities and relationships, and
	  state security.

	  https://www.torproject.org

comment "tor needs a toolchain w/ NPTL"
	depends on BR2_USE_MMU
	depends on !BR2_TOOLCHAIN_HAS_THREADS_NPTL
```

## package/torsmo/Config.in
```kconfig
config BR2_PACKAGE_TORSMO
	bool "torsmo"
	depends on BR2_DEPRECATED_SINCE_2015_11
	depends on BR2_PACKAGE_XORG7
	depends on BR2_USE_MMU # fork()
	select BR2_PACKAGE_XLIB_LIBX11
	select BR2_PACKAGE_XLIB_LIBXEXT
	help
	  Torsmo is a system monitor that sits in the corner of your desktop.

	  http://mirror.egtvedt.no/avr32linux.org/twiki/pub/Main/Torsmo
```

## package/tovid/Config.in
```kconfig
config BR2_PACKAGE_TOVID
	bool "tovid"
	depends on BR2_USE_MMU # fork()
	depends on BR2_TOOLCHAIN_HAS_THREADS
	depends on BR2_INSTALL_LIBSTDCPP
	depends on BR2_USE_WCHAR
	depends on BR2_PACKAGE_PYTHON || BR2_PACKAGE_PYTHON3
	depends on BR2_PACKAGE_FFMPEG_ARCH_SUPPORTS
	depends on BR2_TOOLCHAIN_GCC_AT_LEAST_4_5 # mpv
	depends on BR2_TOOLCHAIN_HAS_ATOMIC || BR2_TOOLCHAIN_HAS_SYNC_8 # mpv
	depends on !BR2_TOOLCHAIN_EXTERNAL_SYNOPSYS_ARC # mpv
	# The below dependencies are runtime dependencies only
	select BR2_PACKAGE_BUSYBOX_SHOW_OTHERS # procps_ng
	select BR2_PACKAGE_DVDAUTHOR
	select BR2_PACKAGE_DVDRW_TOOLS
	select BR2_PACKAGE_FFMPEG
	select BR2_PACKAGE_IMAGEMAGICK
	select BR2_PACKAGE_JPEG
	select BR2_PACKAGE_MJPEGTOOLS
	select BR2_PACKAGE_MPV
	select BR2_PACKAGE_PROCPS_NG # pgrep and pkill
	select BR2_PACKAGE_SOX
	help
	  The tovid suite, also known simply as tovid, is a collection
	  of shell and Python scripts for creating DVDs and
	  (S)VCDs. It is pronounced "to vid" (because it converts to
	  video disc formats).

	  http://tovid.wikia.com/wiki/Installing_tovid

comment "tovid needs a toolchain w/ threads, C++, wchar, gcc >= 4.5"
	depends on BR2_USE_MMU
	depends on BR2_PACKAGE_FFMPEG_ARCH_SUPPORTS
	depends on BR2_TOOLCHAIN_HAS_ATOMIC || BR2_TOOLCHAIN_HAS_SYNC_8
	depends on !BR2_TOOLCHAIN_HAS_THREADS \
		|| !BR2_TOOLCHAIN_GCC_AT_LEAST_4_5 \
		|| !BR2_INSTALL_LIBSTDCPP \
		|| !BR2_USE_WCHAR
	depends on !BR2_TOOLCHAIN_EXTERNAL_SYNOPSYS_ARC

comment "tovid depends on python or python3"
	depends on !BR2_PACKAGE_PYTHON && !BR2_PACKAGE_PYTHON3
	depends on BR2_PACKAGE_FFMPEG_ARCH_SUPPORTS
	depends on BR2_TOOLCHAIN_HAS_ATOMIC || BR2_TOOLCHAIN_HAS_SYNC_8
	depends on !BR2_TOOLCHAIN_HAS_THREADS || \
		!BR2_TOOLCHAIN_GCC_AT_LEAST_4_5
	depends on !BR2_TOOLCHAIN_EXTERNAL_SYNOPSYS_ARC
```

## package/tpm-tools/Config.in
```kconfig
config BR2_PACKAGE_TPM_TOOLS
	bool "tpm-tools"
	depends on BR2_TOOLCHAIN_HAS_THREADS # trousers
	depends on !BR2_STATIC_LIBS # trousers
	depends on !BR2_arc # trousers
	select BR2_PACKAGE_TROUSERS
	select BR2_PACKAGE_OPENSSL
	help
	  Tools to manage and diagnose a TPM

	  http://trousers.sourceforge.net/

comment "tpm-tools needs a toolchain w/ threads, dynamic library"
	depends on !BR2_TOOLCHAIN_HAS_THREADS || BR2_STATIC_LIBS
	depends on !BR2_arc
```

## package/tpm2-abrmd/Config.in
```kconfig
config BR2_PACKAGE_TPM2_ABRMD
	bool "tpm2-abrmd"
	depends on BR2_USE_WCHAR # libglib2
	depends on BR2_TOOLCHAIN_HAS_THREADS # libglib2
	depends on BR2_USE_MMU # libglib2
	depends on !BR2_STATIC_LIBS # tpm2-tss
	select BR2_PACKAGE_LIBGLIB2
	select BR2_PACKAGE_TPM2_TSS
	help
	  A system daemon implementing the TPM2 access broker (TAB) &
	  Resource Manager (RM) spec from the TCG. It should be started
	  during the OS boot process. Communication between the daemon
	  and clients using the TPM is done with a combination of DBus
	  and Unix pipes.

	  The package also provides a client library for interacting
	  with the daemon via TPM Command Transmission Interface (TCTI).
	  It is intended for use with the SAPI library (libtss2-sys)
	  like any other TCTI.

	  https://github.com/tpm2-software/tpm2-abrmd

comment "tpm2-abrmd needs a toolchain w/ dynamic library, wchar, threads"
	depends on BR2_USE_MMU
	depends on !BR2_USE_WCHAR || !BR2_TOOLCHAIN_HAS_THREADS || \
		BR2_STATIC_LIBS
```

## package/tpm2-tools/Config.in
```kconfig
config BR2_PACKAGE_TPM2_TOOLS
	bool "tpm2-tools"
	depends on !BR2_STATIC_LIBS # tpm2-tss
	select BR2_PACKAGE_LIBCURL
	select BR2_PACKAGE_OPENSSL
	select BR2_PACKAGE_TPM2_TSS
	help
	  TPM (Trusted Platform Module) 2.0 CLI tools based on system
	  API of TPM2-TSS. These tools can be used to manage keys,
	  perform encryption/decryption/signing/etc crypto operations,
	  and manage non-volatile storage through a TPM2.0 HW
	  implementation.

	  Notice: An in-kernel resource manager is provided by the
	  Linux kernel since 4.12. Depending on use cases and kernel
	  version, the user space resource manager provided by
	  tpm2-abrmd may be needed.

	  https://github.com/tpm2-software/tpm2-tools

comment "tpm2-tools needs a toolchain w/ dynamic library"
	depends on BR2_STATIC_LIBS
```

## package/tpm2-totp/Config.in
```kconfig
config BR2_PACKAGE_TPM2_TOTP
	bool "tpm2-totp"
	depends on !BR2_STATIC_LIBS # tpm2-tss
	depends on !BR2_TOOLCHAIN_EXTERNAL_CODESOURCERY_ARM # glibc < 2.20
	select BR2_PACKAGE_LIBQRENCODE
	select BR2_PACKAGE_TPM2_TSS
	help
	  This is a reimplementation of Matthew Garrett's tpmtotp
	  software for TPM 2.0 using the tpm2-tss software stack. Its
	  purpose is to attest the trustworthiness of a device against
	  a human using time-based one-time passwords (TOTP),
	  facilitating the Trusted Platform Module (TPM) to bind the
	  TOTP secret to the known trustworthy system state. In
	  addition to the original tpmtotp, given the new capabilities
	  of in-TPM hmac calculation, the tpm2-totp's secret HMAC keys
	  do not have to be exported from the TPM to the CPU's RAM on
	  boot anymore.

	  https://github.com/tpm2-software/tpm2-totp

comment "tpm2-totp needs a toolchain w/ dynamic library"
	depends on BR2_STATIC_LIBS
	depends on !BR2_TOOLCHAIN_EXTERNAL_CODESOURCERY_ARM
```

## package/tpm2-tss/Config.in
```kconfig
config BR2_PACKAGE_TPM2_TSS
	bool "tpm2-tss"
	depends on !BR2_STATIC_LIBS # dlfcn.h
	select BR2_PACKAGE_LIBURIPARSER
	select BR2_PACKAGE_OPENSSL
	select BR2_PACKAGE_OPENSSL_FORCE_LIBOPENSSL
	help
	  OSS implementation of the Trusted Computing Group's (TCG) TPM2
	  Software Stack (TSS). This stack consists of the following
	  layers from top to bottom:

	  * System API (SAPI) as described in the system level API and
	    TPM command transmission interface specification. This API
	    is a 1-to-1 mapping of the TPM2 commands documented in Part
	    3 of the TPM2 specification. Additionally there are
	    asynchronous versions of each command. These asynchronous
	    variants may be useful for integration into event-driven
	    programming environments. Both the synchronous and
	    asynchronous API are exposed through a single library:
	    libtss2-sys.

	  * TPM Command Transmission Interface (TCTI) that is described
	    in the same specification. This API provides a standard
	    interface to transmit / receive TPM command / response
	    buffers. It is expected that any number of libraries
	    implementing the TCTI API will be implemented as a way to
	    abstract various platform specific IPC mechanisms. Currently
	    this repository provides two TCTI implementations:
	    libtss2-tcti-device and libtss2-tcti-mssim. The prior should
	    be used for direct access to the TPM through the Linux
	    kernel driver. The later implements the protocol exposed by
	    the Microsoft software TPM2 simulator.

	  https://github.com/tpm2-software/tpm2-tss

comment "tpm2-tss needs a toolchain w/ dynamic library"
	depends on BR2_STATIC_LIBS
```

## package/trace-cmd/Config.in
```kconfig
config BR2_PACKAGE_TRACE_CMD
	bool "trace-cmd"
	depends on BR2_LARGEFILE
	depends on BR2_TOOLCHAIN_HAS_THREADS
	depends on !BR2_avr32 # AVR32 does not have TLS support
	depends on BR2_USE_MMU # fork()
	depends on !BR2_PREFER_STATIC_LIB # dlopen()
	help
	  Command line reader for ftrace.

	  To use this profiling tool, you should enable ftrace in your kernel
	  configuration. This command collect traces on your target.
	  You can analyse these traces on the target or on the host via the gui
	  "kernel shark"

	  http://git.kernel.org/cgit/linux/kernel/git/rostedt/trace-cmd.git

comment "trace-cmd needs a toolchain w/ largefile, threads, dynamic library"
	depends on BR2_USE_MMU
	depends on !BR2_LARGEFILE || !BR2_TOOLCHAIN_HAS_THREADS \
		|| BR2_PREFER_STATIC_LIB
```

## package/traceroute/Config.in
```kconfig
config BR2_PACKAGE_TRACEROUTE
	bool "traceroute"
	help
	  A new modern implementation of the traceroute(8) utility for
	  Linux systems. It tracks the route packets taken from an IP
	  network on their way to a given host.

	  http://traceroute.sourceforge.net/
```

## package/transmission/Config.in
```kconfig
config BR2_PACKAGE_TRANSMISSION
	bool "transmission"
	depends on BR2_TOOLCHAIN_HAS_THREADS
	depends on BR2_USE_MMU # fork()
	select BR2_PACKAGE_ZLIB
	select BR2_PACKAGE_OPENSSL
	select BR2_PACKAGE_LIBCURL
	select BR2_PACKAGE_LIBEVENT
	help
	  Transmission is a cross-platform BitTorrent client.

	  http://www.transmissionbt.com/

if BR2_PACKAGE_TRANSMISSION

config BR2_PACKAGE_TRANSMISSION_UTP
	bool "Transmission uTP support"
	depends on BR2_INSTALL_LIBSTDCPP
	help
	  Install support for uTorrent Transport Protocol

comment "uTP needs a toolchain w/ C++"
	depends on !BR2_INSTALL_LIBSTDCPP

config BR2_PACKAGE_TRANSMISSION_CLI
	bool "transmission-cli"
	help
	  Install transmission command line interface.

config BR2_PACKAGE_TRANSMISSION_DAEMON
	bool "transmission-daemon"
	help
	  Install transmission daemon.

config BR2_PACKAGE_TRANSMISSION_REMOTE
	bool "transmission-remote"
	help
	  Install transmission remote management tool.

config BR2_PACKAGE_TRANSMISSION_GTK
	bool "transmission-gtk"
	depends on BR2_PACKAGE_LIBGTK3 && BR2_SYSTEM_ENABLE_NLS
	help
	  Install transmission GTK-based GUI interface.

comment "transmission-gtk needs NLS enabled"
	depends on BR2_PACKAGE_LIBGTK3 && !BR2_SYSTEM_ENABLE_NLS
endif

comment "transmission needs a toolchain w/ threads"
	depends on BR2_USE_MMU
	depends on !BR2_TOOLCHAIN_HAS_THREADS
```

## package/tree/Config.in
```kconfig
config BR2_PACKAGE_TREE
	bool "tree"
	depends on BR2_USE_WCHAR
	help
	  Tree is a recursive directory listing command that produces
	  a depth indented listing of files, which is colorized ala
	  dircolors if the LS_COLORS environment variable is set and
	  output is to tty.

	  http://mama.indstate.edu/users/ice/tree/

comment "tree needs a toolchain w/ wchar"
	depends on !BR2_USE_WCHAR
```
