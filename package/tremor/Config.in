## package/tremor/Config.in
```kconfig
config BR2_PACKAGE_TREMOR
	bool "tremor (fixed point vorbis decoder)"
	select BR2_PACKAGE_LIBOGG
	help
	  Tremor is a fixed point implementation of an Ogg Vorbis
	  decoder. It provides a decoding API similar to libvorbis,
	  but gives much better performance on systems without a
	  floating-point unit.
```

## package/triggerhappy/Config.in
```kconfig
config BR2_PACKAGE_TRIGGERHAPPY
	bool "triggerhappy"
	depends on BR2_USE_MMU # fork()
	help
	  Triggerhappy is a hotkey daemon developed with small and
	  embedded systems in mind, e.g. linux based routers. It
	  attaches to the input device files and interprets the event
	  data received and executes scripts configured in its
	  configuration.

	  https://github.com/wertarbyte/triggerhappy
```

## package/trinity/Config.in
```kconfig
config BR2_PACKAGE_TRINITY
	bool "trinity"
	depends on BR2_aarch64 || BR2_arm || BR2_armeb || BR2_i386 || \
		BR2_mips || BR2_mipsel || BR2_powerpc || BR2_powerpc64 || \
		BR2_powerpc64le || BR2_sparc || BR2_x86_64
	help
	  A Linux System call fuzz tester

	  http://codemonkey.org.uk/projects/trinity/
```

## package/trousers/Config.in
```kconfig
config BR2_PACKAGE_TROUSERS
	bool "trousers"
	depends on BR2_TOOLCHAIN_HAS_THREADS
	# doesn't build properly in static only configurations
	depends on !BR2_STATIC_LIBS
	# ARC toolchain issue
	depends on !BR2_arc
	select BR2_PACKAGE_OPENSSL
	select BR2_PACKAGE_LIBICONV if !BR2_ENABLE_LOCALE
	help
	  The open-source TCG Software Stack (TSS).

	  This library enables the use of a Trusted Platform Module
	  that complies with the TPM specification, version 1.2. It
	  implements the TSS specification, version 1.2.

	  http://trousers.sourceforge.net/

comment "trousers needs a toolchain w/ threads, dynamic library"
	depends on !BR2_TOOLCHAIN_HAS_THREADS || BR2_STATIC_LIBS
	depends on !BR2_arc
```

## package/tslib/Config.in
```kconfig
config BR2_PACKAGE_TSLIB
	bool "tslib"
	help
	  Tslib is a filtering layer for touchscreen panel events.

	  http://tslib.org
```

## package/tstools/Config.in
```kconfig
config BR2_PACKAGE_TSTOOLS
	bool "tstools"
	depends on BR2_USE_MMU # fork()
	help
	  This is a set of cross-platform command line tools for
	  working with MPEG data

	  The emphasis is on relatively simple tools which concentrate
	  on MPEG (H.264 and H.262) data packaged according to H.222
	  (i.e., TS or PS), with a particular interest in checking for
	  conformance.

	  Transport Stream (TS) is typically used for distribution of
	  cable and satellite data. Program Stream (PS) is typically
	  used to store data on DVDs.

	  https://code.google.com/p/tstools/
```

## package/ttcp/Config.in
```kconfig
config BR2_PACKAGE_TTCP
	bool "ttcp"
	depends on BR2_DEPRECATED_SINCE_2012_05
	help
	  Benchmarking tool for determining TCP and UDP performance.

	  ftp://ftp.sgi.com/sgi/src/ttcp/README
```

## package/turbolua/Config.in
```kconfig
config BR2_PACKAGE_TURBOLUA
	bool "turbolua"
	depends on BR2_PACKAGE_LUAJIT
	help
	  Turbo.lua is a framework built for LuaJIT 2 to simplify the
	  task of building fast and scalable network applications. It
	  uses a event-driven, non-blocking, no thread design to deliver
	  excellent performance and minimal footprint to high-load
	  applications while also providing excellent support for
	  embedded uses. The toolkit can be used for HTTP REST API's,
	  traditional dynamic web pages through templating, open
	  connections like WebSockets, or just as high level building
	  blocks for native speed network applications.

	  http://www.turbolua.org

comment "turbolua needs LuaJIT"
	depends on !BR2_PACKAGE_LUAJIT
```

## package/tvheadend/Config.in
```kconfig
comment "tvheadend needs a toolchain w/ NPTL, headers >= 3.2, dynamic library"
	depends on !BR2_microblazeel
	depends on !BR2_TOOLCHAIN_HAS_THREADS_NPTL || \
		!BR2_TOOLCHAIN_HEADERS_AT_LEAST_3_2 || BR2_STATIC_LIBS
	depends on BR2_TOOLCHAIN_HAS_SYNC_4

config BR2_PACKAGE_TVHEADEND
	bool "tvheadend"
	depends on !BR2_microblazeel # assertion failure in binutils
	depends on !BR2_STATIC_LIBS # dladdr()
	depends on BR2_TOOLCHAIN_HAS_THREADS_NPTL
	depends on BR2_TOOLCHAIN_HEADERS_AT_LEAST_3_2
	depends on BR2_TOOLCHAIN_HAS_SYNC_4
	select BR2_PACKAGE_DTV_SCAN_TABLES
	select BR2_PACKAGE_LIBICONV if !BR2_ENABLE_LOCALE
	select BR2_PACKAGE_OPENSSL
	help

	  Tvheadend is a TV streaming server for Linux supporting
	  DVB-S, DVB-S2, DVB-C, DVB-T, ATSC, IPTV, and Analog video
	  (V4L) as input sources.

	  https://www.lonelycoder.com/redmine/projects/tvheadend/

	  Note:
	    - on first run, tvheadend will start in wizard mode; the
	      webUI is available on port 9981.
	    - if you want Avahi support, you'll need to enable:
	          Avahi, D-Bus, libdaemon

if BR2_PACKAGE_TVHEADEND

config BR2_PACKAGE_TVHEADEND_TRANSCODING
	bool "transcoding support"
	depends on BR2_PACKAGE_FFMPEG_ARCH_SUPPORTS
	select BR2_PACKAGE_FFMPEG
	select BR2_PACKAGE_FFMPEG_AVRESAMPLE
	select BR2_PACKAGE_FFMPEG_GPL # needed for x264 support
	select BR2_PACKAGE_FFMPEG_SWSCALE
	select BR2_PACKAGE_LIBVPX
	select BR2_PACKAGE_X264
	help
	  Enable transcoding support.

endif
```

## package/twolame/Config.in
```kconfig
config BR2_PACKAGE_TWOLAME
	bool "twolame"
	help
	  TwoLAME is an optimised MPEG Audio Layer 2 (MP2) encoder
	  based on tooLAME by Mike Cheng, which in turn is based upon
	  the ISO dist10 code and portions of LAME.

	  http://www.twolame.org/
```

## package/tzdata/Config.in
```kconfig
# This package is not meant to be user-visible.
# It gets selected by BR2_TARGET_TZ in system/Config.in

config BR2_PACKAGE_TZDATA
	bool
	help
	  Time zone database

	  http://www.iana.org/time-zones/repository/tz-link.html
```

## package/uacme/Config.in
```kconfig
config BR2_PACKAGE_UACME
	bool "uacme"
	depends on BR2_USE_MMU # fork()
	select BR2_PACKAGE_OPENSSL if !(BR2_PACKAGE_GNUTLS || BR2_PACKAGE_MBEDTLS)
	select BR2_PACKAGE_LIBCURL
	help
	  uacme is a client for the ACMEv2 protocol described in
	  RFC8555, written in plain C with minimal dependencies
	  (libcurl and either of GnuTLS, OpenSSL or mbedTLS). The
	  ACMEv2 protocol allows a Certificate Authority
	  (https://letsencrypt.org is a popular one) and an applicant
	  to automate the process of verification and certificate
	  issuance.

	  https://github.com/ndilieto/uacme

if BR2_PACKAGE_UACME

config BR2_PACKAGE_UACME_UALPN
	bool "enable ualpn"
	depends on BR2_TOOLCHAIN_HAS_THREADS
	depends on BR2_PACKAGE_OPENSSL || BR2_PACKAGE_GNUTLS
	select BR2_PACKAGE_LIBEV
	help
	  Build and install ualpn, the transparent proxying tls-alpn-01
	  challenge responder.

comment "ualpn needs a toolchain w/ threads"
	depends on !BR2_TOOLCHAIN_HAS_THREADS

comment "ualpn needs either OpenSSL or GnuTLS"
	depends on !(BR2_PACKAGE_OPENSSL || BR2_PACKAGE_GNUTLS)

endif
```

## package/uboot-mkimage/Config.in
```kconfig
config BR2_PACKAGE_UBOOT_MKIMAGE
	bool "uboot-mkimage"
	help
	  The mkimage tool from Das U-Boot bootloader, which allows
	  generation of U-Boot images in various formats.

	  http://www.denx.de/wiki/U-Boot/WebHome
```

## package/uboot-tools/Config.in
```kconfig
config BR2_PACKAGE_UBOOT_TOOLS
	bool "u-boot tools"
	help
	  Companion tools for Das U-Boot bootloader.

	  http://www.denx.de/wiki/U-Boot/WebHome

if BR2_PACKAGE_UBOOT_TOOLS

config BR2_PACKAGE_UBOOT_TOOLS_FIT_SUPPORT
	bool "Flattened Image Tree (FIT) support"
	depends on !BR2_STATIC_LIBS
	select BR2_PACKAGE_DTC
	select BR2_PACKAGE_DTC_PROGRAMS
	help
	  Enables support for Flattened Image Tree (FIT).

	  This option allows to boot the new uImage structure,
	  Flattened Image Tree. FIT is formally a FDT, which can include
	  images of various types (kernel, FDT blob, ramdisk, etc.)
	  in a single blob. To boot this new uImage structure,
	  pass the address of the blob to the "bootm" command.

comment "u-boot tools FIT support needs a toolchain w/ dynamic library"
	depends on BR2_STATIC_LIBS

if BR2_PACKAGE_UBOOT_TOOLS_FIT_SUPPORT

config BR2_PACKAGE_UBOOT_TOOLS_FIT_SIGNATURE_SUPPORT
	bool "FIT signature verification support"
	select BR2_PACKAGE_OPENSSL
	help
	  Enables support for FIT Signature Verification.

	  Flat Image Trees (FIT) supports hashing of images so that
	  these hashes can be checked on loading. This protects
	  against corruption of the image. However it does not prevent
	  the substitution of one image for another.

	  The signature feature allows the hash to be signed with a
	  private key such that it can be verified using a public key
	  later. Provided that the private key is kept secret and the
	  public key is stored in a non-volatile place, any image can
	  be verified in this way.

	  Enabling this option pulls in a dependency on libssl and
	  libcrypto, and possibly GPL/OpenSSL licensing
	  incompatibility issues.

config BR2_PACKAGE_UBOOT_TOOLS_FIT_CHECK_SIGN
	bool "fit_check_sign"
	depends on BR2_PACKAGE_UBOOT_TOOLS_FIT_SIGNATURE_SUPPORT
	help
	  Install the fit_check_sign tool on the target system

	  The fit_check_sign tool from Das U-Boot bootloader, which
	  allows FIT image signature validation on target system.

endif

config BR2_PACKAGE_UBOOT_TOOLS_MKIMAGE
	bool "mkimage"
	help
	  Install the mkimage tool on the target system

	  The mkimage tool from Das U-Boot bootloader, which allows
	  generation of U-Boot images in various formats.

config BR2_PACKAGE_UBOOT_TOOLS_MKENVIMAGE
	bool "mkenvimage"
	help
	  Install the mkenvimage tool on the target system

	  The mkenvimage tool from Das U-Boot bootloader, which allows
	  generation of a valid binary environment image from a text
	  file describing the key=value pairs of the environment.

config BR2_PACKAGE_UBOOT_TOOLS_FWPRINTENV
	bool "fw_printenv"
	default y
	help
	  Install the fw_printenv / fw_setenv tools on the target system

	  The fw_printenv and fw_setenv tools from Das U-Boot
	  bootloader, which allows access to the U-Boot environment
	  from Linux.

config BR2_PACKAGE_UBOOT_TOOLS_DUMPIMAGE
	bool "dumpimage"
	help
	  Install the dumpimage tool on the target system

	  The dumpimage tool from Das U-Boot bootloader, which allows
	  extraction of data from U-Boot images.

endif
```

## package/uboot-tools/Config.in.host
```kconfig
config BR2_PACKAGE_HOST_UBOOT_TOOLS
	bool "host u-boot tools"
	help
	  Companion tools for Das U-Boot bootloader.

	  http://www.denx.de/wiki/U-Boot/WebHome

if BR2_PACKAGE_HOST_UBOOT_TOOLS

config BR2_PACKAGE_HOST_UBOOT_TOOLS_FIT_SUPPORT
	bool "Flattened Image Tree (FIT) support"
	select BR2_PACKAGE_HOST_DTC
	help
	  Enables support for Flattened Image Tree (FIT).

	  This option allows to boot the new uImage structure,
	  Flattened Image Tree. FIT is formally a FDT, which can include
	  images of various types (kernel, FDT blob, ramdisk, etc.)
	  in a single blob. To boot this new uImage structure,
	  pass the address of the blob to the "bootm" command.

if BR2_PACKAGE_HOST_UBOOT_TOOLS_FIT_SUPPORT

config BR2_PACKAGE_HOST_UBOOT_TOOLS_FIT_SIGNATURE_SUPPORT
	bool "FIT signature verification support"
	help
	  Enables support for FIT Signature Verification.

	  Flat Image Trees (FIT) supports hashing of images so that
	  these hashes can be checked on loading. This protects
	  against corruption of the image. However it does not prevent
	  the substitution of one image for another.

	  The signature feature allows the hash to be signed with a
	  private key such that it can be verified using a public key
	  later. Provided that the private key is kept secret and the
	  public key is stored in a non-volatile place, any image can
	  be verified in this way.

endif

endif
```

## package/ubus/Config.in
```kconfig
comment "ubus needs a toolchain w/ dynamic library"
	depends on BR2_TOOLCHAIN_HAS_SYNC_4
	depends on BR2_STATIC_LIBS

config BR2_PACKAGE_UBUS
	bool "ubus"
	depends on BR2_TOOLCHAIN_HAS_SYNC_4 # json-c
	depends on !BR2_STATIC_LIBS # libubox
	select BR2_PACKAGE_LIBUBOX
	select BR2_PACKAGE_JSON_C
	help
	  IPC/RPC bus that allows communication between processes.

	  It consists of few parts including a daemon (ubusd), a library
	  (libubus) and a command line interface (ubus). Although created
	  for the OpenWRT project, it can be used as a general IPC/RPC
	  mechanism in other projects.

	  * Select BR2_PACKAGE_LUA_5_1 if you want to have Lua support.

	  https://wiki.openwrt.org/doc/techref/ubus

if BR2_PACKAGE_UBUS

config BR2_PACKAGE_UBUS_EXAMPLES
	bool "build and install ubus examples"
	help
	  Build and install client and server ubus examples.

endif
```

## package/uccp420wlan/Config.in
```kconfig
config BR2_PACKAGE_UCCP420WLAN
	bool "uccp420wlan"
	depends on BR2_LINUX_KERNEL
	help
	  SoftMAC (mac80211) based WiFi driver for Imagination's
	  Explorer RPU uccp420. This supports Dual Band WiFi with
	  2.4GHz - 2x2 b/g/n 40MHz, 5GHz - 2x2 a/n/11ac 80MHz modes

	  Used in creator ci40 board.

	  This module needs a Linux kernel >= v4.2.

	  https://github.com/CreatorDev/uccp420wlan

comment "uccp420wlan needs a Linux kernel >= 4.2 to be built"
	depends on !BR2_LINUX_KERNEL
```
