## package/udpxy/Config.in
```kconfig
config BR2_PACKAGE_UDPXY
	bool "udpxy"
	depends on BR2_USE_MMU
	help
	  udpxy is a UDP-to-HTTP multicast traffic relay daemon: it
	  forwards UDP traffic from a given multicast subscription to
	  the requesting HTTP client.

	  http://www.udpxy.com/
```

## package/uemacs/Config.in
```kconfig
config BR2_PACKAGE_UEMACS
	bool "uemacs"
	select BR2_PACKAGE_NCURSES
	help
	  A small emacs.

	  https://git.kernel.org/cgit/editors/uemacs/uemacs.git/
```

## package/uftp/Config.in
```kconfig
config BR2_PACKAGE_UFTP
	bool "uftp"
	depends on BR2_USE_MMU # fork()
	depends on BR2_TOOLCHAIN_HAS_THREADS
	depends on BR2_USE_WCHAR
	help
	  Encrypted UDP based FTP with multicast.

	  http://uftp-multicast.sourceforge.net/

comment "uftp needs a toolchain w/ threads, wchar"
	depends on BR2_USE_MMU
	depends on !BR2_TOOLCHAIN_HAS_THREADS || !BR2_USE_WCHAR
```

## package/uhttpd/Config.in
```kconfig
config BR2_PACKAGE_UHTTPD
	bool "uhttpd"
	depends on !BR2_STATIC_LIBS # dlopen()
	depends on BR2_TOOLCHAIN_HAS_SYNC_4 # json-c
	depends on BR2_USE_MMU # fork()
	select BR2_PACKAGE_LIBUBOX
	select BR2_PACKAGE_JSON_C
	help
	  uHTTPd is a tiny single threaded HTTP server with TLS, CGI
	  and Lua support. It is intended as a drop-in replacement for
	  the Busybox HTTP daemon.

	  https://wiki.openwrt.org/doc/howto/http.uhttpd

comment "uhttpd needs a toolchain w/ dynamic library"
	depends on BR2_TOOLCHAIN_HAS_SYNC_4
	depends on BR2_USE_MMU
	depends on BR2_STATIC_LIBS
```

## package/uhubctl/Config.in
```kconfig
config BR2_PACKAGE_UHUBCTL
	bool "uhubctl"
	depends on BR2_TOOLCHAIN_HAS_THREADS # libusb
	select BR2_PACKAGE_LIBUSB
	help
	  Control USB power per-port on smart USB hubs.

	  https://github.com/mvp/uhubctl

comment "uhubctl needs a toolchain w/ threads"
	depends on !BR2_TOOLCHAIN_HAS_THREADS
```

## package/ulogd/Config.in
```kconfig
config BR2_PACKAGE_ULOGD
	bool "ulogd"
	depends on !BR2_STATIC_LIBS
	depends on BR2_USE_MMU
	select BR2_PACKAGE_LIBMNL
	select BR2_PACKAGE_LIBNETFILTER_ACCT
	select BR2_PACKAGE_LIBNETFILTER_CONNTRACK
	select BR2_PACKAGE_LIBNETFILTER_LOG
	select BR2_PACKAGE_LIBNFNETLINK
	help
	  ulogd is a userspace logging daemon for netfilter/iptables related logging.

	  http://www.netfilter.org/projects/ulogd/

comment "ulogd needs a toolchain w/ dynamic library"
	depends on BR2_STATIC_LIBS
	depends on BR2_USE_MMU
```

## package/umtprd/Config.in
```kconfig
config BR2_PACKAGE_UMTPRD
	bool "umtprd"
	depends on BR2_TOOLCHAIN_HAS_THREADS
	depends on BR2_TOOLCHAIN_HEADERS_AT_LEAST_3_15
	help
	  Lightweight USB MTP responder daemon for GNU/Linux

	  https://github.com/viveris/uMTP-Responder

comment "umtprd needs a toolchain w/ threads, headers >= 3.15"
	depends on !BR2_TOOLCHAIN_HAS_THREADS || !BR2_TOOLCHAIN_HEADERS_AT_LEAST_3_15
```

## package/unbound/Config.in
```kconfig
config BR2_PACKAGE_UNBOUND
	bool "unbound"
	depends on !BR2_STATIC_LIBS
	select BR2_PACKAGE_EXPAT
	select BR2_PACKAGE_LIBEVENT
	select BR2_PACKAGE_OPENSSL
	help
	  Unbound is a validating, recursive, and caching DNS resolver.
	  It supports DNSSEC, QNAME minimisation, DNS-over-TLS and
	  DNSCrypt.

	  https://www.unbound.net

if BR2_PACKAGE_UNBOUND
config BR2_PACKAGE_UNBOUND_DNSCRYPT
	bool "enable DNSCrypt"
	select BR2_PACKAGE_LIBSODIUM
	help
	  DNSCrypt wraps unmodified DNS queries between a client and
	  a DNS resolver. Default port used is 443 and like with
	  normal unencrypted DNS, it uses UDP first and falling back
	  to TCP if response too large.

	  There is also DNS-over-TLS, a TCP only version
	  of proposed standard for DNS encryption (RFC 7858).
	  Default port for DNS-over-TLS is 853 and Unbound has
	  built-in support for it.

	  https://tools.ietf.org/html/rfc7858

	  Note: Neither DNSCrypt or DNS-over-TLS encrypt the SNI.
	  Here is some suggestions how to handle SNI encryption:

	  https://tools.ietf.org/html/draft-ietf-tls-sni-encryption-00
endif

comment "unbound needs a toolchain w/ dynamic library"
	depends on BR2_STATIC_LIBS
```

## package/unionfs/Config.in
```kconfig
config BR2_PACKAGE_UNIONFS
	bool "unionfs (FUSE)"
	depends on BR2_TOOLCHAIN_HAS_THREADS # libfuse
	depends on BR2_USE_MMU # libfuse
	depends on !BR2_STATIC_LIBS # libfuse
	select BR2_PACKAGE_LIBFUSE
	help
	  A userspace unionfs implementation.

	  https://github.com/rpodgorny/unionfs-fuse

comment "unionfs needs a toolchain w/ threads, dynamic library"
	depends on BR2_USE_MMU
	depends on !BR2_TOOLCHAIN_HAS_THREADS || BR2_STATIC_LIBS
```

## package/unixodbc/Config.in
```kconfig
config BR2_PACKAGE_UNIXODBC
	bool "unixodbc"
	depends on !BR2_STATIC_LIBS # dlopen()
	help
	  The unixODBC Project goals are to develop and promote
	  unixODBC to be the definitive standard for ODBC on non MS
	  Windows platforms.

	  http://www.unixodbc.org

comment "unixodbc needs a toolchain w/ dynamic library"
	depends on BR2_STATIC_LIBS
```

## package/unrar/Config.in
```kconfig
config BR2_PACKAGE_UNRAR
	bool "unrar"
	depends on BR2_INSTALL_LIBSTDCPP
	depends on BR2_TOOLCHAIN_HAS_THREADS
	depends on BR2_USE_WCHAR
	help
	  RAR file uncompressor.

	  http://www.rarlab.com/rar_add.htm

comment "unrar needs a toolchain w/ C++, wchar, threads"
	depends on !BR2_USE_WCHAR || !BR2_INSTALL_LIBSTDCPP \
		|| !BR2_TOOLCHAIN_HAS_THREADS
```

## package/unscd/Config.in
```kconfig
config BR2_PACKAGE_UNSCD
	bool "unscd"
	depends on BR2_TOOLCHAIN_USES_GLIBC
	help
	  Micro Name Service Caching Daemon

	  A daemon which handles passwd, group and host lookups for
	  running programs and caches the results for the next query.
	  You only need this package if you are using slow Name Services
	  like LDAP, NIS or NIS+.

	  This particular NSCD is a complete rewrite of the GNU glibc
	  nscd which is a single threaded server process which offloads
	  all NSS lookups to worker children; cache hits are handled by
	  the parent, and only cache misses start worker children,
	  making the parent immune to resource leaks, hangs, and crashes
	  in NSS libraries.

	  It should mostly be a drop-in replacement for existing
	  installs using nscd.

	  http://busybox.net/~vda/unscd

comment "unscd needs an (e)glibc toolchain"
	depends on !BR2_TOOLCHAIN_USES_GLIBC
```

## package/unzip/Config.in
```kconfig
config BR2_PACKAGE_UNZIP
	bool "unzip"
	help
	  UnZip is an extraction utility for archives compressed in
	  .zip format (also called "zipfiles"). Although highly
	  compatible both with PKWARE's PKZIP and PKUNZIP utilities
	  for MS-DOS and with Info-ZIP's own Zip program, our primary
	  objectives have been portability and non-MSDOS
	  functionality.

	  http://www.info-zip.org/UnZip.html
```

## package/upmpdcli/Config.in
```kconfig
config BR2_PACKAGE_UPMPDCLI
	bool "upmpdcli"
	depends on BR2_USE_MMU # fork()
	depends on BR2_INSTALL_LIBSTDCPP
	depends on BR2_TOOLCHAIN_HAS_THREADS # libupnpp, libmicrohttpd
	depends on BR2_TOOLCHAIN_GCC_AT_LEAST_4_9 # C++11, libupnpp
	select BR2_PACKAGE_JSONCPP
	select BR2_PACKAGE_LIBMICROHTTPD
	select BR2_PACKAGE_LIBMPDCLIENT
	select BR2_PACKAGE_LIBUPNPP
	help
	  upmpdcli is a UPnP Media Renderer front-end for MPD, the Music
	  Player Daemon. It supports UPnP gapless track transitions and
	  the OpenHome ohMedia services.

	  http://www.lesbonscomptes.com/upmpdcli/

comment "upmpdcli needs a toolchain w/ C++, threads, gcc >= 4.9"
	depends on BR2_USE_MMU
	depends on !BR2_INSTALL_LIBSTDCPP || !BR2_TOOLCHAIN_HAS_THREADS || !BR2_TOOLCHAIN_GCC_AT_LEAST_4_9
```

## package/upower/Config.in
```kconfig
config BR2_PACKAGE_UPOWER
	bool "upower"
	depends on BR2_PACKAGE_HAS_UDEV
	depends on BR2_TOOLCHAIN_HAS_THREADS # libgudev, libusb
	depends on BR2_USE_MMU # libgudev
	depends on BR2_USE_WCHAR # libgudev
	select BR2_PACKAGE_LIBGUDEV
	select BR2_PACKAGE_LIBUSB
	help
	  UPower is an abstraction for enumerating power devices,
	  listening to device events and querying history and
	  statistics. Any application or service on the system can
	  access the org.freedesktop.UPower service via the system
	  message bus.

	  Note: upowerd require CONFIG_TIMER_STATS enabled in the
	  Linux kernel.

	  https://upower.freedesktop.org/

comment "upower needs udev /dev management"
	depends on BR2_USE_MMU
	depends on !BR2_PACKAGE_HAS_UDEV

comment "upower needs a toolchain w/ threads, wchar"
	depends on BR2_USE_MMU
	depends on !BR2_USE_WCHAR || !BR2_TOOLCHAIN_HAS_THREADS
```

## package/urg/Config.in
```kconfig
config BR2_PACKAGE_URG
	bool "urg"
	depends on BR2_INSTALL_LIBSTDCPP
	help
	  Library to control Hokuyo's URG series sensors.

	  https://sourceforge.net/p/urgnetwork/wiki/Home/

comment "urg needs a toolchain w/ C++"
	depends on !BR2_INSTALL_LIBSTDCPP
```

## package/usb_modeswitch/Config.in
```kconfig
config BR2_PACKAGE_USB_MODESWITCH
	bool "usb_modeswitch"
	depends on BR2_TOOLCHAIN_HAS_THREADS # libusb
	select BR2_PACKAGE_LIBUSB
	help
	  Some USB devices such as 3G/4G broadband modems power-up
	  in mass storage mode to provide access to drivers
	  for the device's application mode. usb_modeswitch
	  changes the mode of such devices from the initial power-up
	  mode to the application mode.
	  Specific configuration data for each device model is required.

	  usb_modeswitch can be used with the usb_modeswitch_data
	  package and eudev/systemd for automatic mode switching
	  when devices are connected.

	  For more information search the Internet for "Virtual CD-ROM
	  switching utility".

	  http://www.draisberghof.de/usb_modeswitch/

comment "usb_modeswitch needs a toolchain w/ threads"
	depends on !BR2_TOOLCHAIN_HAS_THREADS
```

## package/usb_modeswitch_data/Config.in
```kconfig
config BR2_PACKAGE_USB_MODESWITCH_DATA
	bool "usb_modeswitch_data"
	depends on BR2_TOOLCHAIN_HAS_THREADS # usb_modeswitch -> libusb
	select BR2_PACKAGE_USB_MODESWITCH
	help
	  USB mode switch data
	  Contains udev rules and events to allow usb_modeswitch to
	  function automatically

	  http://www.draisberghof.de/usb_modeswitch/

comment "usb_modeswitch_data needs a toolchain w/ threads"
	depends on !BR2_TOOLCHAIN_HAS_THREADS
```

## package/usbmount/Config.in
```kconfig
config BR2_PACKAGE_USBMOUNT
	bool "usbmount"
	depends on BR2_LARGEFILE # util-linux
	depends on BR2_USE_WCHAR # util-linux
	depends on BR2_PACKAGE_UDEV
	select BR2_PACKAGE_LOCKFILE_PROGS
	select BR2_PACKAGE_UTIL_LINUX
	select BR2_PACKAGE_UTIL_LINUX_LIBBLKID
	help
	  The usbmount package automatically mounts USB mass storage devices
	  when they are plugged in, and unmounts them when they are removed.

	  http://usbmount.alioth.debian.org/

comment "usbmount requires a toolchain with LARGEFILE + WCHAR support"
	depends on !(BR2_LARGEFILE && BR2_USE_WCHAR) && BR2_PACKAGE_UDEV
```

## package/usbredir/Config.in
```kconfig
comment "usbredir needs a toolchain w/ threads"
	depends on !BR2_TOOLCHAIN_HAS_THREADS

config BR2_PACKAGE_USBREDIR
	bool "usbredir"
	depends on BR2_TOOLCHAIN_HAS_THREADS # libusb
	select BR2_PACKAGE_LIBUSB
	help
	  usbredir is the name of a network protocol for sending usb device
	  traffic over a network connection. It is also the name of the
	  software package offering a parsing library, a usbredirhost library
	  and several utilities implementing this protocol.

	  Note: only the library is installed, not the utilities. Say 'y'
	  below if you want the server too.

	  http://www.spice-space.org/page/UsbRedir

if BR2_PACKAGE_USBREDIR

config BR2_PACKAGE_USBREDIR_SERVER
	bool "usbredirserver on target"
	help
	  If you want to serve usbredir requests on your target, say 'y'
	  here to have the usbredir server on the target.

	  Note: the server is not required to use the library.

endif
```

## package/usbutils/Config.in
```kconfig
config BR2_PACKAGE_USBUTILS
	bool "usbutils"
	depends on BR2_TOOLCHAIN_HAS_THREADS # libusb
	depends on BR2_PACKAGE_HAS_UDEV # needs hwdb
	select BR2_PACKAGE_LIBUSB
	help
	  USB enumeration utilities

	  http://linux-usb.sourceforge.net/

comment "usbutils needs udev /dev management and toolchain w/ threads"
	depends on !BR2_TOOLCHAIN_HAS_THREADS || !BR2_PACKAGE_HAS_UDEV
```

## package/ushare/Config.in
```kconfig
config BR2_PACKAGE_USHARE
	bool "ushare"
	depends on BR2_TOOLCHAIN_HAS_THREADS # libupnp
	# ushare has a completely custom configure script that does
	# broken things with library ordering, which breaks static
	# linking.
	depends on !BR2_STATIC_LIBS
	select BR2_PACKAGE_LIBUPNP
	help
	  uShare is a UPnP (TM) A/V & DLNA Media Server.
	  It implements the server component that provides UPnP media
	  devices with information on available multimedia files.

	  http://ushare.geexbox.org/

comment "ushare needs a toolchain w/ threads, dynamic library"
	depends on !BR2_TOOLCHAIN_HAS_THREADS || BR2_STATIC_LIBS
```

## package/ussp-push/Config.in
```kconfig
config BR2_PACKAGE_USSP_PUSH
	bool "ussp-push"
	depends on !BR2_STATIC_LIBS # bluez5_utils
	depends on BR2_USE_WCHAR # libglib2
	depends on BR2_TOOLCHAIN_HAS_THREADS # dbus, alsa-lib, libglib2
	depends on BR2_USE_MMU # dbus
	depends on BR2_TOOLCHAIN_HAS_SYNC_4 # bluez5_utils
	depends on BR2_TOOLCHAIN_HEADERS_AT_LEAST_3_4 # bluez5_utils
	select BR2_PACKAGE_OPENOBEX
	select BR2_PACKAGE_BLUEZ5_UTILS
	help
	  ussp-push is an OBEX object pusher for Linux, using the BlueZ
	  BlueTooth stack.

	  http://www.xmailserver.org/ussp-push.html

comment "ussp-push needs a toolchain w/ wchar, threads, dynamic library, headers >= 3.4"
	depends on BR2_USE_MMU
	depends on BR2_TOOLCHAIN_HAS_SYNC_4
	depends on !BR2_USE_WCHAR || !BR2_TOOLCHAIN_HAS_THREADS || \
		BR2_STATIC_LIBS || !BR2_TOOLCHAIN_HEADERS_AT_LEAST_3_4
```

## package/ustr/Config.in
```kconfig
config BR2_PACKAGE_USTR
	bool "ustr"
	# unconditionally builds a shared library
	depends on !BR2_STATIC_LIBS
	help
	  A small, safe string library.

	  http://www.and.org/ustr/

comment "ustr needs a toolchain w/ dynamic library"
	depends on BR2_STATIC_LIBS
```

## package/utf8proc/Config.in
```kconfig
config BR2_PACKAGE_UTF8PROC
	bool "utf8proc"
	help
	  A clean C library for processing UTF-8 Unicode data.

	  https://juliastrings.github.io/utf8proc
```
