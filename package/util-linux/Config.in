## package/valijson/Config.in
```kconfig
config BR2_PACKAGE_VALIJSON
	bool "valijson"
	depends on BR2_USE_WCHAR
	depends on BR2_INSTALL_LIBSTDCPP
	depends on BR2_TOOLCHAIN_HAS_THREADS
	depends on BR2_PACKAGE_BOOST_ARCH_SUPPORTS
	select BR2_PACKAGE_BOOST
	select BR2_PACKAGE_BOOST_REGEX
	help
	 Valijson is a header-only JSON Schema Validation library for
	 C++. Valijson provides a simple validation API that allows
	 you load JSON Schemas, and validate documents loaded by one
	 of several supported parser libraries like boost, jsoncpp,
	 rapidjson and picoJSON.

	 https://github.com/tristanpenman/valijson

comment "valijson needs a toolchain w/ C++, threads, wchar  support"
	depends on BR2_PACKAGE_BOOST_ARCH_SUPPORTS
	depends on !BR2_INSTALL_LIBSTDCPP  || !BR2_TOOLCHAIN_HAS_THREADS || !BR2_USE_WCHAR
```

## package/vboot-utils/Config.in.host
```kconfig
config BR2_PACKAGE_HOST_VBOOT_UTILS
	bool "host vboot utils"
	select BR2_PACKAGE_HOST_UTIL_LINUX
	help
	  Chromium OS verified boot utilities: futility and cgpt.

	  https://www.chromium.org/chromium-os/chromiumos-design-docs/verified-boot
```

## package/vde2/Config.in
```kconfig
config BR2_PACKAGE_VDE2
	bool "vde2"
	depends on BR2_USE_MMU # fork()
	depends on !BR2_PREFER_STATIC_LIB # dlopen()
	help
	  VDE is an ethernet compliant virtual network that can be
	  spawned over a set of physical computers over the Internet.
	  VDE is part of the virtualsquare project.

	  http://vde.sourceforge.net/

comment "vde2 needs a toolchain w/ dynamic library"
	depends on BR2_USE_MMU
	depends on BR2_PREFER_STATIC_LIB
```

## package/vdr-plugin-vnsiserver/Config.in
```kconfig
config BR2_PACKAGE_VDR_PLUGIN_VNSISERVER
	bool "vdr-plugin-vnsiserver"
	depends on BR2_PACKAGE_VDR
	help
	  VDR plugin to handle KODI clients.
	  The vdr-plugin-vnsiserver is able to handle serveral KODI
	  clients connecting via the VNSI addon.

	  https://github.com/FernetMenta/vdr-plugin-vnsiserver
```

## package/vdr/Config.in
```kconfig
config BR2_PACKAGE_VDR
	bool "vdr"
	depends on BR2_INSTALL_LIBSTDCPP
	depends on !BR2_STATIC_LIBS
	depends on BR2_TOOLCHAIN_HAS_THREADS_NPTL
	depends on !BR2_TOOLCHAIN_USES_MUSL # _nl_msg_cat_cntr
	depends on BR2_USE_MMU # fork()
	depends on BR2_USE_WCHAR
	select BR2_PACKAGE_GETTEXT if BR2_NEEDS_GETTEXT
	select BR2_PACKAGE_FONTCONFIG
	select BR2_PACKAGE_FREETYPE
	select BR2_PACKAGE_JPEG
	select BR2_PACKAGE_LIBCAP
	select BR2_PACKAGE_LIBICONV if !BR2_ENABLE_LOCALE
	help
	  This project describes how to build your own digital
	  satellite receiver and Video Disk Recorder.

	  http://www.tvdr.de

comment "vdr needs a glibc or uClibc toolchain w/ C++, dynamic library, NPTL, wchar"
	depends on BR2_USE_MMU
	depends on !BR2_INSTALL_LIBSTDCPP || BR2_STATIC_LIBS || \
		!BR2_TOOLCHAIN_HAS_THREADS_NPTL || \
		BR2_TOOLCHAIN_USES_MUSL || !BR2_USE_WCHAR
```

## package/vice/Config.in
```kconfig
config BR2_PACKAGE_VICE
	bool "vice"
	default n
	help
	  VICE is a Commodore emulator

	  http://www.viceteam.org/online
```

## package/vim/Config.in
```kconfig
config BR2_PACKAGE_VIM
	bool "vim"
	depends on BR2_USE_MMU # uses fork()
	depends on BR2_USE_WCHAR
	depends on BR2_PACKAGE_BUSYBOX_SHOW_OTHERS
	select BR2_PACKAGE_NCURSES
	help
	  VIM Text editor

	  http://www.vim.org/

if BR2_PACKAGE_VIM

config BR2_PACKAGE_VIM_RUNTIME
	bool "install runtime"
	default y
	help
	  Install VIM runtime (syntax highlighing + macros).
	  This option adds about 11MB of data to /usr/share/

endif

comment "vim needs a toolchain w/ wchar"
	depends on !BR2_USE_WCHAR
	depends on BR2_USE_MMU
	depends on BR2_PACKAGE_BUSYBOX_SHOW_OTHERS
```

## package/vlc/Config.in
```kconfig
config BR2_PACKAGE_VLC
	bool "vlc"
	depends on BR2_USE_MMU # fork()
	depends on BR2_INSTALL_LIBSTDCPP
	depends on !BR2_STATIC_LIBS
	depends on BR2_USE_WCHAR
	depends on BR2_TOOLCHAIN_GCC_AT_LEAST_4_9 # C++11
	depends on BR2_TOOLCHAIN_HAS_THREADS
	depends on BR2_TOOLCHAIN_HEADERS_AT_LEAST_3_7
	select BR2_PACKAGE_LIBVORBIS if BR2_PACKAGE_OPUS
	select BR2_PACKAGE_VLC_OPENCV_BACKEND if BR2_PACKAGE_OPENCV
	select BR2_PACKAGE_VLC_OPENCV3_BACKEND if BR2_PACKAGE_OPENCV3
	select BR2_PACKAGE_ZLIB if BR2_PACKAGE_TAGLIB
	help
	  VLC is a free and open source cross-platform multimedia player
	  and framework that plays most multimedia files as well as DVD,
	  Audio CD, VCD, and various streaming protocols.

	  http://www.videolan.org/vlc/

config BR2_PACKAGE_VLC_OPENCV_BACKEND
	bool
	select BR2_PACKAGE_OPENCV_LIB_IMGPROC
	select BR2_PACKAGE_OPENCV_LIB_OBJDETECT

config BR2_PACKAGE_VLC_OPENCV3_BACKEND
	bool
	select BR2_PACKAGE_OPENCV3_LIB_IMGPROC
	select BR2_PACKAGE_OPENCV3_LIB_OBJDETECT

comment "vlc needs a toolchain w/ C++, dynamic library, wchar, threads, gcc >= 4.9, headers >= 3.7"
	depends on BR2_USE_MMU
	depends on !BR2_INSTALL_LIBSTDCPP || BR2_STATIC_LIBS \
		|| !BR2_USE_WCHAR || !BR2_TOOLCHAIN_HAS_THREADS \
		|| !BR2_TOOLCHAIN_GCC_AT_LEAST_4_9 \
		|| !BR2_TOOLCHAIN_HEADERS_AT_LEAST_3_7
```

## package/vmtouch/Config.in
```kconfig
config BR2_PACKAGE_VMTOUCH
	bool "vmtouch"
	depends on BR2_USE_MMU # fork()
	help
	  vmtouch is a tool for learning about and controlling
	  the file system cache of unix and unix-like systems. It
	  can discover which files the OS is caching, tell the OS
	  to cache or evict some files or regions of files, lock
	  files into memory so the OS won't evict them, and more.

	  https://hoytech.com/vmtouch/
```

## package/vnstat/Config.in
```kconfig
config BR2_PACKAGE_VNSTAT
	bool "vnstat"
	depends on BR2_USE_MMU # fork()
	depends on BR2_USE_WCHAR # mbstowcs()
	help
	  vnStat is a console-based network traffic monitor that keeps a
	  log of network traffic for the selected interface(s). It uses
	  the network interface statistics provided by the kernel as
	  information source. This means that vnStat won't actually be
	  sniffing any traffic and also ensures light use of system
	  resources.

	  http://humdi.net/vnstat

comment "vnstat needs a toolchain w/ wchar"
	depends on BR2_USE_MMU
	depends on !BR2_USE_WCHAR
```

## package/vo-aacenc/Config.in
```kconfig
config BR2_PACKAGE_VO_AACENC
	bool "vo-aacenc"
	help
	  This library contains an encoder implementation of the
	  Advanced Audio Coding (AAC) audio codec. The library is
	  based on a codec implementation by VisualOn as part of the
	  Stagefright framework from the Google Android project.

	  http://sourceforge.net/projects/opencore-amr/
```

## package/vpnc/Config.in
```kconfig
config BR2_PACKAGE_VPNC
	bool "vpnc"
	depends on BR2_PACKAGE_LIBGPG_ERROR_ARCH_SUPPORTS # libgcrypt
	depends on !BR2_STATIC_LIBS # gnutls
	depends on BR2_USE_MMU # fork()
	depends on BR2_USE_WCHAR # gnutls
	select BR2_PACKAGE_LIBGCRYPT
	select BR2_PACKAGE_LIBGPG_ERROR
	select BR2_PACKAGE_GNUTLS
	help
	  Client for Cisco VPN concentrator
	  3000 Series VPN Concentrator
	  IOS Routers
	  PIX/ASA Zecurity Appliances
	  Juniper/Netscreen

	  http://www.unix-ag.uni-kl.de/~massar/vpnc

comment "vpnc needs a toolchain w/ wchar, dynamic library"
	depends on BR2_USE_MMU
	depends on !BR2_USE_WCHAR || BR2_STATIC_LIBS
```

## package/vsftpd/Config.in
```kconfig
config BR2_PACKAGE_VSFTPD
	bool "vsftpd"
	depends on BR2_USE_MMU # fork()
	help
	  vsftpd is an ftp daemon written with security in mind.
	  http://vsftpd.beasts.org/
```

## package/vte/Config.in
```kconfig
config BR2_PACKAGE_VTE
	bool "vte"
	depends on BR2_USE_WCHAR
	depends on BR2_TOOLCHAIN_HAS_THREADS
	depends on BR2_USE_MMU
	depends on BR2_INSTALL_LIBSTDCPP
	depends on BR2_TOOLCHAIN_GCC_AT_LEAST_4_8 # C++11
	depends on BR2_TOOLCHAIN_HAS_SYNC_4
	depends on BR2_PACKAGE_HAS_LIBEGL_WAYLAND || \
		BR2_PACKAGE_HAS_LIBGL
	depends on BR2_PACKAGE_XORG7
	select BR2_PACKAGE_LIBGTK3
	select BR2_PACKAGE_LIBXML2
	select BR2_PACKAGE_PCRE2
	help
	  VTE is a library (libvte) implementing a terminal emulator
	  widget for GTK+, and a minimal sample application (vte)
	  using that. Vte is mainly used in gnome-terminal, but
	  can also be used to embed a console/terminal in games,
	  editors, IDEs, etc.

	  http://github.com/GNOME/vte

comment "vte needs a toolchain w/ wchar, threads, C++, gcc >= 4.8"
	depends on BR2_USE_MMU
	depends on BR2_TOOLCHAIN_HAS_SYNC_4
	depends on !BR2_USE_WCHAR || !BR2_INSTALL_LIBSTDCPP || \
		!BR2_TOOLCHAIN_HAS_THREADS || \
		!BR2_TOOLCHAIN_GCC_AT_LEAST_4_8

comment "vte needs an OpenGL or an OpenGL-EGL/wayland backend"
	depends on BR2_USE_MMU
	depends on BR2_TOOLCHAIN_HAS_SYNC_4
	depends on !BR2_PACKAGE_HAS_LIBEGL_WAYLAND && \
		!BR2_PACKAGE_HAS_LIBGL
```
