## package/vtun/Config.in
```kconfig
config BR2_PACKAGE_VTUN
	bool "vtun"
	depends on BR2_USE_MMU # fork()
	select BR2_PACKAGE_LZO
	select BR2_PACKAGE_OPENSSL
	select BR2_PACKAGE_ZLIB
	help
	  Tool for easily creating Virtual Tunnels over TCP/IP networks
	  with traffic shaping, compression, and encryption.

	  It supports IP, PPP, SLIP, Ethernet and other tunnel types.

	  http://vtun.sourceforge.net/
```

## package/vuejs/Config.in
```kconfig
config BR2_PACKAGE_VUEJS
	bool "vuejs"
	help
	  VueJS web application framework.

	  http://vuejs.org
```

## package/w_scan/Config.in
```kconfig
comment "w_scan needs a toolchain w/ headers >= 3.0"
	depends on !BR2_TOOLCHAIN_HEADERS_AT_LEAST_3_3

config BR2_PACKAGE_W_SCAN
	bool "w_scan"
	depends on BR2_TOOLCHAIN_HEADERS_AT_LEAST_3_3
	select BR2_PACKAGE_LIBICONV if !BR2_ENABLE_LOCALE
	help
	  w_scan is a small command line utility used to perform frequency
	  scans for DVB and ATSC transmissions. It is capable of creating
	  channels.conf files (in different output formats !) as well as
	  initial tuning data for scan.

	  http://wirbel.htpc-forum.de/w_scan/index_en.html
```

## package/waffle/Config.in
```kconfig
config BR2_PACKAGE_WAFFLE_SUPPORTS_GLX
	bool
	default y if BR2_PACKAGE_HAS_LIBGL && BR2_PACKAGE_XORG7

config BR2_PACKAGE_WAFFLE_SUPPORTS_WAYLAND
	bool
	default y if BR2_PACKAGE_WAYLAND && BR2_PACKAGE_HAS_LIBEGL_WAYLAND

config BR2_PACKAGE_WAFFLE_SUPPORTS_X11_EGL
	bool
	default y if BR2_PACKAGE_HAS_LIBEGL && BR2_PACKAGE_XORG7

config BR2_PACKAGE_WAFFLE_SUPPORTS_GBM
	bool
	# mesa3d is for now the only GBM provider, and it is enabled
	# together with its EGL support
	default y if BR2_PACKAGE_HAS_LIBEGL && BR2_PACKAGE_MESA3D_OPENGL_EGL && BR2_PACKAGE_HAS_UDEV

config BR2_PACKAGE_WAFFLE
	bool "waffle"
	depends on BR2_PACKAGE_WAFFLE_SUPPORTS_GLX || \
		BR2_PACKAGE_WAFFLE_SUPPORTS_WAYLAND || \
		BR2_PACKAGE_WAFFLE_SUPPORTS_X11_EGL || \
		BR2_PACKAGE_WAFFLE_SUPPORTS_GBM
	select BR2_PACKAGE_XLIB_LIBX11 if BR2_PACKAGE_WAFFLE_SUPPORTS_GLX || BR2_PACKAGE_WAFFLE_SUPPORTS_X11_EGL
	select BR2_PACKAGE_LIBXCB if BR2_PACKAGE_WAFFLE_SUPPORTS_GLX || BR2_PACKAGE_WAFFLE_SUPPORTS_X11_EGL
	help
	  Waffle is a cross-platform library that allows one to defer
	  selection of an OpenGL API and of window system until
	  runtime. For example, on Linux, Waffle enables an application
	  to select X11/EGL with an OpenGL 3.3 core profile, Wayland
	  with OpenGL ES2, and other window system / API combinations.

	  Waffle's immediate goal is to enable Piglit [1] to test
	  multiple OpenGL flavors in a cross-platform way, and to allow
	  each Piglit test to choose its OpenGL API and window system
	  at runtime. A future goal is to enable the ability to record
	  (with another tool such APITrace [2]) an application's OpenGL
	  calls on one operating system or window system, and then
	  replay that trace on a different system.

	  For more information, visit to Waffle's website.

	  [1] http://piglit.freedesktop.org
	  [2] http://github.com/apitrace/apitrace#readme

	  http://www.waffle-gl.org
```

## package/wampcc/Config.in
```kconfig
config BR2_PACKAGE_WAMPCC
	bool "wampcc"
	depends on BR2_INSTALL_LIBSTDCPP
	depends on BR2_TOOLCHAIN_HAS_THREADS_NPTL # libuv
	depends on BR2_USE_MMU # libuv
	depends on !BR2_STATIC_LIBS # libuv
	depends on BR2_TOOLCHAIN_HAS_ATOMIC
	depends on BR2_TOOLCHAIN_HAS_SYNC_4 # libuv
	depends on !BR2_TOOLCHAIN_HAS_GCC_BUG_64735 # std::shared_future
	select BR2_PACKAGE_LIBUV
	select BR2_PACKAGE_JANSSON
	select BR2_PACKAGE_OPENSSL
	help
	  wampcc is a C++ library that implements the Web Application
	  Messaging Protocol.

	  https://github.com/darrenjs/wampcc

comment "wampcc needs a toolchain w/ C++, NPTL, dynamic library"
	depends on BR2_USE_MMU
	depends on BR2_TOOLCHAIN_HAS_ATOMIC
	depends on BR2_TOOLCHAIN_HAS_SYNC_4
	depends on !BR2_INSTALL_LIBSTDCPP || \
		!BR2_TOOLCHAIN_HAS_THREADS_NPTL || BR2_STATIC_LIBS

comment "wampcc needs a toolchain not affected by GCC bug 64735"
	depends on BR2_USE_MMU
	depends on BR2_TOOLCHAIN_HAS_ATOMIC
	depends on BR2_TOOLCHAIN_HAS_SYNC_4
	depends on BR2_TOOLCHAIN_HAS_GCC_BUG_64735
```

## package/wavemon/Config.in
```kconfig
config BR2_PACKAGE_WAVEMON
	bool "wavemon"
	depends on BR2_TOOLCHAIN_HAS_THREADS_NPTL
	select BR2_PACKAGE_NCURSES
	select BR2_PACKAGE_LIBNL
	help
	  wavemon is a wireless device monitoring application that allows you
	  to watch signal and noise levels, packet statistics, device
	  configuration and network parameters of your wireless network
	  hardware.

	  Note that you need a Linux Kernel configuration with wireless
	  extensions or with wireless extensions compatibility enabled.

	  https://github.com/uoaerg/wavemon

comment "wavemon needs a toolchain w/ NPTL"
	depends on !BR2_TOOLCHAIN_HAS_THREADS_NPTL
```

## package/wavpack/Config.in
```kconfig
config BR2_PACKAGE_WAVPACK
	bool "wavpack"
	select BR2_PACKAGE_LIBICONV if !BR2_ENABLE_LOCALE
	help
	  WavPack is a completely open audio compression format providing
	  lossless, high-quality lossy, and a unique hybrid compression mode.

	  http://www.wavpack.com/
```

## package/wayland-protocols/Config.in
```kconfig
config BR2_PACKAGE_WAYLAND_PROTOCOLS
	bool "wayland-protocols"
	# Not really... but useless otherwise
	depends on BR2_PACKAGE_WAYLAND
	help
	  Wayland protocols that adds functionality not available in
	  the Wayland core protocol.

	  http://wayland.freedesktop.org/
```

## package/wayland/Config.in
```kconfig
config BR2_PACKAGE_WAYLAND
	bool "wayland"
	depends on !BR2_STATIC_LIBS # dlfcn.h
	depends on BR2_TOOLCHAIN_HAS_THREADS
	select BR2_PACKAGE_EXPAT
	select BR2_PACKAGE_LIBFFI
	select BR2_PACKAGE_LIBXML2
	help
	  Wayland is a project to define a protocol for a compositor
	  to talk to its clients as well as a library implementation
	  of the protocol.

	  http://wayland.freedesktop.org/

comment "wayland needs a toolchain w/ threads, dynamic library"
	depends on !BR2_TOOLCHAIN_HAS_THREADS || BR2_STATIC_LIBS
```

## package/waylandpp/Config.in
```kconfig
config BR2_PACKAGE_WAYLANDPP
	bool "waylandpp"
	depends on BR2_PACKAGE_HAS_LIBEGL_WAYLAND
	depends on BR2_HOST_GCC_AT_LEAST_4_9
	depends on BR2_TOOLCHAIN_GCC_AT_LEAST_4_9
	depends on BR2_PACKAGE_WAYLAND
	help
	  Wayland C++ bindings

	  https://github.com/NilsBrause/waylandpp

comment "waylandpp needs an OpenGL-EGL/wayland backend, a toolchain w/ gcc >= 4.9, host gcc >= 4.9"
	depends on BR2_PACKAGE_WAYLAND
	depends on !BR2_PACKAGE_HAS_LIBEGL_WAYLAND || \
		!BR2_HOST_GCC_AT_LEAST_4_9 || \
		!BR2_TOOLCHAIN_GCC_AT_LEAST_4_9
```

## package/webif/Config.in
```kconfig
config BR2_PACKAGE_WEBIF
	bool "webif - Status Console"
	select BR2_PACKAGE_HASERL
	help
	  A web interface for showing different network status. This package
	  requires awk support on the system, either the one provided by
	  Busybox or gawk.

	  The default login on the status web pages are root/root and
	  admin/admin. This can be changed in the etc/httpd.conf file.

config BR2_PACKAGE_WEBIF_INSTALL_INDEX_HTML
	bool "instal index.html in /www which redirects to webif"
	depends on BR2_PACKAGE_WEBIF
	help
	  Installs a /www/index.html which redirects to the status console cgi
	  scripts.

config BR2_PACKAGE_WEBIF_LANGUAGES
	bool "install language support"
	depends on BR2_PACKAGE_WEBIF
	help
	  This option installs support for other languages than english.

	  Supported languages: ca, cz, de, dk, ee, es, fr, hr, hu, it, nl, no,
	                       pl, pt, ru and se.
```

## package/webkit/Config.in
```kconfig
config BR2_PACKAGE_WEBKIT_ARCH_SUPPORTS
	bool
	# ARM needs BLX, so v5t+
	default y if (BR2_arm || BR2_armeb) && !BR2_ARM_CPU_ARMV4
	default y if BR2_i386 || BR2_mips || BR2_mipsel || \
		BR2_sparc || BR2_x86_64
	depends on BR2_USE_MMU # libgail -> pango -> libglib2
	depends on BR2_DEPRECATED_SINCE_2015_08

# disabled on powerpc due to bug https://bugs.webkit.org/show_bug.cgi?id=113638

config BR2_PACKAGE_WEBKIT
	bool "webkit"
	depends on BR2_DEPRECATED_SINCE_2015_08
	depends on BR2_INSTALL_LIBSTDCPP
	depends on BR2_USE_WCHAR # enchant -> libglib2
	depends on BR2_TOOLCHAIN_HAS_THREADS # enchant -> libglib2; icu
	depends on BR2_PACKAGE_LIBGTK2
	depends on BR2_PACKAGE_WEBKIT_ARCH_SUPPORTS
	depends on !BR2_BINFMT_FLAT # icu
	depends on BR2_TOOLCHAIN_HAS_SYNC_4 # harfbuzz
	select BR2_PACKAGE_CAIRO
	select BR2_PACKAGE_CAIRO_PNG
	select BR2_PACKAGE_ENCHANT
	select BR2_PACKAGE_HARFBUZZ
	select BR2_PACKAGE_ICU
	select BR2_PACKAGE_JPEG
	select BR2_PACKAGE_LIBCURL
	select BR2_PACKAGE_LIBGAIL
	select BR2_PACKAGE_LIBSECRET
	select BR2_PACKAGE_LIBSOUP
	select BR2_PACKAGE_LIBXML2
	select BR2_PACKAGE_LIBXSLT
	select BR2_PACKAGE_SQLITE
	select BR2_PACKAGE_WEBP
	select BR2_PACKAGE_XLIB_LIBXT if BR2_PACKAGE_XORG7
	select BR2_PACKAGE_XLIB_LIBXCOMPOSITE if BR2_PACKAGE_HAS_LIBGL
	select BR2_PACKAGE_XLIB_LIBXDAMAGE if BR2_PACKAGE_HAS_LIBGL
	help
	  WebKit is an open source, standards compliant web browser engine.

	  Note that WebKit does not build with a toolchain using the
	  old linuxthreads library.

	  http://webkit.org/

comment "webkit needs libgtk2 and a toolchain w/ C++, wchar, threads"
	depends on BR2_DEPRECATED_SINCE_2015_08
	depends on BR2_PACKAGE_WEBKIT_ARCH_SUPPORTS
	depends on BR2_TOOLCHAIN_HAS_SYNC_4
	depends on !BR2_PACKAGE_LIBGTK2 || !BR2_INSTALL_LIBSTDCPP || \
		!BR2_USE_WCHAR || !BR2_TOOLCHAIN_HAS_THREADS
	depends on BR2_USE_MMU
```

## package/webkitgtk/Config.in
```kconfig
config BR2_PACKAGE_WEBKITGTK_ARCH_SUPPORTS
	bool
	# ARM needs BLX, so v5t+, BE completely untested so disabled
	default y if BR2_arm && !BR2_ARM_CPU_ARMV4
	default y if BR2_aarch64 || BR2_aarch64_be
	default y if BR2_i386 || BR2_x86_64
	# Disabled on MIPS big endian due to sigbus
	default y if BR2_mipsel || BR2_mips64el
	# Disabled on PowerPC pending runtime testing
	# Disabled on SuperH because of segfault
	depends on BR2_USE_MMU # libglib2
	depends on BR2_TOOLCHAIN_HAS_SYNC_4
	depends on BR2_PACKAGE_LIBGPG_ERROR_ARCH_SUPPORTS # libgcrypt

config BR2_PACKAGE_WEBKITGTK_ARCH_SUPPORTS_JIT
	bool
	# ARM needs NEON for JIT.
	default y if BR2_ARM_CPU_HAS_NEON
	# AArch64 is supported upstream but not well tested on big-endian mode.
	default y if BR2_aarch64
	# i386 & x86_64 don't have any special requirements.
	default y if BR2_i386
	default y if BR2_x86_64
	# JIT is known not to work on MIPS64.
	# Plain MIPS32 (pre R2) is not well tested and likely broken, and R6
	# is unsupported, see https://bugs.webkit.org/show_bug.cgi?id=191258
	# The MIPS support is completely untested in big-endian mode.
	default y if BR2_mipsel && BR2_MIPS_CPU_MIPS32R2
	default y if BR2_mipsel && BR2_MIPS_CPU_MIPS32R5

comment "webkitgtk needs libgtk3 and a glibc toolchain w/ C++, gcc >= 6, host gcc >= 4.8"
	depends on BR2_PACKAGE_WEBKITGTK_ARCH_SUPPORTS
	depends on !BR2_PACKAGE_LIBGTK3 || !BR2_INSTALL_LIBSTDCPP || \
		!BR2_TOOLCHAIN_USES_GLIBC || \
		!BR2_HOST_GCC_AT_LEAST_4_8 || \
		!BR2_TOOLCHAIN_GCC_AT_LEAST_6
	depends on BR2_USE_MMU

config BR2_PACKAGE_WEBKITGTK
	bool "webkitgtk"
	depends on BR2_INSTALL_LIBSTDCPP
	depends on BR2_HOST_GCC_AT_LEAST_4_8 # icu
	depends on BR2_TOOLCHAIN_GCC_AT_LEAST_6
	depends on BR2_TOOLCHAIN_USES_GLIBC
	depends on BR2_PACKAGE_LIBGTK3
	depends on BR2_PACKAGE_WEBKITGTK_ARCH_SUPPORTS
	select BR2_PACKAGE_CAIRO
	select BR2_PACKAGE_CAIRO_PNG
	select BR2_PACKAGE_ENCHANT
	select BR2_PACKAGE_HARFBUZZ
	select BR2_PACKAGE_ICU
	select BR2_PACKAGE_JPEG
	select BR2_PACKAGE_LIBGCRYPT
	select BR2_PACKAGE_LIBSECRET
	select BR2_PACKAGE_LIBSOUP
	select BR2_PACKAGE_LIBTASN1
	select BR2_PACKAGE_LIBXML2
	select BR2_PACKAGE_LIBXSLT
	select BR2_PACKAGE_SQLITE
	select BR2_PACKAGE_WEBP
	select BR2_PACKAGE_WEBP_DEMUX
	select BR2_PACKAGE_WOFF2
	select BR2_PACKAGE_XLIB_LIBXCOMPOSITE if BR2_PACKAGE_LIBGTK3_X11
	select BR2_PACKAGE_XLIB_LIBXDAMAGE if BR2_PACKAGE_LIBGTK3_X11
	select BR2_PACKAGE_XLIB_LIBXRENDER if BR2_PACKAGE_LIBGTK3_X11
	select BR2_PACKAGE_XLIB_LIBXT if BR2_PACKAGE_LIBGTK3_X11
	help
	  WebKit is an open source, standards compliant web browser
	  engine.

	  http://www.webkitgtk.org/

if BR2_PACKAGE_WEBKITGTK

config BR2_PACKAGE_WEBKITGTK_HTTPS
	bool "HTTPS support"
	depends on !BR2_STATIC_LIBS # gnutls -> libsoup
	select BR2_PACKAGE_CA_CERTIFICATES # runtime
	select BR2_PACKAGE_LIBSOUP_SSL
	help
	  Enable HTTPS protocol support.

comment "webkitgtk https support needs a toolchain w/ dynamic library"
	depends on BR2_STATIC_LIBS

config BR2_PACKAGE_WEBKITGTK_MULTIMEDIA
	bool "multimedia support"
	select BR2_PACKAGE_GSTREAMER1
	select BR2_PACKAGE_GST1_PLUGINS_BAD
	select BR2_PACKAGE_GST1_PLUGINS_BAD_PLUGIN_MPEGTSDEMUX
	select BR2_PACKAGE_GST1_PLUGINS_BASE
	select BR2_PACKAGE_GST1_PLUGINS_BASE_PLUGIN_ALSA
	select BR2_PACKAGE_GST1_PLUGINS_BASE_PLUGIN_APP
	select BR2_PACKAGE_GST1_PLUGINS_BASE_PLUGIN_AUDIOCONVERT
	select BR2_PACKAGE_GST1_PLUGINS_BASE_PLUGIN_AUDIORESAMPLE
	select BR2_PACKAGE_GST1_PLUGINS_BASE_PLUGIN_PLAYBACK
	select BR2_PACKAGE_GST1_PLUGINS_BASE_PLUGIN_VIDEOCONVERT
	select BR2_PACKAGE_GST1_PLUGINS_BASE_PLUGIN_VIDEOSCALE
	select BR2_PACKAGE_GST1_PLUGINS_BASE_PLUGIN_VOLUME
	select BR2_PACKAGE_GST1_PLUGINS_GOOD
	select BR2_PACKAGE_GST1_PLUGINS_GOOD_PLUGIN_ISOMP4
	select BR2_PACKAGE_GST1_PLUGINS_GOOD_PLUGIN_RTSP
	select BR2_PACKAGE_GST1_LIBAV
	help
	  This option pulls in all of the required dependencies
	  to enable multimedia (video/audio) support.

if BR2_PACKAGE_WEBKITGTK_MULTIMEDIA

config BR2_PACKAGE_WEBKITGTK_USE_GSTREAMER_GL
	bool "use gstreamer-gl"
	default y
	depends on BR2_PACKAGE_GST1_PLUGINS_BASE_HAS_LIB_OPENGL
	select BR2_PACKAGE_GST1_PLUGINS_BAD_PLUGIN_GL
	help
	  Use the GStreamer GL elements for handling video content.
	  This is recommended as it improves performance of video
	  playback. In some target configurations incorrect rendering
	  might be produced, and disabling this option may help.

endif

config BR2_PACKAGE_WEBKITGTK_WEBDRIVER
	bool "WebDriver support"
	help
	  Enable support for WebDriver. This will build and install the
	  WebKitWebDriver program in the target.

endif
```
