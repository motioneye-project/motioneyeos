## package/webkitgtk24/Config.in
```kconfig
config BR2_PACKAGE_WEBKITGTK24_ARCH_SUPPORTS
	bool
	# ARM needs BLX, so v5t+, BE completely untested so disabled
	default y if BR2_arm && !BR2_ARM_CPU_ARMV4
	# i386 / x86_64 external toolchains have issues and old gcc versions
	# https://bugs.webkit.org/show_bug.cgi?id=132231
	# https://stackoverflow.com/questions/9140019/yield-is-not-a-member-of-stdthis-thread
	default y if BR2_i386 || BR2_x86_64
	depends on !BR2_TOOLCHAIN_EXTERNAL_CODESOURCERY_X86_201209
	depends on !BR2_TOOLCHAIN_EXTERNAL_CODESOURCERY_X86_201203
	depends on !BR2_TOOLCHAIN_EXTERNAL_CODESOURCERY_X86_201109
	# Disabled on MIPS big endian due to sigbus
	default y if BR2_mipsel || BR2_mips64el
	# Disabled on PowerPC pending runtime testing
	# Disabled on SuperH because of segfault
	depends on BR2_USE_MMU # libglib2

comment "webkitgtk24 needs libgtk2 and a toolchain w/ C++, wchar, NPTL"
	depends on BR2_PACKAGE_WEBKITGTK24_ARCH_SUPPORTS
	depends on BR2_ARCH_HAS_ATOMICS
	depends on !BR2_PACKAGE_LIBGTK2 || !BR2_PACKAGE_XORG7 || \
		!BR2_TOOLCHAIN_HAS_THREADS_NPTL || !BR2_INSTALL_LIBSTDCPP \
		|| !BR2_USE_WCHAR
	depends on BR2_USE_MMU

config BR2_PACKAGE_WEBKITGTK24
	bool "webkitgtk 2.4.x"
	depends on BR2_INSTALL_LIBSTDCPP
	depends on BR2_USE_WCHAR
	depends on BR2_TOOLCHAIN_HAS_THREADS_NPTL
	depends on (BR2_PACKAGE_LIBGTK2 && BR2_PACKAGE_XORG7)
	depends on BR2_PACKAGE_WEBKITGTK24_ARCH_SUPPORTS
	depends on BR2_ARCH_HAS_ATOMICS
	select BR2_PACKAGE_CAIRO
	select BR2_PACKAGE_CAIRO_PNG
	select BR2_PACKAGE_ENCHANT
	select BR2_PACKAGE_HARFBUZZ
	select BR2_PACKAGE_ICU
	select BR2_PACKAGE_JPEG
	select BR2_PACKAGE_LIBCURL
	select BR2_PACKAGE_LIBSECRET
	select BR2_PACKAGE_LIBSOUP
	select BR2_PACKAGE_LIBXML2
	select BR2_PACKAGE_LIBXSLT
	select BR2_PACKAGE_SQLITE
	select BR2_PACKAGE_WEBP
	select BR2_PACKAGE_XLIB_LIBXT if BR2_PACKAGE_XORG7
	select BR2_PACKAGE_XLIB_LIBXCOMPOSITE if BR2_PACKAGE_HAS_LIBGL || \
		(BR2_PACKAGE_HAS_LIBGLES && BR2_PACKAGE_HAS_LIBEGL)
	select BR2_PACKAGE_XLIB_LIBXDAMAGE if BR2_PACKAGE_HAS_LIBGL || \
		(BR2_PACKAGE_HAS_LIBGLES && BR2_PACKAGE_HAS_LIBEGL)
	help
	  WebKit is an open source, standards compliant web browser engine.

	  http://www.webkitgtk.org/
```

## package/webp/Config.in
```kconfig
config BR2_PACKAGE_WEBP
	bool "webp"
	help
	  WebP is a new image format that provides lossless and lossy
	  compression for images on the web

	  https://developers.google.com/speed/webp/

config BR2_PACKAGE_WEBP_DEMUX
	bool "webpdemux"
	depends on BR2_PACKAGE_WEBP
	help
	  "Demux" is a part of WebPMux for extraction and manipulation of an
	  extended format WebP file, which can have features like color profile,
	  metadata and animation.
```

## package/webrtc-audio-processing/Config.in
```kconfig
config BR2_PACKAGE_WEBRTC_AUDIO_PROCESSING
	bool "webrtc-audio-processing"
	depends on BR2_arm || BR2_i386 || BR2_x86_64
	depends on BR2_INSTALL_LIBSTDCPP
	depends on BR2_TOOLCHAIN_GCC_AT_LEAST_4_8
	# pthread_condattr_setclock
	depends on BR2_TOOLCHAIN_HAS_THREADS_NPTL
	help
	  AudioProcessing library based on Google's implementation of
	  WebRTC.

	  http://freedesktop.org/software/pulseaudio/webrtc-audio-processing/

comment "webrtc-audio-processing needs a toolchain w/ C++, NPTL, gcc >= 4.8"
	depends on BR2_arm || BR2_i386 || BR2_x86_64
	depends on !BR2_INSTALL_LIBSTDCPP || !BR2_TOOLCHAIN_HAS_THREADS_NPTL \
		|| !BR2_TOOLCHAIN_GCC_AT_LEAST_4_8
```

## package/websocketpp/Config.in
```kconfig
config BR2_PACKAGE_WEBSOCKETPP
	bool "websocketpp"
	depends on BR2_TOOLCHAIN_GCC_AT_LEAST_4_8 # C++11
	depends on BR2_INSTALL_LIBSTDCPP
	help
	  WebSocket++ is a header only C++ library that implements
	  RFC6455 The WebSocket Protocol. It allows integrating
	  WebSocket client and server functionality into C++ programs.
	  It uses interchangeable network transport modules including
	  one based on C++ iostreams and one based on Boost Asio.

	  http://www.zaphoyd.com/websocketpp

comment "websocketpp needs a toolchain w/ C++ and gcc >= 4.8"
	depends on !BR2_INSTALL_LIBSTDCPP || !BR2_TOOLCHAIN_GCC_AT_LEAST_4_8
```

## package/weston/Config.in
```kconfig
comment "weston needs udev and a toolchain w/ locale, threads, dynamic library, headers >= 3.0"
	depends on !BR2_PACKAGE_HAS_UDEV || !BR2_TOOLCHAIN_HAS_THREADS || \
		!BR2_TOOLCHAIN_HEADERS_AT_LEAST_3_0 || BR2_STATIC_LIBS || \
		!BR2_ENABLE_LOCALE

config BR2_PACKAGE_WESTON
	bool "weston"
	select BR2_PACKAGE_WAYLAND
	select BR2_PACKAGE_WAYLAND_PROTOCOLS
	select BR2_PACKAGE_LIBXKBCOMMON
	select BR2_PACKAGE_CAIRO
	select BR2_PACKAGE_CAIRO_PNG
	select BR2_PACKAGE_LIBPNG
	select BR2_PACKAGE_JPEG
	select BR2_PACKAGE_MTDEV
	select BR2_PACKAGE_LIBINPUT
	depends on BR2_ENABLE_LOCALE # libinput
	depends on BR2_PACKAGE_HAS_UDEV
	depends on !BR2_STATIC_LIBS # wayland
	depends on BR2_TOOLCHAIN_HAS_THREADS # wayland
	depends on BR2_TOOLCHAIN_HEADERS_AT_LEAST_3_0
	# Runtime dependency
	select BR2_PACKAGE_XKEYBOARD_CONFIG
	# Make sure at least one compositor is selected.
	select BR2_PACKAGE_WESTON_FBDEV if !BR2_PACKAGE_WESTON_HAS_COMPOSITOR
	help
	  Weston is the reference implementation of a Wayland
	  compositor, and a useful compositor in its own right.
	  Weston has various backends that lets it run on Linux kernel
	  modesetting and evdev input as well as under X11.

	  http://wayland.freedesktop.org/

if BR2_PACKAGE_WESTON

# Helper to make sure at least one compositor is selected.
config BR2_PACKAGE_WESTON_HAS_COMPOSITOR
	bool

config BR2_PACKAGE_WESTON_DRM
	bool "DRM compositor"
	depends on BR2_PACKAGE_MESA3D_OPENGL_EGL
	select BR2_PACKAGE_LIBDRM
	select BR2_PACKAGE_WESTON_HAS_COMPOSITOR

# Uses libgbm from mesa3d
comment "DRM compositor needs an OpenGL EGL backend provided by mesa3d"
	depends on !BR2_PACKAGE_MESA3D_OPENGL_EGL

config BR2_PACKAGE_WESTON_FBDEV
	bool "fbdev compositor"

# FreeRDP needs threads and !static, already the case for weston
config BR2_PACKAGE_WESTON_RDP
	bool "RDP compositor"
	depends on BR2_USE_WCHAR # freerdp
	depends on BR2_USE_MMU # freerdp, libglib2
	depends on BR2_TOOLCHAIN_HAS_SYNC_4
	select BR2_PACKAGE_FREERDP
	select BR2_PACKAGE_WESTON_HAS_COMPOSITOR
	help
	  This enables the RDP backend, which allows accessing weston
	  through the network with any RDP-compliant client.

	  Please note that one must pass those options to weston for RDP
	  to be functional:
	    --rdp-tls-cert=/path/to/server.crt
	    --rdp-tls-key=/path/to/server.key

	  By default, Buildroot installs such files in /etc/freerdp/server/
	  so you may want to change them in a post-build script or a rootfs
	  overlay.

comment "RDP compositor needs a toolchain w/ wchar"
	depends on BROKEN # needs FreeRDP master
	depends on BR2_TOOLCHAIN_HAS_SYNC_4
	depends on !BR2_USE_WCHAR

# rpi-userland is an EGL/GLES provider, so we can't select it
config BR2_PACKAGE_WESTON_RPI
	bool "RPi compositor"
	depends on BR2_PACKAGE_RPI_USERLAND
	select BR2_PACKAGE_WESTON_HAS_COMPOSITOR

endif
```

## package/wf111/Config.in
```kconfig
config BR2_PACKAGE_WF111
	bool "wf111"
	depends on BR2_LINUX_KERNEL
	depends on BR2_ARM_CPU_ARMV5 || BR2_ARM_CPU_ARMV7A || BR2_i386
	# Binary tools are distributed alongside the driver, and are
	# dynamically linked against the glibc.
	depends on BR2_TOOLCHAIN_USES_GLIBC
	help
	  Silicon Labs WF111 WiFi driver and utilities.

	  Warning: CONFIG_WIRELESS_EXT and CONFIG_WEXT_PRIV must be
	  selected in the Linux kernel configuration. These are blind
	  options (i.e. not selectable directly) so they cannot be
	  enabled by a change in linux/linux.mk. There are two choices
	  to enable these options:
	  - By making them non blind, with a "WF111 support"
	    configuration entry that selects them, for example.
	  - By enabling another random WiFi driver that select them.

	  https://www.silabs.com/products/wireless/wi-fi/wf111-bluegiga-module

comment "wf111 needs a glibc toolchain"
	depends on BR2_LINUX_KERNEL
	depends on BR2_ARM_CPU_ARMV5 || BR2_ARM_CPU_ARMV7A || BR2_i386
	depends on !BR2_TOOLCHAIN_USES_GLIBC
```

## package/wget/Config.in
```kconfig
config BR2_PACKAGE_WGET
	bool "wget"
	# fork()
	depends on BR2_USE_MMU
	depends on BR2_USE_WCHAR
	help
	  Network utility to retrieve files from http, https and ftp.

	  http://www.gnu.org/software/wget/

comment "wget needs a toolchain w/ wchar"
	depends on !BR2_USE_WCHAR
```

## package/whetstone/Config.in
```kconfig
config BR2_PACKAGE_WHETSTONE
	bool "whetstone"
	help
	  C Converted Whetstone Double Precision Benchmark

	  http://www.netlib.org/benchmark/
```

## package/which/Config.in
```kconfig
config BR2_PACKAGE_WHICH
	bool "which"
	depends on BR2_PACKAGE_BUSYBOX_SHOW_OTHERS
	help
	  The standard 'which' utility.

	  http://carlowood.github.io/which/index.html
```

## package/whois/Config.in
```kconfig
config BR2_PACKAGE_WHOIS
	bool "whois"
	depends on BR2_PACKAGE_BUSYBOX_SHOW_OTHERS
	help
	  Improved whois client.

	  https://github.com/rfc1036/whois
```

## package/wilc1000-firmware/Config.in
```kconfig
config BR2_PACKAGE_WILC1000_FIRMWARE
	bool "wilc1000-firmware"
	help
	  Firmware for Atmel Wilc1000 wireless device

	  https://github.com/linux4sc/wireless-firmware.git
```

## package/wilink-bt-firmware/Config.in
```kconfig
config BR2_PACKAGE_WILINK_BT_FIRMWARE
	bool "wilink-bt-firmware"
	help
	  Texas Instruments Wilink7 and Wilink8 (wl12xx/wl18xx) UART
	  attached Bluetooth firmware.

	  https://github.com/TI-ECS/bt-firmware
```
