## package/wine/Config.in
```kconfig
config BR2_PACKAGE_WINE_ARCH_SUPPORTS
	bool
	default y
	# Wine only builds on certain architectures
	depends on BR2_HOSTARCH = "x86_64" || BR2_HOSTARCH = "x86" || \
	           BR2_HOSTARCH = "powerpc" || BR2_HOSTARCH = "arm" || \
	           BR2_HOSTARCH = "aarch64"
	# Wine has much CPU specific code and mostly makes sense on x86
	depends on BR2_i386

config BR2_PACKAGE_WINE
	bool "wine"
	depends on BR2_PACKAGE_WINE_ARCH_SUPPORTS
	# Wine unconditionally builds shared libraries
	depends on !BR2_STATIC_LIBS
	help
	  Wine is a compatibility layer capable of running Windows
	  applications on Linux. Instead of simulating internal
	  Windows logic like a virtual machine or emulator, Wine
	  translates Windows API calls into POSIX calls on-the-fly,
	  eliminating the performance and memory penalties of other
	  methods.

	  http://www.winehq.org

comment "wine needs a toolchain w/ dynamic library"
	depends on BR2_PACKAGE_WINE_ARCH_SUPPORTS
	depends on BR2_STATIC_LIBS
```

## package/wipe/Config.in
```kconfig
config BR2_PACKAGE_WIPE
	bool "wipe"
	help
	  Wipe is a little command for securely erasing files
	  from magnetic media. It compiles under various unix platforms.

	  http://wipe.sourceforge.net
```

## package/wireguard-linux-compat/Config.in
```kconfig
config BR2_PACKAGE_WIREGUARD_LINUX_COMPAT
	bool "wireguard linux-compat"
	depends on BR2_LINUX_KERNEL
	# kernel module requires 3.10+
	depends on BR2_TOOLCHAIN_HEADERS_AT_LEAST_3_10
	# kernel module in upstream linux since 5.6
	depends on !BR2_TOOLCHAIN_HEADERS_AT_LEAST_5_6
	help
	  WireGuard is an extremely simple yet fast and modern VPN
	  that utilizes state-of-the-art cryptography. It aims to be
	  faster, simpler, leaner, and more useful than IPSec, while
	  avoiding the massive headache. It intends to be considerably
	  more performant than OpenVPN. WireGuard is designed as a
	  general purpose VPN for running on embedded interfaces and
	  super computers alike, fit for many different
	  circumstances.

	  Support for WireGuard is included in Linux 5.6+. This
	  package provides a backport of the kernel support for older
	  kernels.

	  https://www.wireguard.com

comment "wireguard-linux-compat needs a toolchain w/ headers >= 3.10"
	depends on BR2_LINUX_KERNEL
	depends on !BR2_TOOLCHAIN_HEADERS_AT_LEAST_3_10
```

## package/wireguard-tools/Config.in
```kconfig
config BR2_PACKAGE_WIREGUARD_TOOLS
	bool "wireguard tools"
	# kernel module requires 3.10+, userspace makes no sense without it
	depends on BR2_TOOLCHAIN_HEADERS_AT_LEAST_3_10
	help
	  WireGuard is an extremely simple yet fast and modern VPN
	  that utilizes state-of-the-art cryptography. It aims to be
	  faster, simpler, leaner, and more useful than IPSec, while
	  avoiding the massive headache. It intends to be considerably
	  more performant than OpenVPN. WireGuard is designed as a
	  general purpose VPN for running on embedded interfaces and
	  super computers alike, fit for many different
	  circumstances.

	  This package provides the userspace tooling to configure
	  WireGuard tunnels.

	  https://www.wireguard.com

comment "wireguard-tools needs a toolchain w/ headers >= 3.10"
	depends on !BR2_TOOLCHAIN_HEADERS_AT_LEAST_3_10
```

## package/wireguard/Config.in
```kconfig
config BR2_PACKAGE_WIREGUARD
	bool "wireguard"
	# kernel module requires 3.10+, userspace makes no sense without it
	depends on BR2_TOOLCHAIN_HEADERS_AT_LEAST_3_10
	select BR2_PACKAGE_LIBMNL
	help
	  WireGuard is an extremely simple yet fast and modern VPN
	  that utilizes state-of-the-art cryptography. It aims to be
	  faster, simpler, leaner, and more useful than IPSec, while
	  avoiding the massive headache. It intends to be considerably
	  more performant than OpenVPN. WireGuard is designed as a
	  general purpose VPN for running on embedded interfaces and
	  super computers alike, fit for many different
	  circumstances. Initially released for the Linux kernel, it
	  plans to be cross-platform and widely deployable. It is
	  currently under heavy development, but already it might be
	  regarded as the most secure, easiest to use, and simplest
	  VPN solution in the industry.

	  https://www.wireguard.com

comment "wireguard needs a toolchain w/ headers >= 3.10"
	depends on !BR2_TOOLCHAIN_HEADERS_AT_LEAST_3_10
```

## package/wireless-regdb/Config.in
```kconfig
config BR2_PACKAGE_WIRELESS_REGDB
	bool "wireless-regdb"
	help
	  Wireless regulatory database.

	  Wireless regulatory database for CRDA. The database lists the
	  allowed radio frequencies for each local jurisdiction.

	  https://wireless.wiki.kernel.org/en/developers/regulatory/wireless-regdb
```

## package/wireless-tools/Config.in
```kconfig
config BR2_PACKAGE_WIRELESS_TOOLS
	bool "wireless tools"
	help
	  A collection of tools to configure wireless lan cards.

	  http://www.hpl.hp.com/personal/Jean_Tourrilhes/Linux/Tools.html
```

## package/wireless_tools/Config.in
```kconfig
config BR2_PACKAGE_WIRELESS_TOOLS
	bool "wireless tools"
	help
	  A collection of tools to configure wireless lan cards.

	  https://hewlettpackard.github.io/wireless-tools/

if BR2_PACKAGE_WIRELESS_TOOLS

config BR2_PACKAGE_WIRELESS_TOOLS_LIB
	bool "Install shared library"
	depends on !BR2_STATIC_LIBS
	help
	  The shared library of wireless tools

endif
```

## package/wireshark/Config.in
```kconfig
config BR2_PACKAGE_WIRESHARK
	bool "wireshark"
	depends on BR2_PACKAGE_LIBGPG_ERROR_ARCH_SUPPORTS # libgcrypt -> libgpg-error
	depends on !BR2_STATIC_LIBS
	depends on BR2_USE_MMU # fork(), glib2
	depends on BR2_USE_WCHAR # glib2
	depends on BR2_TOOLCHAIN_HAS_THREADS # glib2
	select BR2_PACKAGE_LIBPCAP
	select BR2_PACKAGE_LIBGCRYPT
	select BR2_PACKAGE_LIBGLIB2
	select BR2_PACKAGE_SPEEXDSP
	help
	  Network traffic sniffer and protocol decoder.

	  https://www.wireshark.org

if BR2_PACKAGE_WIRESHARK

config BR2_PACKAGE_WIRESHARK_GUI
	bool "Qt5 GUI"
	default y
	depends on BR2_INSTALL_LIBSTDCPP # qt5
	depends on BR2_TOOLCHAIN_HAS_THREADS_NPTL # qt5
	depends on BR2_TOOLCHAIN_GCC_AT_LEAST_4_8 # qt5
	depends on !BR2_arc # qt5
	depends on BR2_PACKAGE_HAS_UDEV # qt5 input
	select BR2_PACKAGE_QT5
	select BR2_PACKAGE_QT5BASE
	select BR2_PACKAGE_QT5BASE_FONTCONFIG # runtime
	select BR2_PACKAGE_QT5BASE_PNG # runtime
	select BR2_PACKAGE_QT5BASE_WIDGETS
	select BR2_PACKAGE_QT5MULTIMEDIA
	select BR2_PACKAGE_QT5SVG
	select BR2_PACKAGE_QT5TOOLS
	select BR2_PACKAGE_QT5TOOLS_LINGUIST_TOOLS
	help
	  Enable Qt5 GUI

comment "Qt5 GUI needs a udev /dev management and a toolchain w/ C++, NPTL, gcc >= 4.8"
	depends on !BR2_arc
	depends on !BR2_PACKAGE_HAS_UDEV || !BR2_INSTALL_LIBSTDCPP || \
		!BR2_TOOLCHAIN_HAS_THREADS_NPTL || !BR2_TOOLCHAIN_GCC_AT_LEAST_4_8

endif # BR2_PACKAGE_WIRESHARK

comment "wireshark needs a toolchain w/ wchar, threads, dynamic library"
	depends on BR2_PACKAGE_LIBGPG_ERROR_ARCH_SUPPORTS
	depends on BR2_USE_MMU
	depends on !BR2_USE_WCHAR || !BR2_TOOLCHAIN_HAS_THREADS || \
		BR2_STATIC_LIBS
```

## package/wiringpi/Config.in
```kconfig
config BR2_PACKAGE_WIRINGPI
	bool "wiringpi"
	depends on !BR2_STATIC_LIBS
	depends on BR2_USE_MMU # fork()
	depends on BR2_TOOLCHAIN_HAS_THREADS
	help
	  wiringPi libraries (and gpio command)

	  http://wiringpi.com/

comment "wiringpi needs a toolchain w/ threads, dynamic library"
	depends on BR2_USE_MMU
	depends on BR2_STATIC_LIBS || !BR2_TOOLCHAIN_HAS_THREADS
```

## package/wlroots/Config.in
```kconfig
comment "wlroots needs udev, mesa3d w/ EGL and GLES support"
	depends on !BR2_PACKAGE_MESA3D_OPENGL_EGL || \
		!BR2_PACKAGE_MESA3D_OPENGL_ES || \
		!BR2_PACKAGE_HAS_UDEV

comment "wlroots needs a toolchain w/ threads, locale, dynamic library"
	depends on !BR2_TOOLCHAIN_HAS_THREADS || \
		!BR2_ENABLE_LOCALE || \
		BR2_STATIC_LIBS

config BR2_PACKAGE_WLROOTS
	bool "wlroots"
	depends on !BR2_STATIC_LIBS # wayland
	depends on BR2_TOOLCHAIN_HAS_THREADS # libdrm, wayland
	depends on BR2_ENABLE_LOCALE # libinput
	depends on BR2_PACKAGE_HAS_UDEV # libinput
	# Technically wlroots should work with any OpenGL implementation
	# which provides EGL, GLES2, and libgbm; but in practice only
	# Mesa ships an usable libgbm.
	depends on BR2_PACKAGE_MESA3D_OPENGL_EGL
	depends on BR2_PACKAGE_MESA3D_OPENGL_ES
	select BR2_PACKAGE_LIBDRM
	select BR2_PACKAGE_LIBINPUT
	select BR2_PACKAGE_LIBXKBCOMMON
	select BR2_PACKAGE_PIXMAN
	select BR2_PACKAGE_WAYLAND
	select BR2_PACKAGE_WAYLAND_PROTOCOLS
	help
	  wlroots is a modular Wayland library for building compositors
	  which implements many of their common features.

	  https://github.com/swaywm/wlroots

if BR2_PACKAGE_WLROOTS

config BR2_PACKAGE_WLROOTS_X11
	bool "X11 backend"
	depends on BR2_PACKAGE_XORG7
	select BR2_PACKAGE_XLIB_LIBX11
	help
	  Support Wayland sessions nested inside a X11 window

endif
```

## package/wmctrl/Config.in
```kconfig
config BR2_PACKAGE_WMCTRL
	bool "wmctrl"
	select BR2_PACKAGE_XLIB_LIBX11
	select BR2_PACKAGE_XLIB_LIBXMU
	select BR2_PACKAGE_LIBGLIB2
	depends on BR2_PACKAGE_XORG7
	depends on BR2_USE_WCHAR # libglib2
	depends on BR2_TOOLCHAIN_HAS_THREADS # libglib2
	depends on BR2_USE_MMU # libglib2
	help
	  Provides command line access to almost all the features
	  defined in the EWMH specification. It can be used, for
	  example, to get information about the window manager, to get
	  a detailed list of desktops and managed windows, to switch
	  and resize desktops, to make windows full-screen,
	  always-above or sticky, and to activate, close, move,
	  resize, maximize and minimize them.

	  https://sites.google.com/site/tstyblo/wmctrl/

comment "wmctrl needs a toolchain w/ wchar, threads"
	depends on BR2_USE_MMU
	depends on BR2_PACKAGE_XORG7
	depends on !BR2_USE_WCHAR || !BR2_TOOLCHAIN_HAS_THREADS
```

## package/woff2/Config.in
```kconfig
config BR2_PACKAGE_WOFF2
	bool "woff2"
	depends on BR2_INSTALL_LIBSTDCPP
	select BR2_PACKAGE_BROTLI
	help
	  Reference implementation for the WOFF2 font file format,
	  typically used for Web fonts

	  https://github.com/google/woff2
```

## package/wolfssl/Config.in
```kconfig
config BR2_PACKAGE_WOLFSSL
	bool "wolfssl"
	depends on BR2_TOOLCHAIN_HAS_THREADS
	help
	  The wolfSSL embedded SSL library (formerly CyaSSL) is a
	  lightweight, portable, C-language-based SSL/TLS library
	  targeted at IoT, embedded, and RTOS environments primarily
	  because of its size, speed, and feature set.

	  https://www.wolfssl.com/

if BR2_PACKAGE_WOLFSSL

config BR2_PACKAGE_WOLFSSL_ALL
	bool "enable all features, except SSLv3"
	help
	  Enable all wolfSSL features, except SSL version 3.0 support.

config BR2_PACKAGE_WOLFSSL_SSLV3
	bool "enable SSLv3"
	help
	  Enable SSL version 3.0 support.

endif

comment "wolfssl needs a toolchain w/ threads"
	depends on !BR2_TOOLCHAIN_HAS_THREADS
```

## package/wpa_supplicant/Config.in
```kconfig
config BR2_PACKAGE_WPA_SUPPLICANT
	bool "wpa_supplicant"
	depends on BR2_USE_MMU # fork()
	help
	  WPA supplicant for secure wireless networks

	  http://hostap.epitest.fi/wpa_supplicant/

if BR2_PACKAGE_WPA_SUPPLICANT

config BR2_PACKAGE_WPA_SUPPLICANT_NL80211
	bool "Enable nl80211 support"
	default y
	depends on BR2_TOOLCHAIN_HAS_THREADS # libnl
	select BR2_PACKAGE_LIBNL
	help
	  Enable support for nl80211.  This is the current wireless
	  API for Linux, supported by all wireless drivers in vanilla
	  Linux, but may not be supported by some out-of-tree Linux
	  wireless drivers.  wpa_supplicant will still fall back to
	  using the Wireless Extensions (wext) API with these drivers.

	  If this option is disabled, then only the deprecated wext
	  API will be supported, with far less features.  Linux may
	  supports using wext with modern drivers using a
	  compatibility layer, but it must be enabled in the kernel
	  configuration.

comment "nl80211 support needs a toolchain w/ threads"
	depends on !BR2_TOOLCHAIN_HAS_THREADS

config BR2_PACKAGE_WPA_SUPPLICANT_AP_SUPPORT
	bool "Enable AP mode"
	depends on BR2_PACKAGE_WPA_SUPPLICANT_NL80211
	help
	  With this option enabled, wpa_supplicant can act as an
	  access point much like hostapd does with a limited feature set.
	  This links in parts of hostapd functionality into wpa_supplicant,
	  making it bigger but dispensing the need for a separate hostapd
	  binary in some applications hence being smaller overall.

config BR2_PACKAGE_WPA_SUPPLICANT_WIFI_DISPLAY
	bool "Enable Wi-Fi Display"
	depends on BR2_PACKAGE_WPA_SUPPLICANT_AP_SUPPORT
	help
	  Enable support for Wi-Fi Display

config BR2_PACKAGE_WPA_SUPPLICANT_MESH_NETWORKING
	bool "Enable mesh networking"
	depends on BR2_PACKAGE_WPA_SUPPLICANT_AP_SUPPORT
	help
	  Enable support for open and secured mesh networking
	  (IEEE 802.11s)

config BR2_PACKAGE_WPA_SUPPLICANT_AUTOSCAN
	bool "Enable autoscan"
	help
	  Enable support for the autoscan feature (allow periodic scan)

config BR2_PACKAGE_WPA_SUPPLICANT_EAP
	bool "Enable EAP"
	help
	  Enable support for EAP.

config BR2_PACKAGE_WPA_SUPPLICANT_HOTSPOT
	bool "Enable HS20"
	help
	  Enable Hotspot 2.0 and IEEE 802.11u interworking functionality.

config BR2_PACKAGE_WPA_SUPPLICANT_DEBUG_SYSLOG
	bool "Enable syslog support"
	help
	  Enable support for sending debug messages to syslog.

config BR2_PACKAGE_WPA_SUPPLICANT_WPS
	bool "Enable WPS"
	help
	  Enable support for Wi-Fi Protected Setup (WPS).

config BR2_PACKAGE_WPA_SUPPLICANT_CLI
	bool "Install wpa_cli binary"
	help
	  Install wpa_cli command line utility

config BR2_PACKAGE_WPA_SUPPLICANT_WPA_CLIENT_SO
	bool "Install wpa_client shared library"
	depends on !BR2_STATIC_LIBS
	help
	  Install libwpa_client.so.

comment "wpa_client library needs a toolchain w/ dynamic library"
	depends on BR2_STATIC_LIBS

config BR2_PACKAGE_WPA_SUPPLICANT_PASSPHRASE
	bool "Install wpa_passphrase binary"
	help
	  Install wpa_passphrase command line utility.

config BR2_PACKAGE_WPA_SUPPLICANT_DBUS_OLD
	bool "Enable support for old DBus control interface"
	depends on BR2_PACKAGE_DBUS
	help
	  Enable support for old DBus control interface
	  (fi.epitest.hostap.WPASupplicant).

config BR2_PACKAGE_WPA_SUPPLICANT_DBUS_NEW
	bool "Enable support for new DBus control interface"
	depends on BR2_PACKAGE_DBUS
	help
	  Enable support for new DBus control interface (fi.w1.wpa_supplicant1).

config BR2_PACKAGE_WPA_SUPPLICANT_DBUS_INTROSPECTION
	bool "Introspection support"
	depends on BR2_PACKAGE_WPA_SUPPLICANT_DBUS_NEW
	help
	  Add introspection support for new DBus control interface.

endif
```

## package/wpan-tools/Config.in
```kconfig
config BR2_PACKAGE_WPAN_TOOLS
	bool "wpan-tools"
	depends on BR2_TOOLCHAIN_HAS_THREADS
	select BR2_PACKAGE_LIBNL
	help
	  Userspace tools for Linux IEEE 802.15.4 stack.

	  http://wpan.cakelab.org/

comment "wpan-tools needs a toolchain w/ threads"
	depends on !BR2_TOOLCHAIN_HAS_THREADS
```

## package/wpebackend-fdo/Config.in
```kconfig
comment "wpebackend-fdo needs a toolchain w/ C++, wchar, threads, dynamic library and an OpenEGL-capable Wayland backend"
	depends on !BR2_PACKAGE_HAS_LIBEGL_WAYLAND || !BR2_INSTALL_LIBSTDCPP || !BR2_USE_WCHAR \
		|| !BR2_TOOLCHAIN_HAS_THREADS || BR2_STATIC_LIBS

config BR2_PACKAGE_WPEBACKEND_FDO
	bool "wpebackend-fdo"
	depends on !BR2_STATIC_LIBS # wayland
	depends on BR2_INSTALL_LIBSTDCPP
	depends on BR2_TOOLCHAIN_HAS_THREADS # wayland, libglib2
	depends on BR2_USE_WCHAR # libglib2
	depends on BR2_USE_MMU # libglib2
	depends on BR2_PACKAGE_HAS_LIBEGL_WAYLAND
	select BR2_PACKAGE_LIBGLIB2
	select BR2_PACKAGE_LIBWPE
	select BR2_PACKAGE_WAYLAND
	help
	  WPEBackend interface using freedesktop.org API.

	  https://wpewebkit.org/
```
