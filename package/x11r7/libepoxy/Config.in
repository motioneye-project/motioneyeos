## package/x11r7/libepoxy/Config.in
```kconfig
config BR2_PACKAGE_LIBEPOXY
	bool "epoxy"
	depends on BR2_PACKAGE_MESA3D
	help
	  Epoxy is a library for handling OpenGL function pointer management for you.

	  https://github.com/anholt/libepoxy
```

## package/x11r7/libxcb/Config.in
```kconfig
config BR2_PACKAGE_LIBXCB
	bool "libxcb"
	select BR2_PACKAGE_XCB_PROTO
	select BR2_PACKAGE_XLIB_LIBXDMCP
	select BR2_PACKAGE_XLIB_LIBXAU
	help
	  The X protocol C-language Binding (XCB) is a replacement for
	  Xlib featuring a small footprint, latency hiding, direct
	  access to the protocol, improved threading support, and
	  extensibility.

	  http://xcb.freedesktop.org/
```

## package/x11r7/mcookie/Config.in
```kconfig
config BR2_PACKAGE_MCOOKIE
	bool "mcookie"
	help
	  cookie generator for X server

	  http://www.x.org
```

## package/x11r7/mesa3d/Config.in
```kconfig
config BR2_PACKAGE_MESA3D
	bool "Mesa 3D Graphics Library"
	select BR2_PACKAGE_XPROTO_GLPROTO
	select BR2_PACKAGE_XLIB_LIBXXF86VM
	select BR2_PACKAGE_XLIB_LIBXDAMAGE
	select BR2_PACKAGE_XLIB_LIBXFIXES
	select BR2_PACKAGE_XPROTO_DRI2PROTO
	select BR2_PACKAGE_LIBDRM
	select BR2_PACKAGE_EXPAT
	select BR2_PACKAGE_HOST_LIBXML2_PYTHON
	depends on BR2_PACKAGE_XSERVER_XORG_SERVER_MODULAR
	depends on BR2_INSTALL_LIBSTDCPP
	help
	  Mesa 3D, an open-source implementation of the OpenGL specification.
```

## package/x11r7/pixman/Config.in
```kconfig
config BR2_PACKAGE_PIXMAN
	bool "pixman"
	default n
	help
		Cairo pixel manager

		http://cairographics.org/releases/
```

## package/x11r7/pthread-stubs/Config.in
```kconfig
config BR2_PACKAGE_PTHREAD_STUBS
	bool "pthread-stubs"
	help
	  This library provides weak aliases for pthread functions not
	  provided in libc or otherwise available by default.

	  http://xcb.freedesktop.org/
```

## package/x11r7/xapp_appres/Config.in
```kconfig
config BR2_PACKAGE_XAPP_APPRES
	bool "appres"
	select BR2_PACKAGE_XLIB_LIBX11
	select BR2_PACKAGE_XLIB_LIBXT
	help
	  list X application resource database
```

## package/x11r7/xapp_bdftopcf/Config.in
```kconfig
config BR2_PACKAGE_XAPP_BDFTOPCF
	bool "bdftopcf"
	select BR2_PACKAGE_XLIB_LIBXFONT
	help
	  X.Org bdftopcf application
```

## package/x11r7/xapp_beforelight/Config.in
```kconfig
config BR2_PACKAGE_XAPP_BEFORELIGHT
	bool "beforelight"
	select BR2_PACKAGE_XLIB_LIBX11
	select BR2_PACKAGE_XLIB_LIBXSCRNSAVER
	select BR2_PACKAGE_XLIB_LIBXAW
	select BR2_PACKAGE_XLIB_LIBXT
	help
	  screen saver
```

## package/x11r7/xapp_bitmap/Config.in
```kconfig
config BR2_PACKAGE_XAPP_BITMAP
	bool "bitmap"
	select BR2_PACKAGE_XLIB_LIBX11
	select BR2_PACKAGE_XLIB_LIBXAW
	select BR2_PACKAGE_XLIB_LIBXMU
	select BR2_PACKAGE_XDATA_XBITMAPS
	help
	  X.Org bitmap application
```

## package/x11r7/xapp_editres/Config.in
```kconfig
config BR2_PACKAGE_XAPP_EDITRES
	bool "editres"
	select BR2_PACKAGE_XLIB_LIBX11
	select BR2_PACKAGE_XLIB_LIBXAW
	select BR2_PACKAGE_XLIB_LIBXMU
	select BR2_PACKAGE_XLIB_LIBXT
	help
	  a dynamic resource editor for X Toolkit applications
```

## package/x11r7/xapp_fonttosfnt/Config.in
```kconfig
config BR2_PACKAGE_XAPP_FONTTOSFNT
	bool "fonttosfnt"
	select BR2_PACKAGE_FREETYPE
	select BR2_PACKAGE_XLIB_LIBX11
	select BR2_PACKAGE_XLIB_LIBFONTENC
	help
	  X.Org fonttosfnt application
```

## package/x11r7/xapp_fslsfonts/Config.in
```kconfig
config BR2_PACKAGE_XAPP_FSLSFONTS
	bool "fslsfonts"
	select BR2_PACKAGE_XLIB_LIBFS
	select BR2_PACKAGE_XLIB_LIBX11
	help
	  list fonts served by X font server
```

## package/x11r7/xapp_fstobdf/Config.in
```kconfig
config BR2_PACKAGE_XAPP_FSTOBDF
	bool "fstobdf"
	select BR2_PACKAGE_XLIB_LIBFS
	select BR2_PACKAGE_XLIB_LIBX11
	help
	  generate BDF font from X font server
```

## package/x11r7/xapp_iceauth/Config.in
```kconfig
config BR2_PACKAGE_XAPP_ICEAUTH
	bool "iceauth"
	select BR2_PACKAGE_XLIB_LIBICE
	select BR2_PACKAGE_XLIB_LIBX11
	help
	  ICE authority file utility
```

## package/x11r7/xapp_ico/Config.in
```kconfig
config BR2_PACKAGE_XAPP_ICO
	bool "ico"
	select BR2_PACKAGE_XLIB_LIBX11
	help
	  animate an icosahedron or other polyhedron
```

## package/x11r7/xapp_lbxproxy/Config.in
```kconfig
config BR2_PACKAGE_XAPP_LBXPROXY
	bool "lbxproxy"
	default n
	select BR2_PACKAGE_XLIB_LIBICE
	select BR2_PACKAGE_XLIB_LIBX11
	select BR2_PACKAGE_XLIB_LIBXEXT
	select BR2_PACKAGE_XLIB_LIBLBXUTIL
	select BR2_PACKAGE_XLIB_XTRANS
	select BR2_PACKAGE_XPROTO_XPROXYMANAGEMENTPROTOCOL
	help
	  lbxproxy 1.0.1
	  Low BandWidth X proxy
```

## package/x11r7/xapp_listres/Config.in
```kconfig
config BR2_PACKAGE_XAPP_LISTRES
	bool "listres"
	select BR2_PACKAGE_XLIB_LIBX11
	select BR2_PACKAGE_XLIB_LIBXAW
	select BR2_PACKAGE_XLIB_LIBXMU
	select BR2_PACKAGE_XLIB_LIBXT
	help
	  list resources in widgets
```

## package/x11r7/xapp_luit/Config.in
```kconfig
config BR2_PACKAGE_XAPP_LUIT
	bool "luit"
	depends on BR2_USE_MMU # fork()
	select BR2_PACKAGE_XLIB_LIBX11
	select BR2_PACKAGE_XLIB_LIBFONTENC
	help
	  Locale and ISO 2022 support for Unicode terminals
```

## package/x11r7/xapp_mkfontdir/Config.in
```kconfig
config BR2_PACKAGE_XAPP_MKFONTDIR
	bool "mkfontdir"
	select BR2_PACKAGE_XAPP_MKFONTSCALE
	help
	  create an index of X font files in a directory
```

## package/x11r7/xapp_mkfontscale/Config.in
```kconfig
config BR2_PACKAGE_XAPP_MKFONTSCALE
	bool "mkfontscale"
	select BR2_PACKAGE_FREETYPE
	select BR2_PACKAGE_XLIB_LIBX11
	select BR2_PACKAGE_XLIB_LIBFONTENC
	select BR2_PACKAGE_XORGPROTO
	select BR2_PACKAGE_ZLIB
	help
	  create an index of scalable font files for X
```

## package/x11r7/xapp_oclock/Config.in
```kconfig
config BR2_PACKAGE_XAPP_OCLOCK
	bool "oclock"
	select BR2_PACKAGE_XLIB_LIBX11
	select BR2_PACKAGE_XLIB_LIBXEXT
	select BR2_PACKAGE_XLIB_LIBXMU
	help
	  round X clock
```

## package/x11r7/xapp_proxymngr/Config.in
```kconfig
config BR2_PACKAGE_XAPP_PROXYMNGR
	bool "proxymngr"
	default n
	select BR2_PACKAGE_XLIB_LIBICE
	select BR2_PACKAGE_XLIB_LIBX11
	select BR2_PACKAGE_XLIB_LIBXT
	select BR2_PACKAGE_XPROTO_XPROXYMANAGEMENTPROTOCOL
	help
	  proxymngr 1.0.1
	  proxy manager service
```

## package/x11r7/xapp_rgb/Config.in
```kconfig
config BR2_PACKAGE_XAPP_RGB
	bool "rgb"
	select BR2_PACKAGE_XORGPROTO
	help
	  uncompile an rgb color-name database
```

## package/x11r7/xapp_rstart/Config.in
```kconfig
config BR2_PACKAGE_XAPP_RSTART
	bool "rstart"
	depends on BR2_USE_MMU # fork()
	select BR2_PACKAGE_XLIB_LIBX11
	help
	  X.Org rstart application
```
