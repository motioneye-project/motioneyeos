## package/x11r7/xapp_scripts/Config.in
```kconfig
config BR2_PACKAGE_XAPP_SCRIPTS
	bool "scripts"
	select BR2_PACKAGE_XLIB_LIBX11
	help
	  start an X program on a remote machine
```

## package/x11r7/xapp_sessreg/Config.in
```kconfig
config BR2_PACKAGE_XAPP_SESSREG
	bool "sessreg"
	select BR2_PACKAGE_XLIB_LIBX11
	select BR2_PACKAGE_XORGPROTO
	help
	  manage utmp/wtmp entries for non-init clients
```

## package/x11r7/xapp_setxkbmap/Config.in
```kconfig
config BR2_PACKAGE_XAPP_SETXKBMAP
	bool "setxkbmap"
	select BR2_PACKAGE_XLIB_LIBX11
	select BR2_PACKAGE_XLIB_LIBXKBFILE
	help
	  Controls the keyboard layout of a running X server.
```

## package/x11r7/xapp_showfont/Config.in
```kconfig
config BR2_PACKAGE_XAPP_SHOWFONT
	bool "showfont"
	select BR2_PACKAGE_XLIB_LIBFS
	help
	  font dumper for X font server
```

## package/x11r7/xapp_smproxy/Config.in
```kconfig
config BR2_PACKAGE_XAPP_SMPROXY
	bool "smproxy"
	default n
	select BR2_PACKAGE_XLIB_LIBXMU
	select BR2_PACKAGE_XLIB_LIBXT
	help
	  smproxy 1.0.2
	  Session Manager Proxy
```

## package/x11r7/xapp_viewres/Config.in
```kconfig
config BR2_PACKAGE_XAPP_VIEWRES
	bool "viewres"
	select BR2_PACKAGE_XLIB_LIBXAW
	help
	  graphical class browser for Xt
```

## package/x11r7/xapp_x11perf/Config.in
```kconfig
config BR2_PACKAGE_XAPP_X11PERF
	bool "x11perf"
	select BR2_PACKAGE_XLIB_LIBX11
	select BR2_PACKAGE_XLIB_LIBXMU
	select BR2_PACKAGE_XLIB_LIBXFT
	help
	  summarize x11perf results
```

## package/x11r7/xapp_xauth/Config.in
```kconfig
config BR2_PACKAGE_XAPP_XAUTH
	bool "xauth"
	select BR2_PACKAGE_XLIB_LIBX11
	select BR2_PACKAGE_XLIB_LIBXAU
	select BR2_PACKAGE_XLIB_LIBXEXT
	select BR2_PACKAGE_XLIB_LIBXMU
	help
	  X authority file utility
```

## package/x11r7/xapp_xbacklight/Config.in
```kconfig
config BR2_PACKAGE_XAPP_XBACKLIGHT
	bool "xbacklight"
	select BR2_PACKAGE_XCB_UTIL
	select BR2_PACKAGE_XLIB_LIBX11
	select BR2_PACKAGE_XLIB_LIBXRANDR
	select BR2_PACKAGE_XLIB_LIBXRENDER
	help
	  xbacklight
```

## package/x11r7/xapp_xbiff/Config.in
```kconfig
config BR2_PACKAGE_XAPP_XBIFF
	bool "xbiff"
	select BR2_PACKAGE_XLIB_LIBXAW
	select BR2_PACKAGE_XDATA_XBITMAPS
	help
	  mailbox flag for X
```

## package/x11r7/xapp_xcalc/Config.in
```kconfig
config BR2_PACKAGE_XAPP_XCALC
	bool "xcalc"
	select BR2_PACKAGE_XLIB_LIBXAW
	help
	  scientific calculator for X
```

## package/x11r7/xapp_xclipboard/Config.in
```kconfig
config BR2_PACKAGE_XAPP_XCLIPBOARD
	bool "xclipboard"
	select BR2_PACKAGE_XLIB_LIBXAW
	help
	  interchange between cut buffer and selection
```

## package/x11r7/xapp_xclock/Config.in
```kconfig
config BR2_PACKAGE_XAPP_XCLOCK
	bool "xclock"
	select BR2_PACKAGE_XLIB_LIBX11
	select BR2_PACKAGE_XLIB_LIBXAW
	select BR2_PACKAGE_XLIB_LIBXFT
	select BR2_PACKAGE_XLIB_LIBXRENDER
	select BR2_PACKAGE_XLIB_LIBXKBFILE
	help
	  analog / digital clock for X
```

## package/x11r7/xapp_xcmsdb/Config.in
```kconfig
config BR2_PACKAGE_XAPP_XCMSDB
	bool "xcmsdb"
	select BR2_PACKAGE_XLIB_LIBX11
	help
	  Device Color Characterization utility for X Color Management System
```

## package/x11r7/xapp_xcompmgr/Config.in
```kconfig
config BR2_PACKAGE_XAPP_XCOMPMGR
	bool "xcompmgr"
	select BR2_PACKAGE_XLIB_LIBXCOMPOSITE
	select BR2_PACKAGE_XLIB_LIBXDAMAGE
	select BR2_PACKAGE_XLIB_LIBXEXT
	select BR2_PACKAGE_XLIB_LIBXFIXES
	select BR2_PACKAGE_XLIB_LIBXRENDER
	help
	  xcompmgr is a sample compositing manager that enables basic
	  eye-candy effects.
```

## package/x11r7/xapp_xconsole/Config.in
```kconfig
config BR2_PACKAGE_XAPP_XCONSOLE
	bool "xconsole"
	depends on BR2_USE_MMU # fork()
	select BR2_PACKAGE_XLIB_LIBX11
	select BR2_PACKAGE_XLIB_LIBXAW
	select BR2_PACKAGE_XLIB_LIBXT
	select BR2_PACKAGE_XPROTO_XPROTO
	select BR2_PACKAGE_XLIB_LIBXMU
	help
	  xconsole - monitor system console messages with X
```

## package/x11r7/xapp_xcursorgen/Config.in
```kconfig
config BR2_PACKAGE_XAPP_XCURSORGEN
	bool "xcursorgen"
	select BR2_PACKAGE_LIBPNG
	select BR2_PACKAGE_XLIB_LIBX11
	select BR2_PACKAGE_XLIB_LIBXCURSOR
	help
	  create an X cursor file from a collection of PNG images
```

## package/x11r7/xapp_xdbedizzy/Config.in
```kconfig
config BR2_PACKAGE_XAPP_XDBEDIZZY
	bool "xdbedizzy"
	select BR2_PACKAGE_XLIB_LIBXEXT
	help
	  X.Org xdbedizzy application
```

## package/x11r7/xapp_xditview/Config.in
```kconfig
config BR2_PACKAGE_XAPP_XDITVIEW
	bool "xditview"
	select BR2_PACKAGE_XLIB_LIBXAW
	help
	  display ditroff output
```

## package/x11r7/xapp_xdm/Config.in
```kconfig
config BR2_PACKAGE_XAPP_XDM
	bool "xdm"
	depends on BR2_USE_MMU # fork()
	# Runtime dependency: can't start an X server unless there is one
	depends on BR2_PACKAGE_XSERVER_XORG_SERVER
	select BR2_PACKAGE_XAPP_SESSREG
	select BR2_PACKAGE_XAPP_XRDB
	select BR2_PACKAGE_XLIB_LIBX11
	select BR2_PACKAGE_XLIB_LIBXAW
	select BR2_PACKAGE_XLIB_LIBXDMCP
	select BR2_PACKAGE_XLIB_LIBXINERAMA
	select BR2_PACKAGE_XLIB_LIBXT
	select BR2_PACKAGE_XPROTO_XINERAMAPROTO
	select BR2_PACKAGE_XPROTO_XPROTO
	help
	  X.Org xdm application
```

## package/x11r7/xapp_xdpyinfo/Config.in
```kconfig
config BR2_PACKAGE_XAPP_XDPYINFO
	bool "xdpyinfo"
	depends on BR2_USE_MMU # fork()
	select BR2_PACKAGE_XLIB_LIBX11
	select BR2_PACKAGE_XLIB_LIBXEXT
	select BR2_PACKAGE_XLIB_LIBXTST
	help
	  display information utility for X
```

## package/x11r7/xapp_xdriinfo/Config.in
```kconfig
config BR2_PACKAGE_XAPP_XDRIINFO
	bool "xdriinfo"
	depends on BR2_PACKAGE_HAS_LIBGL
	select BR2_PACKAGE_XLIB_LIBX11
	select BR2_PACKAGE_XORGPROTO
	help
	  query configuration information of DRI drivers

comment "xdriinfo needs an OpenGL backend"
	depends on !BR2_PACKAGE_HAS_LIBGL
```

## package/x11r7/xapp_xedit/Config.in
```kconfig
config BR2_PACKAGE_XAPP_XEDIT
	bool "xedit"
	depends on BR2_USE_MMU # fork()
	select BR2_PACKAGE_XLIB_LIBXAW
	help
	  simple text editor for X
```

## package/x11r7/xapp_xev/Config.in
```kconfig
config BR2_PACKAGE_XAPP_XEV
	bool "xev"
	select BR2_PACKAGE_XLIB_LIBX11
	help
	  xev 1.0.1
	  print contents of X events
```
