## package/x11r7/xapp_xeyes/Config.in
```kconfig
config BR2_PACKAGE_XAPP_XEYES
	bool "xeyes"
	select BR2_PACKAGE_XLIB_LIBX11
	select BR2_PACKAGE_XLIB_LIBXEXT
	select BR2_PACKAGE_XLIB_LIBXMU
	select BR2_PACKAGE_XLIB_LIBXT
	help
	  X.Org xeyes application
```

## package/x11r7/xapp_xf86dga/Config.in
```kconfig
config BR2_PACKAGE_XAPP_XF86DGA
	bool "xf86dga"
	depends on BR2_USE_MMU # fork()
	select BR2_PACKAGE_XLIB_LIBX11
	select BR2_PACKAGE_XLIB_LIBXXF86DGA
	help
	  test program for the XFree86-DGA extension
```

## package/x11r7/xapp_xfd/Config.in
```kconfig
config BR2_PACKAGE_XAPP_XFD
	bool "xfd"
	select BR2_PACKAGE_FREETYPE
	select BR2_PACKAGE_FONTCONFIG
	select BR2_PACKAGE_XLIB_LIBXAW
	select BR2_PACKAGE_XLIB_LIBXFT
	help
	  X.Org xfd application
```

## package/x11r7/xapp_xfindproxy/Config.in
```kconfig
config BR2_PACKAGE_XAPP_XFINDPROXY
	bool "xfindproxy"
	select BR2_PACKAGE_XLIB_LIBICE
	select BR2_PACKAGE_XLIB_LIBXT
	select BR2_PACKAGE_XORGPROTO
	help
	  xfindproxy utilizes the Proxy Management Protocol to
	  communicate with a proxy manager to locate available X11
	  proxy services.
```

## package/x11r7/xapp_xfontsel/Config.in
```kconfig
config BR2_PACKAGE_XAPP_XFONTSEL
	bool "xfontsel"
	select BR2_PACKAGE_XLIB_LIBXAW
	help
	  point and click selection of X11 font names
```

## package/x11r7/xapp_xfs/Config.in
```kconfig
config BR2_PACKAGE_XAPP_XFS
	bool "xfs"
	depends on BR2_USE_MMU # fork()
	select BR2_PACKAGE_XLIB_LIBFS
	select BR2_PACKAGE_XLIB_LIBXFONT2
	select BR2_PACKAGE_XPROTO_FONTSPROTO
	help
	  X font server
```

## package/x11r7/xapp_xfsinfo/Config.in
```kconfig
config BR2_PACKAGE_XAPP_XFSINFO
	bool "xfsinfo"
	default n
	select BR2_PACKAGE_XLIB_LIBFS
	select BR2_PACKAGE_XLIB_LIBX11
	help
	  xfsinfo 1.0.1
	  X font server information utility
```

## package/x11r7/xapp_xfwp/Config.in
```kconfig
config BR2_PACKAGE_XAPP_XFWP
	bool "xfwp"
	default n
	select BR2_PACKAGE_XLIB_LIBICE
	select BR2_PACKAGE_XLIB_LIBX11
	select BR2_PACKAGE_XPROTO_XPROXYMANAGEMENTPROTOCOL
	help
	  xfwp 1.0.1
	  X.Org xfwp application
```

## package/x11r7/xapp_xgamma/Config.in
```kconfig
config BR2_PACKAGE_XAPP_XGAMMA
	bool "xgamma"
	select BR2_PACKAGE_XLIB_LIBXXF86VM
	help
	  Alter a monitor's gamma correction through the X server
```

## package/x11r7/xapp_xgc/Config.in
```kconfig
config BR2_PACKAGE_XAPP_XGC
	bool "xgc"
	select BR2_PACKAGE_XLIB_LIBXAW
	help
	  X graphics demo
```

## package/x11r7/xapp_xhost/Config.in
```kconfig
config BR2_PACKAGE_XAPP_XHOST
	bool "xhost"
	select BR2_PACKAGE_XLIB_LIBX11
	select BR2_PACKAGE_XLIB_LIBXMU
	help
	  Controls host and/or user access to a running X server.
```

## package/x11r7/xapp_xinit/Config.in
```kconfig
config BR2_PACKAGE_XAPP_XINIT
	bool "xinit"
	depends on BR2_USE_MMU # fork()
	# Runtime dependency: can't start an X server unless there is one
	depends on BR2_PACKAGE_XSERVER_XORG_SERVER
	# Runtime dependency; mcookie is also in util-linux
	select BR2_PACKAGE_MCOOKIE if !BR2_PACKAGE_UTIL_LINUX
	select BR2_PACKAGE_XAPP_XAUTH
	select BR2_PACKAGE_XLIB_LIBX11
	help
	  X Window System initializer
```

## package/x11r7/xapp_xinput-calibrator/Config.in
```kconfig
config BR2_PACKAGE_XAPP_XINPUT_CALIBRATOR
	bool "xinput-calibrator"
	depends on BR2_INSTALL_LIBSTDCPP
	select BR2_PACKAGE_XLIB_LIBX11
	select BR2_PACKAGE_XLIB_LIBXI
	help
	  A generic touchscreen calibration program for X.Org.

	  http://www.freedesktop.org/wiki/Software/xinput_calibrator

comment "xinput-calibrator needs a toolchain w/ C++"
	depends on !BR2_INSTALL_LIBSTDCPP
```

## package/x11r7/xapp_xinput/Config.in
```kconfig
config BR2_PACKAGE_XAPP_XINPUT
	bool "xinput"
	select BR2_PACKAGE_XLIB_LIBX11
	select BR2_PACKAGE_XLIB_LIBXI
	select BR2_PACKAGE_XLIB_LIBXRANDR
	select BR2_PACKAGE_XLIB_LIBXINERAMA
	help
	  xinput
```

## package/x11r7/xapp_xinput_calibrator/Config.in
```kconfig
config BR2_PACKAGE_XAPP_XINPUT_CALIBRATOR
	bool "xinput-calibrator"
	select BR2_PACKAGE_XLIB_LIBX11
	select BR2_PACKAGE_XLIB_LIBXI
	help
	  A generic touchscreen calibration program for X.Org.

	  http://www.freedesktop.org/wiki/Software/xinput_calibrator
```

## package/x11r7/xapp_xkbcomp/Config.in
```kconfig
config BR2_PACKAGE_XAPP_XKBCOMP
	bool "xkbcomp"
	select BR2_PACKAGE_XLIB_LIBX11
	select BR2_PACKAGE_XLIB_LIBXKBFILE
	help
	  compile XKB keyboard description
```

## package/x11r7/xapp_xkbevd/Config.in
```kconfig
config BR2_PACKAGE_XAPP_XKBEVD
	bool "xkbevd"
	depends on BR2_USE_MMU # fork()
	select BR2_PACKAGE_XLIB_LIBXKBFILE
	help
	  XKB event daemon
```

## package/x11r7/xapp_xkbprint/Config.in
```kconfig
config BR2_PACKAGE_XAPP_XKBPRINT
	bool "xkbprint"
	select BR2_PACKAGE_XLIB_LIBXKBFILE
	help
	  print an XKB keyboard description
```

## package/x11r7/xapp_xkbutils/Config.in
```kconfig
config BR2_PACKAGE_XAPP_XKBUTILS
	bool "xkbutils"
	select BR2_PACKAGE_XLIB_LIBXAW
	select BR2_PACKAGE_XLIB_LIBXKBFILE
	help
	  xkbutils 1.0.1
	  X.Org xkbutils application
```

## package/x11r7/xapp_xkill/Config.in
```kconfig
config BR2_PACKAGE_XAPP_XKILL
	bool "xkill"
	select BR2_PACKAGE_XLIB_LIBX11
	select BR2_PACKAGE_XLIB_LIBXMU
	help
	  kill a client by its X resource
```

## package/x11r7/xapp_xload/Config.in
```kconfig
config BR2_PACKAGE_XAPP_XLOAD
	bool "xload"
	select BR2_PACKAGE_XLIB_LIBXAW
	help
	  system load average display for X
```

## package/x11r7/xapp_xlogo/Config.in
```kconfig
config BR2_PACKAGE_XAPP_XLOGO
	bool "xlogo"
	select BR2_PACKAGE_XLIB_LIBXAW
	select BR2_PACKAGE_XLIB_LIBXRENDER
	select BR2_PACKAGE_XLIB_LIBXFT
	help
	  X Window System logo
```

## package/x11r7/xapp_xlsatoms/Config.in
```kconfig
config BR2_PACKAGE_XAPP_XLSATOMS
	bool "xlsatoms"
	select BR2_PACKAGE_XLIB_LIBX11
	select BR2_PACKAGE_XLIB_LIBXMU
	help
	  list interned atoms defined on server
```

## package/x11r7/xapp_xlsclients/Config.in
```kconfig
config BR2_PACKAGE_XAPP_XLSCLIENTS
	bool "xlsclients"
	select BR2_PACKAGE_XLIB_LIBX11
	select BR2_PACKAGE_XLIB_LIBXMU
	help
	  X.Org xlsclients application
```

## package/x11r7/xapp_xlsfonts/Config.in
```kconfig
config BR2_PACKAGE_XAPP_XLSFONTS
	bool "xlsfonts"
	select BR2_PACKAGE_XLIB_LIBX11
	help
	  xlsfonts 1.0.1
	  X.Org xlsfonts application
```
