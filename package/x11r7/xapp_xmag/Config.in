## package/x11r7/xapp_xmag/Config.in
```kconfig
config BR2_PACKAGE_XAPP_XMAG
	bool "xmag"
	select BR2_PACKAGE_XLIB_LIBXAW
	help
	  X.Org xmag application
```

## package/x11r7/xapp_xman/Config.in
```kconfig
config BR2_PACKAGE_XAPP_XMAN
	bool "xman"
	select BR2_PACKAGE_XLIB_LIBXAW
	help
	  Manual page display program for the X Window System
```

## package/x11r7/xapp_xmessage/Config.in
```kconfig
config BR2_PACKAGE_XAPP_XMESSAGE
	bool "xmessage"
	select BR2_PACKAGE_XLIB_LIBXAW
	help
	  display a message or query in a window (X-based /bin/echo)
```

## package/x11r7/xapp_xmh/Config.in
```kconfig
config BR2_PACKAGE_XAPP_XMH
	bool "xmh"
	select BR2_PACKAGE_XLIB_LIBXAW
	select BR2_PACKAGE_XDATA_XBITMAPS
	help
	  send and read mail with an X interface to MH
```

## package/x11r7/xapp_xmodmap/Config.in
```kconfig
config BR2_PACKAGE_XAPP_XMODMAP
	bool "xmodmap"
	select BR2_PACKAGE_XLIB_LIBX11
	help
	  utility for modifying keymaps and pointer button mappings in X
```

## package/x11r7/xapp_xmore/Config.in
```kconfig
config BR2_PACKAGE_XAPP_XMORE
	bool "xmore"
	select BR2_PACKAGE_XLIB_LIBXPRINTUTIL
	select BR2_PACKAGE_XLIB_LIBXAW
	help
	  plain text display program for the X Window System
```

## package/x11r7/xapp_xphelloworld/Config.in
```kconfig
config BR2_PACKAGE_XAPP_XPHELLOWORLD
	bool "xphelloworld"
	select BR2_PACKAGE_XLIB_LIBXAW
	select BR2_PACKAGE_XLIB_LIBXPRINTAPPUTIL
	select BR2_PACKAGE_XLIB_LIBXPRINTUTIL
	select BR2_PACKAGE_XLIB_LIBXT
	help
	  xphelloworld 1.0.1
	  X.Org xphelloworld application
```

## package/x11r7/xapp_xplsprinters/Config.in
```kconfig
config BR2_PACKAGE_XAPP_XPLSPRINTERS
	bool "xplsprinters"
	select BR2_PACKAGE_XLIB_LIBX11
	select BR2_PACKAGE_XLIB_LIBXP
	select BR2_PACKAGE_XLIB_LIBXPRINTUTIL
	help
	  shows a list of Xprint printers and it's attributes
```

## package/x11r7/xapp_xpr/Config.in
```kconfig
config BR2_PACKAGE_XAPP_XPR
	bool "xpr"
	select BR2_PACKAGE_XLIB_LIBX11
	select BR2_PACKAGE_XLIB_LIBXMU
	help
	  X.Org xpr application
```

## package/x11r7/xapp_xprehashprinterlist/Config.in
```kconfig
config BR2_PACKAGE_XAPP_XPREHASHPRINTERLIST
	bool "xprehashprinterlist"
	select BR2_PACKAGE_XLIB_LIBX11
	select BR2_PACKAGE_XLIB_LIBXP
	help
	  Recomputes the list of available printers.
```

## package/x11r7/xapp_xprop/Config.in
```kconfig
config BR2_PACKAGE_XAPP_XPROP
	bool "xprop"
	select BR2_PACKAGE_XLIB_LIBX11
	select BR2_PACKAGE_XLIB_LIBXMU
	help
	  xprop 1.1.0
	  property displayer for X
```

## package/x11r7/xapp_xrandr/Config.in
```kconfig
config BR2_PACKAGE_XAPP_XRANDR
	bool "xrandr"
	select BR2_PACKAGE_XLIB_LIBXRANDR
	select BR2_PACKAGE_XLIB_LIBX11
	help
	  xrandr 1.0.2
	  primitive command line interface to RandR extension
```

## package/x11r7/xapp_xrdb/Config.in
```kconfig
config BR2_PACKAGE_XAPP_XRDB
	bool "xrdb"
	default n
	select BR2_PACKAGE_XLIB_LIBX11
	select BR2_PACKAGE_XLIB_LIBXMU
	help
	  xrdb 1.0.2
	  X server resource database utility
```

## package/x11r7/xapp_xrefresh/Config.in
```kconfig
config BR2_PACKAGE_XAPP_XREFRESH
	bool "xrefresh"
	select BR2_PACKAGE_XLIB_LIBX11
	help
	  refresh all or part of an X screen
```

## package/x11r7/xapp_xrx/Config.in
```kconfig
config BR2_PACKAGE_XAPP_XRX
	bool "xrx"
	default n
	select BR2_PACKAGE_XLIB_LIBX11
	select BR2_PACKAGE_XLIB_LIBXEXT
	select BR2_PACKAGE_XLIB_LIBXT
	help
	  xrx 1.0.1
	  X.Org xrx application
```

## package/x11r7/xapp_xset/Config.in
```kconfig
config BR2_PACKAGE_XAPP_XSET
	bool "xset"
	select BR2_PACKAGE_XLIB_LIBXFONTCACHE
	select BR2_PACKAGE_XLIB_LIBXMU
	help
	  X.Org xset application
```

## package/x11r7/xapp_xsetmode/Config.in
```kconfig
config BR2_PACKAGE_XAPP_XSETMODE
	bool "xsetmode"
	select BR2_PACKAGE_XLIB_LIBX11
	select BR2_PACKAGE_XLIB_LIBXI
	help
	  set the mode for an X Input device
```

## package/x11r7/xapp_xsetpointer/Config.in
```kconfig
config BR2_PACKAGE_XAPP_XSETPOINTER
	bool "xsetpointer"
	select BR2_PACKAGE_XLIB_LIBX11
	select BR2_PACKAGE_XLIB_LIBXI
	select BR2_PACKAGE_XORGPROTO
	help
	  set an X Input device as the main pointer
```

## package/x11r7/xapp_xsetroot/Config.in
```kconfig
config BR2_PACKAGE_XAPP_XSETROOT
	bool "xsetroot"
	select BR2_PACKAGE_XLIB_LIBX11
	select BR2_PACKAGE_XLIB_LIBXMU
	select BR2_PACKAGE_XDATA_XBITMAPS
	help
	  X.Org xsetroot application
```

## package/x11r7/xapp_xsm/Config.in
```kconfig
config BR2_PACKAGE_XAPP_XSM
	bool "xsm"
	select BR2_PACKAGE_XLIB_LIBXAW
	help
	  X Session Manager
```

## package/x11r7/xapp_xstdcmap/Config.in
```kconfig
config BR2_PACKAGE_XAPP_XSTDCMAP
	bool "xstdcmap"
	select BR2_PACKAGE_XLIB_LIBX11
	select BR2_PACKAGE_XLIB_LIBXMU
	help
	  X standard colormap utility
```

## package/x11r7/xapp_xtrap/Config.in
```kconfig
config BR2_PACKAGE_XAPP_XTRAP
	bool "xtrap"
	select BR2_PACKAGE_XLIB_LIBX11
	select BR2_PACKAGE_XLIB_LIBXTRAP
	help
	  xtrap 1.0.2
	  X.Org xtrap application
```

## package/x11r7/xapp_xvidtune/Config.in
```kconfig
config BR2_PACKAGE_XAPP_XVIDTUNE
	bool "xvidtune"
	select BR2_PACKAGE_XLIB_LIBXAW
	select BR2_PACKAGE_XLIB_LIBXXF86VM
	help
	  xvidtune 1.0.1
	  video mode tuner for Xorg
```

## package/x11r7/xapp_xvinfo/Config.in
```kconfig
config BR2_PACKAGE_XAPP_XVINFO
	bool "xvinfo"
	select BR2_PACKAGE_XLIB_LIBX11
	select BR2_PACKAGE_XLIB_LIBXV
	help
	  Print out X-Video extension adaptor information
```

## package/x11r7/xapp_xwd/Config.in
```kconfig
config BR2_PACKAGE_XAPP_XWD
	bool "xwd"
	select BR2_PACKAGE_XLIB_LIBX11
	select BR2_PACKAGE_XLIB_LIBXMU
	help
	  xwd 1.0.1
	  dump an image of an X window
```
