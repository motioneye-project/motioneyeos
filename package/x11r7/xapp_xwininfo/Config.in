## package/x11r7/xapp_xwininfo/Config.in
```kconfig
config BR2_PACKAGE_XAPP_XWININFO
	bool "xwininfo"
	select BR2_PACKAGE_XLIB_LIBX11
	select BR2_PACKAGE_XLIB_LIBXMU
	help
	  window information utility for X
```

## package/x11r7/xapp_xwud/Config.in
```kconfig
config BR2_PACKAGE_XAPP_XWUD
	bool "xwud"
	select BR2_PACKAGE_XLIB_LIBX11
	help
	  xwud 1.0.1
	  image displayer for X
```

## package/x11r7/xcb-proto/Config.in
```kconfig
config BR2_PACKAGE_XCB_PROTO
	bool "xcb-proto"
	help
	  The protocol headers that define XCB.

	  http://xcb.freedesktop.org/
```

## package/x11r7/xcb-util-cursor/Config.in
```kconfig
config BR2_PACKAGE_XCB_UTIL_CURSOR
	bool "xcb-util-cursor"
	select BR2_PACKAGE_XCB_UTIL
	select BR2_PACKAGE_XCB_UTIL_IMAGE
	select BR2_PACKAGE_XCB_UTIL_RENDERUTIL
	depends on BR2_PACKAGE_LIBXCB
	help
	  The XCB util modules provides a number of libraries which
	  sit on top of libxcb, the core X protocol library, and some
	  of the extension libraries. These experimental libraries
	  provide convenience functions and interfaces which make the
	  raw X protocol more usable. Some of the libraries also
	  provide client-side code which is not strictly part of the X
	  protocol but which have traditionally been provided by Xlib.

	  XCB util-cursor module provides the following libraries:
	    - cursor: port of libxcursor

	  http://xcb.freedesktop.org/
```

## package/x11r7/xcb-util-image/Config.in
```kconfig
config BR2_PACKAGE_XCB_UTIL_IMAGE
	bool "xcb-util-image"
	select BR2_PACKAGE_XCB_UTIL
	help

	  The XCB util modules provides a number of libraries which
	  sit on top of libxcb, the core X protocol library, and some
	  of the extension libraries. These experimental libraries
	  provide convenience functions and interfaces which make the
	  raw X protocol more usable. Some of the libraries also
	  provide client-side code which is not strictly part of the X
	  protocol but which have traditionally been provided by Xlib.

	  XCB util-image module provides the following library:
	    - image: Port of Xlib's XImage and XShmImage functions.

	  http://xcb.freedesktop.org/
```

## package/x11r7/xcb-util-keysyms/Config.in
```kconfig
config BR2_PACKAGE_XCB_UTIL_KEYSYMS
	bool "xcb-util-keysyms"
	select BR2_PACKAGE_LIBXCB
	help
	  The XCB util modules provides a number of libraries which
	  sit on top of libxcb, the core X protocol library, and some
	  of the extension libraries. These experimental libraries
	  provide convenience functions and interfaces which make the
	  raw X protocol more usable. Some of the libraries also
	  provide client-side code which is not strictly part of the X
	  protocol but which have traditionally been provided by Xlib.

	  XCB util-keysyms module provides the following library:
	  keysyms: Standard X key constants and conversion to/from
	  keycodes.

	  http://xcb.freedesktop.org/
```

## package/x11r7/xcb-util-renderutil/Config.in
```kconfig
config BR2_PACKAGE_XCB_UTIL_RENDERUTIL
	bool "xcb-util-renderutil"
	depends on BR2_PACKAGE_LIBXCB # xcb-util
	select BR2_PACKAGE_XCB_UTIL
	help
	  The XCB util modules provides a number of libraries which
	  sit on top of libxcb, the core X protocol library, and some
	  of the extension libraries. These experimental libraries
	  provide convenience functions and interfaces which make the
	  raw X protocol more usable. Some of the libraries also
	  provide client-side code which is not strictly part of the X
	  protocol but which have traditionally been provided by Xlib.

	  XCB util-renderutil module provides the following library:
	    - renderutil: Convenience functions for the Render
	      extension.

	  http://xcb.freedesktop.org/
```

## package/x11r7/xcb-util-wm/Config.in
```kconfig
config BR2_PACKAGE_XCB_UTIL_WM
	bool "xcb-util-wm"
	select BR2_PACKAGE_LIBXCB
	help
	  The XCB util modules provides a number of libraries which
	  sit on top of libxcb, the core X protocol library, and some
	  of the extension libraries. These experimental libraries
	  provide convenience functions and interfaces which make the
	  raw X protocol more usable. Some of the libraries also
	  provide client-side code which is not strictly part of the X
	  protocol but which have traditionally been provided by Xlib.

	  XCB util-wm module provides the following libraries:
	    - ewmh: Both client and window-manager helpers for EWMH.
	    - icccm: Both client and window-manager helpers for ICCCM.

	  http://xcb.freedesktop.org/
```

## package/x11r7/xcb-util/Config.in
```kconfig
config BR2_PACKAGE_XCB_UTIL
	bool "xcb-util"
	help
	  Libraries which sit on top of libxcb, the core X protocol library,
	  and some of the extension libraries.

	  http://xcb.freedesktop.org/
```

## package/x11r7/xcursor-transparent-theme/Config.in
```kconfig
config BR2_PACKAGE_XCURSOR_TRANSPARENT_THEME
	bool "xcursor-transparent-theme"
	select BR2_PACKAGE_XLIB_LIBXCURSOR
	help
	  Completely transparent theme for hiding the X11 cursor.

	  No upstream site.
```

## package/x11r7/xdata_xbitmaps/Config.in
```kconfig
config BR2_PACKAGE_XDATA_XBITMAPS
	bool "xbitmaps"
	help
	  No description available
```

## package/x11r7/xdata_xcursor-themes/Config.in
```kconfig
config BR2_PACKAGE_XDATA_XCURSOR_THEMES
	bool "xdata_xcursor-themes"
	select BR2_PACKAGE_XLIB_LIBXCURSOR
	help
	  No description available
```

## package/x11r7/xdata_xkbdata/Config.in
```kconfig
config BR2_PACKAGE_XDATA_XKBDATA
	bool "xkbdata"
	default n
	depends on !BR2_PACKAGE_XKEYBOARD_CONFIG
	help
	  xkbdata 1.0.1
	  No description available
```

## package/x11r7/xdriver_xf86-input-acecad/Config.in
```kconfig
config BR2_PACKAGE_XDRIVER_XF86_INPUT_ACECAD
	bool "xf86-input-acecad"
	select BR2_PACKAGE_XSERVER_XORG_SERVER
	select BR2_PACKAGE_XPROTO_INPUTPROTO
	select BR2_PACKAGE_XPROTO_RANDRPROTO
	select BR2_PACKAGE_XPROTO_XPROTO
	help
	  Acecad Flair input driver
```

## package/x11r7/xdriver_xf86-input-aiptek/Config.in
```kconfig
config BR2_PACKAGE_XDRIVER_XF86_INPUT_AIPTEK
	bool "xf86-input-aiptek"
	select BR2_PACKAGE_XSERVER_XORG_SERVER
	select BR2_PACKAGE_XPROTO_INPUTPROTO
	select BR2_PACKAGE_XPROTO_RANDRPROTO
	select BR2_PACKAGE_XPROTO_XPROTO
	help
	  Aiptek USB Digital Tablet Input Driver for Linux
```

## package/x11r7/xdriver_xf86-input-calcomp/Config.in
```kconfig
config BR2_PACKAGE_XDRIVER_XF86_INPUT_CALCOMP
	bool "xf86-input-calcomp"
	select BR2_PACKAGE_XSERVER_XORG_SERVER
	select BR2_PACKAGE_XPROTO_INPUTPROTO
	select BR2_PACKAGE_XPROTO_RANDRPROTO
	select BR2_PACKAGE_XPROTO_XPROTO
	help
	  xf86-input-calcomp 1.1.0
	  Calcomp input driver
```

## package/x11r7/xdriver_xf86-input-citron/Config.in
```kconfig
config BR2_PACKAGE_XDRIVER_XF86_INPUT_CITRON
	bool "xf86-input-citron"
	select BR2_PACKAGE_XSERVER_XORG_SERVER
	select BR2_PACKAGE_XPROTO_INPUTPROTO
	select BR2_PACKAGE_XPROTO_RANDRPROTO
	select BR2_PACKAGE_XPROTO_XPROTO
	help
	  xf86-input-citron 2.2.0
	  X.Org driver for citron input devices
```

## package/x11r7/xdriver_xf86-input-digitaledge/Config.in
```kconfig
config BR2_PACKAGE_XDRIVER_XF86_INPUT_DIGITALEDGE
	bool "xf86-input-digitaledge"
	default n
	select BR2_PACKAGE_XSERVER_XORG_SERVER
	select BR2_PACKAGE_XPROTO_INPUTPROTO
	select BR2_PACKAGE_XPROTO_RANDRPROTO
	select BR2_PACKAGE_XPROTO_XPROTO
	help
	  xf86-input-digitaledge 1.1.0
	  X.Org driver for digitaledge input devices
```

## package/x11r7/xdriver_xf86-input-dmc/Config.in
```kconfig
config BR2_PACKAGE_XDRIVER_XF86_INPUT_DMC
	bool "xf86-input-dmc"
	select BR2_PACKAGE_XSERVER_XORG_SERVER
	select BR2_PACKAGE_XPROTO_INPUTPROTO
	select BR2_PACKAGE_XPROTO_RANDRPROTO
	select BR2_PACKAGE_XPROTO_XPROTO
	help
	  xf86-input-dmc 1.1.0
	  DMC input driver
```

## package/x11r7/xdriver_xf86-input-dynapro/Config.in
```kconfig
config BR2_PACKAGE_XDRIVER_XF86_INPUT_DYNAPRO
	bool "xf86-input-dynapro"
	select BR2_PACKAGE_XSERVER_XORG_SERVER
	select BR2_PACKAGE_XPROTO_INPUTPROTO
	select BR2_PACKAGE_XPROTO_RANDRPROTO
	select BR2_PACKAGE_XPROTO_XPROTO
	help
	  xf86-input-dynapro 1.1.0
	  Dynapro input driver
```

## package/x11r7/xdriver_xf86-input-elo2300/Config.in
```kconfig
config BR2_PACKAGE_XDRIVER_XF86_INPUT_ELO2300
	bool "xf86-input-elo2300"
	select BR2_PACKAGE_XSERVER_XORG_SERVER
	select BR2_PACKAGE_XPROTO_INPUTPROTO
	select BR2_PACKAGE_XPROTO_RANDRPROTO
	select BR2_PACKAGE_XPROTO_XPROTO
	help
	  xf86-input-elo2300 1.1.0
	  X.Org driver for elo2300 input devices
```

## package/x11r7/xdriver_xf86-input-evdev/Config.in
```kconfig
config BR2_PACKAGE_XDRIVER_XF86_INPUT_EVDEV
	bool "xf86-input-evdev"
	depends on BR2_PACKAGE_HAS_UDEV # libudev is configure dependency
	select BR2_PACKAGE_LIBEVDEV
	select BR2_PACKAGE_MTDEV
	select BR2_PACKAGE_XORGPROTO
	help
	  Generic Linux input driver

comment "xf86-input-evdev requires udev to be enabled"
	depends on !BR2_PACKAGE_HAS_UDEV
```

## package/x11r7/xdriver_xf86-input-hyperpen/Config.in
```kconfig
config BR2_PACKAGE_XDRIVER_XF86_INPUT_HYPERPEN
	bool "xf86-input-hyperpen"
	select BR2_PACKAGE_XSERVER_XORG_SERVER
	select BR2_PACKAGE_XPROTO_INPUTPROTO
	select BR2_PACKAGE_XPROTO_RANDRPROTO
	select BR2_PACKAGE_XPROTO_XPROTO
	help
	  xf86-input-hyperpen 1.1.0
	  X.Org driver for hyperpen input devices
```

## package/x11r7/xdriver_xf86-input-jamstudio/Config.in
```kconfig
config BR2_PACKAGE_XDRIVER_XF86_INPUT_JAMSTUDIO
	bool "xf86-input-jamstudio"
	select BR2_PACKAGE_XSERVER_XORG_SERVER
	select BR2_PACKAGE_XPROTO_INPUTPROTO
	select BR2_PACKAGE_XPROTO_RANDRPROTO
	select BR2_PACKAGE_XPROTO_XPROTO
	help
	  xf86-input-jamstudio 1.1.0
	  X.Org driver for jamstudio input devices
```

## package/x11r7/xdriver_xf86-input-joystick/Config.in
```kconfig
config BR2_PACKAGE_XDRIVER_XF86_INPUT_JOYSTICK
	bool "xf86-input-joystick"
	select BR2_PACKAGE_XORGPROTO
	help
	  X.Org driver for joystick input devices
```
