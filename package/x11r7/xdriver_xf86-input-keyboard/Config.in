## package/x11r7/xdriver_xf86-input-keyboard/Config.in
```kconfig
config BR2_PACKAGE_XDRIVER_XF86_INPUT_KEYBOARD
	bool "xf86-input-keyboard"
	select BR2_PACKAGE_XORGPROTO
	help
	  Keyboard input driver
```

## package/x11r7/xdriver_xf86-input-libinput/Config.in
```kconfig
config BR2_PACKAGE_XDRIVER_XF86_INPUT_LIBINPUT
	bool "xf86-input-libinput"
	depends on BR2_ENABLE_LOCALE # libinput
	depends on BR2_PACKAGE_HAS_UDEV # libinput
	select BR2_PACKAGE_LIBINPUT
	select BR2_PACKAGE_XPROTO_INPUTPROTO
	select BR2_PACKAGE_XPROTO_XPROTO
	help
	  This is an X driver based on libinput. It is a thin wrapper around
	  libinput, so while it does provide all features that libinput supports
	  it does little beyond.

comment "xf86-input-libinput needs udev /dev management and a toolchain w/ locale"
	depends on !BR2_PACKAGE_HAS_UDEV || !BR2_ENABLE_LOCALE
```

## package/x11r7/xdriver_xf86-input-magictouch/Config.in
```kconfig
config BR2_PACKAGE_XDRIVER_XF86_INPUT_MAGICTOUCH
	bool "xf86-input-magictouch"
	select BR2_PACKAGE_XSERVER_XORG_SERVER
	select BR2_PACKAGE_XPROTO_INPUTPROTO
	select BR2_PACKAGE_XPROTO_RANDRPROTO
	select BR2_PACKAGE_XPROTO_XPROTO
	help
	  xf86-input-magictouch 1.0.0.5
	  MagicTouch input driver
```

## package/x11r7/xdriver_xf86-input-mouse/Config.in
```kconfig
config BR2_PACKAGE_XDRIVER_XF86_INPUT_MOUSE
	bool "xf86-input-mouse"
	select BR2_PACKAGE_XORGPROTO
	help
	  X.Org driver for mouse input devices
```

## package/x11r7/xdriver_xf86-input-mutouch/Config.in
```kconfig
config BR2_PACKAGE_XDRIVER_XF86_INPUT_MUTOUCH
	bool "xf86-input-mutouch"
	select BR2_PACKAGE_XSERVER_XORG_SERVER
	select BR2_PACKAGE_XPROTO_INPUTPROTO
	select BR2_PACKAGE_XPROTO_RANDRPROTO
	select BR2_PACKAGE_XPROTO_XPROTO
	help
	  xf86-input-mutouch 1.1.0
	  Microtouch input driver
```

## package/x11r7/xdriver_xf86-input-palmax/Config.in
```kconfig
config BR2_PACKAGE_XDRIVER_XF86_INPUT_PALMAX
	bool "xf86-input-palmax"
	default n
	select BR2_PACKAGE_XSERVER_XORG_SERVER
	select BR2_PACKAGE_XPROTO_INPUTPROTO
	select BR2_PACKAGE_XPROTO_RANDRPROTO
	select BR2_PACKAGE_XPROTO_XPROTO
	help
	  xf86-input-palmax 1.1.0
	  Palmax (TR88L803) touchscreen driver
```

## package/x11r7/xdriver_xf86-input-penmount/Config.in
```kconfig
config BR2_PACKAGE_XDRIVER_XF86_INPUT_PENMOUNT
	bool "xf86-input-penmount"
	select BR2_PACKAGE_XSERVER_XORG_SERVER
	select BR2_PACKAGE_XPROTO_INPUTPROTO
	select BR2_PACKAGE_XPROTO_RANDRPROTO
	select BR2_PACKAGE_XPROTO_XPROTO
	help
	  xf86-input-penmount 1.2.0
	  PenMount input driver
```

## package/x11r7/xdriver_xf86-input-spaceorb/Config.in
```kconfig
config BR2_PACKAGE_XDRIVER_XF86_INPUT_SPACEORB
	bool "xf86-input-spaceorb"
	select BR2_PACKAGE_XSERVER_XORG_SERVER
	select BR2_PACKAGE_XPROTO_INPUTPROTO
	select BR2_PACKAGE_XPROTO_RANDRPROTO
	select BR2_PACKAGE_XPROTO_XPROTO
	help
	  xf86-input-spaceorb 1.1.0
	  X.Org driver for spaceorb input devices
```

## package/x11r7/xdriver_xf86-input-summa/Config.in
```kconfig
config BR2_PACKAGE_XDRIVER_XF86_INPUT_SUMMA
	bool "xf86-input-summa"
	select BR2_PACKAGE_XSERVER_XORG_SERVER
	select BR2_PACKAGE_XPROTO_INPUTPROTO
	select BR2_PACKAGE_XPROTO_RANDRPROTO
	select BR2_PACKAGE_XPROTO_XPROTO
	help
	  xf86-input-summa 1.1.0
	  X.Org driver for summa input devices
```

## package/x11r7/xdriver_xf86-input-synaptics/Config.in
```kconfig
config BR2_PACKAGE_XDRIVER_XF86_INPUT_SYNAPTICS
	bool "xf86-input-synaptics"
	select BR2_PACKAGE_LIBEVDEV
	select BR2_PACKAGE_MTDEV
	select BR2_PACKAGE_XORGPROTO
	help
	  X.Org driver for synaptics input devices
```

## package/x11r7/xdriver_xf86-input-tek4957/Config.in
```kconfig
config BR2_PACKAGE_XDRIVER_XF86_INPUT_TEK4957
	bool "xf86-input-tek4957"
	select BR2_PACKAGE_XSERVER_XORG_SERVER
	select BR2_PACKAGE_XPROTO_INPUTPROTO
	select BR2_PACKAGE_XPROTO_RANDRPROTO
	select BR2_PACKAGE_XPROTO_XPROTO
	help
	  xf86-input-tek4957 1.1.0
	  Tektronix 4957 input driver
```

## package/x11r7/xdriver_xf86-input-tslib/Config.in
```kconfig
config BR2_PACKAGE_XDRIVER_XF86_INPUT_TSLIB
	bool "xf86-input-tslib"
	select BR2_PACKAGE_XORGPROTO
	select BR2_PACKAGE_TSLIB
	help
	  Touch screen library input driver

	  https://github.com/merge/xf86-input-tslib
```

## package/x11r7/xdriver_xf86-input-vmmouse/Config.in
```kconfig
config BR2_PACKAGE_XDRIVER_XF86_INPUT_VMMOUSE
	bool "xf86-input-vmmouse"
	depends on BR2_i386 || BR2_x86_64
	select BR2_PACKAGE_XORGPROTO
	help
	  VMWare mouse input driver
```

## package/x11r7/xdriver_xf86-input-void/Config.in
```kconfig
config BR2_PACKAGE_XDRIVER_XF86_INPUT_VOID
	bool "xf86-input-void"
	# http://lists.x.org/archives/xorg-announce/2015-April/002585.html
	# "It is just dead weight for any server released after 2007 or so.
	#  Don't use it."
	depends on BR2_DEPRECATED_SINCE_2015_05
	select BR2_PACKAGE_XPROTO_INPUTPROTO
	select BR2_PACKAGE_XPROTO_RANDRPROTO
	select BR2_PACKAGE_XPROTO_XPROTO
	help
	  null input driver
```

## package/x11r7/xdriver_xf86-video-amdgpu/Config.in
```kconfig
config BR2_PACKAGE_XDRIVER_XF86_VIDEO_AMDGPU
	bool "xf86-video-amdgpu"
	depends on BR2_PACKAGE_MESA3D_DRI_DRIVER
	depends on BR2_PACKAGE_MESA3D_OPENGL_EGL # gbm
	select BR2_PACKAGE_LIBDRM
	select BR2_PACKAGE_LIBDRM_AMDGPU
	select BR2_PACKAGE_LIBEPOXY
	select BR2_PACKAGE_XLIB_LIBXCOMPOSITE
	select BR2_PACKAGE_XORGPROTO
	help
	  AMD GPU video driver

comment "xf86-video-amdgpu needs egl/opengl support from mesa3d"
	depends on !BR2_PACKAGE_MESA3D_OPENGL_EGL || \
		!BR2_PACKAGE_MESA3D_DRI_DRIVER
```

## package/x11r7/xdriver_xf86-video-apm/Config.in
```kconfig
config BR2_PACKAGE_XDRIVER_XF86_VIDEO_APM
	bool "xf86-video-apm"
	select BR2_PACKAGE_XSERVER_XORG_SERVER
	select BR2_PACKAGE_XPROTO_FONTSPROTO
	select BR2_PACKAGE_XPROTO_RANDRPROTO
	select BR2_PACKAGE_XPROTO_RENDERPROTO
	select BR2_PACKAGE_XPROTO_VIDEOPROTO
	select BR2_PACKAGE_XPROTO_XEXTPROTO
	select BR2_PACKAGE_XPROTO_XF86RUSHPROTO
	select BR2_PACKAGE_XPROTO_XPROTO
	help
	  Alliance ProMotion video driver
```

## package/x11r7/xdriver_xf86-video-ark/Config.in
```kconfig
config BR2_PACKAGE_XDRIVER_XF86_VIDEO_ARK
	bool "xf86-video-ark"
	select BR2_PACKAGE_XORGPROTO
	help
	  X.Org driver for ark cards
```

## package/x11r7/xdriver_xf86-video-ast/Config.in
```kconfig
config BR2_PACKAGE_XDRIVER_XF86_VIDEO_AST
	bool "xf86-video-ast"
	select BR2_PACKAGE_XORGPROTO
	help
	  No description available
```

## package/x11r7/xdriver_xf86-video-ati/Config.in
```kconfig
config BR2_PACKAGE_XDRIVER_XF86_VIDEO_ATI
	bool "xf86-video-ati"
	depends on BR2_PACKAGE_MESA3D
	select BR2_PACKAGE_LIBDRM
	select BR2_PACKAGE_LIBDRM_RADEON
	select BR2_PACKAGE_MESA3D_DRI_DRIVER_RADEON
	select BR2_PACKAGE_XLIB_LIBXCOMPOSITE
	select BR2_PACKAGE_XORGPROTO
	help
	  ATI video driver

comment "xf86-video-ati needs mesa3d"
	depends on !BR2_PACKAGE_MESA3D
```

## package/x11r7/xdriver_xf86-video-chips/Config.in
```kconfig
config BR2_PACKAGE_XDRIVER_XF86_VIDEO_CHIPS
	bool "xf86-video-chips"
	select BR2_PACKAGE_XSERVER_XORG_SERVER
	select BR2_PACKAGE_XPROTO_FONTSPROTO
	select BR2_PACKAGE_XPROTO_RANDRPROTO
	select BR2_PACKAGE_XPROTO_RENDERPROTO
	select BR2_PACKAGE_XPROTO_VIDEOPROTO
	select BR2_PACKAGE_XPROTO_XPROTO
	help
	  Chips and Technologies video driver
```

## package/x11r7/xdriver_xf86-video-cirrus/Config.in
```kconfig
config BR2_PACKAGE_XDRIVER_XF86_VIDEO_CIRRUS
	bool "xf86-video-cirrus"
	select BR2_PACKAGE_XORGPROTO
	help
	  Cirrus Logic video driver
```

## package/x11r7/xdriver_xf86-video-dummy/Config.in
```kconfig
config BR2_PACKAGE_XDRIVER_XF86_VIDEO_DUMMY
	bool "xf86-video-dummy"
	select BR2_PACKAGE_XORGPROTO
	help
	  X.Org driver for dummy cards
```

## package/x11r7/xdriver_xf86-video-fbdev/Config.in
```kconfig
config BR2_PACKAGE_XDRIVER_XF86_VIDEO_FBDEV
	bool "xf86-video-fbdev"
	select BR2_PACKAGE_XORGPROTO
	help
	  video driver for framebuffer device
```

## package/x11r7/xdriver_xf86-video-fbturbo/Config.in
```kconfig
config BR2_PACKAGE_XDRIVER_XF86_VIDEO_FBTURBO
	bool "xf86-video-fbturbo"
	select BR2_PACKAGE_LIBDRM
	select BR2_PACKAGE_PIXMAN
	select BR2_PACKAGE_XORGPROTO
	help
	  video driver, primarily optimized for the devices powered
	  by the Allwinner SoC (A10, A13, A20). It can use some of
	  the 2D/3D hardware acceleration features.

	  https://github.com/ssvb/xf86-video-fbturbo
```

## package/x11r7/xdriver_xf86-video-geode/Config.in
```kconfig
config BR2_PACKAGE_XDRIVER_XF86_VIDEO_GEODE
	bool "xf86-video-geode"
	depends on BR2_i386
	select BR2_PACKAGE_XORGPROTO
	help
	  video driver for geode device
```
