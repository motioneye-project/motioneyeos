## package/x11r7/xdriver_xf86-video-glide/Config.in
```kconfig
config BR2_PACKAGE_XDRIVER_XF86_VIDEO_GLIDE
	bool "xf86-video-glide"
	select BR2_PACKAGE_XSERVER_XORG_SERVER
	select BR2_PACKAGE_XPROTO_FONTSPROTO
	select BR2_PACKAGE_XPROTO_RANDRPROTO
	select BR2_PACKAGE_XPROTO_RENDERPROTO
	select BR2_PACKAGE_XPROTO_VIDEOPROTO
	select BR2_PACKAGE_XPROTO_XPROTO
	depends on BROKEN # needs glide library from http://glide.sourceforge.net/
	help
	  video driver for glide device
```

## package/x11r7/xdriver_xf86-video-glint/Config.in
```kconfig
config BR2_PACKAGE_XDRIVER_XF86_VIDEO_GLINT
	bool "xf86-video-glint"
	depends on BR2_PACKAGE_MESA3D
	select BR2_PACKAGE_LIBDRM
	select BR2_PACKAGE_XORGPROTO
	help
	  GLINT/Permedia video driver

comment "xf86-video-glint needs mesa3d"
	depends on !BR2_PACKAGE_MESA3D
```

## package/x11r7/xdriver_xf86-video-i128/Config.in
```kconfig
config BR2_PACKAGE_XDRIVER_XF86_VIDEO_I128
	bool "xf86-video-i128"
	select BR2_PACKAGE_XORGPROTO
	help
	  Number 9 I128 video driver
```

## package/x11r7/xdriver_xf86-video-i740/Config.in
```kconfig
config BR2_PACKAGE_XDRIVER_XF86_VIDEO_I740
	bool "xf86-video-i740"
	select BR2_PACKAGE_XSERVER_XORG_SERVER
	select BR2_PACKAGE_XPROTO_FONTSPROTO
	select BR2_PACKAGE_XPROTO_RANDRPROTO
	select BR2_PACKAGE_XPROTO_RENDERPROTO
	select BR2_PACKAGE_XPROTO_VIDEOPROTO
	select BR2_PACKAGE_XPROTO_XEXTPROTO
	select BR2_PACKAGE_XPROTO_XPROTO
	help
	  Intel i740 video driver
```

## package/x11r7/xdriver_xf86-video-i810/Config.in
```kconfig
config BR2_PACKAGE_XDRIVER_XF86_VIDEO_I810
	bool "xf86-video-i810"
	default n
	select BR2_PACKAGE_XSERVER_XORG_SERVER
	select BR2_PACKAGE_LIBDRM
	select BR2_PACKAGE_XLIB_LIBX11
	select BR2_PACKAGE_XLIB_LIBXVMC
	select BR2_PACKAGE_XPROTO_FONTSPROTO
	select BR2_PACKAGE_XPROTO_RANDRPROTO
	select BR2_PACKAGE_XPROTO_RENDERPROTO
	select BR2_PACKAGE_XPROTO_XEXTPROTO
	select BR2_PACKAGE_XPROTO_XF86DRIPROTO
	select BR2_PACKAGE_XPROTO_XPROTO
	help
	  xf86-video-i810 1.6.5
	  X.Org driver for Intel cards
```

## package/x11r7/xdriver_xf86-video-impact/Config.in
```kconfig
config BR2_PACKAGE_XDRIVER_XF86_VIDEO_IMPACT
	bool "xf86-video-impact"
	select BR2_PACKAGE_XSERVER_XORG_SERVER
	select BR2_PACKAGE_XPROTO_FONTSPROTO
	select BR2_PACKAGE_XPROTO_RANDRPROTO
	select BR2_PACKAGE_XPROTO_RENDERPROTO
	select BR2_PACKAGE_XPROTO_VIDEOPROTO
	select BR2_PACKAGE_XPROTO_XEXTPROTO
	select BR2_PACKAGE_XPROTO_XPROTO
	help
	  xf86-video-impact 0.2.0
	  Impact video driver
```

## package/x11r7/xdriver_xf86-video-imstt/Config.in
```kconfig
config BR2_PACKAGE_XDRIVER_XF86_VIDEO_IMSTT
	bool "xf86-video-imstt"
	select BR2_PACKAGE_XSERVER_XORG_SERVER
	select BR2_PACKAGE_XPROTO_FONTSPROTO
	select BR2_PACKAGE_XPROTO_RANDRPROTO
	select BR2_PACKAGE_XPROTO_RENDERPROTO
	select BR2_PACKAGE_XPROTO_XPROTO
	help
	  xf86-video-imstt 1.1.0
	  Integrated Micro Solutions Twin Turbo 128 driver
```

## package/x11r7/xdriver_xf86-video-imx-viv/Config.in
```kconfig
config BR2_PACKAGE_XDRIVER_XF86_VIDEO_IMX_VIV
	bool "xf86-video-imx-viv"
	depends on BR2_PACKAGE_IMX_GPU_VIV_OUTPUT_X11
	depends on BR2_PACKAGE_IMX_GPU_G2D
	depends on BR2_TOOLCHAIN_HAS_SYNC_1 # mesa3d
	select BR2_PACKAGE_MESA3D # Needed in order to compile xorg with glx/dri
	select BR2_PACKAGE_MESA3D_DRI_DRIVER
	select BR2_PACKAGE_LIBDRM
	select BR2_PACKAGE_XPROTO_XPROTO
	select BR2_PACKAGE_XPROTO_XF86DRIPROTO
	help
	  X.Org driver for iMX6 GPU (Vivante)

	  Notice EGL and GLes2 APIs are correctly supported. This
	  driver should also be able to provide Desktop OpenGL
	  implementation but, this feature seems broken since quite
	  some time.

	  To use this driver, add correct configuration to your
	  /etc/X11/xorg.conf:

	  Section "Device"
	    [...]
	    Driver          "vivante"
	    Option          "vivante_fbdev" "/dev/fbX"
	  EndSection

	  Don't forget to load galcore.ko and create /dev/galcore
	  before using this driver (else, Xorg will exit with an
	  obscur message like "Segmentation fault at address 0xc").

comment "xf86-video-imx-viv depends on imx-gpu-viv with X11 output"
	depends on BR2_arm
	depends on !BR2_PACKAGE_IMX_GPU_VIV_OUTPUT_X11
	depends on BR2_TOOLCHAIN_HAS_SYNC_1

comment "xf86-video-imx-viv depends on imx-gpu-g2d"
	depends on BR2_arm
	depends on !BR2_PACKAGE_IMX_GPU_G2D
	depends on BR2_PACKAGE_IMX_GPU_VIV_OUTPUT_X11
	depends on BR2_TOOLCHAIN_HAS_SYNC_1
```

## package/x11r7/xdriver_xf86-video-intel/Config.in
```kconfig
config BR2_PACKAGE_XDRIVER_XF86_VIDEO_INTEL
	bool "xf86-video-intel"
	depends on (BR2_i386 || BR2_x86_64)
	select BR2_PACKAGE_XPROTO_FONTSPROTO
	select BR2_PACKAGE_XPROTO_XPROTO
	select BR2_PACKAGE_XLIB_LIBPCIACCESS
	select BR2_PACKAGE_LIBDRM
	select BR2_PACKAGE_LIBDRM_INTEL
	select BR2_PACKAGE_XLIB_LIBXRANDR
	help
	  Intel video driver
```

## package/x11r7/xdriver_xf86-video-mach64/Config.in
```kconfig
config BR2_PACKAGE_XDRIVER_XF86_VIDEO_MACH64
	bool "xf86-video-mach64"
	select BR2_PACKAGE_XORGPROTO
	help
	  mach64 video driver
```

## package/x11r7/xdriver_xf86-video-mga/Config.in
```kconfig
config BR2_PACKAGE_XDRIVER_XF86_VIDEO_MGA
	bool "xf86-video-mga"
	depends on BR2_PACKAGE_MESA3D
	select BR2_PACKAGE_LIBDRM
	select BR2_PACKAGE_XORGPROTO
	help
	  Matrox video driver

comment "xf86-video-mga needs mesa3d"
	depends on !BR2_PACKAGE_MESA3D
```

## package/x11r7/xdriver_xf86-video-neomagic/Config.in
```kconfig
config BR2_PACKAGE_XDRIVER_XF86_VIDEO_NEOMAGIC
	bool "xf86-video-neomagic"
	select BR2_PACKAGE_XORGPROTO
	help
	  Neomagic video driver
```

## package/x11r7/xdriver_xf86-video-newport/Config.in
```kconfig
config BR2_PACKAGE_XDRIVER_XF86_VIDEO_NEWPORT
	bool "xf86-video-newport"
	select BR2_PACKAGE_XPROTO_FONTSPROTO
	select BR2_PACKAGE_XPROTO_RANDRPROTO
	select BR2_PACKAGE_XPROTO_RENDERPROTO
	select BR2_PACKAGE_XPROTO_VIDEOPROTO
	select BR2_PACKAGE_XPROTO_XPROTO
	help
	  Newport video driver
```

## package/x11r7/xdriver_xf86-video-nouveau/Config.in
```kconfig
config BR2_PACKAGE_XDRIVER_XF86_VIDEO_NOUVEAU
	bool "xf86-video-nouveau"
	depends on BR2_PACKAGE_MESA3D
	select BR2_PACKAGE_MESA3D_DRI_DRIVER_NOUVEAU
	select BR2_PACKAGE_LIBDRM
	select BR2_PACKAGE_LIBDRM_NOUVEAU
	select BR2_PACKAGE_XORGPROTO
	help
	  Nouveau video driver

	  http://nouveau.freedesktop.org

comment "xf86-video-nouveau needs mesa3d"
	depends on !BR2_PACKAGE_MESA3D
```

## package/x11r7/xdriver_xf86-video-nsc/Config.in
```kconfig
config BR2_PACKAGE_XDRIVER_XF86_VIDEO_NSC
	bool "xf86-video-nsc"
	default n
	select BR2_PACKAGE_XSERVER_XORG_SERVER
	select BR2_PACKAGE_XPROTO_FONTSPROTO
	select BR2_PACKAGE_XPROTO_RANDRPROTO
	select BR2_PACKAGE_XPROTO_RENDERPROTO
	select BR2_PACKAGE_XPROTO_VIDEOPROTO
	select BR2_PACKAGE_XPROTO_XEXTPROTO
	select BR2_PACKAGE_XPROTO_XF86DGAPROTO
	select BR2_PACKAGE_XPROTO_XPROTO
	help
	  xf86-video-nsc 2.8.2
	  Nsc video driver
```

## package/x11r7/xdriver_xf86-video-nv/Config.in
```kconfig
config BR2_PACKAGE_XDRIVER_XF86_VIDEO_NV
	bool "xf86-video-nv"
	select BR2_PACKAGE_XORGPROTO
	help
	  NVIDIA video driver
```

## package/x11r7/xdriver_xf86-video-openchrome/Config.in
```kconfig
config BR2_PACKAGE_XDRIVER_XF86_VIDEO_OPENCHROME
	bool "xf86-video-openchrome"
	depends on BR2_PACKAGE_MESA3D_DRI_DRIVER
	select BR2_PACKAGE_LIBDRM
	select BR2_PACKAGE_XLIB_LIBX11
	select BR2_PACKAGE_XLIB_LIBXCOMPOSITE
	select BR2_PACKAGE_XLIB_LIBXVMC
	select BR2_PACKAGE_XORGPROTO
	help
	  Openchrome, A free and Open Source video driver for the
	  VIA/S3G UniChrome and UniChrome Pro graphics chipsets.

	  https://www.freedesktop.org/wiki/Openchrome/

comment "xf86-video-openchrome needs a DRI driver from mesa3d"
	depends on !BR2_PACKAGE_MESA3D_DRI_DRIVER
```

## package/x11r7/xdriver_xf86-video-qxl/Config.in
```kconfig
config BR2_PACKAGE_XDRIVER_XF86_VIDEO_QXL
	bool "xf86-video-qxl"
	depends on (BR2_i386 || BR2_x86_64)
	select BR2_PACKAGE_LIBDRM if BR2_PACKAGE_HAS_UDEV # for KMS
	select BR2_PACKAGE_LIBPCIACCESS
	select BR2_PACKAGE_SPICE_PROTOCOL
	select BR2_PACKAGE_XLIB_LIBXFONT2 if !BR2_PACKAGE_XLIB_LIBXFONT
	select BR2_PACKAGE_XORGPROTO
	help
	  QEMU QXL paravirt video driver

	  http://www.spice-space.org/page/XorgQXL
```

## package/x11r7/xdriver_xf86-video-r128/Config.in
```kconfig
config BR2_PACKAGE_XDRIVER_XF86_VIDEO_R128
	bool "xf86-video-r128"
	select BR2_PACKAGE_XORGPROTO
	help
	  R128 video driver
```

## package/x11r7/xdriver_xf86-video-rendition/Config.in
```kconfig
config BR2_PACKAGE_XDRIVER_XF86_VIDEO_RENDITION
	bool "xf86-video-rendition"
	select BR2_PACKAGE_XSERVER_XORG_SERVER
	select BR2_PACKAGE_XPROTO_FONTSPROTO
	select BR2_PACKAGE_XPROTO_RANDRPROTO
	select BR2_PACKAGE_XPROTO_RENDERPROTO
	select BR2_PACKAGE_XPROTO_XEXTPROTO
	select BR2_PACKAGE_XPROTO_XPROTO
	help
	  Rendition video driver
```

## package/x11r7/xdriver_xf86-video-s3virge/Config.in
```kconfig
config BR2_PACKAGE_XDRIVER_XF86_VIDEO_S3VIRGE
	bool "xf86-video-s3virge"
	select BR2_PACKAGE_XSERVER_XORG_SERVER
	select BR2_PACKAGE_XPROTO_FONTSPROTO
	select BR2_PACKAGE_XPROTO_RANDRPROTO
	select BR2_PACKAGE_XPROTO_RENDERPROTO
	select BR2_PACKAGE_XPROTO_VIDEOPROTO
	select BR2_PACKAGE_XPROTO_XEXTPROTO
	select BR2_PACKAGE_XPROTO_XPROTO
	help
	  xf86-video-s3virge 1.9.1
	  S3 ViRGE video driver
```

## package/x11r7/xdriver_xf86-video-savage/Config.in
```kconfig
config BR2_PACKAGE_XDRIVER_XF86_VIDEO_SAVAGE
	bool "xf86-video-savage"
	depends on BR2_PACKAGE_MESA3D
	select BR2_PACKAGE_LIBDRM
	select BR2_PACKAGE_XORGPROTO
	help
	  S3 Savage video driver

comment "xf86-video-savage needs mesa3d"
	depends on !BR2_PACKAGE_MESA3D
```

## package/x11r7/xdriver_xf86-video-siliconmotion/Config.in
```kconfig
config BR2_PACKAGE_XDRIVER_XF86_VIDEO_SILICONMOTION
	bool "xf86-video-siliconmotion"
	select BR2_PACKAGE_XORGPROTO
	help
	  Silicon Motion video driver
```

## package/x11r7/xdriver_xf86-video-sis/Config.in
```kconfig
config BR2_PACKAGE_XDRIVER_XF86_VIDEO_SIS
	bool "xf86-video-sis"
	depends on BR2_PACKAGE_MESA3D
	select BR2_PACKAGE_LIBDRM
	select BR2_PACKAGE_XORGPROTO
	help
	  SiS and XGI video driver

comment "xf86-video-sis needs mesa3d"
	depends on !BR2_PACKAGE_MESA3D
```

## package/x11r7/xdriver_xf86-video-sunbw2/Config.in
```kconfig
config BR2_PACKAGE_XDRIVER_XF86_VIDEO_SUNBW2
	bool "xf86-video-sunbw2"
	default n
	select BR2_PACKAGE_XSERVER_XORG_SERVER
	select BR2_PACKAGE_XPROTO_RANDRPROTO
	select BR2_PACKAGE_XPROTO_XPROTO
	help
	  xf86-video-sunbw2 1.1.0
	  BW2 video driver
```
