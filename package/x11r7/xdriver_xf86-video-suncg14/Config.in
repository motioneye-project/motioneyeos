## package/x11r7/xdriver_xf86-video-suncg14/Config.in
```kconfig
config BR2_PACKAGE_XDRIVER_XF86_VIDEO_SUNCG14
	bool "xf86-video-suncg14"
	select BR2_PACKAGE_XSERVER_XORG_SERVER
	select BR2_PACKAGE_XPROTO_FONTSPROTO
	select BR2_PACKAGE_XPROTO_RANDRPROTO
	select BR2_PACKAGE_XPROTO_RENDERPROTO
	select BR2_PACKAGE_XPROTO_XPROTO
	help
	  CG14 video driver
```

## package/x11r7/xdriver_xf86-video-suncg6/Config.in
```kconfig
config BR2_PACKAGE_XDRIVER_XF86_VIDEO_SUNCG6
	bool "xf86-video-suncg6"
	select BR2_PACKAGE_XSERVER_XORG_SERVER
	select BR2_PACKAGE_XPROTO_FONTSPROTO
	select BR2_PACKAGE_XPROTO_RANDRPROTO
	select BR2_PACKAGE_XPROTO_RENDERPROTO
	select BR2_PACKAGE_XPROTO_XPROTO
	help
	  GX/Turbo GX video driver
```

## package/x11r7/xdriver_xf86-video-sunffb/Config.in
```kconfig
config BR2_PACKAGE_XDRIVER_XF86_VIDEO_SUNFFB
	bool "xf86-video-sunffb"
	select BR2_PACKAGE_XSERVER_XORG_SERVER
	select BR2_PACKAGE_LIBDRM
	select BR2_PACKAGE_XPROTO_FONTSPROTO
	select BR2_PACKAGE_XPROTO_RANDRPROTO
	select BR2_PACKAGE_XPROTO_RENDERPROTO
	select BR2_PACKAGE_XPROTO_XEXTPROTO
	select BR2_PACKAGE_XPROTO_XF86DRIPROTO
	select BR2_PACKAGE_XPROTO_XPROTO
	help
	  xf86-video-sunffb 1.1.0
	  SUNFFB video driver
```

## package/x11r7/xdriver_xf86-video-sunleo/Config.in
```kconfig
config BR2_PACKAGE_XDRIVER_XF86_VIDEO_SUNLEO
	bool "xf86-video-sunleo"
	select BR2_PACKAGE_XSERVER_XORG_SERVER
	select BR2_PACKAGE_XPROTO_FONTSPROTO
	select BR2_PACKAGE_XPROTO_RANDRPROTO
	select BR2_PACKAGE_XPROTO_RENDERPROTO
	select BR2_PACKAGE_XPROTO_XPROTO
	help
	  Leo video driver
```

## package/x11r7/xdriver_xf86-video-suntcx/Config.in
```kconfig
config BR2_PACKAGE_XDRIVER_XF86_VIDEO_SUNTCX
	bool "xf86-video-suntcx"
	select BR2_PACKAGE_XSERVER_XORG_SERVER
	select BR2_PACKAGE_XPROTO_FONTSPROTO
	select BR2_PACKAGE_XPROTO_RANDRPROTO
	select BR2_PACKAGE_XPROTO_RENDERPROTO
	select BR2_PACKAGE_XPROTO_XPROTO
	help
	  xf86-video-suntcx 1.1.0
	  TCX video driver
```

## package/x11r7/xdriver_xf86-video-tdfx/Config.in
```kconfig
config BR2_PACKAGE_XDRIVER_XF86_VIDEO_TDFX
	bool "xf86-video-tdfx"
	depends on BR2_PACKAGE_MESA3D
	select BR2_PACKAGE_LIBDRM
	select BR2_PACKAGE_XORGPROTO
	help
	  3Dfx video driver

comment "xf86-video-tdfx needs mesa3d"
	depends on !BR2_PACKAGE_MESA3D
```

## package/x11r7/xdriver_xf86-video-tga/Config.in
```kconfig
config BR2_PACKAGE_XDRIVER_XF86_VIDEO_TGA
	bool "xf86-video-tga"
	select BR2_PACKAGE_XORGPROTO
	help
	  X.Org driver for tga cards
```

## package/x11r7/xdriver_xf86-video-trident/Config.in
```kconfig
config BR2_PACKAGE_XDRIVER_XF86_VIDEO_TRIDENT
	bool "xf86-video-trident"
	select BR2_PACKAGE_XORGPROTO
	help
	  Trident video driver
```

## package/x11r7/xdriver_xf86-video-v4l/Config.in
```kconfig
config BR2_PACKAGE_XDRIVER_XF86_VIDEO_V4L
	bool "xf86-video-v4l"
	select BR2_PACKAGE_XPROTO_RANDRPROTO
	select BR2_PACKAGE_XPROTO_VIDEOPROTO
	select BR2_PACKAGE_XPROTO_XPROTO
	depends on BROKEN # Fails to build with xorg xserver >= 1.17
	help
	  video4linux driver
```

## package/x11r7/xdriver_xf86-video-vermilion/Config.in
```kconfig
config BR2_PACKAGE_XDRIVER_XF86_VIDEO_VERMILION
	bool "xf86-video-vermilion"
	select BR2_PACKAGE_XSERVER_XORG_SERVER
	select BR2_PACKAGE_XPROTO_FONTSPROTO
	select BR2_PACKAGE_XPROTO_RANDRPROTO
	select BR2_PACKAGE_XPROTO_RENDERPROTO
	select BR2_PACKAGE_XPROTO_VIDEOPROTO
	select BR2_PACKAGE_XPROTO_XEXTPROTO
	select BR2_PACKAGE_XPROTO_XPROTO
	help
	  xf86-video-vermilion 1.0.1
	  Vermilion video driver
```

## package/x11r7/xdriver_xf86-video-vesa/Config.in
```kconfig
config BR2_PACKAGE_XDRIVER_XF86_VIDEO_VESA
	bool "xf86-video-vesa"
	select BR2_PACKAGE_XORGPROTO
	help
	  Generic VESA video driver
```

## package/x11r7/xdriver_xf86-video-via/Config.in
```kconfig
config BR2_PACKAGE_XDRIVER_XF86_VIDEO_VIA
	bool "xf86-video-via"
	select BR2_PACKAGE_XSERVER_XORG_SERVER
	select BR2_PACKAGE_LIBDRM
	select BR2_PACKAGE_XLIB_LIBX11
	select BR2_PACKAGE_XLIB_LIBXVMC
	select BR2_PACKAGE_XPROTO_FONTSPROTO
	select BR2_PACKAGE_XPROTO_GLPROTO
	select BR2_PACKAGE_XPROTO_RANDRPROTO
	select BR2_PACKAGE_XPROTO_RENDERPROTO
	select BR2_PACKAGE_XPROTO_XEXTPROTO
	select BR2_PACKAGE_XPROTO_XF86DRIPROTO
	select BR2_PACKAGE_XPROTO_XPROTO
	help
	  xf86-video-via 0.2.2
	  VIA unichrome graphics driver
```

## package/x11r7/xdriver_xf86-video-vmware/Config.in
```kconfig
config BR2_PACKAGE_XDRIVER_XF86_VIDEO_VMWARE
	bool "xf86-video-vmware"
	depends on BR2_PACKAGE_MESA3D
	depends on BR2_i386 || BR2_x86_64
	select BR2_PACKAGE_MESA3D_GALLIUM_DRIVER_SVGA
	select BR2_PACKAGE_XORGPROTO
	help
	  VMware SVGA video driver

comment "xf86-video-vmware needs mesa3d"
	depends on !BR2_PACKAGE_MESA3D
```

## package/x11r7/xdriver_xf86-video-voodoo/Config.in
```kconfig
config BR2_PACKAGE_XDRIVER_XF86_VIDEO_VOODOO
	bool "xf86-video-voodoo"
	select BR2_PACKAGE_XORGPROTO
	help
	  Voodoo video driver
```

## package/x11r7/xdriver_xf86-video-xgixp/Config.in
```kconfig
config BR2_PACKAGE_XDRIVER_XF86_VIDEO_XGIXP
	bool "xf86-video-xgixp"
	select BR2_PACKAGE_XSERVER_XORG_SERVER
	select BR2_PACKAGE_XPROTO_FONTSPROTO
	select BR2_PACKAGE_XPROTO_RANDRPROTO
	select BR2_PACKAGE_XPROTO_RENDERPROTO
	select BR2_PACKAGE_XPROTO_XEXTPROTO
	select BR2_PACKAGE_XPROTO_XPROTO
	help
	  xf86-video-xgixp 1.7.99.3
	  XGIXP based chips video driver
```

## package/x11r7/xfont_encodings/Config.in
```kconfig
config BR2_PACKAGE_XFONT_ENCODINGS
	bool "encodings"
	help
	  No description available
```

## package/x11r7/xfont_font-adobe-100dpi/Config.in
```kconfig
config BR2_PACKAGE_XFONT_FONT_ADOBE_100DPI
	bool "font-adobe-100dpi"
	help
	  No description available
```

## package/x11r7/xfont_font-adobe-75dpi/Config.in
```kconfig
config BR2_PACKAGE_XFONT_FONT_ADOBE_75DPI
	bool "font-adobe-75dpi"
	select BR2_PACKAGE_XFONT_FONT_UTIL
	help
	  No description available
```

## package/x11r7/xfont_font-adobe-utopia-100dpi/Config.in
```kconfig
config BR2_PACKAGE_XFONT_FONT_ADOBE_UTOPIA_100DPI
	bool "font-adobe-utopia-100dpi"
	select BR2_PACKAGE_XFONT_FONT_UTIL
	help
	  No description available
```

## package/x11r7/xfont_font-adobe-utopia-75dpi/Config.in
```kconfig
config BR2_PACKAGE_XFONT_FONT_ADOBE_UTOPIA_75DPI
	bool "font-adobe-utopia-75dpi"
	help
	  No description available
```

## package/x11r7/xfont_font-adobe-utopia-type1/Config.in
```kconfig
config BR2_PACKAGE_XFONT_FONT_ADOBE_UTOPIA_TYPE1
	bool "font-adobe-utopia-type1"
	select BR2_PACKAGE_XFONT_FONT_UTIL
	help
	  No description available
```

## package/x11r7/xfont_font-alias/Config.in
```kconfig
config BR2_PACKAGE_XFONT_FONT_ALIAS
	bool "font-alias"
	select BR2_PACKAGE_XFONT_FONT_UTIL
	help
	  No description available
```

## package/x11r7/xfont_font-arabic-misc/Config.in
```kconfig
config BR2_PACKAGE_XFONT_FONT_ARABIC_MISC
	bool "font-arabic-misc"
	help
	  No description available
```

## package/x11r7/xfont_font-bh-100dpi/Config.in
```kconfig
config BR2_PACKAGE_XFONT_FONT_BH_100DPI
	bool "font-bh-100dpi"
	help
	  No description available
```

## package/x11r7/xfont_font-bh-75dpi/Config.in
```kconfig
config BR2_PACKAGE_XFONT_FONT_BH_75DPI
	bool "font-bh-75dpi"
	select BR2_PACKAGE_XFONT_FONT_UTIL
	help
	  No description available
```
