## package/x11r7/xfont_font-bh-lucidatypewriter-100dpi/Config.in
```kconfig
config BR2_PACKAGE_XFONT_FONT_BH_LUCIDATYPEWRITER_100DPI
	bool "font-bh-lucidatypewriter-100dpi"
	select BR2_PACKAGE_XFONT_FONT_UTIL
	help
	  No description available
```

## package/x11r7/xfont_font-bh-lucidatypewriter-75dpi/Config.in
```kconfig
config BR2_PACKAGE_XFONT_FONT_BH_LUCIDATYPEWRITER_75DPI
	bool "font-bh-lucidatypewriter-75dpi"
	select BR2_PACKAGE_XFONT_FONT_UTIL
	help
	  No description available
```

## package/x11r7/xfont_font-bh-ttf/Config.in
```kconfig
config BR2_PACKAGE_XFONT_FONT_BH_TTF
	bool "font-bh-ttf"
	help
	  No description available
```

## package/x11r7/xfont_font-bh-type1/Config.in
```kconfig
config BR2_PACKAGE_XFONT_FONT_BH_TYPE1
	bool "font-bh-type1"
	select BR2_PACKAGE_XFONT_FONT_UTIL
	help
	  No description available
```

## package/x11r7/xfont_font-bitstream-100dpi/Config.in
```kconfig
config BR2_PACKAGE_XFONT_FONT_BITSTREAM_100DPI
	bool "font-bitstream-100dpi"
	help
	  No description available
```

## package/x11r7/xfont_font-bitstream-75dpi/Config.in
```kconfig
config BR2_PACKAGE_XFONT_FONT_BITSTREAM_75DPI
	bool "font-bitstream-75dpi"
	help
	  No description available
```

## package/x11r7/xfont_font-bitstream-speedo/Config.in
```kconfig
config BR2_PACKAGE_XFONT_FONT_BITSTREAM_SPEEDO
	bool "font-bitstream-speedo"
	help
	  No description available
```

## package/x11r7/xfont_font-bitstream-type1/Config.in
```kconfig
config BR2_PACKAGE_XFONT_FONT_BITSTREAM_TYPE1
	bool "font-bitstream-type1"
	select BR2_PACKAGE_XFONT_FONT_UTIL
	help
	  No description available
```

## package/x11r7/xfont_font-cronyx-cyrillic/Config.in
```kconfig
config BR2_PACKAGE_XFONT_FONT_CRONYX_CYRILLIC
	bool "font-cronyx-cyrillic"
	help
	  No description available
```

## package/x11r7/xfont_font-cursor-misc/Config.in
```kconfig
config BR2_PACKAGE_XFONT_FONT_CURSOR_MISC
	bool "font-cursor-misc"
	help
	  No description available
```

## package/x11r7/xfont_font-daewoo-misc/Config.in
```kconfig
config BR2_PACKAGE_XFONT_FONT_DAEWOO_MISC
	bool "font-daewoo-misc"
	select BR2_PACKAGE_XFONT_FONT_UTIL
	help
	  No description available
```

## package/x11r7/xfont_font-dec-misc/Config.in
```kconfig
config BR2_PACKAGE_XFONT_FONT_DEC_MISC
	bool "font-dec-misc"
	select BR2_PACKAGE_XFONT_FONT_UTIL
	help
	  No description available
```

## package/x11r7/xfont_font-ibm-type1/Config.in
```kconfig
config BR2_PACKAGE_XFONT_FONT_IBM_TYPE1
	bool "font-ibm-type1"
	select BR2_PACKAGE_XFONT_FONT_UTIL
	help
	  No description available
```

## package/x11r7/xfont_font-isas-misc/Config.in
```kconfig
config BR2_PACKAGE_XFONT_FONT_ISAS_MISC
	bool "font-isas-misc"
	help
	  No description available
```

## package/x11r7/xfont_font-jis-misc/Config.in
```kconfig
config BR2_PACKAGE_XFONT_FONT_JIS_MISC
	bool "font-jis-misc"
	select BR2_PACKAGE_XFONT_FONT_UTIL
	help
	  No description available
```

## package/x11r7/xfont_font-micro-misc/Config.in
```kconfig
config BR2_PACKAGE_XFONT_FONT_MICRO_MISC
	bool "font-micro-misc"
	select BR2_PACKAGE_XFONT_FONT_UTIL
	help
	  No description available
```

## package/x11r7/xfont_font-misc-cyrillic/Config.in
```kconfig
config BR2_PACKAGE_XFONT_FONT_MISC_CYRILLIC
	bool "font-misc-cyrillic"
	help
	  No description available
```

## package/x11r7/xfont_font-misc-ethiopic/Config.in
```kconfig
config BR2_PACKAGE_XFONT_FONT_MISC_ETHIOPIC
	bool "font-misc-ethiopic"
	select BR2_PACKAGE_XFONT_FONT_UTIL
	help
	  No description available
```

## package/x11r7/xfont_font-misc-meltho/Config.in
```kconfig
config BR2_PACKAGE_XFONT_FONT_MISC_MELTHO
	bool "font-misc-meltho"
	help
	  No description available
```

## package/x11r7/xfont_font-misc-misc/Config.in
```kconfig
config BR2_PACKAGE_XFONT_FONT_MISC_MISC
	bool "font-misc-misc"
	help
	  No description available
```

## package/x11r7/xfont_font-mutt-misc/Config.in
```kconfig
config BR2_PACKAGE_XFONT_FONT_MUTT_MISC
	bool "font-mutt-misc"
	select BR2_PACKAGE_XFONT_FONT_UTIL
	help
	  No description available
```

## package/x11r7/xfont_font-schumacher-misc/Config.in
```kconfig
config BR2_PACKAGE_XFONT_FONT_SCHUMACHER_MISC
	bool "font-schumacher-misc"
	help
	  No description available
```

## package/x11r7/xfont_font-screen-cyrillic/Config.in
```kconfig
config BR2_PACKAGE_XFONT_FONT_SCREEN_CYRILLIC
	bool "font-screen-cyrillic"
	select BR2_PACKAGE_XFONT_FONT_UTIL
	help
	  No description available
```

## package/x11r7/xfont_font-sony-misc/Config.in
```kconfig
config BR2_PACKAGE_XFONT_FONT_SONY_MISC
	bool "font-sony-misc"
	select BR2_PACKAGE_XFONT_FONT_UTIL
	help
	  No description available
```

## package/x11r7/xfont_font-sun-misc/Config.in
```kconfig
config BR2_PACKAGE_XFONT_FONT_SUN_MISC
	bool "font-sun-misc"
	select BR2_PACKAGE_XFONT_FONT_UTIL
	help
	  No description available
```
