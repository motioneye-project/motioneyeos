## package/x11r7/xfont_font-util/Config.in
```kconfig
config BR2_PACKAGE_XFONT_FONT_UTIL
	bool "font-util"
	help
	  No description available
```

## package/x11r7/xfont_font-winitzki-cyrillic/Config.in
```kconfig
config BR2_PACKAGE_XFONT_FONT_WINITZKI_CYRILLIC
	bool "font-winitzki-cyrillic"
	select BR2_PACKAGE_XFONT_FONT_UTIL
	help
	  No description available
```

## package/x11r7/xfont_font-xfree86-type1/Config.in
```kconfig
config BR2_PACKAGE_XFONT_FONT_XFREE86_TYPE1
	bool "font-xfree86-type1"
	help
	  No description available
```

## package/x11r7/xkeyboard-config/Config.in
```kconfig
config BR2_PACKAGE_XKEYBOARD_CONFIG
	bool "xkeyboard-config"
	# Runtime dependencies
	select BR2_PACKAGE_XAPP_XKBCOMP if BR2_PACKAGE_XORG7
	select BR2_PACKAGE_XLIB_LIBX11 if BR2_PACKAGE_XORG7
	select BR2_PACKAGE_XPROTO_XPROTO if BR2_PACKAGE_XORG7
	help
	  keyboard configuration database for X

	  http://xlibs.freedesktop.org/xkbdesc
```

## package/x11r7/xlib_libFS/Config.in
```kconfig
config BR2_PACKAGE_XLIB_LIBFS
	bool "libFS"
	select BR2_PACKAGE_XLIB_XTRANS
	select BR2_PACKAGE_XORGPROTO
	help
	  X.Org FS library
```

## package/x11r7/xlib_libICE/Config.in
```kconfig
config BR2_PACKAGE_XLIB_LIBICE
	bool "libICE"
	select BR2_PACKAGE_XLIB_XTRANS
	select BR2_PACKAGE_XORGPROTO
	help
	  X.Org ICE library
```

## package/x11r7/xlib_libSM/Config.in
```kconfig
config BR2_PACKAGE_XLIB_LIBSM
	bool "libSM"
	select BR2_PACKAGE_XLIB_LIBICE
	select BR2_PACKAGE_XLIB_XTRANS
	select BR2_PACKAGE_XPROTO_XPROTO
	help
	  X.Org SM library
```

## package/x11r7/xlib_libX11/Config.in
```kconfig
config BR2_PACKAGE_XLIB_LIBX11
	bool "libX11"
	select BR2_PACKAGE_LIBXCB
	select BR2_PACKAGE_XUTIL_UTIL_MACROS
	select BR2_PACKAGE_XLIB_XTRANS
	select BR2_PACKAGE_XLIB_LIBXAU
	select BR2_PACKAGE_XLIB_LIBXDMCP
	select BR2_PACKAGE_XORGPROTO
	help
	  X.Org X11 library
```

## package/x11r7/xlib_libXScrnSaver/Config.in
```kconfig
config BR2_PACKAGE_XLIB_LIBXSCRNSAVER
	bool "libXScrnSaver"
	select BR2_PACKAGE_XLIB_LIBX11
	select BR2_PACKAGE_XLIB_LIBXEXT
	select BR2_PACKAGE_XORGPROTO
	help
	  X.Org XScrnSaver library
```

## package/x11r7/xlib_libXTrap/Config.in
```kconfig
config BR2_PACKAGE_XLIB_LIBXTRAP
	bool "libXTrap"
	select BR2_PACKAGE_XLIB_LIBX11
	select BR2_PACKAGE_XLIB_LIBXT
	select BR2_PACKAGE_XLIB_LIBXEXT
	select BR2_PACKAGE_XPROTO_TRAPPROTO
	help
	  libXTrap 1.0.0
	  X.Org XTrap library
```

## package/x11r7/xlib_libXau/Config.in
```kconfig
config BR2_PACKAGE_XLIB_LIBXAU
	bool "libXau"
	select BR2_PACKAGE_XPROTO_XPROTO
	select BR2_PACKAGE_XUTIL_UTIL_MACROS
	help
	  libXau 1.0.5
	  X.Org Xau library
```

## package/x11r7/xlib_libXaw/Config.in
```kconfig
config BR2_PACKAGE_XLIB_LIBXAW
	bool "libXaw"
	select BR2_PACKAGE_XLIB_LIBX11
	select BR2_PACKAGE_XLIB_LIBXT
	select BR2_PACKAGE_XLIB_LIBXMU
	select BR2_PACKAGE_XLIB_LIBXPM
	select BR2_PACKAGE_XPROTO_XPROTO
	help
	  X.Org Xaw library
```

## package/x11r7/xlib_libXcomposite/Config.in
```kconfig
config BR2_PACKAGE_XLIB_LIBXCOMPOSITE
	bool "libXcomposite"
	select BR2_PACKAGE_XLIB_LIBX11
	select BR2_PACKAGE_XLIB_LIBXEXT
	select BR2_PACKAGE_XLIB_LIBXFIXES
	select BR2_PACKAGE_XORGPROTO
	help
	  X.Org Xcomposite library
```

## package/x11r7/xlib_libXcursor/Config.in
```kconfig
config BR2_PACKAGE_XLIB_LIBXCURSOR
	bool "libXcursor"
	select BR2_PACKAGE_XLIB_LIBX11
	select BR2_PACKAGE_XLIB_LIBXFIXES
	select BR2_PACKAGE_XLIB_LIBXRENDER
	select BR2_PACKAGE_XPROTO_XPROTO
	help
	  libXcursor 1.1.8
	  X.Org Xcursor library
```

## package/x11r7/xlib_libXdamage/Config.in
```kconfig
config BR2_PACKAGE_XLIB_LIBXDAMAGE
	bool "libXdamage"
	select BR2_PACKAGE_XLIB_LIBX11
	select BR2_PACKAGE_XLIB_LIBXFIXES
	select BR2_PACKAGE_XORGPROTO
	help
	  X.Org Xdamage library
```

## package/x11r7/xlib_libXdmcp/Config.in
```kconfig
config BR2_PACKAGE_XLIB_LIBXDMCP
	bool "libXdmcp"
	select BR2_PACKAGE_XUTIL_UTIL_MACROS
	select BR2_PACKAGE_XPROTO_XPROTO
	help
	  X.Org Xdmcp library
```

## package/x11r7/xlib_libXevie/Config.in
```kconfig
config BR2_PACKAGE_XLIB_LIBXEVIE
	bool "libXevie"
	default n
	select BR2_PACKAGE_XLIB_LIBX11
	select BR2_PACKAGE_XLIB_LIBXEXT
	select BR2_PACKAGE_XPROTO_EVIEEXT
	select BR2_PACKAGE_XPROTO_XPROTO
	help
	  libXevie 1.0.2
	  X.Org Xevie library
```

## package/x11r7/xlib_libXext/Config.in
```kconfig
config BR2_PACKAGE_XLIB_LIBXEXT
	bool "libXext"
	select BR2_PACKAGE_XLIB_LIBX11
	select BR2_PACKAGE_XORGPROTO
	help
	  X.Org Xext library
```

## package/x11r7/xlib_libXfixes/Config.in
```kconfig
config BR2_PACKAGE_XLIB_LIBXFIXES
	bool "libXfixes"
	select BR2_PACKAGE_XLIB_LIBX11
	select BR2_PACKAGE_XORGPROTO
	help
	  X.Org Xfixes library
```

## package/x11r7/xlib_libXfont/Config.in
```kconfig
config BR2_PACKAGE_XLIB_LIBXFONT
	bool "libXfont"
	select BR2_PACKAGE_FREETYPE
	select BR2_PACKAGE_XLIB_LIBFONTENC
	select BR2_PACKAGE_XLIB_XTRANS
	select BR2_PACKAGE_XFONT_ENCODINGS
	select BR2_PACKAGE_XORGPROTO
	help
	  X.Org Xfont library
```

## package/x11r7/xlib_libXfont2/Config.in
```kconfig
config BR2_PACKAGE_XLIB_LIBXFONT2
	bool "libXfont2"
	select BR2_PACKAGE_FREETYPE
	select BR2_PACKAGE_XLIB_LIBFONTENC
	select BR2_PACKAGE_XLIB_XTRANS
	select BR2_PACKAGE_XFONT_ENCODINGS
	select BR2_PACKAGE_XORGPROTO
	help
	  X.Org Xfont library
```

## package/x11r7/xlib_libXfontcache/Config.in
```kconfig
config BR2_PACKAGE_XLIB_LIBXFONTCACHE
	bool "libXfontcache"
	select BR2_PACKAGE_XLIB_LIBX11
	select BR2_PACKAGE_XLIB_LIBXEXT
	select BR2_PACKAGE_XPROTO_FONTCACHEPROTO
	help
	  X.Org Xfontcache library
```

## package/x11r7/xlib_libXft/Config.in
```kconfig
config BR2_PACKAGE_XLIB_LIBXFT
	bool "libXft"
	default n
	select BR2_PACKAGE_FONTCONFIG
	select BR2_PACKAGE_FREETYPE
	select BR2_PACKAGE_XLIB_LIBX11
	select BR2_PACKAGE_XLIB_LIBXEXT
	select BR2_PACKAGE_XLIB_LIBXRENDER
	select BR2_PACKAGE_XPROTO_XPROTO
	help
	  libXft 2.1.12
	  X.Org Xft library
```

## package/x11r7/xlib_libXi/Config.in
```kconfig
config BR2_PACKAGE_XLIB_LIBXI
	bool "libXi"
	select BR2_PACKAGE_XPROTO_XPROTO
	select BR2_PACKAGE_XPROTO_INPUTPROTO
	select BR2_PACKAGE_XLIB_LIBX11
	select BR2_PACKAGE_XLIB_LIBXEXT
	select BR2_PACKAGE_XLIB_LIBXFIXES
	help
	  X.Org Xi library
```

## package/x11r7/xlib_libXinerama/Config.in
```kconfig
config BR2_PACKAGE_XLIB_LIBXINERAMA
	bool "libXinerama"
	select BR2_PACKAGE_XLIB_LIBX11
	select BR2_PACKAGE_XLIB_LIBXEXT
	select BR2_PACKAGE_XORGPROTO
	help
	  X.Org Xinerama library
```
