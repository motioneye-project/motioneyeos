## package/x11r7/xlib_libXmu/Config.in
```kconfig
config BR2_PACKAGE_XLIB_LIBXMU
	bool "libXmu"
	select BR2_PACKAGE_XLIB_LIBX11
	select BR2_PACKAGE_XLIB_LIBXEXT
	select BR2_PACKAGE_XLIB_LIBXT
	select BR2_PACKAGE_XORGPROTO
	help
	  X.Org Xmu library
```

## package/x11r7/xlib_libXp/Config.in
```kconfig
config BR2_PACKAGE_XLIB_LIBXP
	bool "libXp"
	select BR2_PACKAGE_XLIB_LIBX11
	select BR2_PACKAGE_XLIB_LIBXAU
	select BR2_PACKAGE_XLIB_LIBXEXT
	select BR2_PACKAGE_XPROTO_PRINTPROTO
	help
	  X.Org Xp library
```

## package/x11r7/xlib_libXpm/Config.in
```kconfig
config BR2_PACKAGE_XLIB_LIBXPM
	bool "libXpm"
	select BR2_PACKAGE_XLIB_LIBX11
	select BR2_PACKAGE_XLIB_LIBXEXT
	select BR2_PACKAGE_XLIB_LIBXT
	select BR2_PACKAGE_XORGPROTO
	help
	  X.Org Xpm library
```

## package/x11r7/xlib_libXprintAppUtil/Config.in
```kconfig
config BR2_PACKAGE_XLIB_LIBXPRINTAPPUTIL
	bool "libXprintAppUtil"
	select BR2_PACKAGE_XLIB_LIBX11
	select BR2_PACKAGE_XLIB_LIBXP
	select BR2_PACKAGE_XLIB_LIBXPRINTUTIL
	help
	  X.Org XprintAppUtil library
```

## package/x11r7/xlib_libXprintUtil/Config.in
```kconfig
config BR2_PACKAGE_XLIB_LIBXPRINTUTIL
	bool "libXprintUtil"
	select BR2_PACKAGE_XLIB_LIBX11
	select BR2_PACKAGE_XLIB_LIBXP
	select BR2_PACKAGE_XLIB_LIBXT
	select BR2_PACKAGE_XPROTO_PRINTPROTO
	help
	  X.Org XprintUtil library
```

## package/x11r7/xlib_libXrandr/Config.in
```kconfig
config BR2_PACKAGE_XLIB_LIBXRANDR
	bool "libXrandr"
	select BR2_PACKAGE_XLIB_LIBX11
	select BR2_PACKAGE_XLIB_LIBXEXT
	select BR2_PACKAGE_XLIB_LIBXRENDER
	select BR2_PACKAGE_XORGPROTO
	help
	  X.Org Xrandr library
```

## package/x11r7/xlib_libXrender/Config.in
```kconfig
config BR2_PACKAGE_XLIB_LIBXRENDER
	bool "libXrender"
	select BR2_PACKAGE_XLIB_LIBX11
	select BR2_PACKAGE_XORGPROTO
	help
	  X.Org Xrender library
```

## package/x11r7/xlib_libXres/Config.in
```kconfig
config BR2_PACKAGE_XLIB_LIBXRES
	bool "libXres"
	select BR2_PACKAGE_XLIB_LIBX11
	select BR2_PACKAGE_XLIB_LIBXEXT
	select BR2_PACKAGE_XORGPROTO
	help
	  X.Org XRes library
```

## package/x11r7/xlib_libXt/Config.in
```kconfig
config BR2_PACKAGE_XLIB_LIBXT
	bool "libXt"
	select BR2_PACKAGE_XLIB_LIBSM
	select BR2_PACKAGE_XLIB_LIBX11
	select BR2_PACKAGE_XORGPROTO
	select BR2_PACKAGE_XCB_PROTO
	select BR2_PACKAGE_LIBXCB
	help
	  X.Org Xt library
```

## package/x11r7/xlib_libXtst/Config.in
```kconfig
config BR2_PACKAGE_XLIB_LIBXTST
	bool "libXtst"
	select BR2_PACKAGE_XLIB_LIBX11
	select BR2_PACKAGE_XLIB_LIBXI
	select BR2_PACKAGE_XLIB_LIBXEXT
	select BR2_PACKAGE_XORGPROTO
	help
	  X.Org Xtst library
```

## package/x11r7/xlib_libXv/Config.in
```kconfig
config BR2_PACKAGE_XLIB_LIBXV
	bool "libXv"
	select BR2_PACKAGE_XLIB_LIBX11
	select BR2_PACKAGE_XLIB_LIBXEXT
	select BR2_PACKAGE_XORGPROTO
	help
	  X.Org Xv library
```

## package/x11r7/xlib_libXvMC/Config.in
```kconfig
config BR2_PACKAGE_XLIB_LIBXVMC
	bool "libXvMC"
	select BR2_PACKAGE_XLIB_LIBX11
	select BR2_PACKAGE_XLIB_LIBXEXT
	select BR2_PACKAGE_XLIB_LIBXV
	select BR2_PACKAGE_XORGPROTO
	help
	  X.Org XvMC library
```

## package/x11r7/xlib_libXxf86dga/Config.in
```kconfig
config BR2_PACKAGE_XLIB_LIBXXF86DGA
	bool "libXxf86dga"
	depends on BR2_USE_MMU # fork()
	select BR2_PACKAGE_XLIB_LIBX11
	select BR2_PACKAGE_XLIB_LIBXEXT
	select BR2_PACKAGE_XORGPROTO
	help
	  X.Org Xxf86dga library
```

## package/x11r7/xlib_libXxf86misc/Config.in
```kconfig
config BR2_PACKAGE_XLIB_LIBXXF86MISC
	bool "libXxf86misc"
	select BR2_PACKAGE_XLIB_LIBX11
	select BR2_PACKAGE_XLIB_LIBXEXT
	select BR2_PACKAGE_XPROTO_XF86MISCPROTO
	select BR2_PACKAGE_XPROTO_XPROTO
	help
	  X.Org Xxf86misc library
```

## package/x11r7/xlib_libXxf86vm/Config.in
```kconfig
config BR2_PACKAGE_XLIB_LIBXXF86VM
	bool "libXxf86vm"
	select BR2_PACKAGE_XLIB_LIBX11
	select BR2_PACKAGE_XLIB_LIBXEXT
	select BR2_PACKAGE_XORGPROTO
	help
	  X.Org Xxf86vm library
```

## package/x11r7/xlib_libdmx/Config.in
```kconfig
config BR2_PACKAGE_XLIB_LIBDMX
	bool "libdmx"
	select BR2_PACKAGE_XLIB_LIBX11
	select BR2_PACKAGE_XLIB_LIBXEXT
	select BR2_PACKAGE_XORGPROTO
	help
	  X.Org dmx library
```

## package/x11r7/xlib_libfontenc/Config.in
```kconfig
config BR2_PACKAGE_XLIB_LIBFONTENC
	bool "libfontenc"
	select BR2_PACKAGE_XORGPROTO
	select BR2_PACKAGE_ZLIB
	help
	  X.Org fontenc library
```

## package/x11r7/xlib_liblbxutil/Config.in
```kconfig
config BR2_PACKAGE_XLIB_LIBLBXUTIL
	bool "liblbxutil"
	select BR2_PACKAGE_XPROTO_XEXTPROTO
	help
	  liblbxutil 1.0.1
	  X.Org lbxutil library
```

## package/x11r7/xlib_liboldX/Config.in
```kconfig
config BR2_PACKAGE_XLIB_LIBOLDX
	bool "liboldX"
	select BR2_PACKAGE_XLIB_LIBX11
	help
	  X.Org oldX library
```

## package/x11r7/xlib_libpciaccess/Config.in
```kconfig
config BR2_PACKAGE_XLIB_LIBPCIACCESS
	bool "libpciaccess"
	depends on BR2_LARGEFILE
	help
	  X.Org libpciaccess

comment "libpciaccess needs a toolchain w/ largefile"
	depends on !BR2_LARGEFILE
```

## package/x11r7/xlib_libpthread-stubs/Config.in
```kconfig
config BR2_PACKAGE_XLIB_LIBPTHREAD_STUBS
	bool "libpthread-stubs"
	help
	  This library provides weak aliases for pthread functions not
	  provided in libc or otherwise available by default.

	  http://xcb.freedesktop.org/
```

## package/x11r7/xlib_libxkbfile/Config.in
```kconfig
config BR2_PACKAGE_XLIB_LIBXKBFILE
	bool "libxkbfile"
	select BR2_PACKAGE_XLIB_LIBX11
	select BR2_PACKAGE_XORGPROTO
	help
	  X.Org xkbfile library
```

## package/x11r7/xlib_libxkbui/Config.in
```kconfig
config BR2_PACKAGE_XLIB_LIBXKBUI
	bool "libxkbui"
	select BR2_PACKAGE_XLIB_LIBXKBFILE
	select BR2_PACKAGE_XLIB_LIBXT
	select BR2_PACKAGE_XPROTO_KBPROTO
	help
	  X.Org xkbui library
```

## package/x11r7/xlib_libxshmfence/Config.in
```kconfig
config BR2_PACKAGE_XLIB_LIBXSHMFENCE
	bool "libxshmfence"
	depends on BR2_TOOLCHAIN_HAS_SYNC_4
	select BR2_PACKAGE_XORGPROTO
	help
	  X.Org shmfence library
```
