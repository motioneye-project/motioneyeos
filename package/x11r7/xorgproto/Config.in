## package/x11r7/xorgproto/Config.in
```kconfig
config BR2_PACKAGE_XORGPROTO
	bool "xorgproto"
	help
	  This package combines the protocol headers, which were
	  formerly scattered in individual packages.
```

## package/x11r7/xproto_applewmproto/Config.in
```kconfig
config BR2_PACKAGE_XPROTO_APPLEWMPROTO
	bool "applewmproto"
	help
	  No description available
```

## package/x11r7/xproto_bigreqsproto/Config.in
```kconfig
config BR2_PACKAGE_XPROTO_BIGREQSPROTO
	bool "bigreqsproto"
	help
	  X.Org BigReqs protocol headers
```

## package/x11r7/xproto_compositeproto/Config.in
```kconfig
config BR2_PACKAGE_XPROTO_COMPOSITEPROTO
	bool "compositeproto"
	help
	  X.Org Composite protocol headers
```

## package/x11r7/xproto_damageproto/Config.in
```kconfig
config BR2_PACKAGE_XPROTO_DAMAGEPROTO
	bool "damageproto"
	help
	  X.Org Damage protocol headers
```

## package/x11r7/xproto_dmxproto/Config.in
```kconfig
config BR2_PACKAGE_XPROTO_DMXPROTO
	bool "dmxproto"
	help
	  X.Org DMX protocol headers
```

## package/x11r7/xproto_dri2proto/Config.in
```kconfig
config BR2_PACKAGE_XPROTO_DRI2PROTO
	bool "dri2proto"
	help
	  X.Org DRI2 protocol headers
```

## package/x11r7/xproto_dri3proto/Config.in
```kconfig
config BR2_PACKAGE_XPROTO_DRI3PROTO
	bool "dri3proto"
	help
	  X.Org DRI3 protocol headers
```

## package/x11r7/xproto_evieext/Config.in
```kconfig
config BR2_PACKAGE_XPROTO_EVIEEXT
	bool "evieext"
	help
	  X.Org EvIE protocol headers
```

## package/x11r7/xproto_fixesproto/Config.in
```kconfig
config BR2_PACKAGE_XPROTO_FIXESPROTO
	bool "fixesproto"
	help
	  X.Org Fixes protocol headers
```

## package/x11r7/xproto_fontcacheproto/Config.in
```kconfig
config BR2_PACKAGE_XPROTO_FONTCACHEPROTO
	bool "fontcacheproto"
	help
	  X.Org Fontcache protocol headers
```

## package/x11r7/xproto_fontsproto/Config.in
```kconfig
config BR2_PACKAGE_XPROTO_FONTSPROTO
	bool "fontsproto"
	help
	  X.Org Fonts protocol headers
```

## package/x11r7/xproto_glproto/Config.in
```kconfig
config BR2_PACKAGE_XPROTO_GLPROTO
	bool "glproto"
	help
	  X.Org GL protocol headers
```

## package/x11r7/xproto_inputproto/Config.in
```kconfig
config BR2_PACKAGE_XPROTO_INPUTPROTO
	bool "inputproto"
	help
	  X.Org Input protocol headers
```

## package/x11r7/xproto_kbproto/Config.in
```kconfig
config BR2_PACKAGE_XPROTO_KBPROTO
	bool "kbproto"
	help
	  X.Org KB protocol headers
```

## package/x11r7/xproto_printproto/Config.in
```kconfig
config BR2_PACKAGE_XPROTO_PRINTPROTO
	bool "printproto"
	help
	  X.Org Print protocol headers
```

## package/x11r7/xproto_randrproto/Config.in
```kconfig
config BR2_PACKAGE_XPROTO_RANDRPROTO
	bool "randrproto"
	help
	  X.Org Randr protocol headers
```

## package/x11r7/xproto_recordproto/Config.in
```kconfig
config BR2_PACKAGE_XPROTO_RECORDPROTO
	bool "recordproto"
	help
	  X.Org Record protocol headers
```

## package/x11r7/xproto_renderproto/Config.in
```kconfig
config BR2_PACKAGE_XPROTO_RENDERPROTO
	bool "renderproto"
	help
	  renderproto 0.11
	  X.Org Render protocol headers
```

## package/x11r7/xproto_resourceproto/Config.in
```kconfig
config BR2_PACKAGE_XPROTO_RESOURCEPROTO
	bool "resourceproto"
	help
	  X.Org Resource protocol headers
```

## package/x11r7/xproto_scrnsaverproto/Config.in
```kconfig
config BR2_PACKAGE_XPROTO_SCRNSAVERPROTO
	bool "scrnsaverproto"
	help
	  X.Org ScrnSaver protocol headers
```

## package/x11r7/xproto_trapproto/Config.in
```kconfig
config BR2_PACKAGE_XPROTO_TRAPPROTO
	bool "trapproto"
	select BR2_PACKAGE_XLIB_LIBXT
	help
	  trapproto 3.4.3
	  X.Org Trap protocol headers
```

## package/x11r7/xproto_videoproto/Config.in
```kconfig
config BR2_PACKAGE_XPROTO_VIDEOPROTO
	bool "videoproto"
	help
	  X.Org Video protocol headers
```

## package/x11r7/xproto_windowswmproto/Config.in
```kconfig
config BR2_PACKAGE_XPROTO_WINDOWSWMPROTO
	bool "windowswmproto"
	help
	  No description available
```

## package/x11r7/xproto_xcmiscproto/Config.in
```kconfig
config BR2_PACKAGE_XPROTO_XCMISCPROTO
	bool "xcmiscproto"
	help
	  xcmiscproto 1.2.0
	  X.Org XCMisc protocol headers
```
