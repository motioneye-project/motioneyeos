## package/x11r7/xproto_xextproto/Config.in
```kconfig
config BR2_PACKAGE_XPROTO_XEXTPROTO
	bool "xextproto"
	help
	  X.Org XExt protocol headers
```

## package/x11r7/xproto_xf86bigfontproto/Config.in
```kconfig
config BR2_PACKAGE_XPROTO_XF86BIGFONTPROTO
	bool "xf86bigfontproto"
	help
	  X.Org XF86BigFont protocol headers
```

## package/x11r7/xproto_xf86dgaproto/Config.in
```kconfig
config BR2_PACKAGE_XPROTO_XF86DGAPROTO
	bool "xf86dgaproto"
	help
	  X.Org XF86DGA protocol headers
```

## package/x11r7/xproto_xf86driproto/Config.in
```kconfig
config BR2_PACKAGE_XPROTO_XF86DRIPROTO
	bool "xf86driproto"
	help
	  X.Org XF86DRI protocol headers
```

## package/x11r7/xproto_xf86miscproto/Config.in
```kconfig
config BR2_PACKAGE_XPROTO_XF86MISCPROTO
	bool "xf86miscproto"
	help
	  X.Org XF86Misc protocol headers
```

## package/x11r7/xproto_xf86rushproto/Config.in
```kconfig
config BR2_PACKAGE_XPROTO_XF86RUSHPROTO
	bool "xf86rushproto"
	help
	  X.Org XF86Rush protocol headers
```

## package/x11r7/xproto_xf86vidmodeproto/Config.in
```kconfig
config BR2_PACKAGE_XPROTO_XF86VIDMODEPROTO
	bool "xf86vidmodeproto"
	help
	  X.Org XF86VidMode protocol headers
```

## package/x11r7/xproto_xineramaproto/Config.in
```kconfig
config BR2_PACKAGE_XPROTO_XINERAMAPROTO
	bool "xineramaproto"
	help
	  X.Org Xinerama protocol headers
```

## package/x11r7/xproto_xproto/Config.in
```kconfig
config BR2_PACKAGE_XPROTO_XPROTO
	bool "xproto"
	help
	  X.Org xproto protocol headers
```

## package/x11r7/xproto_xproxymanagementprotocol/Config.in
```kconfig
config BR2_PACKAGE_XPROTO_XPROXYMANAGEMENTPROTOCOL
	bool "xproxymanagementprotocol"
	help
	  The Proxy Management Protocol is an ICE based protocol that
	  provides a way for application servers to easily locate
	  proxy services available to them.
```

## package/x11r7/xserver_xorg-server/Config.in
```kconfig
config BR2_PACKAGE_XSERVER_XORG_SERVER
	bool "xorg-server"
	select BR2_PACKAGE_LIBDRM if BR2_PACKAGE_XSERVER_XORG_SERVER_MODULAR
	select BR2_PACKAGE_LIBPCIACCESS if BR2_PACKAGE_XSERVER_XORG_SERVER_MODULAR
	# We need a SHA1 implementation. If either openssl or
	# libgcrypt are already part of the build, we'll use one of
	# them, otherwise, use the small libsha1 library.
	select BR2_PACKAGE_LIBSHA1 if (!BR2_PACKAGE_OPENSSL && !BR2_PACKAGE_LIBGCRYPT)
	select BR2_PACKAGE_PIXMAN
	select BR2_PACKAGE_XFONT_FONT_ALIAS if !BR2_PACKAGE_XSERVER_XORG_SERVER_BUILTIN_FONTS
	select BR2_PACKAGE_XFONT_FONT_MISC_MISC if !BR2_PACKAGE_XSERVER_XORG_SERVER_BUILTIN_FONTS
	select BR2_PACKAGE_XFONT_FONT_CURSOR_MISC if !BR2_PACKAGE_XSERVER_XORG_SERVER_BUILTIN_FONTS
	select BR2_PACKAGE_XLIB_LIBX11
	select BR2_PACKAGE_XLIB_LIBXAU
	select BR2_PACKAGE_XLIB_LIBXCURSOR
	select BR2_PACKAGE_XLIB_LIBXDAMAGE
	select BR2_PACKAGE_XLIB_LIBXDMCP
	select BR2_PACKAGE_XLIB_LIBXEXT
	select BR2_PACKAGE_XLIB_LIBXFIXES
	select BR2_PACKAGE_XLIB_LIBXFONT
	select BR2_PACKAGE_XLIB_LIBXFT
	select BR2_PACKAGE_XLIB_LIBXI
	select BR2_PACKAGE_XLIB_LIBXINERAMA
	select BR2_PACKAGE_XLIB_LIBXRANDR
	select BR2_PACKAGE_XLIB_LIBXRENDER
	select BR2_PACKAGE_XLIB_LIBXRES
	select BR2_PACKAGE_XLIB_LIBXXF86VM
	select BR2_PACKAGE_XLIB_LIBXKBFILE
	select BR2_PACKAGE_XLIB_XTRANS
	select BR2_PACKAGE_XDATA_XBITMAPS
	select BR2_PACKAGE_XPROTO_BIGREQSPROTO
	select BR2_PACKAGE_XPROTO_COMPOSITEPROTO
	select BR2_PACKAGE_XPROTO_DAMAGEPROTO
	select BR2_PACKAGE_XPROTO_FIXESPROTO
	select BR2_PACKAGE_XPROTO_FONTSPROTO
	select BR2_PACKAGE_XPROTO_GLPROTO
	select BR2_PACKAGE_XPROTO_INPUTPROTO
	select BR2_PACKAGE_XPROTO_KBPROTO
	select BR2_PACKAGE_XPROTO_PRESENTPROTO
	select BR2_PACKAGE_XPROTO_RANDRPROTO
	select BR2_PACKAGE_XPROTO_RENDERPROTO
	select BR2_PACKAGE_XPROTO_RESOURCEPROTO
	select BR2_PACKAGE_XPROTO_VIDEOPROTO
	select BR2_PACKAGE_XPROTO_XCMISCPROTO
	select BR2_PACKAGE_XPROTO_XEXTPROTO
	select BR2_PACKAGE_XPROTO_XF86BIGFONTPROTO
	select BR2_PACKAGE_XPROTO_XF86DGAPROTO
	select BR2_PACKAGE_XPROTO_XF86VIDMODEPROTO
	select BR2_PACKAGE_XPROTO_XPROTO
	select BR2_PACKAGE_XUTIL_UTIL_MACROS
	select BR2_PACKAGE_XKEYBOARD_CONFIG
	depends on !BR2_avr32
	depends on BR2_USE_MMU # fork()
	help
	  X.Org X server

	  http://xorg.freedesktop.org

comment "xorg-xserver is BROKEN on AVR32"
	depends on BR2_avr32 && BR2_USE_MMU

if BR2_PACKAGE_XSERVER_XORG_SERVER

choice
	prompt "X Window System server type"
	default BR2_PACKAGE_XSERVER_XORG_SERVER_KDRIVE
	help
	  Select the X Window System server to use

config BR2_PACKAGE_XSERVER_XORG_SERVER_MODULAR
	bool "Modular X.org"
	depends on BR2_LARGEFILE && BR2_INSTALL_LIBSTDCPP
	help
	  This variant of the X.org server is the full-blown variant,
	  as used by desktop GNU/Linux distributions. The drivers (for
	  input and graphics) are built separately from the X.org
	  server (see the xdriver* packages).

comment "Modular X.org needs a toolchain w/ largefile, C++"
	depends on !(BR2_LARGEFILE && BR2_INSTALL_LIBSTDCPP)

config BR2_PACKAGE_XSERVER_XORG_SERVER_KDRIVE
	bool "KDrive / TinyX"
	help
	  This variant of the X.org server is a lightweight version
	  intended for embedded systems. The drivers (for input and
	  graphics) are built into the server. It is generally used
	  directly on top of the Linux framebuffer without DRM or
	  video card specific drivers.

endchoice

config BR2_PACKAGE_XSERVER_XORG_SERVER_NULL_CURSOR
	bool "Null root cursor"
	help
	  Don't display root cursor.

config BR2_PACKAGE_XSERVER_XORG_SERVER_AIGLX
	bool "Enable AIGLX Extension"
	help
	  Enable/Use AIGLX extension.

if BR2_PACKAGE_XSERVER_XORG_SERVER_KDRIVE

config BR2_PACKAGE_XSERVER_XORG_SERVER_KDRIVE_EVDEV
	bool "Enable KDrive/TinyX evdev input driver"
	help
	  Enable evdev input driver in KDrive. This allows KDrive to
	  use input devices that are integrated in the Linux input
	  subsystem, i.e have a /dev/input/eventX device file. This is
	  most likely the input driver you want to use.

	  This driver can then be enabled by running the X server
	  using:

	  Xfbdev -keybd evdev,,device=/dev/input/eventX -mouse evdev,,device=/dev/input/eventY.

config BR2_PACKAGE_XSERVER_XORG_SERVER_KDRIVE_KBD
	bool "Enable KDrive/TinyX kbd input driver"
	help
	  Enable kbd input driver in KDrive. It uses the console
	  keyboard as input device.

config BR2_PACKAGE_XSERVER_XORG_SERVER_KDRIVE_MOUSE
	bool "Enable KDrive/TinyX mouse input driver"
	help
	  Enable mouse input driver in KDrive. It supports PS/2 mice
	  and serial port mice.

endif

comment "Optional Servers"

config BR2_PACKAGE_XSERVER_XORG_SERVER_XVFB
	bool "Xvfb server"
	help
	  Virtual frame buffer X server.

endif
```

## package/x11r7/xutil_makedepend/Config.in
```kconfig
config BR2_PACKAGE_XUTIL_MAKEDEPEND
	bool "makedepend"
	select BR2_PACKAGE_XORGPROTO
	help
	  No description available
```

## package/x11r7/xutil_util-macros/Config.in
```kconfig
config BR2_PACKAGE_XUTIL_UTIL_MACROS
	bool "util-macros"
	help
	  util-macros 1.3.0
	  No description available
```

## package/x11vnc/Config.in
```kconfig
config BR2_PACKAGE_X11VNC
	bool "x11vnc"
	depends on BR2_PACKAGE_XORG7
	select BR2_PACKAGE_XLIB_LIBXT
	select BR2_PACKAGE_XLIB_LIBXEXT
	select BR2_PACKAGE_XLIB_LIBXTST
	help
	  VNC server for X11 display

	  http://www.karlrunge.com/x11vnc/
```

## package/x264/Config.in
```kconfig
config BR2_PACKAGE_X264
	bool "x264"
	help
	  x264 is a free software library and application for
	  encoding video streams into the H.264/MPEG-4 AVC
	  compression format, and is released under the terms
	  of the GNU GPL.

	  https://www.videolan.org/developers/x264.html

if BR2_PACKAGE_X264

config BR2_PACKAGE_X264_CLI
	bool "CLI"
	help
	  Command-line tool to encode video streams into the
	  H.264/MPEG-4 AVC compression format.

endif
```

## package/x265/Config.in
```kconfig
config BR2_PACKAGE_X265
	bool "x265"
	depends on BR2_INSTALL_LIBSTDCPP
	depends on BR2_TOOLCHAIN_HAS_THREADS
	depends on !BR2_STATIC_LIBS # dlfcn
	help
	  x265 is an open source free software and library for encoding video
	  using the High Efficiency Video Coding (HEVC/H.265) standard. x265 is
	  offered under either the GNU General Public License (GPL) 2 license or
	  a commercial license, similar to the x264 project.

	  http://x265.org

if BR2_PACKAGE_X265

config BR2_PACKAGE_X265_CLI
	bool "CLI"
	help
	  Command-line tool to encode video streams into the
	  H.265/HEVC compression format.

endif

comment "x265 needs a toolchain w/ C++, threads, dynamic library"
	depends on !BR2_INSTALL_LIBSTDCPP || BR2_STATIC_LIBS || \
		!BR2_TOOLCHAIN_HAS_THREADS
```

## package/xapian/Config.in
```kconfig
config BR2_PACKAGE_XAPIAN
	bool "xapian"
	depends on BR2_USE_MMU # fork()
	depends on BR2_INSTALL_LIBSTDCPP
	select BR2_PACKAGE_ZLIB
	help
	  Xapian is an open Source search engine Library
	  It is a highly adaptable toolkit which allows developers
	  to easily add advanced indexing and search facilities to
	  their own applications.
	  It has built-in support for several families of weighting
	  models and supports a rich set of boolean query operators.

	  https://xapian.org/

comment "xapian needs a toolchain w/ C++"
	depends on BR2_USE_MMU
	depends on !BR2_INSTALL_LIBSTDCPP
```

## package/xavante/Config.in
```kconfig
config BR2_PACKAGE_XAVANTE
	bool "xavante"
	select BR2_PACKAGE_COPAS # runtime
	select BR2_PACKAGE_LUAFILESYSTEM # runtime
	select BR2_PACKAGE_LUASOCKET # runtime
	help
	  Xavante is a Lua HTTP 1.1 Web server that uses a modular
	  architecture based on URI mapped handlers. Xavante currently
	  offers a file handler, a redirect handler and a WSAPI handler.
	  Those are used for general files, URI remapping and WSAPI
	  applications respectively.

	  http://keplerproject.github.io/xavante
```

## package/xbmc-addon-xvdr/Config.in
```kconfig
config BR2_PACKAGE_XBMC_ADDON_XVDR
	bool "xbmc-addon-xvdr"
	help
	  This is a PVR add-on for XBMC to add VDR (http://tvdr.de/)
	  as a TV/PVR Backend to XBMC.

	  It adds support for Live TV watching, replaying of Recordings,
	  programming Timers and EPG TV Guide to use on same computer or
	  over the Network.

	  https://github.com/pipelka/xbmc-addon-xvdr

	  Note: since the VDR server is not packaged in Buildroot, using
	  this addon requires that a remote VDR server be used.
```

## package/xbmc-pvr-addons/Config.in
```kconfig
config BR2_PACKAGE_XBMC_PVR_ADDONS
	bool "xbmc-pvr-addons"
	help
	  A collection of PVR backend addons for XBMC.

	  https://github.com/opdenkamp/xbmc-pvr-addons
```
