## package/xenomai/Config.in
```kconfig
config BR2_PACKAGE_XENOMAI_ARCH_SUPPORTS
	bool
	default y
	depends on BR2_i386 || BR2_x86_64 || (BR2_arm && !BR2_ARM_CPU_ARMV7M) || \
		BR2_bfin || BR2_powerpc

comment "xenomai needs an glibc or uClibc toolchain w/ threads"
	depends on !BR2_TOOLCHAIN_HAS_THREADS || BR2_TOOLCHAIN_USES_MUSL
	depends on BR2_PACKAGE_XENOMAI_ARCH_SUPPORTS

config BR2_PACKAGE_XENOMAI
	bool "Xenomai Userspace"
	depends on BR2_PACKAGE_XENOMAI_ARCH_SUPPORTS
	depends on BR2_TOOLCHAIN_HAS_THREADS
	# uses <error.h>, __WORDSIZE and bits/local_lim.h
	depends on !BR2_TOOLCHAIN_USES_MUSL
	help
	  Real-Time Framework for Linux
	  http://www.xenomai.org

	  Xenomai is split in two parts: a kernel part and an
	  userspace part.

	  This package contains the userspace part, which consists
	  mainly in libraries to write userspace real-time programs
	  that interact with the in-kernel Xenomai real-time core.

	  For those libraries to work, you need a Xenomai-enabled
	  kernel. This is possible in two ways:
	   - if you compile your kernel with Buildroot, you need to go
	     to Linux Kernel -> Linux Kernel Extensions to enable the
	     Xenomai extension.
	   - if you compile your kernel outside of Buildroot, you need
	     to make sure that it is Xenomai-enabled.

	  Finally, if you are using a static /dev, make sure to
	  uncomment the Xenomai entries listed in
	  target/generic/device_table_dev.txt.

if BR2_PACKAGE_XENOMAI

config BR2_PACKAGE_XENOMAI_VERSION
	string "Custom Xenomai version"
	help
	  Manually select Xenomai version. If left empty, the default
	  version will be used.

	  Make sure that the selected version has a patch for your
	  selected Linux kernel. If it does not, download and select
	  a patch manually with
	  BR2_LINUX_KERNEL_EXT_XENOMAI_ADEOS_PATCH, in the Linux
	  Kernel -> Linux Kernel Extensions menu.

choice
	prompt "Xenomai core"
	default BR2_PACKAGE_XENOMAI_MERCURY
	help
	  Select the Xenomai core: dual kernel (Cobalt)
	  or native Linux Kernel (Mercury).

config BR2_PACKAGE_XENOMAI_MERCURY
	bool "Mercury"
	depends on !BR2_LINUX_KERNEL_EXT_XENOMAI
	help
	  Select Mercury core for the Xenomai userspace.
	  You want to use it if you have the native Linux Kernel.

config BR2_PACKAGE_XENOMAI_COBALT
	bool "Cobalt"
	help
	  Select Cobalt core (dual kernel) for the Xenomai
	  userspace. Use this if you use a Xenomai-patched
	  Linux kernel.

	  If you want to use Cobalt core, your kernel must have
	  the Adeos and Xenomai patches applied to it. You can
	  add these through the BR2_LINUX_KERNEL_EXT_XENOMAI option
	  in the Linux Kernel Extensions menu.
endchoice

config BR2_PACKAGE_XENOMAI_ENABLE_SMP
	bool "Enable SMP support"
	default y
	help
	  This option enables SMP support in Xenomai userspace.

	  If this option is turned on while no SMP support is enabled
	  in the kernel, things will still work. However, if SMP is
	  enabled in the kernel but this option is not turned on,
	  Xenomai applications will complain with:

	    feature mismatch: missing="smp/nosmp"

	  Please refer to this troubleshooting guide for more
	  information:

	  http://xenomai.org/troubleshooting-a-dual-kernel-configuration/#feature_mismatch_missing8221smpnosmp8221

config BR2_PACKAGE_XENOMAI_ENABLE_REGISTRY
	bool "Enable registry"
	depends on !BR2_STATIC_LIBS # libfuse
	depends on BR2_TOOLCHAIN_HAS_THREADS # libfuse
	depends on BR2_USE_MMU # libfuse
	select BR2_PACKAGE_LIBFUSE
	help
	  Xenomai APIs can export their internal state through a
	  pseudo-filesystem, whose files may be read to obtain
	  information about the existing real-time objects, such as
	  tasks, semaphores, message queues and so on.

comment "registry needs a toolchain w/ threads, dynamic library"
	depends on BR2_USE_MMU
	depends on BR2_STATIC_LIBS || !BR2_TOOLCHAIN_HAS_THREADS

config BR2_PACKAGE_XENOMAI_ENABLE_REGISTRY_PATH
	string "Custom registry root path"
	depends on BR2_PACKAGE_XENOMAI_ENABLE_REGISTRY
	help
	  Specify the root path of the registry here.
	  To use the Xenomai default (currently: /var/run/xenomai),
	  leave this option empty.

config BR2_PACKAGE_XENOMAI_ADDITIONAL_CONF_OPTS
	string "Additional configure options"
	help
	  Specify any additional options to pass to the configure
	  script here.  See Xenomai documentation for details.

config BR2_PACKAGE_XENOMAI_TESTSUITE
	bool "Install testsuite"
	help
	  This option allows to install the Xenomai test programs.

config BR2_PACKAGE_XENOMAI_RTCAN
	bool "RTCan utilities"
	help
	  This option allows to install the Xenomai RT-CAN utilities.

config BR2_PACKAGE_XENOMAI_ANALOGY
	bool "Analogy libs and utils"
	help
	  This option allows to install the Xenomai Analogy utilities
	  and libraries

menu "Skin selection"

config BR2_PACKAGE_XENOMAI_NATIVE_SKIN
	bool "Alchemy (native) skin"
	default y
	help
	  This option allows to install the Alchemy Xenomai skin, previously
	  called 'native'

config BR2_PACKAGE_XENOMAI_POSIX_SKIN
	bool "POSIX skin"
	default y
	help
	  This option allows to install the POSIX Xenomai skin

config BR2_PACKAGE_XENOMAI_PSOS_SKIN
	bool "pSOS skin"
	help
	  This option allows to install the pSOS Xenomai skin

config BR2_PACKAGE_XENOMAI_RTAI_SKIN
	bool "RTAI skin"
	help
	  This option allows to install the RTAI Xenomai skin

config BR2_PACKAGE_XENOMAI_SMOKEY_SKIN
	bool "Smokey skin"
	help
	  This option allows to install the Smokey Xenomai skin

config BR2_PACKAGE_XENOMAI_UITRON_SKIN
	bool "uITRON skin"
	help
	  This option allows to install the uITRON Xenomai skin

config BR2_PACKAGE_XENOMAI_VRTX_SKIN
	bool "VRTX skin"
	help
	  This option allows to install the VRTX Xenomai skin

config BR2_PACKAGE_XENOMAI_VXWORKS_SKIN
	bool "VxWorks skin"
	help
	  This option allows to install the VxWorks Xenomai skin

endmenu

endif
```

## package/xerces/Config.in
```kconfig
config BR2_PACKAGE_XERCES
	bool "xerces-c++"
	depends on BR2_INSTALL_LIBSTDCPP && BR2_USE_WCHAR
	help
	  Xerces-C++ is a validating XML parser written in portable C++.

	  http://xerces.apache.org/xerces-c/

comment "xerces-c++ needs a toolchain w/ C++, wchar"
	depends on !(BR2_INSTALL_LIBSTDCPP && BR2_USE_WCHAR)
```

## package/xfsprogs/Config.in
```kconfig
comment "xfsprogs needs a toolchain w/ threads"
	depends on BR2_USE_MMU
	depends on !BR2_TOOLCHAIN_HAS_THREADS

config BR2_PACKAGE_XFSPROGS
	bool "xfsprogs"
	depends on BR2_USE_MMU # fork()
	depends on BR2_TOOLCHAIN_HAS_THREADS
	select BR2_PACKAGE_UTIL_LINUX
	select BR2_PACKAGE_UTIL_LINUX_LIBUUID
	select BR2_PACKAGE_UTIL_LINUX_LIBBLKID
	help
	  The XFS file system utilities and libraries

	  http://xfs.org
```

## package/xinetd/Config.in
```kconfig
config BR2_PACKAGE_XINETD
	bool "xinetd"
	help
	  xinetd is a secure replacement for inetd. It was originally written by
	  panos@cs.colorado.edu.

	  http://www.xinetd.org
```

## package/xl2tp/Config.in
```kconfig
config BR2_PACKAGE_XL2TP
	bool "xl2tp"
	select BR2_PACKAGE_LIBPCAP
	help
	  Layer 2 Tunnelling Protocol (RFC2661).

	  xl2tpd is an open source implementation of the L2TP tunneling
	  protocol. xl2tpd is forked from l2tpd and is maintained by
	  Xelerance Corporation.

	  http://www.xelerance.com/software/xl2tpd/
```

## package/xmlstarlet/Config.in
```kconfig
config BR2_PACKAGE_XMLSTARLET
	bool "xmlstarlet"
	select BR2_PACKAGE_LIBXML2
	select BR2_PACKAGE_LIBXSLT
	select BR2_PACKAGE_LIBICONV if !BR2_ENABLE_LOCALE
	help
	  Command Line XML Toolkit

	  http://xmlstar.sourceforge.net/
```

## package/xorg/Config.in
```kconfig
config BR2_PACKAGE_XORG
	depends on BR2_DEPRECATED
	bool "X.org X Window System"
	default y if BR2_PACKAGE_XSERVER_xorg
	select BR2_PACKAGE_ZLIB
	select BR2_PACKAGE_LIBPNG
	select BR2_PACKAGE_EXPAT
	select BR2_PACKAGE_FONTCONFIG
	select BR2_PACKAGE_PKGCONFIG
	help
	  The official X Window system and server.

comment "X.org 6.8.2 X Window System disabled"
	depends on BR2_PACKAGE_TINYX||BR2_PACKAGE_XORG7
```

## package/xorriso/Config.in
```kconfig
config BR2_PACKAGE_XORRISO
	bool "xorriso"
	depends on BR2_USE_WCHAR
	depends on BR2_TOOLCHAIN_HAS_THREADS
	depends on BR2_USE_MMU # fork()
	select BR2_PACKAGE_LIBICONV if !BR2_ENABLE_LOCALE
	help
	  xorriso copies file objects from POSIX compliant
	  filesystems into Rock Ridge enhanced ISO 9660 filesystems
	  and allows session-wise manipulation of such filesystems.
	  It can load the management information of existing ISO
	  images and it writes the session results to optical media
	  or to filesystem objects.

	  Vice versa xorriso is able to copy file objects out of ISO
	  9660 filesystems.

	  https://www.gnu.org/software/xorriso

comment "xorriso needs a toolchain w/ wchar, threads"
	depends on BR2_USE_MMU
	depends on !BR2_USE_WCHAR || !BR2_TOOLCHAIN_HAS_THREADS
```

## package/xorriso/Config.in.host
```kconfig
config BR2_PACKAGE_HOST_XORRISO
	bool "host xorriso"
	help
	  xorriso copies file objects from POSIX compliant
	  filesystems into Rock Ridge enhanced ISO 9660 filesystems
	  and allows session-wise manipulation of such filesystems.
	  It can load the management information of existing ISO
	  images and it writes the session results to optical media
	  or to filesystem objects.

	  Vice versa xorriso is able to copy file objects out of ISO
	  9660 filesystems.

	  https://www.gnu.org/software/xorriso
```

## package/xpdf/Config.in
```kconfig
config BR2_PACKAGE_XPDF
	bool "xpdf"
	select BR2_PACKAGE_OPENMOTIF
	help
	  Xpdf is an open source viewer for Portable Document Format
	  (PDF) files.

	  ftp://ftp.foolabs.com/pub/xpdf
```

## package/xr819-xradio/Config.in
```kconfig
config BR2_PACKAGE_XR819_XRADIO
	bool "xr819-xradio"
	depends on BR2_LINUX_KERNEL
	help
	  Wireless driver for SDIO WiFi chip XR819

	  https://github.com/fifteenhex/xradio

comment "xr819-xradio driver needs a Linux kernel to be built"
	depends on !BR2_LINUX_KERNEL
```

## package/xscreensaver/Config.in
```kconfig
config BR2_PACKAGE_XSCREENSAVER
	bool "xscreensaver"
	depends on BR2_PACKAGE_XORG7
	depends on BR2_INSTALL_LIBSTDCPP # libgtk2 -> pango
	depends on BR2_TOOLCHAIN_HAS_THREADS # libgtk2 -> glib2
	depends on BR2_USE_WCHAR # libgtk2 -> glib2
	depends on BR2_USE_MMU # libgtk2 -> glib2
	depends on BR2_TOOLCHAIN_HAS_SYNC_4 # libgtk2 -> pango -> harfbuzz
	select BR2_PACKAGE_LIBGTK2
	select BR2_PACKAGE_LIBGLADE
	select BR2_PACKAGE_JPEG
	select BR2_PACKAGE_XLIB_LIBX11
	select BR2_PACKAGE_XLIB_LIBXT
	help
	  XScreenSaver is the standard screen saver collection shipped
	  on most Linux and Unix systems running the X11 Window
	  System.

	  On X11 systems, XScreenSaver is two things: it is both a
	  large collection of screen savers; and it is also the
	  framework for blanking and locking the screen.

	  http://www.jwz.org/xscreensaver/

comment "xscreensaver needs a toolchain w/ wchar, C++, threads"
	depends on BR2_PACKAGE_XORG7
	depends on BR2_USE_MMU
	depends on BR2_TOOLCHAIN_HAS_SYNC_4
	depends on !BR2_INSTALL_LIBSTDCPP || !BR2_TOOLCHAIN_HAS_THREADS || \
		!BR2_USE_WCHAR
```

## package/xstroke/Config.in
```kconfig
config BR2_PACKAGE_XSTROKE
	bool "xstroke"
	depends on BR2_PACKAGE_XORG7
	# dead upstream, probably not many users
	depends on BR2_DEPRECATED
	select BR2_PACKAGE_XLIB_LIBXFT
	select BR2_PACKAGE_XLIB_LIBXTST
	select BR2_PACKAGE_XLIB_LIBXPM
	select BR2_PACKAGE_XLIB_LIBXRENDER
	select BR2_PACKAGE_XLIB_LIBXEXT
	help
	  Handwriting recognition for X

	  http://mirror.egtvedt.no/avr32linux.org/twiki/pub/Main/XStroke
```

## package/xtables-addons/Config.in
```kconfig
comment "xtables-addons needs a Linux kernel to be built"
	depends on !BR2_LINUX_KERNEL

comment "xtables-addons needs a toolchain w/ dynamic library, largefile, threads"
	depends on BR2_STATIC_LIBS || !BR2_LARGEFILE || \
		!BR2_TOOLCHAIN_HAS_THREADS

config BR2_PACKAGE_XTABLES_ADDONS
	bool "xtables-addons"
	depends on BR2_LINUX_KERNEL
	depends on BR2_LARGEFILE
	depends on BR2_TOOLCHAIN_HAS_THREADS
	depends on !BR2_STATIC_LIBS # extensions are .so
	select BR2_PACKAGE_IPTABLES
	help
	  Xtables-addons is the successor to patch-o-matic(-ng).
	  Likewise, it contains extensions that were not, or are not yet,
	  accepted in the main kernel/iptables packages.

	  http://xtables-addons.sourceforge.net/
```

## package/xterm/Config.in
```kconfig
config BR2_PACKAGE_XTERM
	bool "xterm"
	depends on BR2_PACKAGE_XORG7
	depends on BR2_USE_MMU # fork()
	select BR2_PACKAGE_NCURSES
	select BR2_PACKAGE_XLIB_LIBXAW
	help
	  xterm terminal emulator

	  http://invisible-island.net/xterm/
```

## package/xutil_util-macros/Config.in
```kconfig
config BR2_PACKAGE_XUTIL_UTIL_MACROS
	bool "util-macros"
	help
	  No description available
```

## package/xvisor/Config.in
```kconfig
config BR2_PACKAGE_XVISOR_ARCH_SUPPORTS
	bool
	default y
	depends on BR2_USE_MMU
	depends on BR2_arm || BR2_aarch64 || BR2_x86_64
	depends on !BR2_ARM_CPU_ARMV4 && !BR2_ARM_CPU_ARMV7M

menuconfig BR2_PACKAGE_XVISOR
	bool "xvisor"
	depends on BR2_PACKAGE_XVISOR_ARCH_SUPPORTS
	depends on BR2_TOOLCHAIN_GCC_AT_LEAST_4_9
	help
	  Xvisor is an open-source type-1 hypervisor, which aims at
	  providing a monolithic, light-weight, portable, and flexible
	  virtualization solution.

	  http://www.xhypervisor.org/

if BR2_PACKAGE_XVISOR

choice
	prompt "Xvisor configuration"
	default BR2_PACKAGE_XVISOR_USE_DEFCONFIG

config BR2_PACKAGE_XVISOR_USE_DEFCONFIG
	bool "Using an in-tree defconfig file"

config BR2_PACKAGE_XVISOR_USE_CUSTOM_CONFIG
	bool "Using a custom (def)config file"

endchoice

config BR2_PACKAGE_XVISOR_DEFCONFIG
	string "Defconfig name"
	default "generic-v5" if BR2_ARM_CPU_ARMV5
	default "generic-v6" if BR2_ARM_CPU_ARMV6
	default "generic-v7" if BR2_ARM_CPU_ARMV7A
	default "generic-v8" if BR2_aarch64
	default "x86_64_generic" if BR2_x86_64
	depends on BR2_PACKAGE_XVISOR_USE_DEFCONFIG
	help
	  Name of the Xvisor defconfig file to use, without the
	  trailing -defconfig. The defconfig is located in
	  arch/<arch>/configs in the source tree.

config BR2_PACKAGE_XVISOR_CUSTOM_CONFIG_FILE
	string "Configuration file path"
	depends on BR2_PACKAGE_XVISOR_USE_CUSTOM_CONFIG
	help
	  Path to the Xvisor configuration file

config BR2_PACKAGE_XVISOR_CREATE_UBOOT_IMAGE
	bool "Create U-Boot image of Xvisor"
	depends on BR2_arm
	select BR2_PACKAGE_HOST_UBOOT_TOOLS
	help
	  Create an image file of Xvisor loadable from Das U-Boot.

config BR2_PACKAGE_XVISOR_BUILD_TEST_DTB
	bool "Build test device-tree blobs"
	help
	  Build test device-tree blobs for popular boards.

endif

comment "xvisor needs a toolchain w/ gcc >= 4.9"
	depends on !BR2_TOOLCHAIN_GCC_AT_LEAST_4_9
	depends on BR2_PACKAGE_XVISOR_ARCH_SUPPORTS
```

## package/xvkbd/Config.in
```kconfig
config BR2_PACKAGE_XVKBD
	bool "xvkbd"
	depends on BR2_PACKAGE_XORG7
	select BR2_PACKAGE_XLIB_LIBXAW
	select BR2_PACKAGE_XLIB_LIBXTST
	help
	  on-screen keyboard for X

	  http://homepage3.nifty.com/tsato/xvkbd
```

## package/xxhash/Config.in
```kconfig
config BR2_PACKAGE_XXHASH
	bool "xxhash"
	help
	  xxHash is an extremely fast hash algorithm, running at RAM
	  speed limits.

	  https://github.com/Cyan4973/xxHash
```

## package/xz/Config.in
```kconfig
config BR2_PACKAGE_XZ
	bool "xz-utils"
	help
	  XZ is the successor to the Lempel-Ziv/Markov-chain Algorithm
	  compression format, which provides memory-hungry but powerful
	  compression (often better than bzip2) and fast, easy decompression.

	  This package provides the command line tools for working with XZ
	  compression, including xz, unxz, xzcat, xzgrep, and so on. They can
	  also handle the older LZMA format, and if invoked via appropriate
	  symlinks will emulate the behavior of the commands in the lzma
	  package.

	  http://tukaani.org/xz/
```
