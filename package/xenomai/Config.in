## package/yad/Config.in
```kconfig
config BR2_PACKAGE_YAD
	bool "yad"
	depends on BR2_PACKAGE_XORG7
	depends on BR2_PACKAGE_LIBGTK2 || BR2_PACKAGE_LIBGTK3_X11
	help
	  YAD (yet another dialog) is a tool for create graphical
	  dialogs from shell scripts.

	  http://sourceforge.net/projects/yad-dialog/

comment "yad needs libgtk2 or libgtk3 w/ X11 backend"
	depends on BR2_PACKAGE_XORG7
	depends on !BR2_PACKAGE_LIBGTK2 && !BR2_PACKAGE_LIBGTK3_X11
```

## package/yajl/Config.in
```kconfig
config BR2_PACKAGE_YAJL
	bool "yajl"
	help
	  Yet Another JSON Library. YAJL is a small event-driven
	  (SAX-style) JSON parser written in ANSI C, and a small
	  validating JSON generator.

	  http://lloyd.github.com/yajl/
```

## package/yaml-cpp/Config.in
```kconfig
config BR2_PACKAGE_YAML_CPP
	bool "yaml-cpp"
	depends on BR2_INSTALL_LIBSTDCPP
	depends on BR2_TOOLCHAIN_GCC_AT_LEAST_4_7 # C++11
	help
	  yaml-cpp is a YAML parser and emitter in C++ matching
	  the YAML 1.2 spec.

	  https://github.com/jbeder/yaml-cpp

comment "yaml-cpp needs a toolchain w/ C++, gcc >= 4.7"
	depends on !BR2_INSTALL_LIBSTDCPP || !BR2_TOOLCHAIN_GCC_AT_LEAST_4_7
```

## package/yasm/Config.in
```kconfig
config BR2_PACKAGE_YASM
	bool "yasm"
	depends on BR2_i386 || BR2_x86_64
	help
	  Yasm is a complete rewrite of the NASM-2.10.01 assembler.
	  It supports the x86 and AMD64 instruction sets, accepts NASM
	  and GAS assembler syntaxes and outputs binary, ELF32 and ELF64
	  object formats.

	  http://www.tortall.net/projects/yasm/
```

## package/yavta/Config.in
```kconfig
config BR2_PACKAGE_YAVTA
	bool "yavta"
	help
	  Yet Another V4L2 Test Application

	  http://git.ideasonboard.org/yavta.git
```
