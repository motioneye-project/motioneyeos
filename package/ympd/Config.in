## target/Config.in
```kconfig
menu "Kernel"
choice
	prompt "Kernel type"
	default BR2_KERNEL_none

config BR2_KERNEL_none
	bool "none"
	help
	  Do not build a kernel

config BR2_KERNEL_LINUX_ADVANCED
	bool "linux (Advanced configuration)"
	select BR2_PACKAGE_LINUX
	help
	  The Linux kernel - Advanced Configuration.
	  http://www.kernel.org/

	  Note: Requires kernel-headers >= 2.6.19 since the other
	        kernel headers are just that (headers) and not full
	        kernels. This is a feature.

# The kernel with the same version as linux headers cannot be compiled
# when using an external toolchain, because the linux headers are not
# handled by Buildroot in this case.
if BR2_TOOLCHAIN_BUILDROOT

config BR2_KERNEL_LINUX
	bool "linux (Same version as linux headers)"
	select BR2_PACKAGE_LINUX
	help
	  The Linux kernel.
	  http://www.kernel.org/

	  Note: Requires kernel-headers >= 2.6.19 since the other
	        kernel headers are just that (headers) and not full
	        kernels. This is a feature.

endif

endchoice

config BR2_PACKAGE_LINUX
	bool

if BR2_PACKAGE_LINUX
source "target/linux/Config.in"
source "target/linux/Config.in.advanced"
endif

endmenu
```

## target/cloop/Config.in
```kconfig
config BR2_TARGET_ROOTFS_CLOOP
	bool "cloop root filesystem for the target device"
	default n
	help
	  Build a cloop root filesystem
	  cloop is a Linux kernel module that enables compressed loopback filesystem
	  support.  With it you can mount a compressed filesystem like a block device
	  and seamlessly decompress its data while accessing it.  The majority of the
	  software on an LNX-BBC is accessed in this fashion.
```

## target/cpio/Config.in
```kconfig
config BR2_TARGET_ROOTFS_CPIO
	bool "cpio the root filesystem"
	select BR2_HOST_FAKEROOT
	help
	  Build a cpio archive of the root filesystem

choice
        prompt "Compression method"
        default BR2_TARGET_ROOTFS_CPIO_NONE
        depends on BR2_TARGET_ROOTFS_CPIO
        help
          Select compressor for cpio filesystem of the root filesystem

config BR2_TARGET_ROOTFS_CPIO_NONE
        bool "no compression"
        help
         Do not compress the cpio filesystem.

config BR2_TARGET_ROOTFS_CPIO_GZIP
        bool "gzip"
        help
         Do compress the cpio filesystem with gzip.
         Note that you either have to have gzip installed on your host
         or select to build a gzip for your host. See the packages submenu.

config BR2_TARGET_ROOTFS_CPIO_BZIP2
        bool "bzip2"
        help
         Do compress the cpio filesystem with bzip2.
         Note that you either have to have bzip2 installed on your host
         or select to build a bzip2 for your host. See the packages submenu.

config BR2_TARGET_ROOTFS_CPIO_LZMA
        bool "lzma"
        help
         Do compress the cpio filesystem with lzma.
         Note that you either have to have lzma installed on your host
         or select to build a lzma for your host. See the packages submenu.

endchoice

config BR2_TARGET_ROOTFS_CPIO_COPYTO
	string "also copy the image to..."
	depends on BR2_TARGET_ROOTFS_CPIO
	default ""
	help
	  Copies the resulting image to a secondary location
	  like a tftp server's root directory.
	
	  Example: $(IMAGE)-$(DATE).cpio$(CPIO_ROOTFS_COMPRESSOR_EXT)
```
