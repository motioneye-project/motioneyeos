## package/ympd/Config.in
```kconfig
config BR2_PACKAGE_YMPD
	bool "ympd"
	select BR2_PACKAGE_LIBMPDCLIENT
	depends on BR2_USE_MMU # fork()
	depends on BR2_TOOLCHAIN_HAS_THREADS
	depends on !BR2_STATIC_LIBS
	help
	  ympd, a standalone MPD Web GUI written in C, utilizing
	  Websockets and Bootstrap/JS

comment "ympd needs a toolchain w/ threads, dynamic library"
	depends on BR2_USE_MMU
	depends on !BR2_TOOLCHAIN_HAS_THREADS || BR2_STATIC_LIBS
```

## package/ytree/Config.in
```kconfig
config BR2_PACKAGE_YTREE
	bool "ytree"
	depends on !BR2_TOOLCHAIN_USES_MUSL # re_comp/re_exec
	depends on BR2_USE_MMU # fork()
	select BR2_PACKAGE_NCURSES
	help
	  Ytree - a (curses-based) file manager similar to DOS Xtree(tm)

	  https://www.han.de/~werner/ytree.html

comment "ytree needs a glibc or uClibc toolchain"
	depends on BR2_USE_MMU
	depends on BR2_TOOLCHAIN_USES_MUSL
```

## package/zbar/Config.in
```kconfig
config BR2_PACKAGE_ZBAR
	bool "zbar"
	depends on BR2_TOOLCHAIN_HAS_THREADS # libv4l
	depends on BR2_USE_MMU # libv4l
	depends on BR2_INSTALL_LIBSTDCPP # libv4l
	depends on BR2_TOOLCHAIN_HEADERS_AT_LEAST_3_17 # v4l2_query_ext_ctrl
	select BR2_PACKAGE_JPEG
	select BR2_PACKAGE_LIBV4L
	help
	  QR and barcode scanner

	  https://git.linuxtv.org/zbar.git/about/

comment "zbar needs a toolchain w/ threads, C++ and headers >= 3.17"
	depends on BR2_USE_MMU
	depends on !BR2_TOOLCHAIN_HAS_THREADS \
		|| !BR2_INSTALL_LIBSTDCPP || !BR2_TOOLCHAIN_HEADERS_AT_LEAST_3_17
```

## package/zd1211-firmware/Config.in
```kconfig
config BR2_PACKAGE_ZD1211_FIRMWARE
	bool "zd1211-firmware"
	help
	  Firmware for the ZyDAS ZD1211 / Atheros AR5007UG wifi devices.

	  https://sourceforge.net/projects/zd1211/
```

## package/zeromq/Config.in
```kconfig
comment "zeromq needs a toolchain w/ C++, threads"
	depends on !(BR2_INSTALL_LIBSTDCPP && BR2_TOOLCHAIN_HAS_THREADS)

config BR2_PACKAGE_ZEROMQ
	bool "zeromq"
	depends on BR2_INSTALL_LIBSTDCPP
	depends on BR2_TOOLCHAIN_HAS_THREADS
	select BR2_PACKAGE_UTIL_LINUX
	select BR2_PACKAGE_UTIL_LINUX_LIBUUID
	help
	  ØMQ (ZeroMQ, 0MQ, zmq) looks like an embeddable networking
	  library but acts like a concurrency framework. It gives you
	  sockets that carry whole messages across various transports
	  like in-process, inter- process, TCP, and multicast. You can
	  connect sockets N-to-N with patterns like fanout, pub-sub,
	  task distribution, and request-reply. It's fast enough to
	  be the fabric for clustered products. Its asynchronous I/O
	  model gives you scalable multicore applications, built as
	  asynchronous message-processing tasks. It has a score of
	  language APIs and runs on most operating systems.

	  ØMQ is from iMatix and is LGPL open source.

	  http://www.zeromq.org/

if BR2_PACKAGE_ZEROMQ

comment "norm support needs a toolchain w/ dynamic library"
	depends on BR2_STATIC_LIBS

config BR2_PACKAGE_ZEROMQ_NORM
	bool "NORM support"
	depends on !BR2_STATIC_LIBS
	select BR2_PACKAGE_NORM
	help
	  Add support for NACK-Oriented Reliable Multicast (RFC 5740)
	  protocol.

comment "PGM/EPGM support needs a toolchain w/ wchar"
	depends on BR2_TOOLCHAIN_HAS_SYNC_2
	depends on BR2_TOOLCHAIN_HAS_SYNC_4
	depends on !BR2_USE_WCHAR

config BR2_PACKAGE_ZEROMQ_PGM
	bool "PGM/EPGM support"
	depends on BR2_TOOLCHAIN_HAS_SYNC_2
	depends on BR2_TOOLCHAIN_HAS_SYNC_4
	depends on BR2_USE_WCHAR # openpgm
	select BR2_PACKAGE_OPENPGM
	help
	  Add support for Pragmatic General Multicast protocol (RFC
	  3208) implemented either over raw IP packets or UDP
	  datagrams (encapsulated PGM).

config BR2_PACKAGE_ZEROMQ_DRAFTS
	bool "Draft APIs support"
	help
	  Enable unstable draft ZeroMQ APIs

	  https://pyzmq.readthedocs.io/en/latest/draft.html

endif
```

## package/zip/Config.in.host
```kconfig
config BR2_PACKAGE_HOST_ZIP
	bool "host zip"
	help
	  Zip is a compression and file packaging/archive utility.
	  Although highly compatible both with PKWARE's PKZIP and
	  PKUNZIP utilities for MS-DOS and with Info-ZIP's own UnZip,
	  our primary objectives have been portability and
	  other-than-MSDOS functionality.

	  http://infozip.sourceforge.net/Zip.html
```

## package/zlib/Config.in
```kconfig
config BR2_PACKAGE_ZLIB_NG_ARCH_SUPPORTS
	bool
	default y if BR2_arm
	default y if BR2_aarch64
	default y if BR2_i386
	default y if BR2_x86_64

config BR2_PACKAGE_ZLIB
	bool "zlib support"
	help
	  Select the desired Zlib library provider.

if BR2_PACKAGE_ZLIB

choice
	prompt "zlib variant"
	default BR2_PACKAGE_LIBZLIB
	help
	  Select the desired Zlib library provider.

config BR2_PACKAGE_LIBZLIB
	bool "zlib"
	select BR2_PACKAGE_HAS_ZLIB
	help
	  Standard (de)compression library. Used by things like
	  gzip and libpng.

	  http://www.zlib.net

config BR2_PACKAGE_ZLIB_NG
	bool "zlib-ng"
	depends on BR2_PACKAGE_ZLIB_NG_ARCH_SUPPORTS
	select BR2_PACKAGE_HAS_ZLIB
	help
	  Zlib replacement with optimizations for
	  "next generation" systems.

	  https://github.com/mtl1979/zlib-ng/tree/renamelib

endchoice

config BR2_PACKAGE_HAS_ZLIB
	bool

config BR2_PACKAGE_PROVIDES_ZLIB
	string
	default "libzlib" if BR2_PACKAGE_LIBZLIB
	default "zlib-ng" if BR2_PACKAGE_ZLIB_NG

endif

# ensure libzlib is used for the host variant
config BR2_PACKAGE_PROVIDES_HOST_ZLIB
	string
	default "host-libzlib"
```

## package/zlog/Config.in
```kconfig
config BR2_PACKAGE_ZLOG
	bool "zlog"
	depends on BR2_TOOLCHAIN_HAS_THREADS
	depends on !BR2_STATIC_LIBS
	help
	  zlog is a reliable, high-performance, thread safe, flexible,
	  clear-model, pure C logging library.

	  https://github.com/HardySimpson/zlog

comment "zlog needs a toolchain w/ threads, dynamic library"
	depends on !BR2_TOOLCHAIN_HAS_THREADS || BR2_STATIC_LIBS
```

## package/zmqpp/Config.in
```kconfig
config BR2_PACKAGE_ZMQPP
	bool "zmqpp"
	# c++1x support
	depends on BR2_TOOLCHAIN_GCC_AT_LEAST_4_7
	depends on BR2_INSTALL_LIBSTDCPP
	depends on BR2_TOOLCHAIN_HAS_THREADS # zeromq
	depends on !BR2_TOOLCHAIN_HAS_GCC_BUG_64735 # exception_ptr
	select BR2_PACKAGE_ZEROMQ
	help
	  C++ binding for zeromq (ZeroMQ, 0MQ, zmq).

	  This C++ binding is a 'high-level' library that hides most
	  of the C-style interface core zeromq provides.

	  http://github.com/benjamg/zmqpp

comment "zmqpp needs a toolchain w/ C++, threads, gcc >= 4.7"
	depends on !BR2_INSTALL_LIBSTDCPP || !BR2_TOOLCHAIN_HAS_THREADS || \
		!BR2_TOOLCHAIN_GCC_AT_LEAST_4_7

comment "zmqpp needs exception_ptr"
	depends on BR2_TOOLCHAIN_HAS_GCC_BUG_64735

if BR2_PACKAGE_ZMQPP

config BR2_PACKAGE_ZMQPP_CLIENT
	bool "zmqpp client"
	depends on !BR2_STATIC_LIBS
	depends on BR2_TOOLCHAIN_HAS_THREADS # boost
	depends on BR2_USE_WCHAR # boost
	select BR2_PACKAGE_BOOST
	select BR2_PACKAGE_BOOST_PROGRAM_OPTIONS
	help
	  Build and install the zmqpp client, a command line tool that
	  can be used to listen or send to zeromq sockets.

comment "zmqpp client needs a toolchain w/ dynamic library, threads, wchar"
	depends on BR2_STATIC_LIBS || !BR2_TOOLCHAIN_HAS_THREADS \
		|| !BR2_USE_WCHAR

endif
```

## package/znc/Config.in
```kconfig
config BR2_PACKAGE_ZNC
	bool "znc"
	depends on BR2_INSTALL_LIBSTDCPP
	depends on BR2_USE_MMU # fork()
	depends on !BR2_STATIC_LIBS
	depends on BR2_TOOLCHAIN_GCC_AT_LEAST_4_8
	depends on BR2_TOOLCHAIN_HAS_THREADS
	help
	  Advanced IRC bouncer

	  http://www.znc.in

comment "znc needs a toolchain w/ C++, dynamic library, gcc >= 4.8, threads"
	depends on !BR2_INSTALL_LIBSTDCPP || BR2_STATIC_LIBS || \
		!BR2_TOOLCHAIN_GCC_AT_LEAST_4_8 || !BR2_TOOLCHAIN_HAS_THREADS
	depends on BR2_USE_MMU
```

## package/zsh/Config.in
```kconfig
config BR2_PACKAGE_ZSH
	bool "zsh"
	depends on BR2_USE_MMU # fork()
	select BR2_PACKAGE_NCURSES
	help
	  zsh is a shell designed for interactive use, although it is also
	  a powerful scripting language. Many of the useful features of bash,
	  ksh, and tcsh were incorporated into zsh; many original features
	  were added.

	  http://zsh.sourceforge.net/
```

## package/zstd/Config.in
```kconfig
config BR2_PACKAGE_ZSTD
	bool "zstd"
	help
	  Zstandard, or zstd as short version, is a fast lossless
	  compression algorithm, targeting real-time compression
	  scenarios at zlib-level and better compression ratios

	  The selection of other packages will enable some features:
	  xz, lz4 and/or zlib will enable support for corresponding
	  compression formats

	  https://facebook.github.io/zstd
```

## package/zstd/Config.in.host
```kconfig
config BR2_PACKAGE_HOST_ZSTD
	bool "host zstd"
	help
	  Zstandard, or zstd as short version, is a fast lossless
	  compression algorithm, targeting real-time compression
	  scenarios at zlib-level and better compression ratios

	  https://facebook.github.io/zstd
```

## package/zxing-cpp/Config.in
```kconfig
comment "zxing-cpp needs a toolchain w/ C++, dynamic library"
	depends on !BR2_INSTALL_LIBSTDCPP || BR2_STATIC_LIBS

config BR2_PACKAGE_ZXING_CPP
	bool "zxing-cpp"
	depends on !BR2_STATIC_LIBS
	depends on BR2_INSTALL_LIBSTDCPP
	help
	  ZXing-cpp (pronounced "zebra crossing") is an open-source,
	  multi-format 1D/2D barcode image processing library
	  implemented in Java, with ports to other languages. This
	  compiles the C++ port.

	  https://github.com/glassechidna/zxing-cpp
```

## package/zxing/Config.in
```kconfig
comment "zxing needs a toolchain w/ C++"
	depends on !BR2_INSTALL_LIBSTDCPP

config BR2_PACKAGE_ZXING
	bool "zxing"
	depends on BR2_INSTALL_LIBSTDCPP
	help
	  ZXing (pronounced "zebra crossing") is an open-source,
	  multi-format 1D/2D barcode image processing library
	  implemented in Java, with ports to other languages. This
	  compiles the C++ port.

	  http://code.google.com/p/zxing/
```

## package/zyre/Config.in
```kconfig
config BR2_PACKAGE_ZYRE
	bool "zyre"
	depends on BR2_INSTALL_LIBSTDCPP # zeromq
	depends on BR2_TOOLCHAIN_HAS_THREADS_NPTL # zeromq
	depends on BR2_USE_MMU # czmq
	select BR2_PACKAGE_CZMQ
	select BR2_PACKAGE_ZEROMQ
	help
	  An open-source framework for proximity-based peer-to-peer
	  applications.

	  http://zyre.org

comment "zyre needs a toolchain w/ C++, NPTL"
	depends on BR2_USE_MMU
	depends on !(BR2_INSTALL_LIBSTDCPP && BR2_TOOLCHAIN_HAS_THREADS_NPTL)
```

## package/zziplib/Config.in
```kconfig
config BR2_PACKAGE_ZZIPLIB
	bool "zziplib"
	select BR2_PACKAGE_ZLIB
	help
	  The zziplib provides read access to zipped files in a
	  zip-archive, using compression based solely on free algorithms
	  provided by zlib. It also provides a functionality to overlay
	  the archive filesystem with the filesystem of the operating
	  system environment.

	  http://zziplib.sourceforge.net
```

## project/Config.in
```kconfig
menu "Project Options"

config BR2_PROJECT
	string "Project name"
	default "uclibc"
	help
	  The project name is used to define subdirectories
	  * where the Board Support Packages are built
	    (Linux,Root fs Bootmonitor,Utilities etc.)
	  * where the resulting binaries are stored.
	  Older targets may still build in the build_<arch>
	  and store binaries in the top directory.

endmenu
```

## support/testing/tests/package/br2-external/openjdk/Config.in
```kconfig
source "$BR2_EXTERNAL_OPENJDK_PATH/package/openjdk-hello-world/Config.in"
source "$BR2_EXTERNAL_OPENJDK_PATH/package/openjdk-jni-test/Config.in"
```

## support/testing/tests/package/br2-external/openjdk/package/openjdk-hello-world/Config.in
```kconfig
config BR2_PACKAGE_OPENJDK_HELLO_WORLD
	bool "openjdk hello world"
	depends on BR2_PACKAGE_OPENJDK
	help
	  Simple class for testing openjdk
```

## support/testing/tests/package/br2-external/openjdk/package/openjdk-jni-test/Config.in
```kconfig
config BR2_PACKAGE_OPENJDK_JNI_TEST
	bool "openjdk JNI test"
	depends on BR2_PACKAGE_OPENJDK
	help
	  Tests openjdk JNI support
```
