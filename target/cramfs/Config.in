## target/cramfs/Config.in
```kconfig
config BR2_TARGET_ROOTFS_CRAMFS
	bool "cramfs root filesystem"
	default n
	select BR2_HOST_FAKEROOT
	help
	  Build a cramfs root filesystem

	  http://sourceforge.net/projects/cramfs/
```

## target/device/AMD/Config.in
```kconfig
comment "AMD Specific Device Support"
	depends on BR2_mipsel || BR2_mips

config BR2_TARGET_AMD_ALCHEMY
	bool "Board support for the AMD development boards"
	depends on BR2_mipsel || BR2_mips
	default n
	help
	  AMD Alchemy mips based systems

config BR2_TARGET_AMD_ALCHEMY_DBAU1500
	bool "AMD Alchemy DBAu1500 Development Board Support"
	default n
	depends on BR2_TARGET_AMD_ALCHEMY
	select BR2_PACKAGE_LINUX
	help
	  The AMD Alchemy DBAu1500 Development Board

comment "Package support"
	depends on BR2_TARGET_AMD_ALCHEMY
```

## target/device/ARM/Config.in
```kconfig
menuconfig BR2_TARGET_ARM
	bool "Generic ARM Support"
	depends on BR2_arm
	depends on !BR2_TARGET_ARMLTD
	depends on !BR2_TARGET_ATMEL
	depends on !BR2_TARGET_SHARP
	default y

if BR2_TARGET_ARM

config BR2_BOARD_NAME
	string "Board Name"
	default "arm"

config BR2_BOARD_PATH
	string "Board Path"
	default "target/device/ARM"

endif
```

## target/device/ARMLTD/Config.in
```kconfig
menuconfig BR2_TARGET_ARMLTD
	bool "ARM Ltd. Device Support"
	depends on BR2_arm
	select BR2_ARM_EABI
	select BR2_arm926t

comment "ARM Ltd. based Device Support"
	depends on BR2_TARGET_ARMLTD


if BR2_TARGET_ARMLTD

choice
	prompt "Controller board"
	default BR2_TARGET_ARM_INTEGRATOR_926
	help
	  ARM Ltd. Controller Board to build for

config BR2_TARGET_ARM_INTEGRATOR_926
	bool "Integrator arm926"

config BR2_TARGET_ARM_INTEGRATOR_926_HUGE
	bool "Integrator arm926 (Huge)"

endchoice

config BR2_BOARD_NAME
	string
	default "integrator926"		if BR2_TARGET_ARM_INTEGRATOR_926
	default "integrator926_huge"	if BR2_TARGET_ARM_INTEGRATOR_926_HUGE

config BR2_BOARD_PATH
	string "Board Path"
	default "target/device/ARMLTD/$(BR2_BOARD_NAME)"

endif
```

## target/device/Arm/Config.in
```kconfig
menuconfig BR2_TARGET_ARM
	bool "ARM Ltd. Device Support"
	depends BR2_arm
	default n

comment "Arm based Device Support"
	depends BR2_arm && BR2_TARGET_ARM

config BR2_TARGET_ARM_INTEGRATOR_926
	bool "Integrator arm926"
	depends BR2_arm && BR2_TARGET_ARM
	default n
	select BR2_PACKAGE_LINUX
	select BR2_ARM_EABI
	select BR2_KERNEL_HEADERS_2_6_22
	select BR2_PTHREADS
	select BR2_arm926t
	help
	  An ARM integrator 926 board for use with qemu.
	  This one has an MMU.
```

## target/device/Atmel/Config.in
```kconfig
menuconfig BR2_TARGET_ATMEL
	bool "Atmel Device Support"
	depends on BR2_arm || BR2_avr32
	default n

if BR2_TARGET_ATMEL

source "target/device/Atmel/AT91_Config.in"
source "target/device/Atmel/AVR32_Config.in"

config BR2_BOARD_NAME
	string
	default	"at91rm9200df"		if	BR2_TARGET_AT91RM9200DF
	default	"at91rm9200se"		if	BR2_TARGET_AT91RM9200SE
	default	"at91rm9200ek"		if	BR2_TARGET_AT91RM9200EK
	default	"at91rm9200dk"		if	BR2_TARGET_AT91RM9200DK
	default	"at91sam9260ek"		if	BR2_TARGET_AT91SAM9260EK
	default	"at91sam9260dfc"	if	BR2_TARGET_AT91SAM9260DFC
	default	"at91sam9261ek"		if	BR2_TARGET_AT91SAM9261EK
	default	"at91sam9262ek"		if	BR2_TARGET_AT91SAM9262EK
	default	"at91sam9263ek"		if	BR2_TARGET_AT91SAM9263EK
	default	"at91sam9xeek"		if	BR2_TARGET_AT91SAM9XEEK
	default	"atstk1002"		if	BR2_TARGET_AVR32_ATSTK1002
	default	"atngw100"		if	BR2_TARGET_AVR32_ATNGW100
	default "atngw100-base"		if	BR2_TARGET_AVR32_ATNGW100_BASE
	default "atngw100-expanded"	if  BR2_TARGET_AVR32_ATNGW100_EXPANDED

config BR2_TARGET_AT91_ADVANCED_INFO
	bool "Remove work in progress"
	depends BR2_TARGET_AT91
	default y
	help
	  Atmel AT91 ARM based systems

comment "Package support"
	depends on BR2_TARGET_AT91 || BR2_TARGET_AVR32


menu "Secondary locations"

config BR2_AT91_LINUXPATCH_SITE
	string "AT91 Linux Patch mirror site"
	depends on BR2_TARGET_AT91
	default "http://maxim.org.za/AT91RM9200/2.6"
	help
	    Main download location for AT91 Linux stuff

config BR2_TARGET_ATMEL_COPYTO
	string "also copy the image to..."
	depends on BR2_TARGET_AT91 || BR2_TARGET_AVR32
	default "/tftpboot"
	help
	  Copies the resulting image to a secondary location.

config BR2_BOARD_PATH
	string "Atmel board repository"
	depends on BR2_TARGET_AT91 || BR2_TARGET_AVR32
	default "target/device/Atmel/$(BR2_BOARD_NAME)"
	help
	  Top directory of Atmel board configurations

endmenu


source "target/device/Atmel/DataFlashBoot/Config.in"

source "target/device/Atmel/at91bootstrap/Config.in"

endif
```

## target/device/Atmel/DataFlashBoot/Config.in
```kconfig
config BR2_TARGET_DATAFLASHBOOT
       depends on BR2_TARGET_AT91RM9200 || BR2_TARGET_AT91SAM9261 || BR2_TARGET_AT91SAM9261S
	bool "Build Dataflashboot for selected chip"

choice
	prompt "Target Architecture"
	default BR2_TARGET_DATAFLASHBOOT_AT91RM9200
	depends on BR2_TARGET_DATAFLASHBOOT
	help
	  Select Chip for which Dataflash boot should be built
	  Currently only AT91RM9200 Supported

config BR2_TARGET_DATAFLASHBOOT_AT91RM9200
       depends on BR2_TARGET_AT91RM9200
	bool "AT91RM9200"
config BR2_TARGET_DATAFLASHBOOT_AT91SAM9261
       depends on BR2_TARGET_AT91SAM9261
	bool "AT91SAM9261"
config BR2_TARGET_DATAFLASHBOOT_AT91SAM9261S
       depends on BR2_TARGET_AT91SAM9261S
	bool "AT91SAM9261S"

endchoice
```

## target/device/Atmel/arch-arm/u-boot/Config.in
```kconfig
choice
	prompt "Add AT91 specific patches to u-Boot"
	default BR2_TARGET_U_BOOT_2009_01_ARCH_AT91
	help
	  Select a patch to add to U-Boot

config	BR2_TARGET_U_BOOT_2009_01_ARCH_AT91
	bool "AT91 patches for u-boot-2009.01"
	depends on BR2_TARGET_ATMEL && BR2_arm
	help
	  Apply the at91 u-boot-2009.01 patches

endchoice

config	BR2_TARGET_U_BOOT_ARCH_AT91_PATCH_DIR
	string
	depends on BR2_TARGET_U_BOOT_ARCH_PATCH
	default "target/device/Atmel/arch-arm/u-boot/2009.01" if BR2_TARGET_U_BOOT_2009_01_ARCH_AT91
	default ""
```

## target/device/Atmel/at91bootstrap/Config.in
```kconfig
menuconfig BR2_TARGET_AT91BOOTSTRAP
	depends on BR2_TARGET_AT91SAM9260EK || BR2_TARGET_AT91SAM9260DFC || BR2_TARGET_AT91SAM9260PF || \
	BR2_TARGET_AT91SAM9261EK || BR2_TARGET_AT91SAM9263EK || BR2_TARGET_AT91SAM9XEEK || BR2_TARGET_AT91SAM9G20DFC
	bool "Build AT91 Bootstrap for selected chip"

if	BR2_TARGET_AT91BOOTSTRAP

config BR2_TARGET_AT91BOOTSTRAP_BOARD
	string "Bootstrap board"
	default "$(BOARD_NAME)"
	help
	  This is used to do a make <board>_config

choice
	prompt "Boot Memory"
	default BR2_TARGET_AT91BOOT_DATAFLASHCARD
	depends on BR2_TARGET_AT91BOOTSTRAP
	help
	  Select Chip for which AT91 bootstrap should be built

config BR2_TARGET_AT91BOOT_DATAFLASH
	bool "AT45 Dataflash"
	depends on BR2_BOOTSOURCE_DATAFLASH

config BR2_TARGET_AT91BOOT_DATAFLASHCARD
	bool "AT45 Dataflash Card"
	depends on BR2_BOOTSOURCE_DATAFLASHCARD

config BR2_TARGET_AT91BOOT_NANDFLASH
	bool "NAND Flash"
	depends on BR2_BOOTSOURCE_NANDFLASH

config BR2_TARGET_AT91BOOT_FLASH
	bool "Internal Flash or external parallel flash"
	depends on BR2_BOOTSOURCE_FLASH

config BR2_TARGET_AT91BOOT_SDCARD
	bool "SD-Card"
	depends on BR2_BOOTSOURCE_SDCARD

config BR2_TARGET_AT91BOOT_EEPROM
	bool "EEPROM"
	depends on BR2_BOOTSOURCE_EEPROM

endchoice

config BR2_TARGET_AT91BOOTSTRAP_MEMORY
	string
	depends on BR2_TARGET_AT91BOOTSTRAP
	default	"dataflash"	if	BR2_TARGET_AT91BOOT_DATAFLASH
	default	"dataflashcard"	if	BR2_TARGET_AT91BOOT_DATAFLASHCARD
	default	"nandflash"	if	BR2_TARGET_AT91BOOT_NANDFLASH
	default	"flash"		if	BR2_TARGET_AT91BOOT_FLASH
	default	"sdcard"	if	BR2_TARGET_AT91BOOT_SDCARD
	default	"eeprom"	if	BR2_TARGET_AT91BOOT_EEPROM

config	BR2_AT91BOOTSTRAP_IMG_SIZE
	string	"Image Size to copy to SDRAM"
	depends on BR2_TARGET_AT91BOOTSTRAP
	default	"0x32000"	if	BR2_TARGET_AT91BOOT_DATAFLASH
	default	"0x32000"	if	BR2_TARGET_AT91BOOT_DATAFLASHCARD
	default	"0x30000"	if	BR2_TARGET_AT91BOOT_NANDFLASH
	default	"0x100000"	if	BR2_TARGET_AT91BOOT_FLASH
	default	"0x30000"	if	BR2_TARGET_AT91BOOT_SDCARD
	default	"0x30000"	if	BR2_TARGET_AT91BOOT_EEPROM
	help
	  Select the size of your application
	  AT91 Bootstrap will copy this amount from flash to SDRAM

choice
	prompt "Start address of application"
	default BR2_AT91BOOTSTRAP_JUMP_TO_DEFAULT
	depends on BR2_TARGET_AT91BOOTSTRAP
	help
	  Select Chip for which AT91 bootstrap should be built
	  Currently supports AT91SAM9260EK, AT91SAM9261EK,
	  AT91SAM9XEEK, AT91SAM9263EK


config	BR2_AT91BOOTSTRAP_JUMP_TO_DEFAULT
	bool "Copy to the default U-Boot start location in the SDRAM"
	help
	  This is where you copy the U-Boot boot loader

config	BR2_AT91BOOTSTRAP_JUMP_TO_HIGH_SDRAM
	bool "Copy to the last Megabyte of the SDRAM"
	help
	  This is where you copy a boot loader

config	BR2_AT91BOOTSTRAP_JUMP_TO_START_OF_SDRAM
	bool "Copy to the start of the SDRAM"
	help
	  This is where you copy a standalone application
endchoice

config	BR2_AT91BOOTSTRAP_JUMP_ADDR
	string
	default	"0x23F00000" if BR2_AT91BOOTSTRAP_JUMP_TO_DEFAULT
	default	"0x23F00000" if BR2_AT91BOOTSTRAP_JUMP_TO_HIGH_SDRAM
	default "0x20000000" if BR2_AT91BOOTSTRAP_JUMP_TO_START_OF_SDRAM
	depends on BR2_TARGET_AT91BOOTSTRAP

comment "It will be copied to $(BR2_AT91BOOTSTRAP_JUMP_ADDR)"
	depends on BR2_TARGET_AT91BOOTSTRAP

endif
```

## target/device/Atmel/u-boot/Config.in
```kconfig
config BR2_TARGET_UBOOT_AT91
	bool "Das U-Boot Boot Monitor"
	depends on BR2_TARGET_AT91
	depends on !BR2_TARGET_AT91SAM9260PF
	default n
	help
	  Build "Das U-Boot" Boot Monitor

config BR2_TARGET_UBOOT_SERVERIP_AT91
	string "server ip"
	depends on BR2_TARGET_UBOOT_AT91
	default "10.175.196.221"
	help
	  TFTP server ip address

config BR2_TARGET_UBOOT_IPADDR_AT91
	string "ip address"
	depends on BR2_TARGET_UBOOT_AT91
	default "10.175.196.18"
	help
	  Target server ip address

config BR2_TARGET_UBOOT_GATEWAY_AT91
	string "gateway ip"
	depends on BR2_TARGET_UBOOT_AT91
	default "10.175.196.1"
	help
	  Gateway ip address

config BR2_TARGET_UBOOT_NETMASK_AT91
	string "netmask"
	depends on BR2_TARGET_UBOOT_AT91
	default "255.255.255.0"
	help
	  Network Mask

config BR2_TARGET_UBOOT_ETHADDR_AT91
	string "Ethernet address"
	depends on BR2_TARGET_UBOOT_AT91
	default "04:25:fe:ed:00:18"
	help
	  Target ip address, this should be changed for production units
```

## target/device/Config.in
```kconfig
menu "Target options"

source "project/Config.in"

comment "Preset Devices"

source "target/device/AMD/Config.in"
source "target/device/ARMLTD/Config.in"
source "target/device/Atmel/Config.in"
source "target/device/KwikByte/Config.in"
source "target/device/valka/Config.in"
source "target/device/x86/Config.in"
source "target/device/xtensa/Config.in"

# This must be last
source "target/generic/Config.in"

endmenu
```

## target/device/Hitachi/Config.in
```kconfig
comment "Hitachi ULSI Systems device support"
	depends on BR2_sh

config BR2_TARGET_HITACHI_SE
	bool "Board support for Solution Engine development boards"
	depends on BR2_sh
	default n

config BR2_TARGET_HITACHI_MS7206SE01
	bool "MS7206SE01 development board support"
	depends on BR2_TARGET_HITACHI_SE && BR2_sh2a_nofpueb
	default n
```
