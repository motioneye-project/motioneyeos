## target/device/KwikByte/Config.in
```kconfig
menuconfig BR2_TARGET_KWIKBYTE
	bool "KwikByte Board Support"
	depends on BR2_arm
	default n

if BR2_TARGET_KWIKBYTE

comment "Board Selection"

choice
	prompt	"KwikByte target board"
	default BR2_TARGET_KB9202

config BR2_TARGET_KB9202
	bool "Board support for the KwikByte 9202 Evaluation Board"
	depends on BR2_arm920t || BR2_generic_arm
	help
	  KwikByte kb9202 Eval Board

endchoice


config BR2_BOARD_NAME
	string
	default "kb9202"	if	BR2_TARGET_KB9202
choice
	prompt "Add AT91 specific patches"
	depends on BR2_KERNEL_ARCH_PATCH_ENABLED
	depends on BR2_arm
	default BR2_ARCH_AT91_2_6_24		if BR2_LINUX_2_6_24
#	default BR2_ARCH_AT91_2_6_24		if BR2_LINUX_2_6_23
#	default BR2_ARCH_AT91_2_6_22_1		if BR2_LINUX_2_6_22_1
#	default BR2_ARCH_AT91_2_6_21_5		if BR2_LINUX_2_6_21 || BR2_LINUX_2_6_21_5
#	default BR2_ARCH_AT91_2_6_21_1		if BR2_LINUX_2_6_21_1
#	default BR2_ARCH_AT91_2_6_20_4		if BR2_LINUX_2_6_20 || BR2_LINUX_2_6_20_4
#	default BR2_ARCH_AT91_2_6_24
	help
	  Select a patch to add to the Linux kernel

config	BR2_ARCH_AT91_2_6_24
	bool "2.6.24"
	help
	  Apply the at91 linux-2.6.24 patches"

#config	BR2_ARCH_AT91_2_6_22_1
#	bool "2.6.22.1"
#	help
#	  Apply the at91 linux-2.6.22.1 patches"
#
#config	BR2_ARCH_AT91_2_6_21_5
#	bool "2.6.21.5"
#	help
#	  Apply the at91 linux-2.6.21.5 patches"
#
#config	BR2_ARCH_AT91_2_6_21_1
#	bool "2.6.21.1"
#	help
#	  Apply the at91 linux-2.6.21.1 patches"
#
#config	BR2_ARCH_AT91_2_6_20_4
#	bool "2.6.20.4"
#	help
#	  Apply the at91 linux-2.6.20.4 patches"

endchoice

config	BR2_KERNEL_ARCH_PATCH_VERSION
	string
	depends on BR2_KERNEL_ARCH_PATCH_ENABLED
	depends on BR2_arm
	default "2.6.24" if BR2_ARCH_AT91_2_6_24
#	default "2.6.22.1" if BR2_ARCH_AT91_2_6_22_1
#	default "2.6.21.5" if BR2_ARCH_AT91_2_6_21_5
#	default "2.6.21.1" if BR2_ARCH_AT91_2_6_21_1
#	default "2.6.20.4" if BR2_ARCH_AT91_2_6_20_4

config	BR2_KERNEL_ARCH_PATCH_DIR
	string
	default "target/device/Atmel/arch-arm/kernel-patches-$(BR2_KERNEL_ARCH_PATCH_VERSION)"

config BR2_BOARD_PATH
	string "Board Path"
	default "target/device/KwikByte/$(BR2_BOARD_NAME)"

config BR2_AT91_LINUXPATCH_SITE
	string "AT91 Linux Patch mirror site"
	default "http://maxim.org.za/AT91RM9200/2.6"
	help
	    Main download location for AT91 Linux stuff

endif
```

## target/device/Sharp/Config.in
```kconfig
menuconfig BR2_TARGET_SHARP
	bool "Sharp Device Support"
	depends on BR2_arm

if BR2_TARGET_SHARP
comment "Sharp Specific Device Support"
	depends on BR2_arm
 
config BR2_TARGET_SHARP_LNODE80
	bool "Board support for the LNode80 development board"
	depends on BR2_arm
	help
	  Support for the LNode80 LH79520 based device
endif
```

## target/device/Soekris/Config.in
```kconfig
menuconfig BR2_TARGET_SOEKRIS
	bool "Soekris device support"
	depends BR2_i386
	default n

if BR2_TARGET_SOEKRIS
config BR2_TARGET_SOEKRIS_NET4521
	bool "Soekris net4521"
	default n
	select BR2_PACKAGE_LINUX
	help
	  The Soekris net4521

config BR2_TARGET_SOEKRIS_NET4801
	bool "Soekris net4801"
	depends BR2_i386
	default n
	select BR2_PACKAGE_LINUX
	help
	  The Soekris net4801

comment "Package support"
	depends on BR2_TARGET_SOEKRIS_NET4521 || BR2_TARGET_SOEKRIS_NET4801

endif
```

## target/device/Via/Config.in
```kconfig
config BR2_TARGET_VIA_EPIA_MII
	bool "EPIA MII"
	depends on BR2_i386
	select BR2_PACKAGE_LINUX
	help
	  The Via EPIA MII board
```

## target/device/generic/access_point/Config.in
```kconfig
config BR2_TARGET_GENERIC_ACCESS_POINT
	bool "Generic wireless access point"
	default n
	help
	  Board support for a generic wireless access point.
```

## target/device/jp/Config.in
```kconfig
config BR2_TARGET_Q5
	bool "jp-embedded Q5 board support"
	default n
	depends on BR2_mipsel
	select BR2_PACKAGE_LINUX
	help
	  jp-embedded Q5 series MIPS based boards, see http://www.jp-embedded.com for further information.

comment "Package support"
	depends on BR2_TARGET_Q5
```

## target/device/valka/Config.in
```kconfig
menuconfig BR2_TARGET_VALKA
	bool "ValkaSys"
	depends on BR2_avr32
	default n

if BR2_TARGET_VALKA

choice
	prompt "Controller board"
	depends on BR2_TARGET_VALKA
	help
	  Valka Controller Board to build for

config BR2_TARGET_VALKA_V100SC2
	bool "V100SC2 (Based on NGW100)"
	depends on BR2_TARGET_VALKA
	help
	  Board based on NGW100

endchoice

config BR2_BOARD_NAME
	string
	default "v100sc2"	if	BR2_TARGET_VALKA_V100SC2

config BR2_BOARD_PATH
	string "Board repository"
	depends on BR2_TARGET_VALKA
	default "target/device/valka/$(BR2_BOARD_NAME)"
	help
	  Top directory of Valka board configurations

endif
```

## target/device/x86/Config.in
```kconfig
menuconfig BR2_TARGET_X86
	bool "Generic x86 Device Support"
	depends on BR2_i386

if BR2_TARGET_X86

choice
	prompt "Pentium (or later) Controller board"
	help

config BR2_TARGET_I686
	bool "i686"
	depends on BR2_i386

endchoice

config BR2_BOARD_NAME
	string
	default "i686"		if BR2_TARGET_I686

config BR2_BOARD_PATH
	string "Board Path"
	default "target/device/x86/$(BR2_BOARD_NAME)"

endif
```

## target/device/xtensa/Config.in
```kconfig
menuconfig	BR2_TARGET_XTENSA
	bool "Device and Board Support for Xtensa and Diamond cores"
	depends on BR2_xtensa
	default y
	help
	  Lists development boards with support for the Xtensa architecture.

if BR2_TARGET_XTENSA
comment "Tensilica Xtensa/Diamond based Device Support"
	depends on BR2_xtensa

config BR2_TARGET_XTENSA_XTAV60
	bool "XTAV60/200 board (Avnet LX60 or LX200 plus Tensilica IP)"
	depends on BR2_xtensa
	default y
	help
	  The XTAV60 or XTAV200 board, which is an Avnet LX60 or LX200
	  emulation board programmed with an FPGA bitstream obtained
	  from Tensilica.

endif
```

## target/ext2/Config.in
```kconfig
config BR2_TARGET_ROOTFS_EXT2
	bool "ext2 root filesystem"
	default y
	help
	  Build an ext2 root filesystem

config BR2_TARGET_ROOTFS_EXT2_BLOCKS
	int "size in blocks (leave at 0 for auto calculation)"
	depends on BR2_TARGET_ROOTFS_EXT2
	default	0

config BR2_TARGET_ROOTFS_EXT2_INODES
	int "inodes (leave at 0 for auto calculation)"
	depends on BR2_TARGET_ROOTFS_EXT2
	default	0

config BR2_TARGET_ROOTFS_EXT2_RESBLKS
	int "reserved blocks percentage"
	depends on BR2_TARGET_ROOTFS_EXT2
	default 0

config BR2_TARGET_ROOTFS_EXT2_SQUASH
	bool "Make all files be owned by root"
	depends on 	BR2_TARGET_ROOTFS_EXT2
	default y

config BR2_TARGET_ROOTFS_EXT2_OUTPUT
	string "Output File"
	depends on BR2_TARGET_ROOTFS_EXT2
	default "$(IMAGE).ext2"

choice
        prompt "Compression method"
        default BR2_TARGET_ROOTFS_EXT2_NONE
        depends on BR2_TARGET_ROOTFS_EXT2
        help
          Select compressor for ext2 filesystem of the root filesystem

config BR2_TARGET_ROOTFS_EXT2_NONE
        bool "no compression"
        help
         Do not compress the ext2 filesystem.

config BR2_TARGET_ROOTFS_EXT2_GZIP
        bool "gzip"
        help
         Do compress the ext2 filesystem with gzip.
         Note that you either have to have gzip installed on your host
         or select to build a gzip for your host. See the packages submenu.

config BR2_TARGET_ROOTFS_EXT2_BZIP2
        bool "bzip2"
        help
         Do compress the ext2 filesystem with bzip2.
         Note that you either have to have bzip2 installed on your host
         or select to build a bzip2 for your host. See the packages submenu.

config BR2_TARGET_ROOTFS_EXT2_LZMA
        bool "lzma"
        help
         Do compress the ext2 filesystem with lzma.
         Note that you either have to have lzma installed on your host
         or select to build a lzma for your host. See the packages submenu.

endchoice

config BR2_TARGET_ROOTFS_EXT2_COPYTO
	string "also copy the image to..."
	depends on 	BR2_TARGET_ROOTFS_EXT2
	default ""
	help
	  Copies the resulting image to a secondary location
	  like a tftp server's root directory.
```

## target/generic/Config.in
```kconfig
menu "System configuration"

config BR2_TARGET_GENERIC_HOSTNAME
       string "System hostname"
       default "buildroot"
       help
         Select system hostname to be stored in /etc/hostname.

config BR2_TARGET_GENERIC_ISSUE
       string "System banner"
       default "Welcome to Buildroot"
       help
         Select system banner (/etc/issue) to be displayed at login.

choice
	prompt "/dev management"
	default BR2_ROOTFS_DEVICE_CREATION_STATIC

config BR2_ROOTFS_DEVICE_CREATION_STATIC
	bool "Static using device table"

config BR2_ROOTFS_DEVICE_CREATION_DYNAMIC_DEVTMPFS
	bool "Dynamic using devtmpfs only"

config BR2_ROOTFS_DEVICE_CREATION_DYNAMIC_MDEV
	bool "Dynamic using mdev"
	select BR2_PACKAGE_BUSYBOX

config BR2_ROOTFS_DEVICE_CREATION_DYNAMIC_UDEV
	bool "Dynamic using udev"
	depends on BR2_LARGEFILE # udev
	depends on BR2_USE_WCHAR # udev
	select BR2_PACKAGE_UDEV

comment "udev requires a toolchain with LARGEFILE + WCHAR support"
	depends on !(BR2_LARGEFILE && BR2_USE_WCHAR)

endchoice

choice
	prompt "Init system"
	default BR2_INIT_BUSYBOX

config BR2_INIT_BUSYBOX
	bool "Busybox"
	select BR2_PACKAGE_BUSYBOX

config BR2_INIT_SYSV
	bool "systemV"
	select BR2_PACKAGE_SYSVINIT

config BR2_INIT_SYSTEMD
	bool "systemd"
	depends on BR2_LARGEFILE
	depends on BR2_USE_WCHAR
	depends on BR2_INET_IPV6
	depends on BR2_ROOTFS_DEVICE_CREATION_DYNAMIC_UDEV
	depends on BR2_TOOLCHAIN_HAS_THREADS
	select BR2_PACKAGE_DBUS
	select BR2_PACKAGE_SYSTEMD

comment 'systemd requires largefile, wchar, IPv6, threads and udev support'
	depends on !(BR2_LARGEFILE && BR2_USE_WCHAR && \
		     BR2_INET_IPV6 && BR2_TOOLCHAIN_HAS_THREADS && \
		     BR2_ROOTFS_DEVICE_CREATION_DYNAMIC_UDEV)

config BR2_INIT_NONE
	bool "None"

endchoice

config BR2_ROOTFS_DEVICE_TABLE
	string "Path to the permission tables"
	default "target/generic/device_table.txt"
	help
	  Specify a space-separated list of permission table locations,
	  that will be passed to the makedevs utility to assign
	  correct owners and permissions on various files in the
	  target filesystem.

	  See package/makedevs/README for details on the usage and
	  syntax of these files.

config BR2_ROOTFS_STATIC_DEVICE_TABLE
	string "Path to the device tables"
	default "target/generic/device_table_dev.txt"
	depends on BR2_ROOTFS_DEVICE_CREATION_STATIC
	help
	  Specify a space-separated list of device table locations,
	  that will be passed to the makedevs utility to create all
	  the special device files under /dev.

	  See package/makedevs/README for details on the usage and
	  syntax of these files.

choice
	prompt "Root FS skeleton"

config BR2_ROOTFS_SKELETON_DEFAULT
	bool "default target skeleton"
	help
	  Use default target skeleton

config BR2_ROOTFS_SKELETON_CUSTOM
	bool "custom target skeleton"
	help
	  Use custom target skeleton.

endchoice

if BR2_ROOTFS_SKELETON_CUSTOM
config BR2_ROOTFS_SKELETON_CUSTOM_PATH
	string "custom target skeleton path"
	default "fs/skeleton"
	help
	  Path custom target skeleton.
endif

if BR2_ROOTFS_SKELETON_DEFAULT

config BR2_TARGET_GENERIC_GETTY_PORT
	string "Port to run a getty (login prompt) on"
	default "ttyS0"
	help
	  Specify a port to run a getty (login prompt) on.

choice
	prompt "Baudrate to use"
	default BR2_TARGET_GENERIC_GETTY_BAUDRATE_115200
	help
	  Select a baudrate to use.

config BR2_TARGET_GENERIC_GETTY_BAUDRATE_KEEP
       bool "keep kernel default"
config BR2_TARGET_GENERIC_GETTY_BAUDRATE_9600
	bool "9600"
config BR2_TARGET_GENERIC_GETTY_BAUDRATE_19200
	bool "19200"
config BR2_TARGET_GENERIC_GETTY_BAUDRATE_38400
	bool "38400"
config BR2_TARGET_GENERIC_GETTY_BAUDRATE_57600
	bool "57600"
config BR2_TARGET_GENERIC_GETTY_BAUDRATE_115200
	bool "115200"
endchoice

config BR2_TARGET_GENERIC_GETTY_BAUDRATE
	string
	default "0"		if BR2_TARGET_GENERIC_GETTY_BAUDRATE_KEEP
	default "9600"		if BR2_TARGET_GENERIC_GETTY_BAUDRATE_9600
	default "19200"		if BR2_TARGET_GENERIC_GETTY_BAUDRATE_19200
	default "38400"		if BR2_TARGET_GENERIC_GETTY_BAUDRATE_38400
	default "57600"		if BR2_TARGET_GENERIC_GETTY_BAUDRATE_57600
	default "115200"	if BR2_TARGET_GENERIC_GETTY_BAUDRATE_115200

config BR2_TARGET_GENERIC_REMOUNT_ROOTFS_RW
	bool "remount root filesystem read-write during boot"
	default y
	help
	  The root filesystem is typically mounted read-only at boot.
	  By default, buildroot remounts it in read-write mode early during the
	  boot process.
	  Say no here if you would rather like your root filesystem to remain
	  read-only.
	  If unsure, say Y.

endif # BR2_ROOTFS_SKELETON_DEFAULT

config BR2_ROOTFS_POST_BUILD_SCRIPT
	string "Custom script to run before creating filesystem images"
	default ""
	help
	  Specify a script to be run after the build has finished and before
	  Buildroot starts packing the files into selected filesystem images.

	  This gives users the oportunity to do board-specific cleanups,
	  add-ons and the like, so the generated files can be used directly
	  without further processing.

	  The script is called with the target directory name as first and
	  only argument. Make sure the exit code of that script is 0,
	  otherwise make will stop after calling it.

endmenu
```

## target/generic/firewall/Config.in
```kconfig
config BR2_TARGET_GENERIC_ACCESS_POINT
	bool "Generic firewall"
	default n
	help
	  Board support for a generic firewalling router.
```

## target/hurd/Config.in
```kconfig
config BR2_PACKAGE_HURD
	bool "Hurd kernel (see helptext)"
	depends on BR2_KERNEL_HURD
	default y
	help
	  The GNU/Hurd kernel.
	  http://www.gnu.org/software/hurd/

	  FIXME: Currently not implemented.
```

## target/initramfs/Config.in
```kconfig
config BR2_TARGET_ROOTFS_INITRAMFS
	bool "initramfs for initial ramdisk of linux kernel"
	default n
	help
	  Build a file which is usable for the gen_init_cpio tool
	  at linux kernel build. 
	  This file is normally called initramfs_list and can be
	  generated with gen_initramfs_list.sh script from the root
	  directory structure. 
	  The file is then used in the kernel build process to generate
	  the cpio filesystem for the initial ramdisk. Make sure that
	  you configure this file in kernel build configuration.
	  The location in the kernel build configuration menu is
	  Device Drivers -> Block devices -> Initramfs source file(s).
	  The configuration variable is CONFIG_INITRAMFS_SOURCE
```

## target/iso9660/Config.in
```kconfig
config BR2_TARGET_ROOTFS_ISO9660
	bool "iso image"
	depends on BR2_i386
	select BR2_TARGET_ROOTFS_EXT2
	select BR2_TARGET_GRUB
	select BR2_HOST_FAKEROOT
	help
	  Build a bootable iso9660 image

config BR2_TARGET_ROOTFS_ISO9660_OUTPUT
	string "Output File"
	depends on BR2_TARGET_ROOTFS_ISO9660
	default "$(IMAGE).iso"

config BR2_TARGET_ROOTFS_ISO9660_BOOT_MENU
	string "Boot menu.lst file"
	depends on BR2_TARGET_ROOTFS_ISO9660
	default "target/iso9660/menu.lst"
```
