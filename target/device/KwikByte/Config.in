## target/jffs2/Config.in
```kconfig
config BR2_TARGET_ROOTFS_JFFS2
	bool "jffs2 root filesystem"
	default n
	select BR2_HOST_FAKEROOT
	select BR2_PACKAGE_MTD
	help
	  Build a jffs2 root filesystem

choice
	prompt "Memory Type"
	default BR2_TARGET_ROOTFS_JFFS2_FLASH_128
	depends on BR2_TARGET_ROOTFS_JFFS2

config BR2_TARGET_ROOTFS_JFFS2_DATAFLASH_1056
	bool "AT45 dataflash with 1056 byte pagesize"
	depends on BR2_TARGET_ROOTFS_JFFS2
	select BR2_TARGET_ROOTFS_JFFS2_NOCLEANMARKER

config BR2_TARGET_ROOTFS_JFFS2_DATAFLASH_528
	bool "AT45 dataflash with 528 byte pagesize"
	depends on BR2_TARGET_ROOTFS_JFFS2
	select BR2_TARGET_ROOTFS_JFFS2_NOCLEANMARKER

config BR2_TARGET_ROOTFS_JFFS2_FLASH_128
	bool "Parallel flash with 4 kB pagesize and 128 kB erase size"
	depends on BR2_TARGET_ROOTFS_JFFS2

config BR2_TARGET_ROOTFS_JFFS2_FLASH_64
	bool "Parallel flash with 4 kB pagesize and 64 kB erase size"
	depends on BR2_TARGET_ROOTFS_JFFS2

config BR2_TARGET_ROOTFS_JFFS2_CUSTOM
	bool "Select custom page and erase size"
	depends on BR2_TARGET_ROOTFS_JFFS2

endchoice

config BR2_TARGET_ROOTFS_JFFS2_CUSTOM_PAGESIZE
	hex "Page Size"
	depends on BR2_TARGET_ROOTFS_JFFS2_CUSTOM
	default 0x1000
	help
	  Set to pagesize of memory

config BR2_TARGET_ROOTFS_JFFS2_CUSTOM_EBSIZE
	hex "Erase block size"
	depends on BR2_TARGET_ROOTFS_JFFS2_CUSTOM
	default 0x20000
	help
	  Set to erase size of memory

config BR2_TARGET_ROOTFS_JFFS2_PAGESIZE
	hex
	depends on BR2_TARGET_ROOTFS_JFFS2
	default 0x420 if BR2_TARGET_ROOTFS_JFFS2_DATAFLASH_1056
	default 0x210 if BR2_TARGET_ROOTFS_JFFS2_DATAFLASH_528
	default 0x1000 if BR2_TARGET_ROOTFS_JFFS2_FLASH_128
	default 0x1000 if BR2_TARGET_ROOTFS_JFFS2_FLASH_64
	default $(BR2_TARGET_ROOTFS_JFFS2_CUSTOM_PAGESIZE) if BR2_TARGET_ROOTFS_JFFS2_CUSTOM
	help
	  Set to pagesize of memory

config BR2_TARGET_ROOTFS_JFFS2_EBSIZE
	hex
	depends on BR2_TARGET_ROOTFS_JFFS2
	default 0x2100 if BR2_TARGET_ROOTFS_JFFS2_DATAFLASH_1056
	default 0x1080 if BR2_TARGET_ROOTFS_JFFS2_DATAFLASH_528
	default 0x20000 if BR2_TARGET_ROOTFS_JFFS2_FLASH_128
	default 0x10000 if BR2_TARGET_ROOTFS_JFFS2_FLASH_64
	default $(BR2_TARGET_ROOTFS_JFFS2_CUSTOM_EBSIZE) if BR2_TARGET_ROOTFS_JFFS2_CUSTOM
	help
	  Set to Erase Size of memory

config BR2_TARGET_ROOTFS_JFFS2_NOCLEANMARKER
	bool "Do not use Cleanmarker"
	depends on BR2_TARGET_ROOTFS_JFFS2
	default n
	help
	  Do not use cleanmarkers if using NAND flash or Dataflash where
	  the pagesize is not a power of 2

config BR2_JFFS2_TARGET_SREC
	bool "RootFS in SREC file formet"
	depends on BR2_TARGET_ROOTFS_JFFS2
	default n

config BR2_TARGET_ROOTFS_JFFS2_PAD
	bool "Pad output"
	depends on BR2_TARGET_ROOTFS_JFFS2

config BR2_TARGET_ROOTFS_JFFS2_PADSIZE
	hex "Pad output size (0x0 = to end of EB)"
	depends on BR2_TARGET_ROOTFS_JFFS2_PAD
	default 0x0
	help
	  Set to 0x0 to pad to end of erase block.

choice
	prompt "Endianess"
	default BR2_TARGET_ROOTFS_JFFS2_LE
	depends on BR2_TARGET_ROOTFS_JFFS2

config BR2_TARGET_ROOTFS_JFFS2_LE
	bool "little-endian"
	depends on BR2_TARGET_ROOTFS_JFFS2

config BR2_TARGET_ROOTFS_JFFS2_BE
	bool "big-endian"
	depends on BR2_TARGET_ROOTFS_JFFS2

endchoice

config BR2_TARGET_ROOTFS_JFFS2_SQUASH
	bool "Make all files be owned by root"
	depends on BR2_TARGET_ROOTFS_JFFS2

config BR2_TARGET_ROOTFS_JFFS2_OUTPUT
	string "Output File"
	depends on BR2_TARGET_ROOTFS_JFFS2
	default "$(IMAGE).jffs2"

config BR2_TARGET_ROOTFS_JFFS2_COPYTO
	string "also copy the image to..."
	depends on BR2_TARGET_ROOTFS_JFFS2
	default ""
	help
	  Copies the resulting image to a secondary location.
```

## target/linux/Config.in
```kconfig
#comment "Linux kernel options"

if BR2_KERNEL_LINUX
config BR2_PACKAGE_LINUX_KCONFIG
	string ".config file"
	depends on BR2_PACKAGE_LINUX
	default ""
	help
	  kernel's .config to use to build a kernel for the target.

	  If the above setting is empty, you can change the default
	  board-imposed value by passing LINUX26_KCONFIG=<path> to
	  make.

config BR2_PACKAGE_LINUX_FORMAT
	string "kernel binary format"
	depends on BR2_PACKAGE_LINUX
	default ""
	help
	  kernel binary format.
	  Popular values include:
	  - bzImage
	  - zImage
	  and other, architecture dependant formats.

	  Note that the default format is supposed to be set by your
	  board-description, if any.
	  i386 and compatible default to bzImage if nothing was given
	  above.
	  If the above setting is empty, you can change the default
	  board-imposed value by passing LINUX26_FORMAT=<string> to
	  make.
endif
```

## target/powerpc/yaboot/Config.in
```kconfig
config BR2_TARGET_YABOOT
	bool "yaboot"
	default n
	depends on BR2_powerpc
	help
	  The yaboot bootloader for new world powerpc systems.
```

## target/romfs/Config.in
```kconfig
config BR2_TARGET_ROOTFS_ROMFS
	bool "romfs root filesystem"
	default n
	select BR2_HOST_FAKEROOT
	help
	  Build a romfs image of the root filesystem.
```

## target/squashfs/Config.in
```kconfig
config BR2_TARGET_ROOTFS_SQUASHFS
	bool "squashfs root filesystem"
	select BR2_HOST_FAKEROOT
	help
	  Build a squashfs root filesystem

choice
	prompt "Squashfs version"
	default BR2_TARGET_ROOTFS_SQUASHFS_4
	depends on BR2_TARGET_ROOTFS_SQUASHFS
	help
	  Select squashfs version - This must match what your kernel
	  supports. Select 3.x if you use the legacy 3.x kernel
	  patches (pre 2.6.29), and 4.x otherwise.

config BR2_TARGET_ROOTFS_SQUASHFS_3
       depends on BR2_DEPRECATED || BR2_RECENT
       bool "3.x"
       help
         Select this if you use the legacy 3.x kernel patches (pre 2.6.29)

config BR2_TARGET_ROOTFS_SQUASHFS_4
       bool "4.x"
       help
         Select this if you use the squashfs version in mainline (from 2.6.29)

endchoice

config BR2_TARGET_ROOTFS_SQUASHFS_VERSION
	string
	default "3.4"	if BR2_TARGET_ROOTFS_SQUASHFS_3
	default "4.0"	if BR2_TARGET_ROOTFS_SQUASHFS_4
```

## target/tar/Config.in
```kconfig
config BR2_TARGET_ROOTFS_TAR
	bool "tar the root filesystem"
	default n
	select BR2_HOST_FAKEROUTE
	help
	  Build a tar archive of the root filesystem

choice
	prompt "Compression method"
	default BR2_TARGET_ROOTFS_TAR_NONE
	depends on BR2_TARGET_ROOTFS_TAR
	help
	  Select compressor for tar archive of the root filesystem

config BR2_TARGET_ROOTFS_TAR_NONE
	bool "no compression"
	help
	 Do not compress the tarball.

config BR2_TARGET_ROOTFS_TAR_GZIP
	bool "gzip"
	help
	 Do compress the tarball with gzip.
	 Note that you either have to have gzip installed on your host
	 or select to build a gzip for your host. See the packages submenu.

config BR2_TARGET_ROOTFS_TAR_BZIP2
	bool "bzip2"
	help
	 Do compress the tarball with bzip2.
	 Note that you either have to have bzip2 installed on your host
	 or select to build a bzip2 for your host. See the packages submenu.

config BR2_TARGET_ROOTFS_TAR_LZMA
	bool "lzma"
	help
	 Do compress the tarball with lzma.
	 Note that you either have to have lzma installed on your host
	 or select to build a lzma for your host. See the packages submenu.

endchoice

config BR2_TARGET_ROOTFS_TAR_OPTIONS
	string "other random options to pass to tar"
	depends on BR2_TARGET_ROOTFS_TAR
	default ""
	help
	  Any other flags you want to pass to tar
	  Refer to tar --help for details
```
