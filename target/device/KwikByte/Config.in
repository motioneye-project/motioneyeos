## target/u-boot/Config.in
```kconfig
menuconfig BR2_TARGET_UBOOT
	bool "Das U-Boot Boot Monitor"
	help
	  Build "Das U-Boot" Boot Monitor

if BR2_TARGET_UBOOT
config BR2_TARGET_UBOOT_BOARDNAME
	string "board name"
	depends on BR2_TARGET_UBOOT
	default "$(BOARD_NAME)"
	help
	  One of U-Boot supported boards to be built.
	  This will be suffixed with _config to meet U-Boot standard naming.

choice
	prompt "U-Boot Version"
	default BR2_TARGET_UBOOT_2009_01_RC1
	help
	  Select the specific Linux version you want to use
	
config BR2_TARGET_UBOOT_2009_01_RC1
	bool "u-boot-2009.01-rc1"
	depends on BR2_TARGET_UBOOT

config BR2_TARGET_UBOOT_2008_10
	bool "u-boot-2008.10"
	depends on BR2_TARGET_UBOOT
	
config BR2_TARGET_UBOOT_1_3_4
	bool "u-boot-1.3.4"
	depends on BR2_TARGET_UBOOT
	
config BR2_TARGET_UBOOT_1_2_0_ATMEL
	bool "u-boot-1.2.0-atmel"
	depends on BR2_TARGET_AT91
	depends on BR2_TARGET_UBOOT
	
config BR2_TARGET_UBOOT_2009_01
	bool "u-boot-2009.01"
	depends on BR2_TARGET_UBOOT

endchoice

config BR2_UBOOT_VERSION
	string
	default "2009.01-rc1"	if BR2_TARGET_UBOOT_2009_01_RC1
	default "2008.10"	if BR2_TARGET_UBOOT_2008_10
	default "1.3.4"		if BR2_TARGET_UBOOT_1_3_4
	default "1.2.0-atmel"	if BR2_TARGET_UBOOT_1_2_0_ATMEL
	default "2009.01"	if BR2_TARGET_UBOOT_2009_01

config BR2_U_BOOT_SITE
	string
	default "$(BR2_ATMEL_MIRROR)"		if BR2_TARGET_UBOOT_1_2_0_ATMEL
	default "ftp://ftp.denx.de/pub/u-boot"

config BR2_TARGET_UBOOT_CUSTOM_PATCH
	string "custom patch"
	depends on BR2_TARGET_UBOOT
	help
	  If your board requires a custom patch, add the path to the file here.
	  Most users may leave this empty

choice
	prompt "Bootsource"
	depends on BR2_BOOTSOURCE
	default BR2_TARGET_UBOOT_BOOTSOURCE_DATAFLASHCARD

	config BR2_TARGET_UBOOT_BOOTSOURCE_DATAFLASHCARD
	bool "Boot from dataflashcard"
	depends on BR2_BOOTSOURCE_DATAFLASHCARD

	config BR2_TARGET_UBOOT_BOOTSOURCE_DATAFLASH
	bool "Boot from dataflash"
	depends on BR2_BOOTSOURCE_DATAFLASH

	config BR2_TARGET_UBOOT_BOOTSOURCE_NANDFLASH
	bool "Boot from a NAND flash"
	depends on BR2_BOOTSOURCE_NANDFLASH

	config BR2_TARGET_UBOOT_BOOTSOURCE_FLASH
	bool "Boot from a parallell flash"
	depends on BR2_BOOTSOURCE_FLASH

	config BR2_TARGET_UBOOT_BOOTSOURCE_SDCARD
	bool "Boot from an SD-Card"
	depends on BR2_BOOTSOURCE_SDCARD

	config BR2_TARGET_UBOOT_BOOTSOURCE_EEPROM
	bool "Boot from a serial EEPROM (Not yet supported)"
	depends on BR2_BOOTSOURCE_EEPROM

endchoice

config BR2_TARGET_UBOOT_BOOTSOURCE
	string
	depends on BR2_BOOTSOURCE
	default "dataflash"	if BR2_TARGET_UBOOT_BOOTSOURCE_DATAFLASHCARD
	default "dataflash"	if BR2_TARGET_UBOOT_BOOTSOURCE_DATAFLASH
	default "nandflash"	if BR2_TARGET_UBOOT_BOOTSOURCE_NANDFLASH
	default "flash"		if BR2_TARGET_UBOOT_BOOTSOURCE_FLASH
	default "sdcard"	if BR2_TARGET_UBOOT_BOOTSOURCE_SDCARD
	default "eeprom"	if BR2_TARGET_UBOOT_BOOTSOURCE_EEPROM

config BR2_TARGET_UBOOT_SILENT
	bool "silent console"
	depends on BR2_TARGET_UBOOT
	help
	  If the option has been enabled, the output can be
	  silenced by setting the environment variable "silent".

config BR2_TARGET_UBOOT_TOOL_MKIMAGE
	bool "mkimage tool in target"
	depends on BR2_TARGET_UBOOT
	help
	  Install mkimage tool in target.

config BR2_TARGET_UBOOT_TOOL_ENV
	bool "fw_printenv tool in target"
	depends on BR2_TARGET_UBOOT
	help
	  Install fw_printenv / fw_setenv tools in target.


choice
	prompt "SDRAM Memory size"
	default BR2_TARGET_UBOOT_SDRAM_SIZE_64M
	help
	  Size of the onboard SDRAM

config BR2_TARGET_UBOOT_SDRAM_SIZE_256MB
	bool "256 MB"

config BR2_TARGET_UBOOT_SDRAM_SIZE_128MB
	bool "128 MB"

config BR2_TARGET_UBOOT_SDRAM_SIZE_64MB
	bool "64 MB"

config BR2_TARGET_UBOOT_SDRAM_SIZE_32MB
	bool "32 MB"

config BR2_TARGET_UBOOT_SDRAM_SIZE_16MB
	bool "16 MB"

config BR2_TARGET_UBOOT_SDRAM_SIZE_8MB
	bool "8 MB"

endchoice

config BR2_TARGET_UBOOT_MEMORY_SIZE
	string
	default "256M"	if BR2_TARGET_UBOOT_SDRAM_SIZE_256MB
	default "128M"	if BR2_TARGET_UBOOT_SDRAM_SIZE_128MB
	default "64M"	if BR2_TARGET_UBOOT_SDRAM_SIZE_64MB
	default "32M"	if BR2_TARGET_UBOOT_SDRAM_SIZE_32MB
	default "16M"	if BR2_TARGET_UBOOT_SDRAM_SIZE_16MB
	default "8M"	if BR2_TARGET_UBOOT_SDRAM_SIZE_8MB

choice
	prompt "Kernel Size"
	default BR2_TARGET_UBOOT_KERNEL_SIZE_2_00MB

config BR2_TARGET_UBOOT_KERNEL_SIZE_1_25MB
	bool "Kernel size is less than 1.25 MB"

config BR2_TARGET_UBOOT_KERNEL_SIZE_1_50MB
	bool "Kernel size is less than 1.50 MB"

config BR2_TARGET_UBOOT_KERNEL_SIZE_1_75MB
	bool "Kernel size is less than 1.75 MB"

config BR2_TARGET_UBOOT_KERNEL_SIZE_2_00MB
	bool "Kernel size is less than 2.00 MB"

config BR2_TARGET_UBOOT_KERNEL_SIZE_2_25MB
	bool "Kernel size is less than 2.25 MB"

config BR2_TARGET_UBOOT_KERNEL_SIZE_2_50MB
	bool "Kernel size is less than 2.50 MB"

endchoice

choice
	prompt "Dataflash Size"
	default BR2_TARGET_UBOOT_DATAFLASH_SIZE_2_00MB

config BR2_TARGET_UBOOT_DATAFLASH_SIZE_8MB
	bool "Dataflash size is 8 MB"

config BR2_TARGET_UBOOT_DATAFLASH_SIZE_4MB
	bool "Dataflash size is 4 MB"

config BR2_TARGET_UBOOT_DATAFLASH_SIZE_2MB
	bool "Dataflash size is 2 MB"

config BR2_TARGET_UBOOT_DATAFLASH_SIZE_1MB
	bool "Dataflash size is 1 MB"

config BR2_TARGET_UBOOT_DATAFLASH_SIZE_0_50MB
	bool "Dataflash size is 0.5 MB"

config BR2_TARGET_UBOOT_DATAFLASH_SIZE_0_25MB
	bool "Dataflash size is 0.25 MB"

endchoice

config BR2_TARGET_UBOOT_DATAFLASH_SIZE
	string
	default "8M"	if BR2_TARGET_DATAFLASH_SIZE_8MB
	default "4M"	if BR2_TARGET_DATAFLASH_SIZE_4MB
	default "2M"	if BR2_TARGET_DATAFLASH_SIZE_2MB
	default "1M"	if BR2_TARGET_DATAFLASH_SIZE_1MB
	default "0.5M"	if BR2_TARGET_DATAFLASH_SIZE_0_50MB
	default "0.25M"	if BR2_TARGET_DATAFLASH_SIZE_0_25MB

config BR2_TARGET_UBOOT_END_OF_FLASH
	string
	default "C083FFFF" if  BR2_TARGET_UBOOT_DATAFLASH_SIZE_8MB
	default "C041FFFF" if  BR2_TARGET_UBOOT_DATAFLASH_SIZE_4MB
	default "C020FFFF" if  BR2_TARGET_UBOOT_DATAFLASH_SIZE_2MB
	default "C0107FFF" if  BR2_TARGET_UBOOT_DATAFLASH_SIZE_1MB
	default "C0083FFF" if  BR2_TARGET_UBOOT_DATAFLASH_SIZE_0_50MB
	default "C0041FFF" if  BR2_TARGET_UBOOT_DATAFLASH_SIZE_0_25MB
	help
	  

config BR2_TARGET_UBOOT_KERNEL_START
	string "Kernel SDRAM address"
	default "21000000"
	help
	  Kernel is loaded to this address in SDRAM 

config BR2_TARGET_UBOOT_KERNEL_LOCATION
	string "Kernel flash address"
	default "C0042000"
	help
	  Kernel location in dataflash

config BR2_TARGET_UBOOT_FILESYSTEM_START
	string
	default "2114A000" if BR2_TARGET_UBOOT_KERNEL_SIZE_1_25MB
	default "2118C000" if BR2_TARGET_UBOOT_KERNEL_SIZE_1_50MB
  	default "211CE000" if BR2_TARGET_UBOOT_KERNEL_SIZE_1_75MB
  	default "21210000" if BR2_TARGET_UBOOT_KERNEL_SIZE_2_00MB
  	default "21252000" if BR2_TARGET_UBOOT_KERNEL_SIZE_2_25MB
  	default "21294000" if BR2_TARGET_UBOOT_KERNEL_SIZE_2_50MB
	help
	  Kernel is loaded to this SDRAM address
	  Assumes SDRAM starts at 20000000
	  Will need to be updated if the SDRAM is located elsewhere

config BR2_TARGET_UBOOT_FILESYSTEM_LOCATION
	string
	default "C018C000" if BR2_TARGET_UBOOT_KERNEL_SIZE_1_25MB
  	default "C01CE000" if BR2_TARGET_UBOOT_KERNEL_SIZE_1_50MB
  	default "C0210000" if BR2_TARGET_UBOOT_KERNEL_SIZE_1_75MB
  	default "C0252000" if BR2_TARGET_UBOOT_KERNEL_SIZE_2_00MB
  	default "C0294000" if BR2_TARGET_UBOOT_KERNEL_SIZE_2_25MB
  	default "C02D6000" if BR2_TARGET_UBOOT_KERNEL_SIZE_2_50MB
	help
	  Determine location for File System in Dataflash
	  This needs to be updated for other memory technologies

config BR2_TARGET_UBOOT_FILESYSTEM_SIZE
	string "File System Size"
	default "6000000"
	help
	  

menuconfig BR2_TARGET_UBOOT_NETWORK
	bool "Network Settings"
	default y
	depends on BR2_TARGET_UBOOT
	help
	  Network settings for U-boot

if BR2_TARGET_UBOOT_NETWORK

config BR2_TARGET_UBOOT_SERVERIP
	string "server ip"
	depends on BR2_TARGET_UBOOT
	default "10.175.196.221"
	help
	  TFTP server ip address

config BR2_TARGET_UBOOT_IPADDR
	string "ip address"
	depends on BR2_TARGET_UBOOT
	default "10.175.196.18"
	help
	  Target ip address

config BR2_TARGET_UBOOT_GATEWAY
	string "gateway ip"
	depends on BR2_TARGET_UBOOT
	default "10.175.196.1"
	help
	  Gateway ip address

config BR2_TARGET_UBOOT_NETMASK
	string "netmask"
	depends on BR2_TARGET_UBOOT
	default "255.255.255.0"
	help
	  Network Mask

config BR2_TARGET_UBOOT_ETHADDR
	string "ethernet address"
	depends on BR2_TARGET_UBOOT
	default "04:25:fe:ed:00:18"
	help
	  Target MAC address for the ethernet interface.
	  This should be changed for production units

config BR2_TARGET_UBOOT_ETH1ADDR
	string "ethernet 2 address"
	depends on BR2_TARGET_UBOOT
	depends on BR2_TARGET_AVR32
	help
	  Target MAC address for the second ethernet interface.
endif

endif

config BR2_BOOTSOURCE_DATAFLASHCARD
	bool
	help
	  Allow use of a dataflashcard as a boot source

config BR2_BOOTSOURCE_DATAFLASH
	bool
	help
	  Allow use of a dataflash as a boot source

config BR2_BOOTSOURCE_NANDFLASH
	bool
	help
	  Allow use of a NAND flash as a boot source

config BR2_BOOTSOURCE_FLASH
	bool
	help
	  Allow use of a flash RAM as a boot source

config BR2_BOOTSOURCE_SDCARD
	bool
	help
	  Allow use of an SD-card as a boot source

config BR2_BOOTSOURCE_EEPROM
	bool
	help
	  Allow use of a serial eeprom as a boot source

config	BR2_BOOTSOURCE
	bool
	default y if BR2_BOOTSOURCE_DATAFLASHCARD
	default y if BR2_BOOTSOURCE_DATAFLASH
	default y if BR2_BOOTSOURCE_NANDFLASH
	default y if BR2_BOOTSOURCE_FLASH
	default y if BR2_BOOTSOURCE_SDCARD
	default y if BR2_BOOTSOURCE_EEPROM
	default n
```

## target/ubifs/Config.in
```kconfig
config BR2_TARGET_ROOTFS_UBIFS
	bool "ubifs root filesystem"
	select BR2_HOST_FAKEROOT
	help
	  Build a ubifs root filesystem

config BR2_TARGET_ROOTFS_UBIFS_LEBSIZE
	hex "UBI logical erase block size"
	depends on BR2_TARGET_ROOTFS_UBIFS
	default 0x1f800

config BR2_TARGET_ROOTFS_UBIFS_MINIOSIZE
	hex "UBI minimum I/O size"
	depends on BR2_TARGET_ROOTFS_UBIFS
	default 0x800
	help
	  Some comment required here

config BR2_TARGET_ROOTFS_UBIFS_MAXLEBCNT
	int "Maximum LEB count"
	depends on BR2_TARGET_ROOTFS_UBIFS
	default 2048
	help
	  Some comment required here

config BR2_TARGET_ROOTFS_UBIFS_SQUASH
	bool "Make all files be owned by root"
	depends on  BR2_TARGET_ROOTFS_UBIFS
	default y

config BR2_TARGET_ROOTFS_UBIFS_OUTPUT
	string "Output File"
	depends on BR2_TARGET_ROOTFS_UBIFS
	default "$(IMAGE).ubifs"

choice
	prompt "ubifs runtime compression"
	default BR2_TARGET_ROOTFS_UBIFS_RT_LZO
	depends on BR2_TARGET_ROOTFS_UBIFS
	help
	  Select which compression format to use at run-time within the ubifs file system.

config BR2_TARGET_ROOTFS_UBIFS_RT_NONE
	bool "no compression"
	help
	  Don't use run-time compression.

config BR2_TARGET_ROOTFS_UBIFS_RT_ZLIB
	bool "gzip"
	help
	  Use zlib compression at run-time.

config BR2_TARGET_ROOTFS_UBIFS_RT_LZO
	bool "lzo"
	help
	  Use lzo compression at run-time.

endchoice

choice
	prompt "Compression method"
	default BR2_TARGET_ROOTFS_UBIFS_NONE
	depends on BR2_TARGET_ROOTFS_UBIFS
	help
	  Select which compression format to compress the final image into.

config BR2_TARGET_ROOTFS_UBIFS_NONE
	bool "no compression"
	help
	  Do not compress the ubifs filesystem.

config BR2_TARGET_ROOTFS_UBIFS_GZIP
	bool "gzip"
	help
	  Do compress the ubifs filesystem with gzip.
	  Note that you either have to have gzip installed on your host
	  or select to build a gzip for your host. See the packages submenu.

config BR2_TARGET_ROOTFS_UBIFS_BZIP2
	bool "bzip2"
	help
	  Do compress the ubifs filesystem with bzip2.
	  Note that you either have to have bzip2 installed on your host
	  or select to build a bzip2 for your host. See the packages submenu.

config BR2_TARGET_ROOTFS_UBIFS_LZMA
	bool "lzma"
	help
	  Do compress the ubifs filesystem with lzma.
	  Note that you either have to have lzma installed on your host
	  or select to build a lzma for your host. See the packages submenu.

endchoice

config BR2_TARGET_ROOTFS_UBIFS_COPYTO
	string "also copy the image to..."
	depends on BR2_TARGET_ROOTFS_UBIFS
	default ""
	help
	  Copies the resulting image to a secondary location
	  like a tftp server's root directory.
```

## target/x86/grub/Config.in
```kconfig
config BR2_TARGET_GRUB
	bool "grub"
	depends on BR2_i386 || BR2_x86_64
	help
	  The GRand Unified Bootloader for x86 systems.

config BR2_TARGET_GRUB_SPLASH
	bool "Splashimage support"
	depends on BR2_TARGET_GRUB
	help
	  Add support for splashimage.
	  
	  A splashimage is a 14-color indexed .xpm picture which
	  is displayed as background for the grub menu.

config BR2_TARGET_GRUB_DISKLESS
	bool "diskless support"
	depends on BR2_TARGET_GRUB
	help
	  enable diskless support

config BR2_TARGET_GRUB_3c595
	bool "3Com595 driver"
	depends on BR2_TARGET_GRUB
	help
	  enable 3Com595 driver

config BR2_TARGET_GRUB_3c90x
	bool "3Com90x driver"
	depends on BR2_TARGET_GRUB
	help
	  enable 3Com90x driver

config BR2_TARGET_GRUB_davicom
	bool "Davicom driver"
	depends on BR2_TARGET_GRUB
	help
	  enable Davicom driver

config BR2_TARGET_GRUB_e1000
	bool "Etherexpress Pro/1000 driver"
	depends on BR2_TARGET_GRUB
	help
	  enable Etherexpress Pro/1000 driver

config BR2_TARGET_GRUB_eepro100
	bool "Etherexpress Pro/100 driver"
	depends on BR2_TARGET_GRUB
	help
	  enable Etherexpress Pro/100 driver

config BR2_TARGET_GRUB_epic100
	bool "SMC 83c170 EPIC/100 driver"
	depends on BR2_TARGET_GRUB
	help
	  enable SMC 83c170 EPIC/100 driver

config BR2_TARGET_GRUB_forcedeth
	bool "Nvidia Geforce driver"
	depends on BR2_TARGET_GRUB
	help
	  enable Nvidia Geforce driver

config BR2_TARGET_GRUB_natsemi
	bool "NatSemi DP8381x driver"
	depends on BR2_TARGET_GRUB
	help
	  enable NatSemi DP8381x driver

config BR2_TARGET_GRUB_ns83820
	bool "NS83820 driver"
	depends on BR2_TARGET_GRUB
	help
	  enable NS83820 driver

config BR2_TARGET_GRUB_ns8390
	bool "NE2000 PCI driver"
	depends on BR2_TARGET_GRUB
	help
	  enable NE2000 PCI driver

config BR2_TARGET_GRUB_pcnet32
	bool "AMD Lance/PCI PCNet/32 driver"
	depends on BR2_TARGET_GRUB
	help
	  enable AMD Lance/PCI PCNet/32 driver

config BR2_TARGET_GRUB_pnic
	bool "Bochs Pseudo Nic driver"
	depends on BR2_TARGET_GRUB
	help
	  enable Bochs Pseudo Nic driver

config BR2_TARGET_GRUB_rtl8139
	bool "Realtek 8139 driver"
	depends on BR2_TARGET_GRUB
	help
	  enable Realtek 8139 driver

config BR2_TARGET_GRUB_r8169
	bool "Realtek 8169 driver"
	depends on BR2_TARGET_GRUB
	help
	  enable Realtek 8169 driver

config BR2_TARGET_GRUB_sis900
	bool "SIS 900 and SIS 7016 driver"
	depends on BR2_TARGET_GRUB
	help
	  enable SIS 900 and SIS 7016 driver

config BR2_TARGET_GRUB_tg3
	bool "Broadcom Tigon3 driver"
	depends on BR2_TARGET_GRUB
	help
	  enable Broadcom Tigon3 driver

config BR2_TARGET_GRUB_tulip
	bool "Tulip driver"
	depends on BR2_TARGET_GRUB
	help
	  enable Tulip driver

config BR2_TARGET_GRUB_tlan
	bool "TI ThunderLAN driver"
	depends on BR2_TARGET_GRUB
	help
	  enable TI ThunderLAN driver

config BR2_TARGET_GRUB_undi
	bool "PXE UNDI driver"
	depends on BR2_TARGET_GRUB
	help
	  enable PXE UNDI driver

config BR2_TARGET_GRUB_via_rhine
	bool "Rhine-I/II driver"
	depends on BR2_TARGET_GRUB
	help
	  enable Rhine-I/II driver

config BR2_TARGET_GRUB_w89c840
	bool "Winbond W89c840 driver"
	depends on BR2_TARGET_GRUB
	help
	  enable Winbond W89c840 driver
```
