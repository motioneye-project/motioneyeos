## toolchain/toolchain-external/toolchain-external-codescape-mti-mips/Config.in
```kconfig
config BR2_TOOLCHAIN_EXTERNAL_CODESCAPE_MTI_MIPS
	bool "Codescape MTI GNU Linux Toolchain 2016.05"
	depends on BR2_mips || BR2_mipsel || BR2_mips64 || BR2_mips64el
	depends on BR2_HOSTARCH = "x86_64" || BR2_HOSTARCH = "x86"
	depends on BR2_MIPS_CPU_MIPS32R2 || (BR2_MIPS_CPU_MIPS64R2 && !BR2_MIPS_SOFT_FLOAT) || \
		BR2_MIPS_CPU_MIPS32R5 || (BR2_MIPS_CPU_MIPS64R5 && !BR2_MIPS_SOFT_FLOAT)
	select BR2_TOOLCHAIN_EXTERNAL_GLIBC
	select BR2_INSTALL_LIBSTDCPP
	select BR2_TOOLCHAIN_HEADERS_AT_LEAST_4_7
	select BR2_TOOLCHAIN_GCC_AT_LEAST_4_9
	select BR2_TOOLCHAIN_HAS_FORTRAN
	help
	  Codescape MTI GNU Linux Toolchain 2016.05 for the MIPS
	  architecture, from Imagination Technologies. It uses gcc
	  4.9.2, binutils 2.24.90, glibc 2.20, gdb 7.9.1 and kernel
	  headers 4.7. It has support for the following variants:
	    - MIPS32r2 - Big-Endian, Hard-Float, Legacy NaN, o32 ABI
	      Select 'MIPS (big endian)' Target Architecture
	      Select 'mips 32r2' Target Architecture Variant
	      Disable 'Use soft-float'
	    - MIPS32r2 - Big-Endian, Hard-Float, 2008 NaN, o32 ABI
	      Select 'MIPS (big endian)' Target Architecture
	      Select 'mips 32r2' Target Architecture Variant
	      Disable 'Use soft-float'
	      Set BR2_TARGET_OPTIMIZATION to '-mnan=2008'
	    - MIPS32r2 - Big-Endian, Soft-Float, Legacy NaN, o32 ABI
	      Select 'MIPS (big endian)' Target Architecture
	      Select 'mips 32r2' Target Architecture Variant
	      Enable 'Use soft-float'
	    - MIPS32r2 - Little-Endian, Hard-Float, Legacy NaN, o32 ABI
	      Select 'MIPS (little endian)' Target Architecture
	      Select 'mips 32r2' Target Architecture Variant
	      Disable 'Use soft-float'
	    - MIPS32r2 - Little-Endian, Hard-Float, 2008 NaN, o32 ABI
	      Select 'MIPS (little endian)' Target Architecture
	      Select 'mips 32r2' Target Architecture Variant
	      Disable 'Use soft-float'
	      Set BR2_TARGET_OPTIMIZATION to '-mnan=2008'
	    - MIPS32r2 - Little-Endian, Soft-Float, Legacy NaN, o32 ABI
	      Select 'MIPS (little endian)' Target Architecture
	      Select 'mips 32r2' Target Architecture Variant
	      Enable 'Use soft-float'
	    - MIPS32r2 - Little-Endian, Hard-Float, 2008 NaN, o32 ABI, microMIPS
	      Select 'MIPS (little endian)' Target Architecture
	      Select 'mips 32r2' Target Architecture Variant
	      Enable 'Use soft-float'
	      Set BR2_TARGET_OPTIMIZATION to '-mmicromips'
	    - MIPS32r2 - Little-Endian, Soft-Float, Legacy NaN, o32 ABI, microMIPS
	      Select 'MIPS (little endian)' Target Architecture
	      Select 'mips 32r2' Target Architecture Variant
	      Disable 'Use soft-float'
	      Set BR2_TARGET_OPTIMIZATION to '-mmicromips'
	    - MIPS64r2 - Big-Endian, Hard-Float, Legacy NaN, n32 ABI
	      Select 'MIPS64 (big endian)' Target Architecture
	      Select 'mips 64r2' Target Architecture Variant
	      Select 'n32' Target ABI
	      Disable 'Use soft-float'
	    - MIPS64r2 - Little-Endian, Hard-Float, Legacy NaN, n32 ABI
	      Select 'MIPS64 (little endian)' Target Architecture
	      Select 'mips 64r2' Target Architecture Variant
	      Select 'n32' Target ABI
	      Disable 'Use soft-float'
	    - MIPS64r2 - Big-Endian, Hard-Float, Legacy NaN, n64 ABI
	      Select 'MIPS64 (big endian)' Target Architecture
	      Select 'mips 64r2' Target Architecture Variant
	      Select 'n64' Target ABI
	      Disable 'Use soft-float'
	    - MIPS64r2 - Little-Endian, Hard-Float, Legacy NaN, n64 ABI
	      Select 'MIPS64 (little endian)' Target Architecture
	      Select 'mips 64r2' Target Architecture Variant
	      Select 'n64' Target ABI
	      Disable 'Use soft-float'
```

## toolchain/toolchain-external/toolchain-external-codesourcery-aarch64/Config.in
```kconfig
config BR2_TOOLCHAIN_EXTERNAL_CODESOURCERY_AARCH64
	bool "CodeSourcery AArch64 2014.11"
	depends on BR2_aarch64
	# a57/a53 and a72/a53 appeared in gcc-6 or were broken before
	depends on !BR2_cortex_a57_a53 && !BR2_cortex_a72_a53
	depends on BR2_HOSTARCH = "x86_64" || BR2_HOSTARCH = "x86"
	depends on !BR2_STATIC_LIBS
	select BR2_TOOLCHAIN_EXTERNAL_GLIBC
	select BR2_TOOLCHAIN_HAS_SSP
	select BR2_INSTALL_LIBSTDCPP
	select BR2_HOSTARCH_NEEDS_IA32_LIBS
	select BR2_TOOLCHAIN_HAS_NATIVE_RPC
	select BR2_TOOLCHAIN_HEADERS_AT_LEAST_3_16
	select BR2_TOOLCHAIN_GCC_AT_LEAST_4_9
	help
	  Sourcery CodeBench toolchain for the AArch64 architecture,
	  from Mentor Graphics. It uses gcc 4.9.1, binutils
	  2.24.51.20140217, glibc 2.20, gdb 7.7.50 and kernel headers
	  3.16.2.
```

## toolchain/toolchain-external/toolchain-external-codesourcery-amd64/Config.in
```kconfig
config BR2_TOOLCHAIN_EXTERNAL_CODESOURCERY_AMD64
	bool "Sourcery CodeBench AMD64 2016.11"
	depends on BR2_x86_64
	depends on !BR2_ARCH_NEEDS_GCC_AT_LEAST_7
	depends on BR2_HOSTARCH = "x86_64" || BR2_HOSTARCH = "x86"
	depends on !BR2_STATIC_LIBS
	depends on BR2_x86_jaguar || BR2_x86_steamroller
	select BR2_TOOLCHAIN_EXTERNAL_GLIBC
	select BR2_TOOLCHAIN_HAS_SSP
	select BR2_TOOLCHAIN_HAS_NATIVE_RPC
	select BR2_INSTALL_LIBSTDCPP
	select BR2_HOSTARCH_NEEDS_IA32_LIBS
	select BR2_TOOLCHAIN_HEADERS_AT_LEAST_4_7
	select BR2_TOOLCHAIN_GCC_AT_LEAST_6
	select BR2_TOOLCHAIN_HAS_BINUTILS_BUG_19615 # based-on binutils-2.26
	help
	  Sourcery CodeBench toolchain for the amd64 (x86_64)
	  architectures, from Mentor Graphics. It uses gcc 6.2,
	  binutils 2.26, glibc 2.24, gdb 7.11 and kernel headers
	  4.7. It has support for the following variants:
	    - AMD Puma/Jaguar (family 16h), glibc
	    Default for x86_64, nothing special to do.
	    - AMD Steamroller (family 15h), glibc
	    Select a steamroller core.
	  No other architecture variants are supported since glibc
	  is optimized for one of these two baselines.
```
