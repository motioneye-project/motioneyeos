## toolchain/toolchain-external/Config.in
```kconfig
if BR2_TOOLCHAIN_EXTERNAL

comment "Toolchain External Options"

choice
	prompt "Toolchain"

comment "glibc toolchains only available with shared lib support"
	depends on BR2_STATIC_LIBS

# Kept toolchains sorted by architecture in order to use some toolchain
# as default choice

# Aarch64 (use ARM toolchain by default)
source "toolchain/toolchain-external/toolchain-external-arm-aarch64/Config.in"
source "toolchain/toolchain-external/toolchain-external-linaro-aarch64/Config.in"
source "toolchain/toolchain-external/toolchain-external-codesourcery-aarch64/Config.in"

# Aarch64 big-endian
source "toolchain/toolchain-external/toolchain-external-arm-aarch64-be/Config.in"
source "toolchain/toolchain-external/toolchain-external-linaro-aarch64-be/Config.in"

# ARC
source "toolchain/toolchain-external/toolchain-external-synopsys-arc/Config.in"

# Andes
source "toolchain/toolchain-external/toolchain-external-andes-nds32/Config.in"

# ARM (use ARM toolchain by default)
source "toolchain/toolchain-external/toolchain-external-arm-arm/Config.in"
source "toolchain/toolchain-external/toolchain-external-linaro-arm/Config.in"
source "toolchain/toolchain-external/toolchain-external-codesourcery-arm/Config.in"

# ARM big-endian
source "toolchain/toolchain-external/toolchain-external-linaro-armeb/Config.in"

# MIPS (use codesourcery toolchain by default)
source "toolchain/toolchain-external/toolchain-external-codesourcery-mips/Config.in"
source "toolchain/toolchain-external/toolchain-external-codescape-img-mips/Config.in"
source "toolchain/toolchain-external/toolchain-external-codescape-mti-mips/Config.in"

# NIOSII
source "toolchain/toolchain-external/toolchain-external-codesourcery-niosII/Config.in"

# x86_64
source "toolchain/toolchain-external/toolchain-external-codesourcery-amd64/Config.in"

# Kept last, so it remains the non-default choice, unless there isn't
# any available toolchain profile for the currently selected
# architecture, but before toolchains from br2-external trees.
source "toolchain/toolchain-external/toolchain-external-custom/Config.in"

# Toolchains from br2-external trees, if any
source "$BR2_BASE_DIR/.br2-external.in.toolchains"

endchoice

choice
	prompt "Toolchain origin"
	# Keep compatibility with old defconfig files that are using
	# custom toolchains, and which are therefore assuming that
	# "preinstalled" in the default choice.
	default BR2_TOOLCHAIN_EXTERNAL_PREINSTALLED if BR2_TOOLCHAIN_EXTERNAL_CUSTOM

config BR2_TOOLCHAIN_EXTERNAL_DOWNLOAD
	bool "Toolchain to be downloaded and installed"
	help
	  Select this option if you want Buildroot to download and
	  install the toolchain. If you have selected a custom
	  toolchain, specify the URL in BR2_TOOLCHAIN_EXTERNAL_URL.

config BR2_TOOLCHAIN_EXTERNAL_PREINSTALLED
	bool "Pre-installed toolchain"
	help
	  Select this option if you want to use a pre-installed
	  toolchain. Specify the path to this toolchain in
	  BR2_TOOLCHAIN_EXTERNAL_PATH.

endchoice

config BR2_TOOLCHAIN_EXTERNAL_PATH
	string "Toolchain path"
	default ""
	depends on BR2_TOOLCHAIN_EXTERNAL_PREINSTALLED
	help
	  Path to where the external toolchain is installed. The
	  compiler itself is expected to be in the "bin" subdirectory
	  of this path.

	  If empty, the compiler will be searched in $PATH.

config BR2_TOOLCHAIN_EXTERNAL_GLIBC
	bool
	select BR2_TOOLCHAIN_USES_GLIBC

config BR2_TOOLCHAIN_EXTERNAL_UCLIBC
	bool
	select BR2_TOOLCHAIN_USES_UCLIBC

config BR2_TOOLCHAIN_EXTERNAL_MUSL
	bool
	select BR2_TOOLCHAIN_USES_MUSL
	# Compatibility headers: cdefs.h, queue.h
	select BR2_PACKAGE_MUSL_COMPAT_HEADERS

# Make sure the virtual-package infra checks the provider
config BR2_PACKAGE_HAS_TOOLCHAIN_EXTERNAL
	bool
	default y

config BR2_PACKAGE_PROVIDES_TOOLCHAIN_EXTERNAL
	string

config BR2_TOOLCHAIN_EXTERNAL_PREFIX
	string

# Kept toolchains sorted as in the choice above
# The toolchain Config.in.options must define
# BR2_PACKAGE_PROVIDES_TOOLCHAIN_EXTERNAL and BR2_TOOLCHAIN_EXTERNAL_PREFIX

# Aarch64
source "toolchain/toolchain-external/toolchain-external-arm-aarch64/Config.in.options"
source "toolchain/toolchain-external/toolchain-external-linaro-aarch64/Config.in.options"
source "toolchain/toolchain-external/toolchain-external-codesourcery-aarch64/Config.in.options"

# Aarch64 big-endian
source "toolchain/toolchain-external/toolchain-external-arm-aarch64-be/Config.in.options"
source "toolchain/toolchain-external/toolchain-external-linaro-aarch64-be/Config.in.options"

# ARC
source "toolchain/toolchain-external/toolchain-external-synopsys-arc/Config.in.options"

# Andes
source "toolchain/toolchain-external/toolchain-external-andes-nds32/Config.in.options"

# ARM
source "toolchain/toolchain-external/toolchain-external-arm-arm/Config.in.options"
source "toolchain/toolchain-external/toolchain-external-linaro-arm/Config.in.options"
source "toolchain/toolchain-external/toolchain-external-codesourcery-arm/Config.in.options"

# ARM big-endian
source "toolchain/toolchain-external/toolchain-external-linaro-armeb/Config.in.options"

# MIPS
source "toolchain/toolchain-external/toolchain-external-codesourcery-mips/Config.in.options"
source "toolchain/toolchain-external/toolchain-external-codescape-img-mips/Config.in.options"
source "toolchain/toolchain-external/toolchain-external-codescape-mti-mips/Config.in.options"

# NIOSII
source "toolchain/toolchain-external/toolchain-external-codesourcery-niosII/Config.in.options"

# x86_64
source "toolchain/toolchain-external/toolchain-external-codesourcery-amd64/Config.in.options"

# Custom toolchains
source "toolchain/toolchain-external/toolchain-external-custom/Config.in.options"

config BR2_TOOLCHAIN_EXTERNAL_GDB_SERVER_COPY
	bool "Copy gdb server to the Target"
	depends on BR2_TOOLCHAIN_EXTERNAL
	help
	  Copy the gdbserver provided by the external toolchain to the
	  target.

endif # BR2_TOOLCHAIN_EXTERNAL
```

## toolchain/toolchain-external/toolchain-external-andes-nds32/Config.in
```kconfig
config BR2_TOOLCHAIN_EXTERNAL_ANDES_NDS32
	bool "Andes nds32"
	depends on BR2_nds32
	depends on !BR2_STATIC_LIBS
	depends on BR2_HOSTARCH = "x86_64" || BR2_HOSTARCH = "x86"
	select BR2_HOSTARCH_NEEDS_IA32_LIBS
	select BR2_TOOLCHAIN_GCC_AT_LEAST_8
	select BR2_TOOLCHAIN_EXTERNAL_GLIBC
	select BR2_TOOLCHAIN_HEADERS_AT_LEAST_4_17
	select BR2_TOOLCHAIN_HAS_NATIVE_RPC
	select BR2_TOOLCHAIN_HAS_SSP
	help
	  nds32 toolchain for the nds32 architecture. It uses GCC
	  8.2.1, GDB 8.1.1, glibc 2.28, Binutils 2.30. It generates
	  code that runs on ae3xx platform
```

## toolchain/toolchain-external/toolchain-external-arm-aarch64-be/Config.in
```kconfig
config BR2_TOOLCHAIN_EXTERNAL_ARM_AARCH64_BE
	bool "Arm AArch64 BE 2018.11"
	depends on BR2_aarch64_be
	depends on BR2_HOSTARCH = "x86_64"
	depends on !BR2_STATIC_LIBS
	select BR2_TOOLCHAIN_EXTERNAL_GLIBC
	select BR2_TOOLCHAIN_HAS_SSP
	select BR2_INSTALL_LIBSTDCPP
	select BR2_TOOLCHAIN_HAS_NATIVE_RPC
	select BR2_TOOLCHAIN_HEADERS_AT_LEAST_4_20
	select BR2_TOOLCHAIN_GCC_AT_LEAST_8
	select BR2_TOOLCHAIN_HAS_FORTRAN
	help
	  Arm toolchain for the AArch64 Big Endian architecture.

	  This is the same toolchain that was previously distributed by
	  Linaro.

	  https://developer.arm.com/open-source/gnu-toolchain
```

## toolchain/toolchain-external/toolchain-external-arm-arm/Config.in
```kconfig
comment "Arm toolchains available for Cortex-A + EABIhf"
	depends on BR2_arm
	depends on !BR2_ARM_CPU_ARMV7A || !BR2_ARM_EABIHF
	depends on !BR2_STATIC_LIBS

config BR2_TOOLCHAIN_EXTERNAL_ARM_ARM
	bool "Arm ARM 2019.12"
	depends on BR2_arm
	depends on BR2_ARM_CPU_ARMV7A || BR2_ARM_CPU_ARMV8A
	depends on BR2_HOSTARCH = "x86_64"
	depends on BR2_ARM_EABIHF
	depends on !BR2_STATIC_LIBS
	select BR2_TOOLCHAIN_EXTERNAL_GLIBC
	select BR2_TOOLCHAIN_HAS_SSP
	select BR2_TOOLCHAIN_HAS_NATIVE_RPC
	select BR2_INSTALL_LIBSTDCPP
	select BR2_TOOLCHAIN_HEADERS_AT_LEAST_4_20
	select BR2_TOOLCHAIN_GCC_AT_LEAST_9
	select BR2_TOOLCHAIN_HAS_FORTRAN
	select BR2_TOOLCHAIN_HAS_OPENMP
	help
	  Arm toolchain for the ARM architecture. It uses GCC 9.2.1,
	  GDB 8.3.0, glibc 2.30, Binutils 2.33.1. It generates code that
	  runs on all Cortex-A profile devices, but tuned for the
	  Cortex-A9. The code generated uses the hard floating point
	  calling convention, and uses the VFPv3-D16 FPU instructions.

	  This is the same toolchain that was previously distributed by
	  Linaro.

	  https://developer.arm.com/open-source/gnu-toolchain
```

## toolchain/toolchain-external/toolchain-external-blackfin-uclinux/Config.in
```kconfig
config BR2_TOOLCHAIN_EXTERNAL_BLACKFIN_UCLINUX
	bool "Blackfin.uclinux.org 2014R1"
	depends on BR2_bfin
	depends on BR2_HOSTARCH = "x86_64" || BR2_HOSTARCH = "x86"
	select BR2_TOOLCHAIN_EXTERNAL_UCLIBC
	select BR2_INSTALL_LIBSTDCPP
	select BR2_TOOLCHAIN_HAS_NATIVE_RPC
	select BR2_USE_WCHAR
	select BR2_TOOLCHAIN_HAS_THREADS
	select BR2_TOOLCHAIN_HAS_THREADS_DEBUG
	select BR2_HOSTARCH_NEEDS_IA32_LIBS
	select BR2_TOOLCHAIN_HEADERS_AT_LEAST_3_10
	select BR2_TOOLCHAIN_GCC_AT_LEAST_4_3
	select BR2_TOOLCHAIN_HAS_FORTRAN
	help
	  Toolchain for the Blackfin architecture, from
	  http://blackfin.uclinux.org.
```

## toolchain/toolchain-external/toolchain-external-codescape-img-mips/Config.in
```kconfig
config BR2_TOOLCHAIN_EXTERNAL_CODESCAPE_IMG_MIPS
	bool "Codescape IMG GNU Linux Toolchain 2018.09"
	depends on BR2_mips || BR2_mipsel || BR2_mips64 || BR2_mips64el
	depends on !BR2_ARCH_NEEDS_GCC_AT_LEAST_7
	depends on BR2_HOSTARCH = "x86_64" || BR2_HOSTARCH = "x86"
	depends on BR2_MIPS_CPU_MIPS32R6 || (BR2_MIPS_CPU_MIPS64R6 && !BR2_MIPS_SOFT_FLOAT)
	select BR2_TOOLCHAIN_EXTERNAL_GLIBC
	select BR2_INSTALL_LIBSTDCPP
	select BR2_TOOLCHAIN_HEADERS_AT_LEAST_4_7
	select BR2_TOOLCHAIN_GCC_AT_LEAST_6
	select BR2_TOOLCHAIN_HAS_FORTRAN
	help
	  Codescape IMG GNU Linux Toolchain 2018.09 for the MIPS
	  architecture, from MIPS Tech LLC. It uses gcc 6.3.0,
	  binutils 2.28.51, glibc 2.20, gdb 7.9.1 and kernel headers
	  4.7. It has support for the following variants:
	    - MIPS32r6 - Big-Endian, Hard-Float, 2008 NaN, o32 ABI
	      Select 'MIPS (big endian)' Target Architecture
	      Select 'mips 32r6' Target Architecture Variant
	      Disable 'Use soft-float'
	    - MIPS32r6 - Big-Endian, Soft-Float, 2008 NaN, o32 ABI
	      Select 'MIPS (big endian)' Target Architecture
	      Select 'mips 32r6' Target Architecture Variant
	      Enable 'Use soft-float'
	    - MIPS32r6 - Little-Endian, Hard-Float, 2008 NaN, o32 ABI
	      Select 'MIPS (little endian)' Target Architecture
	      Select 'mips 32r6' Target Architecture Variant
	      Disable 'Use soft-float'
	    - MIPS32r6 - Little-Endian, Soft-Float, 2008 NaN, o32 ABI
	      Select 'MIPS (little endian)' Target Architecture
	      Select 'mips 32r6' Target Architecture Variant
	      Enable 'Use soft-float'
	    - MIPS32r6 - Little-Endian, Hard-Float, 2008 NaN, o32 ABI,
	      microMIPS
	      Select 'MIPS (little endian)' Target Architecture
	      Select 'mips 32r6' Target Architecture Variant
	      Disable 'Use soft-float'
	      Set BR2_TARGET_OPTIMIZATION to '-mmicromips'
	    - MIPS32r6 - Little-Endian, Soft-Float, 2008 NaN, o32 ABI,
	      microMIPS
	      Select 'MIPS (little endian)' Target Architecture
	      Select 'mips 32r6' Target Architecture Variant
	      Enable 'Use soft-float'
	      Set BR2_TARGET_OPTIMIZATION to '-mmicromips'
	    - MIPS64r6 - Big-Endian, Hard-Float, 2008 NaN, n32 ABI
	      Select 'MIPS64 (big endian)' Target Architecture
	      Select 'mips 64r6' Target Architecture Variant
	      Select 'n32' Target ABI
	      Disable 'Use soft-float'
	    - MIPS64r6 - Little-Endian, Hard-Float, 2008 NaN, n32 ABI
	      Select 'MIPS64 (little endian)' Target Architecture
	      Select 'mips 64r6' Target Architecture Variant
	      Select 'n32' Target ABI
	      Disable 'Use soft-float'
	    - MIPS64r6 - Big-Endian, Hard-Float, 2008 NaN, n64 ABI
	      Select 'MIPS64 (big endian)' Target Architecture
	      Select 'mips 64r6' Target Architecture Variant
	      Select 'n64' Target ABI
	      Disable 'Use soft-float'
	    - MIPS64r6 - Little-Endian, Hard-Float, 2008 NaN, n64 ABI
	      Select 'MIPS64 (little endian)' Target Architecture
	      Select 'mips 64r6' Target Architecture Variant
	      Select 'n64' Target ABI
	      Disable 'Use soft-float'
```
