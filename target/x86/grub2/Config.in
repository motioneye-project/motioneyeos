## target/x86/grub2/Config.in
```kconfig
config BR2_TARGET_GRUB2
	bool "grub2"
	help
	  The GRand Unified Bootloader for x86 systems, take #2.

config BR2_TARGET_GRUB2_SPLASH
	bool "Splashimage support"
	depends on BR2_TARGET_GRUB2
	help
	  Add support for splashimage.
	  
	  A splashimage is a 14-color indexed .xpm picture which
	  is displayed as background for the grub menu.
```

## target/x86/syslinux/Config.in
```kconfig
config BR2_TARGET_SYSLINUX
	bool "syslinux"
	depends on BR2_i386
	help
	  The syslinux bootloader for x86 systems.

config BR2_TARGET_PXELINUX
	bool "pxelinux"
	depends on BR2_i386 || BR2_x86_64
	help
	  The pxelinux loader for x86 systems.
```

## target/xtensa/defconfig
```kconfig
# Default buildroot configuration for running Linux on an Xtensa processor
# on an LX60 board.

#
# Project Options
#
BR2_BANNER="Welcome to your custom Xtensa processor based uClibc environment."
BR2_HAVE_DOT_CONFIG=y
BR2_xtensa=y
BR2_xtensa_dc232b=y
BR2_xtensa_core_name="dc232b"
BR2_ARCH="xtensa"

#
# Build options
#
BR2_WGET="wget --passive-ftp"
# BR2_STRIP_strip is not set
# BR2_STRIP_none=y

## Added by Maxim

#
# Kernel Header Options
#
BR2_KERNEL_none=y
BR2_KERNEL_HEADERS_2_6_22_1=y
BR2_DEFAULT_KERNEL_HEADERS="2.6.22.1"

#
# uClibc Options
#
BR2_UCLIBC_VERSION_0_9_30=y
# BR2_UCLIBC_VERSION_SNAPSHOT is not set
BR2_UCLIBC_CONFIG="target/xtensa/uClibc-0.9.30.config"
BR2_PTHREADS_OLD=y
# BR2_PTHREADS_NATIVE is not set
BR2_PTHREAD_DEBUG=y

#
# Binutils Options
#
BR2_BINUTILS_VERSION_2_19=y
BR2_BINUTILS_VERSION="2.19"
BR2_EXTRA_BINUTILS_CONFIG_OPTIONS=""

#
# Gcc Options
#
BR2_GCC_VERSION_4_3_2=y
# BR2_GCC_IS_SNAP is not set
BR2_GCC_VERSION="4.3.2"
BR2_TOOLCHAIN_SYSROOT=y
BR2_EXTRA_GCC_CONFIG_OPTIONS=""
BR2_GCC_CROSS_CXX=y
BR2_INSTALL_LIBSTDCPP=y
BR2_GCC_SHARED_LIBGCC=y

#
# Gdb Options
#
BR2_PACKAGE_GDB=y
BR2_PACKAGE_GDB_SERVER=y
BR2_PACKAGE_GDB_HOST=y
# BR2_GDB_VERSION_6_2_1 is not set
# BR2_GDB_VERSION_6_3 is not set
# BR2_GDB_VERSION_6_4 is not set
# BR2_GDB_VERSION_6_5 is not set
# BR2_GDB_VERSION_6_6 is not set
# BR2_GDB_VERSION_6_7_1 is not set
BR2_GDB_VERSION_6_8=y
# BR2_GDB_VERSION_SNAPSHOT is not set
BR2_GDB_VERSION="6.8"

#
# Common Toolchain Options
#
# BR2_PACKAGE_SSTRIP_TARGET is not set
# BR2_PACKAGE_SSTRIP_HOST is not set
BR2_LARGEFILE=y
BR2_INET_RPC=y
BR2_TARGET_OPTIMIZATION="-Os -pipe"


## Added by Maxim
BR2_TOOLCHAIN_BUILDROOT=y


# BR2_PACKAGE_BUSYBOX_SHOW_OTHERS is not set

#
# Other development stuff
#
# BR2_PACKAGE_LIBINTL is not set
#  For NFS mount:
BR2_PACKAGE_PORTMAP=y

#
# Other stuff
#

#
# filesystem for target device
#
BR2_ROOTFS_DEVICE_TABLE="target/device/xtensa/device_table.txt"
BR2_TARGET_ROOTFS_CPIO=y
BR2_TARGET_ROOTFS_CPIO_GZIP=y
BR2_TARGET_ROOTFS_INITRAMFS=y

#
# Linux Options
#
# BR2_PACKAGE_LINUX is not set

#
# Board Support Options
#
BR2_TARGET_XTENSA=y

#
# Tensilica Xtensa/Diamond based Device Support
#
BR2_TARGET_XTENSA_XTAV60=y

#
# Compressors / decompressors
#

BR2_PACKAGE_ZLIB=y
```

## toolchain/Config.in
```kconfig
menu "Toolchain"

# Invisible option that makes sure the toolchain package always gets
# built
config BR2_TOOLCHAIN
	bool
	default y

# Should be selected for glibc or eglibc
config BR2_TOOLCHAIN_USES_GLIBC
	bool
	select BR2_USE_WCHAR
	select BR2_ENABLE_LOCALE
	select BR2_TOOLCHAIN_HAS_FULL_GETTEXT
	select BR2_TOOLCHAIN_HAS_THREADS
	select BR2_TOOLCHAIN_HAS_THREADS_DEBUG
	select BR2_TOOLCHAIN_HAS_THREADS_NPTL
	select BR2_TOOLCHAIN_HAS_SHADOW_PASSWORDS
	select BR2_TOOLCHAIN_SUPPORTS_PIE

config BR2_TOOLCHAIN_USES_UCLIBC
	bool
	select BR2_TOOLCHAIN_SUPPORTS_PIE if !BR2_m68k && !BR2_microblaze && !BR2_STATIC_LIBS

config BR2_TOOLCHAIN_USES_MUSL
	bool
	select BR2_USE_WCHAR
	select BR2_ENABLE_LOCALE
	select BR2_TOOLCHAIN_HAS_THREADS
	select BR2_TOOLCHAIN_HAS_THREADS_DEBUG
	select BR2_TOOLCHAIN_HAS_THREADS_NPTL
	select BR2_TOOLCHAIN_SUPPORTS_PIE if !BR2_STATIC_LIBS

choice
	prompt "Toolchain type"
	help
	  Select whether to use the toolchain provided by buildroot
	  or an external toolchain.

	  Some vendors provide toolchains in binary form, some in
	  source form.

config BR2_TOOLCHAIN_BUILDROOT
	bool "Buildroot toolchain"
	select BR2_TOOLCHAIN_HAS_SHADOW_PASSWORDS
	depends on !BR2_bf606
	depends on !BR2_bf607
	depends on !BR2_bf608
	depends on !BR2_bf609
	depends on !BR2_csky

config BR2_TOOLCHAIN_EXTERNAL
	bool "External toolchain"
	help
	  Select if you want to use an existing cross-compiling
	  toolchain. Buildroot can either download automatically a
	  toolchain, or use an already installed toolchain.

endchoice

source "toolchain/toolchain-buildroot/Config.in"
source "toolchain/toolchain-external/Config.in"
source "toolchain/toolchain-common.in"

endmenu
```

## toolchain/binutils/Config.in
```kconfig
# Choose binutils version.

comment "Binutils Options"

choice
	prompt "Binutils Version"
	default BR2_BINUTILS_VERSION_2_20
	help
	  Select the version of binutils you wish to use.

	config BR2_BINUTILS_VERSION_2_17
		depends on !BR2_nios2 && !BR2_avr32
		depends on BR2_DEPRECATED
		bool "binutils 2.17"

	config BR2_BINUTILS_VERSION_2_18
		depends on !BR2_nios2 && !BR2_avr32
		depends on BR2_DEPRECATED
		bool "binutils 2.18"

	config BR2_BINUTILS_VERSION_2_18_50_0_9
		depends on !BR2_avr32 && !BR2_nios2
		depends on BR2_DEPRECATED
		bool "binutils 2.18.50.0.9"

	config BR2_BINUTILS_VERSION_2_18_AVR32_1_0_1
	       depends on BR2_avr32
	       bool "binutils 2.18-avr32-1.0.1"

	config BR2_BINUTILS_VERSION_2_19
		depends on !BR2_avr32 && !BR2_nios2
		depends on BR2_DEPRECATED
		bool "binutils 2.19"

	config BR2_BINUTILS_VERSION_2_19_1
		depends on !BR2_avr32 && !BR2_nios2
		depends on BR2_DEPRECATED || BR2_RECENT
		bool "binutils 2.19.1"

	config BR2_BINUTILS_VERSION_2_20
		depends on !BR2_avr32 && !BR2_nios2
		bool "binutils 2.20"

endchoice

config BR2_BINUTILS_VERSION
	string
	default "2.15"		if BR2_nios2
	default "2.17"		if BR2_BINUTILS_VERSION_2_17
	default "2.18"		if BR2_BINUTILS_VERSION_2_18
	default "2.18.50.0.9"	if BR2_BINUTILS_VERSION_2_18_50_0_9
	default "2.18-avr32-1.0.1" if BR2_BINUTILS_VERSION_2_18_AVR32_1_0_1
	default "2.19"		if BR2_BINUTILS_VERSION_2_19
	default "2.19.1"	if BR2_BINUTILS_VERSION_2_19_1
	default "2.20"		if BR2_BINUTILS_VERSION_2_20

config BR2_EXTRA_BINUTILS_CONFIG_OPTIONS
	string "Additional binutils options"
	default ""
	help
	  Any additional binutils options you may want to include.
```

## toolchain/ccache/Config.in
```kconfig
#

comment "Ccache Options"

config BR2_CCACHE
	bool "Enable ccache support?"
	help
	    Enable ccache support?

config BR2_CCACHE_DIR
	string "ccache dir location?"
	depends on BR2_CCACHE
	default "$(TOOL_BUILD_DIR)/ccache-$(CCACHE_VER)/cache"
	help
	    Where ccache should store cached files.

comment "ccache dir location?       - disabled (requires ccache support)"
	depends on !BR2_CCACHE
```

## toolchain/elf2flt/Config.in
```kconfig
config BR2_ELF2FLT
	bool "Enable elf2flt support?"
	depends on BR2_arm || BR2_sh || BR2_sparc
	help
	  uCLinux uses a Binary Flat format commonly known as BFLT. It
	  is a relatively simple and lightweight executable format
	  based on the original a.out format.

	  This option compiles the required tools and makes the required
	  modifications on your toolchain (linker).
```

## toolchain/export-toolchain/Config.in
```kconfig
config BR2_EXPORT_TOOLCHAIN
	bool "Create script exporting toolchain to home directory"
	default n
	help
	  This will generate a batchfile which, if run
	  will add the Buildroot toolchain to the user PATH
	  The file is called "$(ARCH)-uclibc-gcc-$(GCC_VERSION).sh"
```

## toolchain/external-toolchain/Config.in
```kconfig
#

if BR2_TOOLCHAIN_EXTERNAL
config BR2_TOOLCHAIN_EXTERNAL_LIB_C
	string "The core C library from the external toolchain"
	default "libc.so.0"
	help
	  Specify the core C shared library found in the external
	  toolchain. This is required in addition to any other
	  libraries to be copied.

config BR2_TOOLCHAIN_EXTERNAL_LIBS
	string "Libraries to copy from the external toolchain"
	default "ld-uClibc.so.0 libcrypt.so.0 libdl.so.0 libgcc_s.so libm.so.0 libnsl.so.0 libpthread.so.0 libresolv.so.0 librt.so.0 libutil.so.0"
	help
	  A space separated list of the shared libraries to be copied
	  from the external toolchain into the root filesystem. Only
	  the top-level name is needed, i.e. libc.so, libpthread.so as
	  the actual shared library symlinked to will be copied also.

config BR2_TOOLCHAIN_EXTERNAL_STRIP
        bool
        default y
        prompt "Strip shared libraries"
	help
	  Strip shared libraries copied from the external toolchain.
endif
```

## toolchain/gcc/Config.in
```kconfig
# Choose gcc version.

comment "GCC Options"

choice
	prompt "GCC compiler Version"
	default BR2_GCC_VERSION_4_5_X if !BR2_avr32 && !BR2_sparc_sparchfleon && !BR2_sparc_sparchfleonv8 && !BR2_sparc_sparcsfleon && !BR2_sparc_sparcsfleonv8
	default BR2_GCC_VERSION_4_4_X if BR2_sparc_sparchfleon || BR2_sparc_sparchfleonv8 || BR2_sparc_sparcsfleon || BR2_sparc_sparcsfleonv8
	default BR2_GCC_VERSION_4_2_2_AVR32_2_1_5 if BR2_avr32
	help
	  Select the version of gcc you wish to use.

	config BR2_GCC_VERSION_4_2_2_AVR32_2_1_5
	       depends on BR2_avr32
	       bool "gcc 4.2.2-avr32-2.1.5"

	config BR2_GCC_VERSION_4_3_X
		depends on !BR2_avr32 && !BR2_sparc_sparchfleon && !BR2_sparc_sparchfleonv8 && !BR2_sparc_sparcsfleon && !BR2_sparc_sparcsfleonv8 && !BR2_cortex_a8 && !BR2_cortex_a9 && !BR2_x86_atom && !BR2_powerpc_e300c2 && !BR2_powerpc_e300c3 && !BR2_powerpc_e500mc
		bool "gcc 4.3.x"

	config BR2_GCC_VERSION_4_4_X
		depends on !BR2_avr32 && !BR2_x86_atom
		bool "gcc 4.4.x"

	config BR2_GCC_VERSION_4_5_X
		depends on !BR2_avr32 && !BR2_sparc_sparchfleon && !BR2_sparc_sparchfleonv8 && !BR2_sparc_sparcsfleon && !BR2_sparc_sparcsfleonv8
		bool "gcc 4.5.x"

	config BR2_GCC_VERSION_4_6_X
		depends on !BR2_avr32 && !BR2_sparc_sparchfleon && !BR2_sparc_sparchfleonv8 && !BR2_sparc_sparcsfleon && !BR2_sparc_sparcsfleonv8
		bool "gcc 4.6.x"

	config BR2_GCC_VERSION_4_7_X
		depends on !BR2_avr32 && !BR2_sparc_sparchfleon && !BR2_sparc_sparchfleonv8 && !BR2_sparc_sparcsfleon && !BR2_sparc_sparcsfleonv8
		bool "gcc 4.7.x"

	config BR2_GCC_VERSION_SNAP
		depends on !BR2_avr32 && !BR2_sparc_sparchfleon && !BR2_sparc_sparchfleonv8 && !BR2_sparc_sparcsfleon && !BR2_sparc_sparcsfleonv8
		bool "gcc snapshot"
endchoice

config BR2_GCC_SUPPORTS_FINEGRAINEDMTUNE
	bool
	default y if !BR2_GCC_VERSION_4_2_2_AVR32_2_1_5

config BR2_GCC_SNAP_DATE
	string "GCC snapshot date"
	default "4.8-20120429"
	depends on BR2_GCC_VERSION_SNAP
	help
	  Enter snapshot date to use for gcc.
	  Format is: A.B-YYYYMMDD

	  A is GCC major version, for example 4.
	  B is GCC minor version, for example 7.
	  YYYYMMDD is snapshot date, for example 20110430.

	  This way we'd get version 4.7-20110430

config BR2_GCC_VERSION
	string
	default "4.2.2-avr32-2.1.5" if BR2_GCC_VERSION_4_2_2_AVR32_2_1_5
	default "4.3.6"     if BR2_GCC_VERSION_4_3_X
	default "4.4.7"     if BR2_GCC_VERSION_4_4_X
	default "4.5.4"     if BR2_GCC_VERSION_4_5_X
	default "4.6.3"     if BR2_GCC_VERSION_4_6_X
	default "4.7.1"     if BR2_GCC_VERSION_4_7_X
	default $BR2_GCC_SNAP_DATE if BR2_GCC_VERSION_SNAP

config BR2_EXTRA_GCC_CONFIG_OPTIONS
	string "Additional gcc options"
	default ""
	help
	  Any additional gcc configure options you may want to include....

config BR2_INSTALL_OBJC
	bool "Build/install Objective-C compiler and runtime?"
	depends on !BR2_avr32
	help
	  Build/install Objective-C compiler and runtime?

config BR2_INSTALL_FORTRAN
	bool "Build/install Fortran compiler and runtime?"
	depends on !BR2_avr32
	select BR2_PACKAGE_LIBMPFR
	help
	  Build/install Fortran compiler and runtime?
	  Note that it is highly recommended NOT to use gfortran
	  from gcc older than 4.2.0

config BR2_GCC_SHARED_LIBGCC
	bool "Build/install a shared libgcc?"
	depends on !BR2_PREFER_STATIC_LIB
	default y
	depends on !BR2_sparc
	help
	  Build/install a shared libgcc library

config BR2_GCC_ENABLE_TLS
	bool "Enable compiler tls support"
	default y
	depends on BR2_PTHREADS_NATIVE
	help
	  Enable the compiler to generate code for accessing
	  thread local storage variables

config BR2_GCC_ENABLE_OPENMP
	bool "Enable compiler OpenMP support"
	depends on !BR2_PTHREADS_NONE && !BR2_avr32
	help
	  Enable OpenMP support for the compiler
```

## toolchain/gdb/Config.in
```kconfig
comment "Gdb Options"

config BR2_PACKAGE_GDB
	bool "Build gdb debugger for the Target"
	select BR2_PACKAGE_NCURSES
	depends on BR2_USE_WCHAR
	depends on BR2_TOOLCHAIN_HAS_THREADS
	depends on !BR2_sh && !BR2_sh64 && !BR2_avr32
	help
	    Build the full gdb debugger to run on the target.

comment "Gdb debugger for the target needs WCHAR support in toolchain"
	depends on !BR2_USE_WCHAR

config BR2_PACKAGE_GDB_SERVER
	bool "Build gdb server for the Target"
	depends on !BR2_TOOLCHAIN_EXTERNAL
	help
	    Build the gdbserver stub to run on the target.
	    A full gdb is needed to debug the progam.

config BR2_TOOLCHAIN_EXTERNAL_GDB_SERVER_COPY
	bool "Copy gdb server to the Target"
	depends on BR2_TOOLCHAIN_EXTERNAL
	help
	  Copy the gdbserver provided by the external toolchain to the
	  target.

config BR2_PACKAGE_GDB_HOST
	bool "Build gdb for the Host"
	# cross-gdb is supposed to be part of the external
	# toolchain. And the build currently fails.
	depends on !BR2_TOOLCHAIN_EXTERNAL
	help
	    Build gdb to run on the host to debug programs run on the target.

choice
	prompt "GDB debugger Version"
	default BR2_GDB_VERSION_6_6 if BR2_bfin
	default BR2_GDB_VERSION_6_7_1_AVR32_2_1_5 if BR2_avr32
	default BR2_GDB_VERSION_7_4
	depends on BR2_PACKAGE_GDB || BR2_PACKAGE_GDB_SERVER || BR2_PACKAGE_GDB_HOST
	help
	  Select the version of gdb you wish to use.

	config BR2_GDB_VERSION_6_6
		bool "gdb 6.6"
		depends on BR2_bfin

	config BR2_GDB_VERSION_6_7_1_AVR32_2_1_5
		depends on BR2_avr32
		bool "gdb 6.7.1-avr32-2.1.5"

	config BR2_GDB_VERSION_6_8
		bool "gdb 6.8"
		depends on !(BR2_avr32 || BR2_bfin)
		depends on BR2_DEPRECATED

	config BR2_GDB_VERSION_7_0_1
		bool "gdb 7.0.1"
		depends on !BR2_bfin
		depends on BR2_DEPRECATED
		depends on BR2_TOOLCHAIN_HAS_THREADS_DEBUG_IF_NEEDED
		select BR2_PTHREAD_DEBUG if (BR2_TOOLCHAIN_BUILDROOT && !BR2_PTHREADS_NONE)

	config BR2_GDB_VERSION_7_1
		bool "gdb 7.1"
		depends on !BR2_bfin
		depends on BR2_DEPRECATED
		depends on BR2_TOOLCHAIN_HAS_THREADS_DEBUG_IF_NEEDED
		select BR2_PTHREAD_DEBUG if (BR2_TOOLCHAIN_BUILDROOT && !BR2_PTHREADS_NONE)

	config BR2_GDB_VERSION_7_2
		bool "gdb 7.2.x"
		depends on !BR2_bfin
		depends on BR2_TOOLCHAIN_HAS_THREADS_DEBUG_IF_NEEDED
		select BR2_PTHREAD_DEBUG if (BR2_TOOLCHAIN_BUILDROOT && !BR2_PTHREADS_NONE)

	config BR2_GDB_VERSION_7_3
		bool "gdb 7.3.x"
		depends on !BR2_bfin
		depends on BR2_TOOLCHAIN_HAS_THREADS_DEBUG_IF_NEEDED
		select BR2_PTHREAD_DEBUG if (BR2_TOOLCHAIN_BUILDROOT && !BR2_PTHREADS_NONE)

	config BR2_GDB_VERSION_7_4
		bool "gdb 7.4.x"
		depends on !BR2_bfin
		depends on BR2_TOOLCHAIN_HAS_THREADS_DEBUG_IF_NEEDED
		select BR2_PTHREAD_DEBUG if (BR2_TOOLCHAIN_BUILDROOT && !BR2_PTHREADS_NONE)

endchoice

comment "gdb 7.x support needs pthread debug support in toolchain"
	depends on BR2_PACKAGE_GDB || BR2_PACKAGE_GDB_SERVER || BR2_PACKAGE_GDB_HOST
	depends on !BR2_TOOLCHAIN_HAS_THREADS_DEBUG_IF_NEEDED

config BR2_GDB_VERSION
	string
	default "6.6a"     if BR2_GDB_VERSION_6_6
	default "6.7.1-avr32-2.1.5" if BR2_GDB_VERSION_6_7_1_AVR32_2_1_5
	default "6.8a"     if BR2_GDB_VERSION_6_8
	default "7.0.1a"   if BR2_GDB_VERSION_7_0_1
	default "7.1a"     if BR2_GDB_VERSION_7_1
	default "7.2a"     if BR2_GDB_VERSION_7_2
	default "7.3.1"    if BR2_GDB_VERSION_7_3
	default "7.4.1"    if BR2_GDB_VERSION_7_4
```
