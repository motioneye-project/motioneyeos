## toolchain/kernel-headers/Config.in
```kconfig
# Choose the kernel headers to use for kernel-headers target. This is
# ignored if you are building your own kernel or using the system kernel.
#

comment "Kernel Header Options"

choice
	prompt "Kernel Headers"
	default BR2_KERNEL_HEADERS_3_4
	help
	  Select the version of kernel header files you wish to use.
	  You must select the correct set of header files to match
	  the kernel you intend to use on your target system.

	  For the snapshot, you have to provide the
	  linux-2.6.tar.bz2 tarball in your download dir.

	config BR2_KERNEL_HEADERS_2_6_36
		bool "Linux 2.6.36.x kernel headers"
		depends on BR2_DEPRECATED

	config BR2_KERNEL_HEADERS_2_6_37
		bool "Linux 2.6.37.x kernel headers"
		depends on BR2_DEPRECATED

	config BR2_KERNEL_HEADERS_2_6_38
		bool "Linux 2.6.38.x kernel headers"

	config BR2_KERNEL_HEADERS_2_6_39
		bool "Linux 2.6.39.x kernel headers"

	config BR2_KERNEL_HEADERS_3_0
		bool "Linux 3.0.x kernel headers"

	config BR2_KERNEL_HEADERS_3_1
		bool "Linux 3.1.x kernel headers"

	config BR2_KERNEL_HEADERS_3_2
		bool "Linux 3.2.x kernel headers"

	config BR2_KERNEL_HEADERS_3_3
		bool "Linux 3.3.x kernel headers"

	config BR2_KERNEL_HEADERS_3_4
		bool "Linux 3.4.x kernel headers"

	config BR2_KERNEL_HEADERS_VERSION
		bool "Linux 2.6 (manually specified version)"

	config BR2_KERNEL_HEADERS_SNAP
		bool "Local Linux snapshot (linux-2.6.tar.bz2)"
endchoice

config BR2_DEFAULT_KERNEL_VERSION
	string "linux version"
	depends on BR2_KERNEL_HEADERS_VERSION
	help
	  Specify the version you want to use.
	  E.G.: 2.6.38

config BR2_DEFAULT_KERNEL_HEADERS
	string
	default "2.6.36.4"	if BR2_KERNEL_HEADERS_2_6_36
	default "2.6.37.6"	if BR2_KERNEL_HEADERS_2_6_37
	default "2.6.38.8"	if BR2_KERNEL_HEADERS_2_6_38
	default "2.6.39.4"	if BR2_KERNEL_HEADERS_2_6_39
	default "3.0.40"	if BR2_KERNEL_HEADERS_3_0
	default "3.1.10"	if BR2_KERNEL_HEADERS_3_1
	default "3.2.26"	if BR2_KERNEL_HEADERS_3_2
	default "3.3.8"		if BR2_KERNEL_HEADERS_3_3
	default "3.4.8"		if BR2_KERNEL_HEADERS_3_4
	default "2.6"		if BR2_KERNEL_HEADERS_SNAP
	default $BR2_DEFAULT_KERNEL_VERSION if BR2_KERNEL_HEADERS_VERSION
```

## toolchain/mklibs/Config.in
```kconfig
config BR2_MKLIBS
	bool "Run mklibs on the built root filesystem"
	default n
	help
	  Recompiles all the shared libraries to only include the
	  symbols actually needed to run the binaries on the target
```

## toolchain/sstrip/Config.in
```kconfig
config BR2_PACKAGE_SSTRIP_TARGET
	bool "sstrip for the target system."
	default n
	help
	  Maximal 'strip'ing utility.

config BR2_PACKAGE_SSTRIP_HOST
	bool "sstrip for the host/build system."
	default n
	help
	  Maximal 'strip'ing utility.
```

## toolchain/toolchain-buildroot/Config.in
```kconfig
# Config entries for internal toolchain backend

if BR2_TOOLCHAIN_BUILDROOT

comment "Toolchain Buildroot Options"

config BR2_TOOLCHAIN_BUILDROOT_VENDOR
	string "custom toolchain vendor name"
	default "buildroot"
	help
	  This option allows to customize the "vendor" part of the
	  toolchain tuple, where the toolchain tuple has the form
	  <arch>-<vendor>-<os>-<libc>. The default value, "buildroot",
	  is fine for most cases, except in very specific situations
	  where gcc might make different decisions based on the vendor
	  part of the tuple. The value "unknown" is not allowed, as the
	  cross-compiling toolchain might then be confused with the
	  native toolchain when the target and host architecture are
	  identical. The value can not be empty either.

	  If you're not sure, just leave the default "buildroot" value.

choice
	prompt "C library"
	default BR2_TOOLCHAIN_UCLIBC
	default BR2_TOOLCHAIN_BUILDROOT_GLIBC if BR2_powerpc64

config BR2_TOOLCHAIN_BUILDROOT_UCLIBC
	bool "uClibc-ng"
	select BR2_TOOLCHAIN_USES_UCLIBC
	depends on BR2_aarch64 || BR2_aarch64_be || BR2_arcle   || BR2_arceb  || \
		   BR2_arm     || BR2_armeb    || \
		   BR2_bfin    || BR2_i386   || BR2_m68k   || BR2_microblaze || \
		   BR2_mips    || BR2_mipsel || BR2_mips64 || BR2_mips64el || \
		   BR2_or1k    || BR2_powerpc || BR2_sh2a   || BR2_sh4	   || \
		   BR2_sh4eb   || BR2_sparc   || BR2_xtensa || BR2_x86_64
	help
	  This option selects uClibc-ng as the C library for the
	  cross-compilation toolchain.

	  http://uclibc-ng.org

config BR2_TOOLCHAIN_BUILDROOT_GLIBC
	bool "glibc"
	depends on BR2_arm         || BR2_armeb      || BR2_aarch64 || \
		   BR2_aarch64_be  || BR2_i386       || BR2_mips    || \
		   BR2_mipsel      || BR2_mips64     || BR2_mips64el|| \
		   BR2_powerpc     || BR2_powerpc64  || BR2_powerpc64le || \
		   BR2_sh          || BR2_sparc64    || BR2_x86_64 || \
		   BR2_microblaze  || BR2_nios2      || BR2_archs38
	depends on BR2_USE_MMU
	depends on !BR2_STATIC_LIBS
	depends on BR2_TOOLCHAIN_HEADERS_AT_LEAST_3_2
	depends on BR2_TOOLCHAIN_HEADERS_AT_LEAST_3_10 || !BR2_powerpc64le
	depends on BR2_TOOLCHAIN_HEADERS_AT_LEAST_4_5 || !BR2_MIPS_NAN_2008
	depends on !BR2_powerpc_SPE
	select BR2_TOOLCHAIN_USES_GLIBC
	# our glibc.mk enables RPC support
	select BR2_TOOLCHAIN_HAS_NATIVE_RPC
	help
	  This option selects glibc as the C library for the
	  cross-compilation toolchain.

	  http://www.gnu.org/software/libc/

comment "glibc needs a toolchain w/ dynamic library, kernel headers >= 3.2"
	depends on BR2_USE_MMU
	depends on BR2_STATIC_LIBS || !BR2_TOOLCHAIN_HEADERS_AT_LEAST_3_2

# glibc >= 2.26 require kernel headers >= 3.10 on powerpc64le.
comment "glibc on powerpc64le needs a toolchain w/ headers >= 3.10"
	depends on BR2_powerpc64le
	depends on !BR2_TOOLCHAIN_HEADERS_AT_LEAST_3_10

# Support for MIPS NAN2008 needs headers >= 4.5
comment "glibc on MIPS w/ NAN2008 needs a toolchain w/ headers >= 4.5"
	depends on BR2_MIPS_NAN_2008
	depends on !BR2_TOOLCHAIN_HEADERS_AT_LEAST_4_5

config BR2_TOOLCHAIN_BUILDROOT_MUSL
	bool "musl"
	depends on BR2_aarch64	   || BR2_arm   || BR2_armeb   || BR2_i386 || \
		   BR2_microblaze  || BR2_mips  || BR2_mipsel  || BR2_mips64 || \
		   BR2_mips64el    || BR2_or1k  || BR2_powerpc || BR2_powerpc64 || \
		   BR2_powerpc64le || BR2_sh    || BR2_x86_64
	depends on !BR2_powerpc_SPE # not supported, build breaks
	# sh2 nommu is supported by musl, but we don't have support
	# for it in Buildroot.
	depends on BR2_USE_MMU
	select BR2_TOOLCHAIN_USES_MUSL
	help
	  This option selects musl as the C library for the
	  cross-compilation toolchain.

endchoice

config BR2_TOOLCHAIN_BUILDROOT_LIBC
	string
	default "uclibc" if BR2_TOOLCHAIN_BUILDROOT_UCLIBC
	default "glibc"  if BR2_TOOLCHAIN_BUILDROOT_GLIBC
	default "musl"	 if BR2_TOOLCHAIN_BUILDROOT_MUSL

source "package/linux-headers/Config.in.host"
source "package/linux-headers/Config.in"
source "package/musl/Config.in"
source "package/uclibc/Config.in"
source "package/glibc/Config.in"
source "package/binutils/Config.in.host"
source "package/gcc/Config.in.host"
source "package/elf2flt/Config.in.host"
endif
```

## toolchain/toolchain-crosstool-ng/Config.in
```kconfig
# Selection options for crosstool-NG

if BR2_TOOLCHAIN_CTNG

choice
 	prompt "Crosstool-NG C library"

config BR2_TOOLCHAIN_CTNG_uClibc
	bool "uClibc"
	select BR2_TOOLCHAIN_USES_UCLIBC

# Although eglibc can be configured to opt-out some features,
# let's not deal with that for the time being, it's complex...
config BR2_TOOLCHAIN_CTNG_eglibc
	bool "eglibc"
	# Our default ct-ng configuration uses eglibc 2.12, which has
	# native RPC support
	select BR2_TOOLCHAIN_HAS_NATIVE_RPC
	select BR2_TOOLCHAIN_USES_GLIBC

config BR2_TOOLCHAIN_CTNG_glibc
	bool "glibc"
	# Our default ct-ng configuration uses glibc 2.14.1, which
	# does not have native RPC support
	select BR2_TOOLCHAIN_USES_GLIBC

endchoice # C library

config BR2_TOOLCHAIN_CTNG_LIBC
	string
	default "uClibc"	if BR2_TOOLCHAIN_CTNG_uClibc
	default "eglibc"	if BR2_TOOLCHAIN_CTNG_eglibc
	default "glibc"		if BR2_TOOLCHAIN_CTNG_glibc

config BR2_TOOLCHAIN_CTNG_CONFIG
	string "crosstool-NG configuration file to use"
	default "toolchain/toolchain-crosstool-ng/crosstool-ng.config-uClibc" if BR2_TOOLCHAIN_CTNG_uClibc
	default "toolchain/toolchain-crosstool-ng/crosstool-ng.config-eglibc" if BR2_TOOLCHAIN_CTNG_eglibc
	default "toolchain/toolchain-crosstool-ng/crosstool-ng.config-glibc"  if BR2_TOOLCHAIN_CTNG_glibc
	help
	  Enter here the path to the crosstool-NG .config file to use.
	  
	  Generally, the default crosstool-NG configuration files bundled with
	  Buildroot work fine in most situations. Use 'make ctng-menuconfig'
	  from the command line, for expert customization of your toolchain.
	  
	  If unsure, keep the default value.

if BR2_TOOLCHAIN_CTNG_uClibc

comment "Toolchain Options"

config BR2_TOOLCHAIN_CTNG_uClibc_LARGEFILE
	bool "Enable large file (files > 2 GB) support"
	select BR2_LARGEFILE
	help
	  Enable this option if you want your toolchain to support
	  files bigger than 2 GB.

config BR2_TOOLCHAIN_CTNG_uClibc_INET_IPV6
	bool "Enable IPv6 support"
	select BR2_INET_IPV6
	help
	  Enable this option if you want your toolchain to support
	  IPv6.

config BR2_TOOLCHAIN_CTNG_uClibc_INET_RPC
	bool "Enable RPC support"
	select BR2_TOOLCHAIN_HAS_NATIVE_RPC
	help
	  Enable this option if you want your toolchain to support
	  RPC (needed for NFS, for example).

config BR2_TOOLCHAIN_CTNG_uClibc_WCHAR
	bool "Enable WCHAR support"
	select BR2_USE_WCHAR
	help
	  Enable this option if you want your toolchain to support
	  wide characters (i.e characters longer than 8 bits, needed
	  for locale support).

config BR2_TOOLCHAIN_CTNG_uClibc_LOCALE
	bool "Enable toolchain locale/i18n support"
	select BR2_TOOLCHAIN_CTNG_uClibc_WCHAR
	select BR2_ENABLE_LOCALE
	help
	  Enable this option if you want your toolchain to support
	  localization and internationalization.

endif # BR2_TOOLCHAIN_CTNG_uClibc

config BR2_TOOLCHAIN_CTNG_CXX
	bool "Enable C++ support"
	select BR2_INSTALL_LIBSTDCPP
	help
	  Enable this option if you want your toolchain to support the
	  C++ language and you want C++ libraries to be installed on
	  your target system.

choice
	prompt "Thread library implementation"
	default BR2_TOOLCHAIN_CTNG_THREADS_NPTL
	help
	  Enable thread support and select thread implementation. With
	  glibc, thread support is mandatory but several
	  implementations are available. With uClibc, thread support
	  is optional, and when enabled, several implementations are
	  available. However, not all thread variants work with all
	  versions of uClibc for all architectures, the "linuxthreads
	  (stable/old)" may be a working fallback.

	config BR2_TOOLCHAIN_CTNG_THREADS_NONE
		bool "none"
		depends on BR2_TOOLCHAIN_CTNG_uClibc

	config BR2_TOOLCHAIN_CTNG_THREADS_PTHREADS
		bool "linuxthreads"
		select BR2_TOOLCHAIN_HAS_THREADS
		select BR2_TOOLCHAIN_HAS_THREADS_DEBUG

	config BR2_TOOLCHAIN_CTNG_THREADS_PTHREADS_OLD
		bool "linuxthreads (stable/old)"
		select BR2_TOOLCHAIN_HAS_THREADS
		select BR2_TOOLCHAIN_HAS_THREADS_DEBUG
		depends on BR2_TOOLCHAIN_CTNG_uClibc

	config BR2_TOOLCHAIN_CTNG_THREADS_NPTL
		bool "Native POSIX Threading (NPTL)"
		select BR2_TOOLCHAIN_HAS_THREADS
		select BR2_TOOLCHAIN_HAS_THREADS_DEBUG
endchoice

endif # BR2_TOOLCHAIN_CTNG
```
