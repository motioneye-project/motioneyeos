## toolchain/toolchain-external/toolchain-external-codesourcery-arm/Config.in
```kconfig
config BR2_TOOLCHAIN_EXTERNAL_CODESOURCERY_ARM
	bool "Sourcery CodeBench ARM 2014.05"
	depends on BR2_arm
	depends on !BR2_ARCH_NEEDS_GCC_AT_LEAST_4_9
	depends on BR2_HOSTARCH = "x86_64" || BR2_HOSTARCH = "x86"
	depends on BR2_ARM_EABI
	# Unsupported ARM cores
	depends on !BR2_cortex_a12 && !BR2_cortex_a17 && !BR2_ARM_CPU_ARMV8A
	depends on !BR2_STATIC_LIBS
	select BR2_TOOLCHAIN_EXTERNAL_GLIBC
	select BR2_TOOLCHAIN_HAS_SSP
	select BR2_TOOLCHAIN_HAS_NATIVE_RPC
	select BR2_INSTALL_LIBSTDCPP
	select BR2_HOSTARCH_NEEDS_IA32_LIBS
	select BR2_TOOLCHAIN_HEADERS_AT_LEAST_3_13
	select BR2_TOOLCHAIN_GCC_AT_LEAST_4_8
	help
	  Sourcery CodeBench toolchain for the ARM architecture, from
	  Mentor Graphics. It uses gcc 4.8.3, binutils 2.24.51, glibc
	  2.18 and gdb 7.7.50, kernel headers 3.13. It has support
	  for the following variants:
	    - ARMv5TE, little endian, soft-float, glibc
	      Select ARM926T, ARM10T, XScale or another ARMv5 core
	      Select BR2_SOFT_FLOAT
	    - ARMv4T, little endian, soft-float, glibc
	      Select ARM720T, ARM920T, ARM922T or another ARMv4 core
	      Select BR2_SOFT_FLOAT
	    - ARMv7-A, Thumb 2, little endian, soft-float, glibc
	      Select Cortex-A8, Cortex-A9 or another ARMv7-A core
	      Select BR2_SOFT_FLOAT
	      Set BR2_TARGET_OPTIMIZATION to -mthumb

comment "Sourcery CodeBench toolchains available for the EABI ABI"
	depends on BR2_arm
	depends on !BR2_ARCH_NEEDS_GCC_AT_LEAST_4_9
	depends on !BR2_ARM_EABI
	depends on !BR2_STATIC_LIBS
```

## toolchain/toolchain-external/toolchain-external-codesourcery-mips/Config.in
```kconfig
config BR2_TOOLCHAIN_EXTERNAL_CODESOURCERY_MIPS
	bool "Sourcery CodeBench MIPS 2016.05"
	depends on BR2_mips || BR2_mipsel || BR2_mips64 || BR2_mips64el
	depends on BR2_MIPS_CPU_MIPS32R2 || BR2_MIPS_CPU_MIPS64R2
	depends on !BR2_ARCH_NEEDS_GCC_AT_LEAST_6
	# Unsupported MIPS cores
	depends on !BR2_mips_interaptiv
	depends on BR2_HOSTARCH = "x86_64" || BR2_HOSTARCH = "x86"
	depends on !BR2_MIPS_NABI32
	depends on !BR2_STATIC_LIBS
	select BR2_TOOLCHAIN_EXTERNAL_GLIBC
	select BR2_TOOLCHAIN_HAS_SSP
	select BR2_TOOLCHAIN_HAS_NATIVE_RPC
	select BR2_TOOLCHAIN_HAS_OPENMP
	select BR2_INSTALL_LIBSTDCPP
	select BR2_HOSTARCH_NEEDS_IA32_LIBS
	select BR2_TOOLCHAIN_HEADERS_AT_LEAST_4_4
	select BR2_TOOLCHAIN_GCC_AT_LEAST_5
	help
	  Sourcery CodeBench toolchain for the MIPS architecture, from
	  Mentor Graphics. It uses gcc 5.3, binutils 2.25.51, glibc
	  2.23, uClibc 0.9.30 and gdb 7.10.50, kernel headers 4.4.1. It
	  has support for the following variants:
	    - MIPS32r2 - Big-Endian, 2008 NaN, O32
	      Select MIPS (big endian) core
	      Disable BR2_SOFT_FLOAT
	      Set BR2_TARGET_OPTIMIZATION to -mnan=2008
	    - MIPS32r2 - Big-Endian, O32
	      Select MIPS (big endian) core
	      Disable BR2_SOFT_FLOAT
	    - MIPS32r2 - Big-Endian, O32, MIPS16
	      Select MIPS (big endian) core
	      Disable BR2_SOFT_FLOAT
	      Set BR2_TARGET_OPTIMIZATION to -mips16
	    - MIPS32r2 - Big-Endian, Soft-Float, O32
	      Select MIPS (big endian) core
	      Select BR2_SOFT_FLOAT
	    - MIPS32r2 - Big-Endian, Soft-Float, O32, MIPS16
	      Select MIPS (big endian) core
	      Select BR2_SOFT_FLOAT
	      Set BR2_TARGET_OPTIMIZATION to -mips16
	    - MIPS32r2 - Little-Endian, 2008 NaN, O32
	      Select MIPS (little endian) core
	      Disable BR2_SOFT_FLOAT
	      Set BR2_TARGET_OPTIMIZATION to -mnan=2008
	    - MIPS32r2 - Little-Endian, O32
	      Select MIPS (little endian) core
	      Disable BR2_SOFT_FLOAT
	    - MIPS32r2 - Little-Endian, O32, MIPS16
	      Select MIPS (little endian) core
	      Disable BR2_SOFT_FLOAT
	      Set BR2_TARGET_OPTIMIZATION to -mips16
	    - MIPS32r2 - Little-Endian, Soft-Float, O32
	      Select MIPS (little endian) core
	      Select BR2_SOFT_FLOAT
	    - MIPS32r2 - Little-Endian, Soft-Float, O32, MIPS16
	      Select MIPS (little endian) core
	      Select BR2_SOFT_FLOAT
	      Set BR2_TARGET_OPTIMIZATION to -mips16
	    - MIPS32r2 - Little-Endian, Soft-Float, O32, microMIPS
	      Select MIPS (little endian) core
	      Select BR2_SOFT_FLOAT
	      Set BR2_TARGET_OPTIMIZATION to -mmicromips
	    - MIPS32r2 - uClibc, Big-Endian, 2008 NaN, O32
	      Not usable in Buildroot yet.
	    - MIPS32r2 - uClibc, Big-Endian, O32
	      Not usable in Buildroot yet.
	    - MIPS32r2 - uClibc, Big-Endian, Soft-Float, O32
	      Not usable in Buildroot yet.
	    - MIPS32r2 - uClibc, Little-Endian, 2008 NaN, O32
	      Not usable in Buildroot yet.
	    - MIPS32r2 - uClibc, Little-Endian, O32
	      Not usable in Buildroot yet.
	    - MIPS32r2 - uClibc, Little-Endian, Soft-Float, O32
	      Not usable in Buildroot yet.
	    - MIPS64r2 - Big-Endian, N64
	      Select MIPS64 (big endian) core
	      Select the n64 ABI
	      Disable BR2_SOFT_FLOAT
	    - MIPS64r2 - Big-Endian, Soft-Float, N64
	      Select MIPS64 (big endian) core
	      Select the n64 ABI
	      Select BR2_SOFT_FLOAT
	    - MIPS64r2 - Little-Endian, N64
	      Select MIPS64 (little endian) core
	      Select the n64 ABI
	      Disable BR2_SOFT_FLOAT
	    - MIPS64r2 - Little-Endian, Soft-Float, N64
	      Select MIPS64 (little endian) core
	      Select the n64 ABI
	      Select BR2_SOFT_FLOAT

comment "Sourcery CodeBench toolchains are only available for MIPS/MIPS64 o32 and n64"
	depends on !BR2_ARCH_NEEDS_GCC_AT_LEAST_6
	depends on BR2_MIPS_NABI32
	depends on !BR2_STATIC_LIBS
```

## toolchain/toolchain-external/toolchain-external-codesourcery-niosII/Config.in
```kconfig
config BR2_TOOLCHAIN_EXTERNAL_CODESOURCERY_NIOSII
	bool "Sourcery CodeBench Nios-II 2018.05"
	depends on BR2_nios2
	depends on !BR2_ARCH_NEEDS_GCC_AT_LEAST_8
	depends on BR2_HOSTARCH = "x86_64" || BR2_HOSTARCH = "x86"
	depends on !BR2_STATIC_LIBS
	select BR2_TOOLCHAIN_EXTERNAL_GLIBC
	select BR2_TOOLCHAIN_HAS_SSP
	select BR2_TOOLCHAIN_HAS_NATIVE_RPC
	select BR2_INSTALL_LIBSTDCPP
	select BR2_HOSTARCH_NEEDS_IA32_LIBS
	select BR2_TOOLCHAIN_HEADERS_AT_LEAST_4_15
	select BR2_TOOLCHAIN_GCC_AT_LEAST_7
	help
	  Sourcery CodeBench toolchain for the Nios-II architecture,
	  from Mentor Graphics. It uses gcc 7.3, binutils 2.28,
	  glibc 2.27, gdb 8.0.1 and kernel headers 4.15.5.
```

## toolchain/toolchain-external/toolchain-external-codesourcery-sh/Config.in
```kconfig
config BR2_TOOLCHAIN_EXTERNAL_CODESOURCERY_SH
	bool "Sourcery CodeBench SH 2012.09"
	depends on BR2_sh4a || BR2_sh4aeb
	depends on BR2_HOSTARCH = "x86_64" || BR2_HOSTARCH = "x86"
	depends on !BR2_STATIC_LIBS
	select BR2_TOOLCHAIN_EXTERNAL_GLIBC
	select BR2_TOOLCHAIN_HAS_SSP
	select BR2_TOOLCHAIN_HAS_NATIVE_RPC
	select BR2_INSTALL_LIBSTDCPP
	select BR2_HOSTARCH_NEEDS_IA32_LIBS
	select BR2_TOOLCHAIN_HEADERS_AT_LEAST_3_5
	select BR2_TOOLCHAIN_GCC_AT_LEAST_4_7
	help
	  Sourcery CodeBench toolchain for the SuperH architecture,
	  from Mentor Graphics. It uses gcc 4.7.2, binutils 2.23.51,
	  glibc 2.16, uClibc 0.9.30, gdb 7.4.50 and kernel headers
	  3.5.4. It has support for the following variants:
	    - SH4A, glibc, little endian
	      Default.
	    - SH4A, glibc, big endian
	      Add -mb to BR2_TARGET_OPTIMIZATION
	    - SH4A, uClibc, little endian
	      Not usable in Buildroot yet.
	    - SH4A, uClibc, big endian
	      Not usable in Buildroot yet.
```

## toolchain/toolchain-external/toolchain-external-codesourcery-x86/Config.in
```kconfig
config BR2_TOOLCHAIN_EXTERNAL_CODESOURCERY_X86
	bool "Sourcery CodeBench x86/x86_64 2012.09"
	depends on BR2_i386 || BR2_x86_64
	depends on BR2_HOSTARCH = "x86_64" || BR2_HOSTARCH = "x86"
	depends on !BR2_STATIC_LIBS
	depends on !BR2_x86_jaguar
	depends on !BR2_x86_steamroller
	select BR2_TOOLCHAIN_EXTERNAL_GLIBC
	select BR2_TOOLCHAIN_HAS_SSP
	select BR2_TOOLCHAIN_HAS_NATIVE_RPC
	select BR2_INSTALL_LIBSTDCPP
	select BR2_HOSTARCH_NEEDS_IA32_LIBS
	select BR2_TOOLCHAIN_HEADERS_AT_LEAST_3_5
	select BR2_TOOLCHAIN_GCC_AT_LEAST_4_7
	help
	  Sourcery CodeBench toolchain for the x86/x86_64
	  architectures, from Mentor Graphics. It uses gcc 4.7.2,
	  binutils 2.23.51, glibc 2.16, gdb 7.4.50 and kernel headers
	  3.5.4. It has support for the following variants:
	    - Intel Pentium 4, glibc, 32 bits
	      Default for x86, nothing special to do.
	    - Intel Atom, glibc, 32 bits
	      Select an Atom core
	    - Intel Xeon, glibc, 64 bits
	      Default for x86_64, nothing special to do.
	    - Intel Core 2, glibc, 64 bits
	      Select a Core 2 core
	  Other architecture variants (beyond Pentium-4/Xeon) are
	  supported as well, but glibc is not optimised for it.
```

## toolchain/toolchain-external/toolchain-external-custom/Config.in
```kconfig
config BR2_TOOLCHAIN_EXTERNAL_CUSTOM
	bool "Custom toolchain"
	help
	  Use this option to use a custom toolchain pre-installed on
	  your system.
```

## toolchain/toolchain-external/toolchain-external-linaro-aarch64/Config.in
```kconfig
config BR2_TOOLCHAIN_EXTERNAL_LINARO_AARCH64
	bool "Linaro AArch64 2017.08"
	depends on BR2_aarch64
	depends on BR2_HOSTARCH = "x86_64" || BR2_HOSTARCH = "x86"
	depends on !BR2_STATIC_LIBS
	select BR2_TOOLCHAIN_EXTERNAL_GLIBC
	select BR2_TOOLCHAIN_HAS_SSP
	select BR2_INSTALL_LIBSTDCPP
	select BR2_TOOLCHAIN_HAS_NATIVE_RPC
	select BR2_TOOLCHAIN_HEADERS_AT_LEAST_4_6
	select BR2_TOOLCHAIN_GCC_AT_LEAST_6
	select BR2_TOOLCHAIN_HAS_FORTRAN
	help
	  Toolchain for the AArch64 architecture, from
	  http://www.linaro.org/engineering/armv8/
```

## toolchain/toolchain-external/toolchain-external-linaro-armeb/Config.in
```kconfig
comment "Linaro toolchains available for Cortex-A + EABIhf"
	depends on BR2_armeb
	depends on !BR2_ARM_CPU_ARMV7A || !BR2_ARM_EABIHF
	depends on !BR2_STATIC_LIBS

config BR2_TOOLCHAIN_EXTERNAL_LINARO_ARMEB
	bool "Linaro armeb 2018.05"
	depends on BR2_armeb
	depends on BR2_ARM_CPU_ARMV7A || BR2_ARM_CPU_ARMV8A
	depends on BR2_HOSTARCH = "x86_64" || BR2_HOSTARCH = "x86"
	depends on BR2_ARM_EABIHF
	depends on !BR2_STATIC_LIBS
	select BR2_TOOLCHAIN_EXTERNAL_GLIBC
	select BR2_TOOLCHAIN_HAS_SSP
	select BR2_TOOLCHAIN_HAS_NATIVE_RPC
	select BR2_INSTALL_LIBSTDCPP
	select BR2_TOOLCHAIN_HEADERS_AT_LEAST_4_10
	select BR2_TOOLCHAIN_GCC_AT_LEAST_7
	help
	  Linaro toolchain for the ARM big endian architecture. It
	  uses Linaro GCC 2018.05 (based on gcc 7.3.1), Linaro GDB
	  2018.05 (based on GDB 8.1), glibc 2.25, Binutils 2018.05
	  (based on 2.28). It generates code that runs on all Cortex-A
	  profile devices, but tuned for the Cortex-A9. The code
	  generated is Thumb 2, with the hard floating point calling
	  convention, and uses the VFPv3-D16 FPU instructions.
```

## toolchain/toolchain-external/toolchain-external-musl-cross/Config.in
```kconfig
config BR2_TOOLCHAIN_EXTERNAL_MUSL_CROSS
	bool "Musl 1.1.12 toolchain"
	depends on (BR2_arm && BR2_ARM_EABI && BR2_USE_MMU) || \
		(BR2_arm && BR2_ARM_EABIHF && !BR2_ARM_CPU_ARMV4 && BR2_USE_MMU) || \
		(BR2_armeb && BR2_ARM_EABI && !BR2_ARM_CPU_ARMV7A && BR2_USE_MMU) || \
		BR2_i386 || (BR2_mips && !BR2_SOFT_FLOAT) || \
		BR2_mipsel || (BR2_powerpc && BR2_powerpc_CLASSIC) || \
		BR2_sh4 || BR2_sh4eb || \
		BR2_x86_64
	depends on BR2_HOSTARCH = "x86_64" || BR2_HOSTARCH = "x86"
	# Unsupported MIPS cores
	depends on !BR2_mips_interaptiv && !BR2_mips_m5150
	# Unsupported for MIPS R6
	depends on !BR2_MIPS_CPU_MIPS32R6 && !BR2_MIPS_CPU_MIPS64R6
	select BR2_TOOLCHAIN_EXTERNAL_MUSL
	select BR2_TOOLCHAIN_HAS_SSP
	select BR2_INSTALL_LIBSTDCPP
	select BR2_HOSTARCH_NEEDS_IA32_LIBS
	select BR2_TOOLCHAIN_HEADERS_AT_LEAST_3_12
	select BR2_TOOLCHAIN_GCC_AT_LEAST_5
	help
	  Toolchain based on the Musl C library, provided by the
	  musl-cross project. It uses gcc 5.3, binutils 2.25.1 and
	  musl 1.1.12. It does not have a cross debugger included.

	  The ARM soft-float toolchain is built for ARMv4t, while the
	  ARM hard-float toolchain is built for ARMv5t.
	  The x86 toolchain is built for i486.

	  http://musl.codu.org/
```

## toolchain/toolchain-external/toolchain-external-synopsys-arc/Config.in
```kconfig
config BR2_TOOLCHAIN_EXTERNAL_SYNOPSYS_ARC
	bool "Synopsys ARC 2017.09 toolchain"
	depends on BR2_arc
	depends on !BR2_ARCH_NEEDS_GCC_AT_LEAST_7
	depends on BR2_HOSTARCH = "x86_64"
	select BR2_TOOLCHAIN_EXTERNAL_UCLIBC
	select BR2_INSTALL_LIBSTDCPP
	select BR2_ENABLE_LOCALE
	select BR2_USE_WCHAR
	select BR2_TOOLCHAIN_HAS_THREADS
	select BR2_TOOLCHAIN_HAS_THREADS_NPTL
	select BR2_TOOLCHAIN_HAS_THREADS_DEBUG
	select BR2_TOOLCHAIN_HAS_SSP
	select BR2_TOOLCHAIN_HEADERS_AT_LEAST_4_12
	select BR2_TOOLCHAIN_GCC_AT_LEAST_7
	help
	  Toolchain for the ARC cores, from
	  https://github.com/foss-for-synopsys-dwc-arc-processors/toolchain/releases
```
